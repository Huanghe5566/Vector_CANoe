/*@!Encoding:936*/
includes
{
  #include "crc.cin"
}

variables
{
//  msTimer ABS_ESP_1_2E9_miss_time;
//  msTimer ICM_5_287_miss_time;
//  msTimer TCU_2_300_miss_time;
//  msTimer FCM_5_4DD_miss_time;

  int gGwSpeedFromSysvar;
  int gGwSteerFromSysvar;
  int gGwYawFromSysvar;
  msTimer gGwSyncTimer;

  const int IHU_SW_NOT_ACTIVE = 0;
  const int IHU_SW_ON         = 1;
  const int IHU_SW_OFF        = 2;
  const int IHU_SW_NOT_USED   = 3;

  const int IHU11_EVENT_TX_COUNT = 3;
  const long IHU11_CAN_ID        = 0x4FC;

  const int IHU_SW_IDX_BSD  = 0;
  const int IHU_SW_IDX_DOW  = 1;
  const int IHU_SW_IDX_RCW  = 2;
  const int IHU_SW_IDX_RCTB = 3;
  const int IHU_SW_IDX_RAEB = 4;
  const int IHU_SW_IDX_COUNT = 5;

  int gIhu11IlTxAllow;
  int gLastIhu11SwitchSts[5];
  int gIhu11FromSysvar[5];
  int gIhu11SuppressSysvar[5];
}

void PushGwVehicleSpeedToSignal(float value)
{
  gGwSpeedFromSysvar = 1;
  $CAN1::ABS_ESP_1::ABS_ESP_1_VehicleSpeedVSOSig.phys = value;
}

void PushGwSteeringAngleToSignal(float value)
{
  gGwSteerFromSysvar = 1;
  $CAN1::SAM_1_G::SteeringAngle.phys = value;
}

void PushGwYawRateToSignal(float value)
{
  gGwYawFromSysvar = 1;
  $CAN1::YAS_1::YawRate.phys = value;
}

void ApplyGwSysvarToSignals()
{
  PushGwVehicleSpeedToSignal(@sysvar::GW::VehicleSpeed);
  PushGwSteeringAngleToSignal(@sysvar::GW::SteeringAngle);
  PushGwYawRateToSignal(@sysvar::GW::YawRate);
}

void SyncGwSysvarsFromPanelSignals()
{
  float sigVal;

  if (gGwSpeedFromSysvar)
  {
    gGwSpeedFromSysvar = 0;
  }
  else
  {
    sigVal = $CAN1::ABS_ESP_1::ABS_ESP_1_VehicleSpeedVSOSig.phys;
    if (sigVal != @sysvar::GW::VehicleSpeed)
    {
      @sysvar::GW::VehicleSpeed = sigVal;
    }
  }

  if (gGwSteerFromSysvar)
  {
    gGwSteerFromSysvar = 0;
  }
  else
  {
    sigVal = $CAN1::SAM_1_G::SteeringAngle.phys;
    if (sigVal != @sysvar::GW::SteeringAngle)
    {
      @sysvar::GW::SteeringAngle = sigVal;
    }
  }

  if (gGwYawFromSysvar)
  {
    gGwYawFromSysvar = 0;
  }
  else
  {
    sigVal = $CAN1::YAS_1::YawRate.phys;
    if (sigVal != @sysvar::GW::YawRate)
    {
      @sysvar::GW::YawRate = sigVal;
    }
  }
}

on preStart
{
  set_value_to_valid();
}

on start
{
  int i;

  for (i = 0; i < IHU_SW_IDX_COUNT; i++)
  {
    gLastIhu11SwitchSts[i] = -1;
    gIhu11FromSysvar[i] = 0;
    gIhu11SuppressSysvar[i] = 0;
  }
  gIhu11IlTxAllow = 0;
  setTimerCyclic(gGwSyncTimer, 50);
  ApplyGwSysvarToSignals();
}

on timer gGwSyncTimer
{
  SyncGwSysvarsFromPanelSignals();
  SyncIhu11SwitchesFromPanel();
}

on sysvar_update sysvar::GW::VehicleSpeed
{
  PushGwVehicleSpeedToSignal(@sysvar::GW::VehicleSpeed);
}

on sysvar_update sysvar::GW::SteeringAngle
{
  PushGwSteeringAngleToSignal(@sysvar::GW::SteeringAngle);
}

on sysvar_update sysvar::GW::YawRate
{
  PushGwYawRateToSignal(@sysvar::GW::YawRate);
}

long IsValidIhu11SwitchValue(int value)
{
  if (value >= IHU_SW_NOT_ACTIVE && value <= IHU_SW_NOT_USED)
  {
    return 1;
  }
  return 0;
}

void ArmIhu11IlEventTx()
{
  gIhu11IlTxAllow = IHU11_EVENT_TX_COUNT;
}

void WriteIhu11SwitchToCan(int idx, int value)
{
  if (idx == IHU_SW_IDX_BSD)
  {
    $CAN1::IHU_11::IHU_11_BSDSwitchSts = value;
  }
  else if (idx == IHU_SW_IDX_DOW)
  {
    $CAN1::IHU_11::DVD_SET_DOW = value;
  }
  else if (idx == IHU_SW_IDX_RCW)
  {
    $CAN1::IHU_11::DVD_SET_RCW = value;
  }
  else if (idx == IHU_SW_IDX_RCTB)
  {
    $CAN1::IHU_11::IHU_11_RCTBSwtSet = value;
  }
  else if (idx == IHU_SW_IDX_RAEB)
  {
    $CAN1::IHU_11::IHU_11_RAEBSwtSet = value;
  }
}

int ReadIhu11SwitchFromCan(int idx)
{
  if (idx == IHU_SW_IDX_BSD)
  {
    return $CAN1::IHU_11::IHU_11_BSDSwitchSts;
  }
  else if (idx == IHU_SW_IDX_DOW)
  {
    return $CAN1::IHU_11::DVD_SET_DOW;
  }
  else if (idx == IHU_SW_IDX_RCW)
  {
    return $CAN1::IHU_11::DVD_SET_RCW;
  }
  else if (idx == IHU_SW_IDX_RCTB)
  {
    return $CAN1::IHU_11::IHU_11_RCTBSwtSet;
  }
  else if (idx == IHU_SW_IDX_RAEB)
  {
    return $CAN1::IHU_11::IHU_11_RAEBSwtSet;
  }
  return 0;
}

void SetIhu11SwitchSysvar(int idx, int value)
{
  if (idx == IHU_SW_IDX_BSD)
  {
    @sysvar::Vehicle_Input::EventSwitch::IHU_11_BSDSwitchSts = value;
  }
  else if (idx == IHU_SW_IDX_DOW)
  {
    @sysvar::Vehicle_Input::EventSwitch::DVD_SET_DOW = value;
  }
  else if (idx == IHU_SW_IDX_RCW)
  {
    @sysvar::Vehicle_Input::EventSwitch::DVD_SET_RCW = value;
  }
  else if (idx == IHU_SW_IDX_RCTB)
  {
    @sysvar::Vehicle_Input::EventSwitch::IHU_11_RCTBSwtSet = value;
  }
  else if (idx == IHU_SW_IDX_RAEB)
  {
    @sysvar::Vehicle_Input::EventSwitch::IHU_11_RAEBSwtSet = value;
  }
}

int GetIhu11SwitchSysvar(int idx)
{
  if (idx == IHU_SW_IDX_BSD)
  {
    return @sysvar::Vehicle_Input::EventSwitch::IHU_11_BSDSwitchSts;
  }
  else if (idx == IHU_SW_IDX_DOW)
  {
    return @sysvar::Vehicle_Input::EventSwitch::DVD_SET_DOW;
  }
  else if (idx == IHU_SW_IDX_RCW)
  {
    return @sysvar::Vehicle_Input::EventSwitch::DVD_SET_RCW;
  }
  else if (idx == IHU_SW_IDX_RCTB)
  {
    return @sysvar::Vehicle_Input::EventSwitch::IHU_11_RCTBSwtSet;
  }
  else if (idx == IHU_SW_IDX_RAEB)
  {
    return @sysvar::Vehicle_Input::EventSwitch::IHU_11_RAEBSwtSet;
  }
  return 0;
}

void TriggerIhu11SwitchEvent(int idx, int value, int forceRetrigger)
{
  if (!IsValidIhu11SwitchValue(value))
  {
    writelineex(0, 2, "IHU_11 switch[%d] invalid value %d", idx, value);
    return;
  }

  gIhu11FromSysvar[idx] = 1;
  if (forceRetrigger && (ReadIhu11SwitchFromCan(idx) == value))
  {
    WriteIhu11SwitchToCan(idx, IHU_SW_NOT_ACTIVE);
  }
  WriteIhu11SwitchToCan(idx, value);
  gLastIhu11SwitchSts[idx] = value;
  ArmIhu11IlEventTx();
  writelineex(0, 1, "IHU_11 switch[%d]=%d, IL allow=%d", idx, value, IHU11_EVENT_TX_COUNT);
}

void SyncIhu11SwitchesFromPanel()
{
  int i;
  int sigVal;

  for (i = 0; i < IHU_SW_IDX_COUNT; i++)
  {
    if (gIhu11FromSysvar[i])
    {
      gIhu11FromSysvar[i] = 0;
    }
    else
    {
      sigVal = ReadIhu11SwitchFromCan(i);
      if (sigVal != gLastIhu11SwitchSts[i])
      {
        gLastIhu11SwitchSts[i] = sigVal;
        gIhu11SuppressSysvar[i] = 1;
        SetIhu11SwitchSysvar(i, sigVal);
        gIhu11SuppressSysvar[i] = 0;
        ArmIhu11IlEventTx();
      }
      else if (sigVal != GetIhu11SwitchSysvar(i))
      {
        gIhu11SuppressSysvar[i] = 1;
        SetIhu11SwitchSysvar(i, sigVal);
        gIhu11SuppressSysvar[i] = 0;
      }
    }
  }
}

on sysvar_update sysvar::Vehicle_Input::EventSwitch::IHU_11_BSDSwitchSts
{
  if (!gIhu11SuppressSysvar[IHU_SW_IDX_BSD])
  {
    TriggerIhu11SwitchEvent(IHU_SW_IDX_BSD, @sysvar::Vehicle_Input::EventSwitch::IHU_11_BSDSwitchSts, 0);
  }
}

on sysvar_update sysvar::Vehicle_Input::EventSwitch::IHU_11_BSDSwitchSts_Fire
{
  if (@sysvar::Vehicle_Input::EventSwitch::IHU_11_BSDSwitchSts_Fire == 1)
  {
    TriggerIhu11SwitchEvent(IHU_SW_IDX_BSD, @sysvar::Vehicle_Input::EventSwitch::IHU_11_BSDSwitchSts, 1);
    @sysvar::Vehicle_Input::EventSwitch::IHU_11_BSDSwitchSts_Fire = 0;
  }
}

on sysvar_update sysvar::Vehicle_Input::EventSwitch::DVD_SET_DOW
{
  if (!gIhu11SuppressSysvar[IHU_SW_IDX_DOW])
  {
    TriggerIhu11SwitchEvent(IHU_SW_IDX_DOW, @sysvar::Vehicle_Input::EventSwitch::DVD_SET_DOW, 0);
  }
}

on sysvar_update sysvar::Vehicle_Input::EventSwitch::DVD_SET_DOW_Fire
{
  if (@sysvar::Vehicle_Input::EventSwitch::DVD_SET_DOW_Fire == 1)
  {
    TriggerIhu11SwitchEvent(IHU_SW_IDX_DOW, @sysvar::Vehicle_Input::EventSwitch::DVD_SET_DOW, 1);
    @sysvar::Vehicle_Input::EventSwitch::DVD_SET_DOW_Fire = 0;
  }
}

on sysvar_update sysvar::Vehicle_Input::EventSwitch::DVD_SET_RCW
{
  if (!gIhu11SuppressSysvar[IHU_SW_IDX_RCW])
  {
    TriggerIhu11SwitchEvent(IHU_SW_IDX_RCW, @sysvar::Vehicle_Input::EventSwitch::DVD_SET_RCW, 0);
  }
}

on sysvar_update sysvar::Vehicle_Input::EventSwitch::DVD_SET_RCW_Fire
{
  if (@sysvar::Vehicle_Input::EventSwitch::DVD_SET_RCW_Fire == 1)
  {
    TriggerIhu11SwitchEvent(IHU_SW_IDX_RCW, @sysvar::Vehicle_Input::EventSwitch::DVD_SET_RCW, 1);
    @sysvar::Vehicle_Input::EventSwitch::DVD_SET_RCW_Fire = 0;
  }
}

on sysvar_update sysvar::Vehicle_Input::EventSwitch::IHU_11_RCTBSwtSet
{
  if (!gIhu11SuppressSysvar[IHU_SW_IDX_RCTB])
  {
    TriggerIhu11SwitchEvent(IHU_SW_IDX_RCTB, @sysvar::Vehicle_Input::EventSwitch::IHU_11_RCTBSwtSet, 0);
  }
}

on sysvar_update sysvar::Vehicle_Input::EventSwitch::IHU_11_RCTBSwtSet_Fire
{
  if (@sysvar::Vehicle_Input::EventSwitch::IHU_11_RCTBSwtSet_Fire == 1)
  {
    TriggerIhu11SwitchEvent(IHU_SW_IDX_RCTB, @sysvar::Vehicle_Input::EventSwitch::IHU_11_RCTBSwtSet, 1);
    @sysvar::Vehicle_Input::EventSwitch::IHU_11_RCTBSwtSet_Fire = 0;
  }
}

on sysvar_update sysvar::Vehicle_Input::EventSwitch::IHU_11_RAEBSwtSet
{
  if (!gIhu11SuppressSysvar[IHU_SW_IDX_RAEB])
  {
    TriggerIhu11SwitchEvent(IHU_SW_IDX_RAEB, @sysvar::Vehicle_Input::EventSwitch::IHU_11_RAEBSwtSet, 0);
  }
}

on sysvar_update sysvar::Vehicle_Input::EventSwitch::IHU_11_RAEBSwtSet_Fire
{
  if (@sysvar::Vehicle_Input::EventSwitch::IHU_11_RAEBSwtSet_Fire == 1)
  {
    TriggerIhu11SwitchEvent(IHU_SW_IDX_RAEB, @sysvar::Vehicle_Input::EventSwitch::IHU_11_RAEBSwtSet, 1);
    @sysvar::Vehicle_Input::EventSwitch::IHU_11_RAEBSwtSet_Fire = 0;
  }
}

on busoff{
  resetCanEx(this.can);
}

// ??????????????
//on sysvar_update sysvar::Vehicle_Input::Node::FCR_GW
//{
//  long node;
//  if (@this == 1)
//  {
//     node = ILControlStop();   // ???????????
//  }
//  else
//  {
//    node = ILControlStart();   // ????????????
//  }
//}
//
//on sysvar_update sysvar::Vehicle_Input::Message_Missing::FCM_5_0x4DD
//{
//  if(@this == 1)
//  {ILFaultInjectionDisableMsg(FCM_5); 
//    setTimer(FCM_5_4DD_miss_time, @sysvar::Vehicle_Input::Message_Missing::FCM_5_0x4DD_MissTime); 
//  }
//  else
//  { ILFaultInjectionEnableMsg(FCM_5);} 
//}
//
//
//on sysvar_update sysvar::Vehicle_Input::Message_Missing::ABS_ESP_1_0x2E9
//{
//  if(@this == 1)
//  {ILFaultInjectionDisableMsg(ABS_ESP_1);
//    setTimer(ABS_ESP_1_2E9_miss_time, @sysvar::Vehicle_Input::Message_Missing::ABS_ESP_1_0x2E9_MissTime);
//  }
//  else
//  { ILFaultInjectionEnableMsg(ABS_ESP_1);} 
//}
//
//on sysvar_update sysvar::Vehicle_Input::Message_Missing::ICM_5_0x287
//{
//  if(@this == 1)
//  {ILFaultInjectionDisableMsg(ICM_5);  
//    setTimer(ICM_5_287_miss_time, @sysvar::Vehicle_Input::Message_Missing::ICM_5_0x287_MissTime);}
//  else
//  { ILFaultInjectionEnableMsg(ICM_5);} 
//}
//
//on sysvar_update sysvar::Vehicle_Input::Message_Missing::TCU_2_0x300
//{
//  if(@this == 1)
//  {ILFaultInjectionDisableMsg(TCU_2);  
//    setTimer(TCU_2_300_miss_time, @sysvar::Vehicle_Input::Message_Missing::TCU_2_0x300_MissTime);}
//  else
//  { ILFaultInjectionEnableMsg(TCU_2);} 
//}
//
//on timer FCM_5_4DD_miss_time
//{
//  @ sysvar::Vehicle_Input::Message_Missing::FCM_5_0x4DD = 0;
//}
//
//on timer ABS_ESP_1_2E9_miss_time
//{
//  @ sysvar::Vehicle_Input::Message_Missing::ABS_ESP_1_0x2E9 = 0;
//}
//
//on timer ICM_5_287_miss_time
//{
//  @ sysvar::Vehicle_Input::Message_Missing::ICM_5_0x287 = 0;
//}
//
//on timer TCU_2_300_miss_time
//{
//  @ sysvar::Vehicle_Input::Message_Missing::TCU_2_0x300 = 0;
//}

// ?????????ID??????????????????
dword applILTxPending (long aId, dword aDlc, byte data[])
{
  dword i;
  byte MSG_RawData[64];
  byte result_crc;
  
  if(aId == 0x300){
    if(@sysvar::Vehicle_Input::CheckSum::TCU_2_Counter == 1)
    {
      int current_counter;
      current_counter++;
    //  write("the current counter is %d",current_counter);
      if(current_counter >= @sysvar::Vehicle_Input::CRC::Message_Counter_times)
      {
        @sysvar::Vehicle_Input::CheckSum::TCU_2_Counter = 0;
        current_counter = 0;
      }
    }
    else {
    data[6] = E2E_Counter1(data,6);  
    } 
    data[7] = @sysvar::Vehicle_Input::CheckSum::TCU_2_CheckSum + checksum_sum_7B(data);
  }
  
    if(aId == 0x2E9){
    if(@sysvar::Vehicle_Input::CheckSum::ABS_EPS_1_Counter == 1)
    {
      int current_counter;
      current_counter++;
    //  write("the current counter is %d",current_counter);
      if(current_counter >= @sysvar::Vehicle_Input::CRC::Message_Counter_times)
      {
        @sysvar::Vehicle_Input::CheckSum::ABS_EPS_1_Counter = 0;
        current_counter = 0;
      }
    }
    else {
    data[7] = E2E_Counter1(data,7);  
    } 
    data[5] = @sysvar::Vehicle_Input::CheckSum::ABS_EPS_1_CheckSum + checksum_sum_5B(data);
  }
    
  if(aId == 0x313){
    if(@sysvar::Vehicle_Input::CheckSum::ABS_EPS_3_Counter == 1)
    {
      int current_counter;
      current_counter++;
    //  write("the current counter is %d",current_counter);
      if(current_counter >= @sysvar::Vehicle_Input::CRC::Message_Counter_times)
      {
        @sysvar::Vehicle_Input::CheckSum::ABS_EPS_3_Counter = 0;
        current_counter = 0;
      }
    }
    else {
    data[6] = E2E_Counter1(data,6);  
    } 
    data[7] = @sysvar::Vehicle_Input::CheckSum::ABS_EPS_3_CheckSum + checksum_sum_7B(data);
  }
    
  if(aId == 0x316){
    if(@sysvar::Vehicle_Input::CheckSum::ABS_EPS_4_Counter == 1)
    {
      int current_counter;
      current_counter++;
    //  write("the current counter is %d",current_counter);
      if(current_counter >= @sysvar::Vehicle_Input::CRC::Message_Counter_times)
      {
        @sysvar::Vehicle_Input::CheckSum::ABS_EPS_4_Counter = 0;
        current_counter = 0;
      }
    }
    else {
    data[6] = E2E_Counter1(data,6);  
    } 
    data[7] = @sysvar::Vehicle_Input::CheckSum::ABS_EPS_4_CheckSum + checksum_sum_7B(data);
  }
   
  if(aId == 0x260){
    if(@sysvar::Vehicle_Input::CheckSum::ABS_EPS_7_Counter == 1)
    {
      int current_counter;
      current_counter++;
    //  write("the current counter is %d",current_counter);
      if(current_counter >= @sysvar::Vehicle_Input::CRC::Message_Counter_times)
      {
        @sysvar::Vehicle_Input::CheckSum::ABS_EPS_7_Counter = 0;
        current_counter = 0;
      }
    }
    else {
    data[6] = E2E_Counter1(data,6);  
    } 
    data[7] = @sysvar::Vehicle_Input::CheckSum::ABS_EPS_7_CheckSum + checksum_sum_7B(data);
  }

  if(aId == 0x281){
    if(@sysvar::Vehicle_Input::CheckSum::ABS_EPS_8_Counter == 1)
    {
      int current_counter;
      current_counter++;
    //  write("the current counter is %d",current_counter);
      if(current_counter >= @sysvar::Vehicle_Input::CRC::Message_Counter_times)
      {
        @sysvar::Vehicle_Input::CheckSum::ABS_EPS_8_Counter = 0;
        current_counter = 0;
      }
    }
    else {
    data[6] = E2E_Counter1(data,6);  
    } 
    data[7] = @sysvar::Vehicle_Input::CheckSum::ABS_EPS_8_CheckSum + checksum_sum_7B(data);
  }

  if(aId == 0x287){
    if(@sysvar::Vehicle_Input::CheckSum::ICM_5_Counter == 1)
    {
      int current_counter;
      current_counter++;
    //  write("the current counter is %d",current_counter);
      if(current_counter >= @sysvar::Vehicle_Input::CRC::Message_Counter_times)
      {
        @sysvar::Vehicle_Input::CheckSum::ICM_5_Counter = 0;
        current_counter = 0;
      }
    }
    else {
    data[6] = E2E_Counter1(data,6);  
    } 
    data[7] = @sysvar::Vehicle_Input::CheckSum::ICM_5_CheckSum + checksum_sum_7B(data);
  }
  
  if(aId == 0x421){
    if(@sysvar::Vehicle_Input::CheckSum::EMS_2_G_Counter == 1)
    {
      int current_counter;
      current_counter++;
    //  write("the current counter is %d",current_counter);
      if(current_counter >= @sysvar::Vehicle_Input::CRC::Message_Counter_times)
      {
        @sysvar::Vehicle_Input::CheckSum::EMS_2_G_Counter = 0;
        current_counter = 0;
      }
    }
    else {
    data[6] = E2E_Counter1(data,6);  
    } 
    data[7] = @sysvar::Vehicle_Input::CheckSum::EMS_2_G_CheckSum + E2E_CRC8_Table_B7(data,7,0xff);
  }
  
  if(aId == 0x391){
    data[6] = E2E_Counter1(data,6);   
    data[1] = checksum_sum_1B(data);
  }
  
  if(aId == 0x2EA){
    data[6] = E2E_Counter1(data,6);   
    data[7] = checksum_sum_7B(data);
  }
  
  if(aId == 0xC4){
    data[5] = E2E_Counter1(data,5);
    data[7] = E2E_CRC8_Table_B7(data,7,0xff);
  }
  
  if(aId == 0x127){
    data[0] = E2E_Counter1(data,0);   
    data[7] = checksum_sum_7B(data);
  }
    
  if(aId == 0x128){
    data[0] = E2E_Counter1(data,0);   
    data[7] = checksum_sum_7B(data);
  }
  
  if(aId == 0x535){
  data[2] = E2E_Counter2(data,2);
  data[7] = E2E_CRC8_Table_B7(data,7,0xff);
  }
  
  if(aId == 0x31C){
  data[1] = E2E_Counter2(data,1);
  data[2] = checksum_sum_2B(data);
  }

  if (aId == IHU11_CAN_ID)
  {
    if (gIhu11IlTxAllow > 0)
    {
      gIhu11IlTxAllow--;
      return 1;
    }
    return 0;
  }

   return 1; // don't prevent sending of the message
}


set_value_to_valid()
{
  $CAN1::TCU_2::ActualGear.phys = 11;
  $CAN1::ABS_ESP_1::ABS_ESP_1_VehicleSpeedVSOSig.phys = 0;
  $CAN1::SAM_1_G::SteeringAngle.phys = 0;
  $CAN1::YAS_1::YawRate.phys = 0;
  $CAN1::SAM_1_G::SteeringAngleValidData.phys = 0;
  $CAN1::BCM_1::KeySts.phys = 2;
  
}