/*@!Encoding:936*/
includes
{
  #include "..\Include\CRC.cin"
}

variables
{
  msTimer ABS_ESP_1_2E9_miss_time;
  msTimer ICM_5_287_miss_time;
  msTimer TCU_2_300_miss_time;
  msTimer FCM_5_4DD_miss_time;

  int gGwSpeedFromSysvar;
  int gGwSteerFromSysvar;
  int gGwYawFromSysvar;
  msTimer gGwSyncTimer;
}

void PushGwVehicleSpeedToSignal(float value)
{
  gGwSpeedFromSysvar = 1;
  $CAN1::ABS_ESP_1::ABS_ESP_1_VehicleSpeedVSOSig.phys = value;
}

void PushGwSteeringAngleToSignal(float value)
{
  gGwSteerFromSysvar = 1;
  $CAN1::SAM_1_G::SteeringAngle.phys = value;
}

void PushGwYawRateToSignal(float value)
{
  gGwYawFromSysvar = 1;
  $CAN1::YAS_1::YawRate.phys = value;
}

void ApplyGwSysvarToSignals()
{
  PushGwVehicleSpeedToSignal(@sysvar::GW::VehicleSpeed);
  PushGwSteeringAngleToSignal(@sysvar::GW::SteeringAngle);
  PushGwYawRateToSignal(@sysvar::GW::YawRate);
}

void SyncGwSysvarsFromPanelSignals()
{
  float sigVal;

  if (gGwSpeedFromSysvar)
  {
    gGwSpeedFromSysvar = 0;
  }
  else
  {
    sigVal = $CAN1::ABS_ESP_1::ABS_ESP_1_VehicleSpeedVSOSig.phys;
    if (sigVal != @sysvar::GW::VehicleSpeed)
    {
      @sysvar::GW::VehicleSpeed = sigVal;
    }
  }

  if (gGwSteerFromSysvar)
  {
    gGwSteerFromSysvar = 0;
  }
  else
  {
    sigVal = $CAN1::SAM_1_G::SteeringAngle.phys;
    if (sigVal != @sysvar::GW::SteeringAngle)
    {
      @sysvar::GW::SteeringAngle = sigVal;
    }
  }

  if (gGwYawFromSysvar)
  {
    gGwYawFromSysvar = 0;
  }
  else
  {
    sigVal = $CAN1::YAS_1::YawRate.phys;
    if (sigVal != @sysvar::GW::YawRate)
    {
      @sysvar::GW::YawRate = sigVal;
    }
  }
}

on start
{
  setTimerCyclic(gGwSyncTimer, 50);
  ApplyGwSysvarToSignals();
}

on timer gGwSyncTimer
{
  SyncGwSysvarsFromPanelSignals();
}

on sysvar_update sysvar::GW::VehicleSpeed
{
  PushGwVehicleSpeedToSignal(@this);
}

on sysvar_update sysvar::GW::SteeringAngle
{
  PushGwSteeringAngleToSignal(@this);
}

on sysvar_update sysvar::GW::YawRate
{
  PushGwYawRateToSignal(@this);
}

on busoff{
  resetCanEx(this.can);
}

dword applILTxPending (long aId, dword aDlc, byte data[])
{
  dword i;
  byte MSG_RawData[64];
  byte result_crc;

  if(aId == 0x300){
    if(@sysvar::Vehicle_Input::CheckSum::TCU_2_Counter == 1)
    {
      int current_counter;
      current_counter++;
      if(current_counter >= @sysvar::Vehicle_Input::CRC::Message_Counter_times)
      {
        @sysvar::Vehicle_Input::CheckSum::TCU_2_Counter = 0;
        current_counter = 0;
      }
    }
    else {
    data[6] = E2E_Counter1(data,6);
    }
    data[7] = @sysvar::Vehicle_Input::CheckSum::TCU_2_CheckSum + checksum_sum_7B(data);
  }

    if(aId == 0x2E9){
    if(@sysvar::Vehicle_Input::CheckSum::ABS_EPS_1_Counter == 1)
    {
      int current_counter;
      current_counter++;
      if(current_counter >= @sysvar::Vehicle_Input::CRC::Message_Counter_times)
      {
        @sysvar::Vehicle_Input::CheckSum::ABS_EPS_1_Counter = 0;
        current_counter = 0;
      }
    }
    else {
    data[7] = E2E_Counter1(data,7);
    }
    data[5] = @sysvar::Vehicle_Input::CheckSum::ABS_EPS_1_CheckSum + checksum_sum_5B(data);
  }

  if(aId == 0x313){
    if(@sysvar::Vehicle_Input::CheckSum::ABS_EPS_3_Counter == 1)
    {
      int current_counter;
      current_counter++;
      if(current_counter >= @sysvar::Vehicle_Input::CRC::Message_Counter_times)
      {
        @sysvar::Vehicle_Input::CheckSum::ABS_EPS_3_Counter = 0;
        current_counter = 0;
      }
    }
    else {
    data[6] = E2E_Counter1(data,6);
    }
    data[7] = @sysvar::Vehicle_Input::CheckSum::ABS_EPS_3_CheckSum + checksum_sum_7B(data);
  }

  if(aId == 0x316){
    if(@sysvar::Vehicle_Input::CheckSum::ABS_EPS_4_Counter == 1)
    {
      int current_counter;
      current_counter++;
      if(current_counter >= @sysvar::Vehicle_Input::CRC::Message_Counter_times)
      {
        @sysvar::Vehicle_Input::CheckSum::ABS_EPS_4_Counter = 0;
        current_counter = 0;
      }
    }
    else {
    data[6] = E2E_Counter1(data,6);
    }
    data[7] = @sysvar::Vehicle_Input::CheckSum::ABS_EPS_4_CheckSum + checksum_sum_7B(data);
  }

  if(aId == 0x260){
    if(@sysvar::Vehicle_Input::CheckSum::ABS_EPS_7_Counter == 1)
    {
      int current_counter;
      current_counter++;
      if(current_counter >= @sysvar::Vehicle_Input::CRC::Message_Counter_times)
      {
        @sysvar::Vehicle_Input::CheckSum::ABS_EPS_7_Counter = 0;
        current_counter = 0;
      }
    }
    else {
    data[6] = E2E_Counter1(data,6);
    }
    data[7] = @sysvar::Vehicle_Input::CheckSum::ABS_EPS_7_CheckSum + checksum_sum_7B(data);
  }

  if(aId == 0x281){
    if(@sysvar::Vehicle_Input::CheckSum::ABS_EPS_8_Counter == 1)
    {
      int current_counter;
      current_counter++;
      if(current_counter >= @sysvar::Vehicle_Input::CRC::Message_Counter_times)
      {
        @sysvar::Vehicle_Input::CheckSum::ABS_EPS_8_Counter = 0;
        current_counter = 0;
      }
    }
    else {
    data[6] = E2E_Counter1(data,6);
    }
    data[7] = @sysvar::Vehicle_Input::CheckSum::ABS_EPS_8_CheckSum + checksum_sum_7B(data);
  }

  if(aId == 0x287){
    if(@sysvar::Vehicle_Input::CheckSum::ICM_5_Counter == 1)
    {
      int current_counter;
      current_counter++;
      if(current_counter >= @sysvar::Vehicle_Input::CRC::Message_Counter_times)
      {
        @sysvar::Vehicle_Input::CheckSum::ICM_5_Counter = 0;
        current_counter = 0;
      }
    }
    else {
    data[6] = E2E_Counter1(data,6);
    }
    data[7] = @sysvar::Vehicle_Input::CheckSum::ICM_5_CheckSum + checksum_sum_7B(data);
  }

  if(aId == 0x421){
    if(@sysvar::Vehicle_Input::CheckSum::EMS_2_G_Counter == 1)
    {
      int current_counter;
      current_counter++;
      if(current_counter >= @sysvar::Vehicle_Input::CRC::Message_Counter_times)
      {
        @sysvar::Vehicle_Input::CheckSum::EMS_2_G_Counter = 0;
        current_counter = 0;
      }
    }
    else {
    data[6] = E2E_Counter1(data,6);
    }
    data[7] = @sysvar::Vehicle_Input::CheckSum::EMS_2_G_CheckSum + E2E_CRC8_Table_B7(data,7,0xff);
  }

  if(aId == 0x391){
    data[6] = E2E_Counter1(data,6);
    data[1] = checksum_sum_1B(data);
  }

  if(aId == 0x2EA){
    data[6] = E2E_Counter1(data,6);
    data[7] = checksum_sum_7B(data);
  }

  if(aId == 0xC4){
    data[5] = E2E_Counter1(data,5);
    data[7] = E2E_CRC8_Table_B7(data,7,0xff);
  }

  if(aId == 0x127){
    data[0] = E2E_Counter1(data,0);
    data[7] = checksum_sum_7B(data);
  }

  if(aId == 0x128){
    data[0] = E2E_Counter1(data,0);
    data[7] = checksum_sum_7B(data);
  }

  if(aId == 0x535){
  data[2] = E2E_Counter2(data,2);
  data[7] = E2E_CRC8_Table_B7(data,7,0xff);
  }

  if(aId == 0x31C){
  data[1] = E2E_Counter2(data,1);
  data[2] = checksum_sum_2B(data);
  }

   return 1;
}
