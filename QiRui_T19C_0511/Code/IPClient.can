/*@!Encoding:936*/
includes
{
  #include "IPCommon.can"
}

variables
{
  char      gIpClientIni[260] = "Code\\IPClient.ini";
  msTimer   gUdpSettingsSaveTimer;
  const int kUdpSettingsSaveDelayMs = 300;
  long      gUdpSettingsLoaded = 0;
}

void ScheduleSaveUdpPanelSettings()
{
  cancelTimer(gUdpSettingsSaveTimer);
  setTimer(gUdpSettingsSaveTimer, kUdpSettingsSaveDelayMs);
}

void SaveUdpPanelSettings()
{
  char serverIp[64];
  char clientData[4096];
  char portStr[32];

  SysGetVariableString(sysvar::UDP::UdpServerIp, serverIp, elcount(serverIp));
  SysGetVariableString(sysvar::UDP::UdpClientData, clientData, elcount(clientData));

  writeProfileString("UDP", "ServerIp", serverIp, gIpClientIni);

  snprintf(portStr, elcount(portStr), "%d", @sysvar::UDP::UdpClientPort);
  writeProfileString("UDP", "ClientPort", portStr, gIpClientIni);

  snprintf(portStr, elcount(portStr), "%d", @sysvar::UDP::UdpServerPort);
  writeProfileString("UDP", "ServerPort", portStr, gIpClientIni);

  writeProfileString("UDP", "ClientData", clientData, gIpClientIni);
}

void LoadUdpPanelSettings()
{
  char serverIp[64];
  char clientData[4096];
  char portStr[32];
  long port;

  getProfileString("UDP", "ServerIp", "", serverIp, elcount(serverIp), gIpClientIni);
  if (strlen(serverIp) > 0)
  {
    SysSetVariableString(sysvar::UDP::UdpServerIp, serverIp);
  }

  getProfileString("UDP", "ClientPort", "", portStr, elcount(portStr), gIpClientIni);
  port = atol(portStr);
  if (port > 0)
  {
    @sysvar::UDP::UdpClientPort = port;
  }

  getProfileString("UDP", "ServerPort", "", portStr, elcount(portStr), gIpClientIni);
  port = atol(portStr);
  if (port > 0)
  {
    @sysvar::UDP::UdpServerPort = port;
  }

  getProfileString("UDP", "ClientData", "", clientData, elcount(clientData), gIpClientIni);
  SysSetVariableString(sysvar::UDP::UdpClientData, clientData);

  gUdpSettingsLoaded = 1;
  writelineex(0, 1, "UDP panel settings loaded from %s", gIpClientIni);
}

void SetupIp()
{
  int   adapterIndex = 1;
  char  text[512] = "";
  char  info[512] = "";
  int   size = 512;
  long  result = 0;
  dword addresses[1];

  writeClear(0);

  if (1 > IpGetAdapterCount())
  {
    writelineex(0, 3, "Error: There is no network interface available!");
    stop();
  }

  if (0 != IpGetAdapterAddress(adapterIndex, addresses, 1))
  {
    writelineex(0, 3, "Error: Could not retrieve ip address!");
    stop();
  }

  gIpAddress = addresses[0];

  if (INVALID_IP == gIpAddress)
  {
    writelineex(0, 3, "Error: ip address to be used is invalid!");
    stop();
  }

  IpGetAdapterDescription(adapterIndex, text, size);
  snprintf(info, size, "Interface: %s", text);
  writelineex(0, 1, info);

  IpGetAdapterAddressAsString(adapterIndex, text, size);
  snprintf(info, size, "Ip address: %s", text);
  writelineex(0, 1, info);

  SysSetVariableString(sysvar::TCPIP::TcpClientIp, text);
  SysSetVariableString(sysvar::UDP::UdpClientIp, text);

  IpGetAdapterMaskAsString(adapterIndex, text, size);
  snprintf(info, size, "Subnet mask: %s", text);
  writelineex(0, 1, info);

  IpGetAdapterGatewayAsString(adapterIndex, text, size);
  snprintf(info, size, "Gateway address: %s", text);
  writelineex(0, 1, info);

  gStatus = gkSTATUS_INITIALISED;
}

long IsSpaceChar(char c)
{
  if (c == ' ' || c == '\t' || c == '\r' || c == '\n')
  {
    return 1;
  }
  return 0;
}

float ParseDecimalStringToFloat(char buffer[], dword buflen, dword &pos, long &ok)
{
  float value;
  float scale;
  long sign;
  long hasDigit;
  long inFraction;
  byte ch;

  ok = 0;
  value = 0.0;
  sign = 1;
  hasDigit = 0;
  inFraction = 0;
  scale = 0.1;

  while (pos < buflen && IsSpaceChar(buffer[pos]))
  {
    pos++;
  }

  if (pos >= buflen)
  {
    return 0.0;
  }

  if (buffer[pos] == '-')
  {
    sign = -1;
    pos++;
  }
  else if (buffer[pos] == '+')
  {
    pos++;
  }

  while (pos < buflen)
  {
    ch = buffer[pos];
    if (ch >= '0' && ch <= '9')
    {
      hasDigit = 1;
      if (!inFraction)
      {
        value = value * 10.0 + (ch - '0');
      }
      else
      {
        value = value + (ch - '0') * scale;
        scale = scale / 10.0;
      }
      pos++;
    }
    else if (ch == '.' && !inFraction)
    {
      inFraction = 1;
      pos++;
    }
    else
    {
      break;
    }
  }

  if (hasDigit)
  {
    ok = 1;
    return sign * value;
  }
  return 0.0;
}

void SkipUdpFieldSeparators(char buffer[], dword buflen, dword &pos)
{
  while (pos < buflen && (buffer[pos] == ',' || IsSpaceChar(buffer[pos])))
  {
    pos++;
  }
}

long UdpPayloadHasComma(char buffer[], dword count)
{
  dword i;

  for (i = 0; i < count; i++)
  {
    if (buffer[i] == ',')
    {
      return 1;
    }
  }
  return 0;
}

void UpdateGwFromUdpLegacyBytes(char buffer[], dword count)
{
  if (count >= 1)
  {
    @sysvar::GW::VehicleSpeed = (float)buffer[0];
  }
  if (count >= 2)
  {
    @sysvar::GW::SteeringAngle = (float)buffer[1];
  }
  if (count >= 3)
  {
    @sysvar::GW::YawRate = (float)buffer[2];
  }
}

void UpdateGwFromUdpAsciiCsv(char buffer[], dword count)
{
  char text[4096];
  dword pos;
  dword i;
  long okSpeed;
  long okSteer;
  long okYaw;
  float speed;
  float steer;
  float yaw;

  if (count >= elcount(text))
  {
    count = elcount(text) - 1;
  }

  for (i = 0; i < count; i++)
  {
    text[i] = buffer[i];
  }
  text[count] = 0;

  pos = 0;
  speed = ParseDecimalStringToFloat(text, count, pos, okSpeed);
  SkipUdpFieldSeparators(text, count, pos);
  steer = ParseDecimalStringToFloat(text, count, pos, okSteer);
  SkipUdpFieldSeparators(text, count, pos);
  yaw = ParseDecimalStringToFloat(text, count, pos, okYaw);

  if (okSpeed && okSteer && okYaw)
  {
    @sysvar::GW::VehicleSpeed = speed;
    @sysvar::GW::SteeringAngle = steer;
    @sysvar::GW::YawRate = yaw;
  }
  else
  {
    writelineex(0, 2, "UDP CSV parse failed (%d/%d/%d): %s", okSpeed, okSteer, okYaw, text);
  }
}

void UpdateGwFromUdpPayload(char buffer[], dword count)
{
  if (count == 0)
  {
    return;
  }

  if (UdpPayloadHasComma(buffer, count))
  {
    UpdateGwFromUdpAsciiCsv(buffer, count);
  }
  else if (count == 8)
  {
    // Sender end notification: three 8-byte frames; ignore.
  }
  else if (count <= 3)
  {
    UpdateGwFromUdpLegacyBytes(buffer, count);
  }
  else
  {
    writelineex(0, 2, "UDP payload ignored, len=%d", count);
  }
}

on start
{
  LoadUdpPanelSettings();
  SetupIp();
}

on stopMeasurement
{
  SaveUdpPanelSettings();
  ResetIp();
}

on timer gUdpSettingsSaveTimer
{
  SaveUdpPanelSettings();
}

void OnTcpReceive( dword socket, long result, dword address, dword port, char buffer[], dword size)
{
  char  addressString[64] = "";

  if ( gTcpDataSocket != socket)
  {
    writelineex(0, 2, "OnTcpReceive called for unknown socket 0x%X", socket);
    return;
  }

  if (0 != result)
  {
    IpGetLastSocketErrorAsString( socket, gIpLastErrStr, elcount( gIpLastErrStr));
    writelineex( 0, 2, "OnTcpReceive error (%d): %s", IpGetLastSocketError( socket), gIpLastErrStr);
    return;
  }

  IpGetAddressAsString(address, addressString, elcount(addressString));
  SysSetVariableString(sysvar::TCPIP::TcpData, buffer);
  TcpRecv( socket);
}

void OnTcpSend( dword socket, long result, char buffer[], dword size)
{
  if ( gTcpDataSocket != socket)
  {
    writelineex(0, 2, "OnTcpSend called for unknown socket 0x%X", socket);
  }

  if (0 != result)
  {
    IpGetLastSocketErrorAsString( socket, gIpLastErrStr, elcount( gIpLastErrStr));
    writelineex( 0, 2, "OnTcpSend error (%d): %s", IpGetLastSocketError( socket), gIpLastErrStr);
  }
}

void ConnectTcp()
{
  char buffer[64];
  dword serverIp;

  SysGetVariableString(sysvar::TCPIP::TcpServerIp, buffer, elcount(buffer));
  serverIp = IpGetAddressAsNumber(buffer);

  if (INVALID_IP == serverIp)
  {
    writelineex(0, 1, "Error: invalid server Ip address!");
    return;
  }

  gTcpPort = @sysvar::TCPIP::TcpClientPort;
  gTcpDataSocket = TcpOpen(gIpAddress, gTcpPort);

  if ( INVALID_SOCKET == gTcpDataSocket)
  {
    writelineex(0, 1, "Error: could not open Tcp socket!");
    return;
  }
  else
  {
    writelineex(0, 1, "Tcp socket opened.");
  }

  if (0 == TcpConnect(gTcpDataSocket, serverIp, @sysvar::TCPIP::TcpServerPort))
  {
    writelineex(0, 1, "Successfully connected to server %s:%d", buffer, @sysvar::TCPIP::TcpServerPort);
    TcpRecv( gTcpDataSocket);
  }
}

void DisconnectTcp()
{
  if (INVALID_SOCKET != gTcpDataSocket)
  {
    TcpClose(gTcpDataSocket);
    gTcpDataSocket = INVALID_SOCKET;
  }
  writelineex(0, 1, "Tcp socket is closed.");
}

void SendTcpData()
{
  char buffer[8192];

  SysGetVariableString(sysvar::TCPIP::TcpClientData, buffer, elcount(buffer));

  if (INVALID_SOCKET == gTcpDataSocket)
  {
    writelineex( 0, 2, "Tcp socket is invalid!");
    return;
  }

  if (0 != TcpSend( gTcpDataSocket, buffer, elcount(buffer)))
  {
    gIpLastErr = IpGetLastSocketError( gTcpDataSocket);
    if ( WSA_IO_PENDING != gIpLastErr)
    {
      IpGetLastSocketErrorAsString( gTcpDataSocket, gIpLastErrStr, elcount( gIpLastErrStr));
      writelineex( 0, 2, "Tcp send error (%d): %s", gIpLastErr, gIpLastErrStr);
    }
  }
  else
  {
    writelineex( 0, 1, "Tcp data sent successfully!");
  }
}

void ClearCharBuffer(char buffer[], dword buflen)
{
  dword i;

  for (i = 0; i < buflen; i++)
  {
    buffer[i] = 0;
  }
}

long SendUdpPayload(char payload[])
{
  char buffer[64];
  dword serverIp;

  if (INVALID_SOCKET == gUdpSocket)
  {
    writelineex(0, 1, "Error: Udp socket is not opened!");
    return -1;
  }

  SysGetVariableString(sysvar::UDP::UdpServerIp, buffer, elcount(buffer));
  serverIp = IpGetAddressAsNumber(buffer);

  if (INVALID_IP == serverIp)
  {
    writelineex(0, 1, "Error: invalid server Ip address!");
    return -1;
  }

  if (0 == UdpSendTo(gUdpSocket, serverIp, @sysvar::UDP::UdpServerPort, payload, strlen(payload)))
  {
    writelineex(0, 1, "Successfully sent Udp data: %s", payload);
    return 0;
  }

  writelineex(0, 1, "Error: failed to send Udp data to %s:%d", buffer, @sysvar::UDP::UdpServerPort);
  return -1;
}

void SendUdpData()
{
  char data[4096];

  ClearCharBuffer(data, elcount(data));
  SysGetVariableString(sysvar::UDP::UdpClientData, data, elcount(data));
  SendUdpPayload(data);
}

void SendUdpStop()
{
  SendUdpPayload("STOP");
}

void OpenUdpPort()
{
  gUdpPort = @sysvar::UDP::UdpClientPort;
  gUdpSocket = UdpOpen( gIpAddress, gUdpPort);

  if ( INVALID_SOCKET == gUdpSocket)
  {
    writelineex(0, 1, "Error: could not create Udp socket!");
  }
  else
  {
    writelineex(0, 1, "Udp socket is opened successfully.");
    UdpRecv( gUdpSocket);
  }
}

void CloseUdpPort()
{
  if (INVALID_SOCKET != gUdpSocket)
  {
    UdpClose(gUdpSocket);
    gUdpSocket = INVALID_SOCKET;
    writelineex(0, 2, "Udp port is closed.");
  }
}

void ResetIp()
{
  if (INVALID_SOCKET != gTcpDataSocket)
  {
    TcpClose(gTcpDataSocket);
    gTcpDataSocket = INVALID_SOCKET;
  }

  if (INVALID_SOCKET != gUdpSocket)
  {
    UdpClose(gUdpSocket);
    gUdpSocket = INVALID_SOCKET;
  }
}

void OnUdpReceiveFrom( dword socket, long result, dword address, dword port, char buffer[], dword count)
{
  if ( gUdpSocket != socket)
  {
    writelineex(0, 2, "OnUdpReceiveFrom called for unknown socket!");
  }

  if (0 != result)
  {
    IpGetLastSocketErrorAsString( socket, gIpLastErrStr, elcount( gIpLastErrStr));
    writelineex( 0, 2, "OnUdpReceiveFrom error (%d): %s", IpGetLastSocketError( socket), gIpLastErrStr);
  }

  SysSetVariableString(sysvar::UDP::UdpData, buffer);
  UpdateGwFromUdpPayload(buffer, count);

  UdpRecv( socket);
}

void OnUdpSendTo( dword socket, long result, char buffer[], dword size)
{
  if ( gUdpSocket != socket)
  {
    writelineex(0, 2, "OnUdpSendTo called for unknown socket 0x%X", socket);
  }

  if (0 != result)
  {
    IpGetLastSocketErrorAsString( socket, gIpLastErrStr, elcount( gIpLastErrStr));
    writelineex( 0, 2, "OnUdpSendTo error (%d): %s", IpGetLastSocketError( socket), gIpLastErrStr);
  }
  else
  {
    writelineex(0, 1, "Successfully sent Udp data.");
  }
}

void OnTcpConnect( dword socket, long result)
{
  if ( gTcpDataSocket != socket)
  {
    writelineex(0, 2, "OnTcpConnect called for unknown socket 0x%X", socket);
    return;
  }

  if (0 != result)
  {
    IpGetLastSocketErrorAsString( socket, gIpLastErrStr, elcount( gIpLastErrStr));
    writelineex( 0, 2, "OnTcpConnect error (%d): %s", IpGetLastSocketError( socket), gIpLastErrStr);
    return;
  }
  else
  {
    writelineex(0, 1, "Successfully connected to server via Tcp");
    TcpRecv( socket);
  }
}

on sysvar_update sysvar::TCPIP::TcpConnect
{
  if (@this)
  {
    ConnectTcp();
  }
}

on sysvar_update sysvar::TCPIP::TcpDisconnect
{
  if (@this)
  {
    DisconnectTcp();
  }
}

on sysvar_update sysvar::TCPIP::TcpSend
{
  if (@this)
  {
    SendTcpData();
  }
}

on sysvar_update sysvar::UDP::UdpClose
{
  if (@this)
  {
    CloseUdpPort();
  }
}

on sysvar_update sysvar::UDP::UdpOpen
{
  if (@this)
  {
    OpenUdpPort();
  }
}

on sysvar_update sysvar::UDP::UdpSend
{
  if (@this)
  {
    SendUdpData();
  }
}

on sysvar_update sysvar::UDP::UdpSendStop
{
  if (@this)
  {
    SendUdpStop();
  }
}

on sysvar_update sysvar::UDP::UdpServerIp
{
  if (gUdpSettingsLoaded)
  {
    ScheduleSaveUdpPanelSettings();
  }
}

on sysvar_update sysvar::UDP::UdpClientPort
{
  if (gUdpSettingsLoaded)
  {
    ScheduleSaveUdpPanelSettings();
  }
}

on sysvar_update sysvar::UDP::UdpServerPort
{
  if (gUdpSettingsLoaded)
  {
    ScheduleSaveUdpPanelSettings();
  }
}

on sysvar_update sysvar::UDP::UdpClientData
{
  if (gUdpSettingsLoaded)
  {
    ScheduleSaveUdpPanelSettings();
  }
}
