/*@!Encoding:936*/
includes
{
  
}

variables
{
  //以下用于控制报文自定义时间丢失的作用，默认为5000ms
  //建议命名方式为message名 + ID 
  msTimer ONEBOX_1_0x98;
  msTimer ACU_2_0x31;
  msTimer ACU_3_0x21;
  msTimer FLZCU_1_0x23B;
  msTimer FLZCU_9_0x49D;
  msTimer FRZCU_1_0x2AB;
  msTimer FLZCU_28_0x4E9;
  msTimer ICC_COM_8_0x510;
  msTimer ICC_DA_15_0x485;
  msTimer ONEBOX_3_0x22B;
  msTimer ONEBOX_4_0x24B;
  msTimer RZCU_2_0x2BB;
  msTimer SAS_1_0x132;
  msTimer TMS_1_0x494;
  msTimer VCU_2_G_0x4B9;
  msTimer VCU_COM_10_0x38;
  msTimer VCU_ONEBOX_11_0x3B;
  msTimer RRCR_2_0x4F7;
  msTimer VCC_1_0x40B;
  msTimer Gettime;
  dword gc_dwCRC16InitValue = 0xFFFF;         
  long tm[9];
  
}


on timer Gettime{
  InitReportAndLog();
}

//在函数内部完成所有操作
void InitReportAndLog()
{
  long tm[9];
  getLocalTime(tm);
  //正确赋值到变量（确保时间在合理范围）
  $CAN1::GCW51::ICC_COM_8::CurrentTimeYear = tm[5]+1900; // 年（如2025）
  $CAN1::GCW51::ICC_COM_8::CurrentTimeMonth = tm[4]+1; // 月（1-12）
  $CAN1::GCW51::ICC_COM_8::CurrentTimeDay = tm[3];    // 日（1-31）
  $CAN1::GCW51::ICC_COM_8::CurrentTimeHour = tm[2];   // 时（0-23）
  $CAN1::GCW51::ICC_COM_8::CurrentTimeMinute = tm[1]; // 分（0-59）
  $CAN1::GCW51::ICC_COM_8::CurrentTimeSecond = tm[0]; // 秒（0-59） 
  setTimer(Gettime,1000);
  //write("%d_%02d_%02d_%02d_%02d_%02d",tm[5]+1900,tm[4]+1,tm[3],tm[2],tm[1],tm[0]);
  
}




on Start
{
  InitReportAndLog();
  //$CAN1::GCW_T1TP::FLZCU_9::FLZCU_9_PowerMode=2;
  $CAN1::GCW51::FLZCU_9::FuelVehPowerMode=2;
  //$CAN1::GCW51::VCU_COM_10::VCU_ActualGearValidData=1;
  $CAN1::GCW51::SAS_1::SAM_1_SteeringAngle=0;
  $CAN1::GCW51::ACU_2::ACU_2_YawRate=0;
  $CAN1::GCW51::TMS_1::ExternalTemperature_C=20;
  
}

on timer VCC_1_0x40B
  
{
  @sysvar::Vehicle_input::MSG::VCC_1_0x40B = 0;
}

on timer ACU_2_0x31
{
  @sysvar::Vehicle_input::MSG::ACU_2_0x31 = 0;
}

on timer ACU_3_0x21
{
  @sysvar::Vehicle_input::MSG::ACU_3_0x21 = 0;
}

on timer FLZCU_28_0x4E9
{
  @sysvar::Vehicle_input::MSG::FLZCU_28_0x4E9 = 0;
}

on timer FLZCU_1_0x23B
{
  @sysvar::Vehicle_input::MSG::FLZCU_1_0x23B = 0;
}

on timer FLZCU_9_0x49D
{
  @sysvar::Vehicle_input::MSG::FLZCU_9_0x49D = 0;
}

on timer FRZCU_1_0x2AB
{
  @sysvar::Vehicle_input::MSG::FRZCU_1_0x2AB = 0;
}

on timer RZCU_2_0x2BB
{
  @sysvar::Vehicle_input::MSG::RZCU_2_0x2BB = 0;
}

on timer ICC_COM_8_0x510
{
  @sysvar::Vehicle_input::MSG::ICC_COM_8_0x510 = 0;
}

on timer ICC_DA_15_0x485
{
  @sysvar::Vehicle_input::MSG::ICC_DA_15_0x485 = 0;
}

on timer ONEBOX_1_0x98
{
  @sysvar::Vehicle_input::MSG::ONEBOX_1_0x98 = 0;
}

on timer ONEBOX_3_0x22B
{
  @sysvar::Vehicle_input::MSG::ONEBOX_3_0x22B = 0;
}

on timer ONEBOX_4_0x24B
{
  @sysvar::Vehicle_input::MSG::ONEBOX_4_0x24B = 0;
}

on timer SAS_1_0x132
{
  @sysvar::Vehicle_input::MSG::SAS_1_0x132 = 0;
}

on timer TMS_1_0x494
{
  @sysvar::Vehicle_input::MSG::TMS_1_0x494 = 0;
}

on timer VCU_2_G_0x4B9
{
  @sysvar::Vehicle_input::MSG::VCU_2_G_0x4B9 = 0;
}

on timer VCU_COM_10_0x38
{
  @sysvar::Vehicle_input::MSG::VCU_COM_10_0x38 = 0;
}

on timer VCU_ONEBOX_11_0x3B
{
  @sysvar::Vehicle_input::MSG::VCU_ONEBOX_11_0x3B = 0;
}

on timer RRCR_2_0x4F7
{
  @sysvar::Vehicle_input::MSG::RRCR_2_0x4F7 = 0;
}



//以下是节点控制报文
on sysvar_update sysvar::Vehicle_input::Node::GCW51
{
  long node;
  if (@this == 1)
  {
    node = ILControlStop();//停止发送该节点报文
  }
  else
  {
    node = ILControlStart();//开始发送该节点报文
  }
}



on sysvar_update sysvar::Vehicle_input::MSG::RRCR_2_0x4F7
{
  if(@this == 1)
  {
    ILFaultInjectionDisableMsg(RRCR_2);
    setTimer(RRCR_2_0x4F7,@sysvar::Vehicle_input::Message_MissingTime::RRCR_2_0x4F7);
  }
  else
  {
    ILFaultInjectionEnableMsg(RRCR_2);
  } 
}


on sysvar_update sysvar::Vehicle_input::MSG::ACU_2_0x31
{
  if(@this == 1)
  {ILFaultInjectionDisableMsg(ACU_2);
    setTimer(ACU_2_0x31,@sysvar::Vehicle_input::Message_MissingTime::ACU_2_0x31);
  }
  else
  {
    ILFaultInjectionEnableMsg(ACU_2);
  } 
}

on sysvar_update sysvar::Vehicle_input::MSG::ACU_3_0x21
{
  if(@this == 1)
  {
    ILFaultInjectionDisableMsg(ACU_3);
    setTimer(ACU_3_0x21,@sysvar::Vehicle_input::Message_MissingTime::ACU_3_0x21);
  }
  else
  { 
    ILFaultInjectionEnableMsg(ACU_3);
  } 
}

on sysvar_update sysvar::Vehicle_input::MSG::FLZCU_1_0x23B
{
  if(@this == 1)
  {
    ILFaultInjectionDisableMsg(FLZCU_1);
    setTimer(FLZCU_1_0x23B,@sysvar::Vehicle_input::Message_MissingTime::FLZCU_1_0x23B );
  }
  else
  {
    ILFaultInjectionEnableMsg(FLZCU_1);
  } 
}

on sysvar_update sysvar::Vehicle_input::MSG::FLZCU_9_0x49D
{
  if(@this == 1)
  {
    ILFaultInjectionDisableMsg(FLZCU_9);
    setTimer(FLZCU_9_0x49D,@sysvar::Vehicle_input::Message_MissingTime::FLZCU_9_0x49D );
  }
  else
  {
    ILFaultInjectionEnableMsg(FLZCU_9);
  }  
}

on sysvar_update sysvar::Vehicle_input::MSG::FRZCU_1_0x2AB
{
  if(@this == 1)
  {
    ILFaultInjectionDisableMsg(FRZCU_1);
    setTimer(FRZCU_1_0x2AB,@sysvar::Vehicle_input::Message_MissingTime::FRZCU_1_0x2AB );
  }
  else
  {
    ILFaultInjectionEnableMsg(FRZCU_1);
  } 
}

on sysvar_update sysvar::Vehicle_input::MSG::RZCU_2_0x2BB
{
  if(@this == 1)
  {
    ILFaultInjectionDisableMsg(RZCU_2);
    setTimer(RZCU_2_0x2BB,@sysvar::Vehicle_input::Message_MissingTime::RZCU_2_0x2BB );
  }
  else
  {
    ILFaultInjectionEnableMsg(RZCU_2);
  } 
}

on sysvar_update sysvar::Vehicle_input::MSG::ICC_COM_8_0x510
{
  if(@this == 1)
  {
    ILFaultInjectionDisableMsg(ICC_COM_8);
    setTimer(ICC_COM_8_0x510,@sysvar::Vehicle_input::Message_MissingTime::ICC_COM_8_0x510 );
  }
  else
  {
    ILFaultInjectionEnableMsg(ICC_COM_8);
  } 
}

on sysvar_update sysvar::Vehicle_input::MSG::ICC_DA_15_0x485
{
  if(@this == 1)
  {
    ILFaultInjectionDisableMsg(ICC_DA_15);
    setTimer(ICC_DA_15_0x485,@sysvar::Vehicle_input::Message_MissingTime::ICC_DA_15_0x485 );
  }
  else
  {
    ILFaultInjectionEnableMsg(ICC_DA_15);
  } 
}

on sysvar_update sysvar::Vehicle_input::MSG::ONEBOX_1_0x98
{
  if(@this == 1)
  {
    ILFaultInjectionDisableMsg(ONEBOX_1);
    setTimer(ONEBOX_1_0x98,@sysvar::Vehicle_input::Message_MissingTime::ONEBOX_1_0x98 );
  }
  else
  {
    ILFaultInjectionEnableMsg(ONEBOX_1);
  } 
}

on sysvar_update sysvar::Vehicle_input::MSG::ONEBOX_3_0x22B
{
  if(@this == 1)
  {
    ILFaultInjectionDisableMsg(ONEBOX_3);
    setTimer(ONEBOX_3_0x22B,@sysvar::Vehicle_input::Message_MissingTime::ONEBOX_3_0x22B );
  }
  else
  {
    ILFaultInjectionEnableMsg(ONEBOX_3);
  } 
}

on sysvar_update sysvar::Vehicle_input::MSG::ONEBOX_4_0x24B
{
  if(@this == 1)
  {
    ILFaultInjectionDisableMsg(ONEBOX_4);
    setTimer(ONEBOX_4_0x24B,@sysvar::Vehicle_input::Message_MissingTime::ONEBOX_4_0x24B );
  }
  else
  {
    ILFaultInjectionEnableMsg(ONEBOX_4);
  }  
}

on sysvar_update sysvar::Vehicle_input::MSG::SAS_1_0x132
{
  if(@this == 1)
  {
    ILFaultInjectionDisableMsg(SAS_1);
   setTimer(SAS_1_0x132,@sysvar::Vehicle_input::Message_MissingTime::SAS_1_0x132 );
  }
  else
  {
    ILFaultInjectionEnableMsg(SAS_1);
  } 
}

on sysvar_update sysvar::Vehicle_input::MSG::TMS_1_0x494
{
  if(@this == 1)
  {
    ILFaultInjectionDisableMsg(TMS_1);
    setTimer(TMS_1_0x494,@sysvar::Vehicle_input::Message_MissingTime::TMS_1_0x494 );
  }
  else
  {
    ILFaultInjectionEnableMsg(TMS_1);
  }
}

on sysvar_update sysvar::Vehicle_input::MSG::VCU_2_G_0x4B9
{
  if(@this == 1)
  {
    ILFaultInjectionDisableMsg(VCU_2_G);
    setTimer(VCU_2_G_0x4B9,@sysvar::Vehicle_input::Message_MissingTime::VCU_2_G_0x4B9 );
  }
  else
  {
    ILFaultInjectionEnableMsg(VCU_2_G);
  } 
}

on sysvar_update sysvar::Vehicle_input::MSG::VCU_COM_10_0x38
{ 
  if(@this == 1)
  {
    ILFaultInjectionDisableMsg(VCU_COM_10);
    setTimer(VCU_COM_10_0x38,@sysvar::Vehicle_input::Message_MissingTime::VCU_COM_10_0x38 );
  }
  else
  {
    ILFaultInjectionEnableMsg(VCU_COM_10);
  } 
}

on sysvar_update sysvar::Vehicle_input::MSG::VCU_ONEBOX_11_0x3B
{
  if(@this == 1)
  {
    ILFaultInjectionDisableMsg(VCU_ONEBOX_11);
    setTimer(VCU_ONEBOX_11_0x3B,@sysvar::Vehicle_input::Message_MissingTime::VCU_ONEBOX_11_0x3B );
  }
  else
  {
    ILFaultInjectionEnableMsg(VCU_ONEBOX_11);
  } 
}



//以下部分实现counter 进行0~14的累加
byte E2E_Counter(byte data[],byte c_pos)
{
    int Counter;       
    Counter = data[c_pos] & 0x0F;
    Counter++;
    if(Counter > 14)
      Counter = Counter - 15;
    Counter = (data[c_pos] & 0xF0)+ Counter;
    return  Counter;
}

//奇瑞 Checksum 算法
byte E2E_CRC8(byte buffer[], byte length)
{ 
  byte checksum,i,j;
  byte CRC8_Poly = 0x1D;
  checksum = 0x00;
  CRC8_Poly = 0x1D;
  for(i=0; i<length; i++)
  {
    checksum = checksum ^ buffer[i];
    for( j=0; j<8; j++ )
    {
      if(checksum & 0x80)
      {
        checksum = ((checksum << 1) ^ CRC8_Poly); 
      }
      else
      {
        checksum = (checksum << 1);
      }
    }
  }
  checksum = checksum ^ 0x00;
  return checksum;
}

word ssh_crc16_cheery(byte buffer[], byte length)
{
  word wCRCin;
  word wCPoly=0x1021;
  dword i,j;
  byte wChar = 0; 
  j=0;
  wCRCin=gc_dwCRC16InitValue;
  
  while(length--) 
  {
    wChar =buffer[j++]; 
    wCRCin ^= (wChar << 8); 
    for(i = 0; i < 8; i++) 
    { 
      if(wCRCin & 0x8000) 
      { 
        wCRCin = (wCRCin << 1) ^ wCPoly; 
      } 
      else 
      { 
        wCRCin = wCRCin << 1; 
      } 
    } 
  }
  wCRCin=wCRCin ^ 0x0000;
  return wCRCin;
}

//以下代码是检查雷达外发的CRC是否正确
on message RLCR_1
{
  int i;
  byte MSG_RawData[64];
  MSG_RawData[0]=0x44;
  MSG_RawData[1]=0x00;
  for (i = 0; i < 8; i++)
  {
    MSG_RawData[i+2] = this.byte(i+1);   
  }
  @sysvar::Vehicle_input::Message_CRC::RLCR_1_0x447 = E2E_CRC8(MSG_RawData,9);
  if (this.byte(0) == (@sysvar::Vehicle_input::Message_CRC::RLCR_1_0x447))
  {
    @sysvar::Vehicle_input::MSG::RLCR_1_0x447 = 1;
  }
  else 
  {
    @sysvar::Vehicle_input::MSG::RLCR_1_0x447 = 0;
  }
}
//
//
//
//on message RLCR_2
//{
//  int i;
//  byte MSG_RawData[64];
//  MSG_RawData[0]=0x45;
//  MSG_RawData[1]=0x00;
//  for (i = 0; i < 8; i++)
//  {
//    MSG_RawData[i+2] = this.byte(i+1);   
//  }
//  @sysvar::Vehicle_input::Message_CRC::RLCR_2_0x450 = E2E_CRC8(MSG_RawData,9);
//  if (this.byte(0) == (@sysvar::Vehicle_input::Message_CRC::RLCR_2_0x450))
//  {
//    @sysvar::Vehicle_input::MSG::RLCR_2_0x450 = 1;
//  }
//  else 
//  {
//    @sysvar::Vehicle_input::MSG::RLCR_2_0x450 = 0;
//  }
//}
//
on message RLCR_3
{
  int i;
  byte MSG_RawData[64];
  MSG_RawData[22]=0xA7;
  MSG_RawData[23]=0x03;
  for (i = 0; i < 22; i++)
  {
    MSG_RawData[i] = this.byte(i+2);   

  }
  @sysvar::Vehicle_input::Message_CRC::RLCR_3_0x3A7 = ssh_crc16_cheery(MSG_RawData,24);
  if ((this.byte(0)<<8 | this.byte(1))== (@sysvar::Vehicle_input::Message_CRC::RLCR_3_0x3A7))
  {
    @sysvar::Vehicle_input::MSG::RLCR_3_0x3A7 = 1;
  }
  else 
  {
    @sysvar::Vehicle_input::MSG::RLCR_3_0x3A7 = 0;
  }
}

on message RRCR_1
{
  int i;
  byte MSG_RawData[64];
  MSG_RawData[0]=0x46;
  MSG_RawData[1]=0x00;
  for (i = 0; i < 8; i++)
  {
    MSG_RawData[i+2] = this.byte(i+1);   
  }
  @sysvar::Vehicle_input::Message_CRC::RRCR_1_0x4F3 = E2E_CRC8(MSG_RawData,9);
  if (this.byte(0) == (@sysvar::Vehicle_input::Message_CRC::RRCR_1_0x4F3))
  {
  @sysvar::Vehicle_input::MSG::RRCR_1_0x4F3 = 1;
  }
  else 
  {
    @sysvar::Vehicle_input::MSG::RRCR_1_0x4F3 = 0;
  }
}
//
//
//on message RRCR_2
//{
//  int i;
//  byte MSG_RawData[64];
//  MSG_RawData[0]=0x47;
//  MSG_RawData[1]=0x00;
//  for (i = 0; i < 8; i++)
//  {
//    MSG_RawData[i+2] = this.byte(i+1);   
//  }
//  @sysvar::Vehicle_input::Message_CRC::RRCR_2_0x4F7 = E2E_CRC8(MSG_RawData,9);
//  write("@sysvar::Vehicle_input::Message_CRC::RRCR_2_0x4F7 = %d", @sysvar::Vehicle_input::Message_CRC::RRCR_2_0x4F7);
//  write("(this.byte(0)<<8 | this.byte(1)) = %d", (this.byte(0)<<8 | this.byte(1)));
//  if (this.byte(0) == (@sysvar::Vehicle_input::Message_CRC::RRCR_2_0x4F7))
//  {
//    @sysvar::Vehicle_input::MSG::RRCR_2_0x4F7 = 1;
//    write(" @sysvar::Vehicle_input::MSG::RRCR_2_0x4F7 = %d", @sysvar::Vehicle_input::MSG::RRCR_2_0x4F7 = 1);
//  }
//  else 
//  {
//    @sysvar::Vehicle_input::MSG::RRCR_2_0x4F7 = 0;
//  }
//}

on message RRCR_3
{
  int i;
  byte MSG_RawData[64];
  MSG_RawData[22]=0xBF;
  MSG_RawData[23]=0x03;
  for (i = 0; i < 22; i++)
  {
    MSG_RawData[i] = this.byte(i+2);   
  }
  @sysvar::Vehicle_input::Message_CRC::RRCR_3_0x3BF = ssh_crc16_cheery(MSG_RawData,24);
  //write("@sysvar::Vehicle_input::Message_CRC::RRCR_3_0x3BF = %d", @sysvar::Vehicle_input::Message_CRC::RRCR_3_0x3BF);
  //write("(this.byte(0)<<8 | this.byte(1)) = %d", (this.byte(0)<<8 | this.byte(1)));
  if ((this.byte(0)<<8 | this.byte(1)) == (@sysvar::Vehicle_input::Message_CRC::RRCR_3_0x3BF))
  {
    
    @sysvar::Vehicle_input::MSG::RRCR_3_0x3BF = 1;
    //write(" @sysvar::Vehicle_input::MSG::RRCR_3_0x3BF = %d", @sysvar::Vehicle_input::MSG::RRCR_3_0x3BF = 1);
    
  }
  else 
  {
    @sysvar::Vehicle_input::MSG::RRCR_3_0x3BF = 0;
  }
}



//Calculation of a checksum and a message counter 示例:
dword applILTxPending (long aId, dword aDlc, byte data[]) // 在CANoe交互层（CANoe IL）向总线发送消息之前，调用此回调。
{
  dword i;
  byte MSG_Data[64];  //存储报文
  byte result_crc;
  
  //0x098 ONEBOX_1
  if(aId == 0x98)  //写 message ID
  {
    if(@ sysvar::Vehicle_input::Message_Counter::ONEBOX_1_0x98_RC1 ==1)
    {
      int current_counter;
      current_counter++;
      //write("the current counter is %d",current_counter);
      if(current_counter >= @sysvar::Vehicle_input::Message_Counter::Counter_unchange)
      {
        @ sysvar::Vehicle_input::Message_Counter::ONEBOX_1_0x98_RC1 = 0;
        current_counter = 0;
      }
    }
    else
    {
      data[1] = E2E_Counter(data,1);
      //set the new checksum
      MSG_Data[0] = 0x49; // 将CANID 添加进待校验的数组  
      MSG_Data[1] = 0x00;
      for(i = 1; i < 7; i++)
      {
        MSG_Data[i+1] = data[i];  // 将前7个Byte添加进待校验的数组 
      }
      data[0]  = E2E_CRC8(MSG_Data, 9) + @sysvar::Vehicle_input::Message_CRC::ONEBOX_1_0x98_CRC1;  // 要校验的数据为 DataID + CRC外的7个Byte 
    }
    if(@ sysvar::Vehicle_input::Message_Counter::ONEBOX_1_0x98_RC2 ==1)
    {
      int current_counter;
      current_counter++;
      //write("the current counter is %d",current_counter);
      if(current_counter >= @sysvar::Vehicle_input::Message_Counter::Counter_unchange)
      {
        @ sysvar::Vehicle_input::Message_Counter::ONEBOX_1_0x98_RC2 = 0;
        current_counter = 0;
      }
    }
    else
    {
      data[9] = E2E_Counter(data,9);
      MSG_Data[0] = 0x4A;
      MSG_Data[1] = 0x00;
      for(i = 1; i < 7; i++)
      {
        MSG_Data[i+1] = data[i+8];
      }
      data[8]  = E2E_CRC8(MSG_Data,9) + @sysvar::Vehicle_input::Message_CRC::ONEBOX_1_0x98_CRC2;
    }
  }
  
  //0x22B ONEBOX_3
  if(aId == 0x22B)
  {
    if(@sysvar::Vehicle_input::Message_Counter::ONEBOX_3_0x22B_RC1 ==1)
    {
      int current_counter;
      current_counter++;
      if(current_counter >= @sysvar::Vehicle_input::Message_Counter::Counter_unchange)
      {
        @sysvar::Vehicle_input::Message_Counter::ONEBOX_3_0x22B_RC1 = 0;
        current_counter = 0;
      }
    }
    else
    {
      data[1] = E2E_Counter(data,1);
      MSG_Data[0] = 0x4D;
      MSG_Data[1] = 0x00;
      for(i = 1; i < 7; i++)
      {
        MSG_Data[i+1] = data[i]; 
      }
      data[0]  = E2E_CRC8(MSG_Data,9) + @sysvar::Vehicle_input::Message_CRC::ONEBOX_3_0x22B_CRC1;
    }
    if(@sysvar::Vehicle_input::Message_Counter::ONEBOX_3_0x22B_RC2 ==1)
    {
      int current_counter;
      current_counter++;
      if(current_counter >= @sysvar::Vehicle_input::Message_Counter::Counter_unchange)
      {
        @sysvar::Vehicle_input::Message_Counter::ONEBOX_3_0x22B_RC2 = 0;
        current_counter = 0;
      }
    }
    else
    {
      data[9] = E2E_Counter(data,9);
      MSG_Data[0] = 0x4E;
      MSG_Data[1] = 0x00;
      for(i = 1; i < 7; i++)
      {
        MSG_Data[i+1] = data[i+8]; 
      }
      data[8]  = E2E_CRC8(MSG_Data,9) + @sysvar::Vehicle_input::Message_CRC::ONEBOX_3_0x22B_CRC2;
    }
    if(@sysvar::Vehicle_input::Message_Counter::ONEBOX_3_0x22B_RC4 ==1)
    {
      int current_counter;
      current_counter++;
      if(current_counter >= @sysvar::Vehicle_input::Message_Counter::Counter_unchange)
      {
        @sysvar::Vehicle_input::Message_Counter::ONEBOX_3_0x22B_RC4 = 0;
        current_counter = 0;
      }
    }
    else
    {
      data[25] = E2E_Counter(data,25);
      MSG_Data[0] = 0x50;
      MSG_Data[1] = 0x00;
      for(i = 1; i < 7; i++)
      {
        MSG_Data[i+1] = data[i+24]; 
      }
      data[24]  = E2E_CRC8(MSG_Data,9) + @sysvar::Vehicle_input::Message_CRC::ONEBOX_3_0x22B_CRC4;
    }
  }
  
  if(aId == 0x24B)
  {
    if(@sysvar::Vehicle_input::Message_Counter::ONEBOX_4_0x24B_RC1 ==1)
    {
      int current_counter;
      current_counter++;
      if(current_counter >= @sysvar::Vehicle_input::Message_Counter::Counter_unchange)
      {
        @sysvar::Vehicle_input::Message_Counter::ONEBOX_4_0x24B_RC1 = 0;
        current_counter = 0;
      }
    }
    else
    {
      data[1] = E2E_Counter(data,1);
      MSG_Data[0] = 0x51;
      MSG_Data[1] = 0x00;
      for(i = 1; i < 7; i++)
      {
        MSG_Data[i+1] = data[i]; 
      }
      data[0]  = E2E_CRC8(MSG_Data,9) + @sysvar::Vehicle_input::Message_CRC::ONEBOX_4_0x24B_CRC1;
    }
    if(@sysvar::Vehicle_input::Message_Counter::ONEBOX_4_0x24B_RC2 ==1)
    {
      int current_counter;
      current_counter++;
      if(current_counter >= @sysvar::Vehicle_input::Message_Counter::Counter_unchange)
      {
        @sysvar::Vehicle_input::Message_Counter::ONEBOX_4_0x24B_RC2 = 0;
        current_counter = 0;
      }
    }
    else
    {
      data[9] = E2E_Counter(data,9);
      MSG_Data[0] = 0x52;
      MSG_Data[1] = 0x00;
      for(i = 1; i < 7; i++)
      {
        MSG_Data[i+1] = data[i+8]; 
      }
      data[8]  = E2E_CRC8(MSG_Data,9) + @sysvar::Vehicle_input::Message_CRC::ONEBOX_4_0x24B_CRC2;
    }
    if(@sysvar::Vehicle_input::Message_Counter::ONEBOX_4_0x24B_RC3 ==1)
    {
      int current_counter;
      current_counter++;
      if(current_counter >= @sysvar::Vehicle_input::Message_Counter::Counter_unchange)
      {
        @sysvar::Vehicle_input::Message_Counter::ONEBOX_4_0x24B_RC3 = 0;
        current_counter = 0;
      }
    }
    else
    {
      data[17] = E2E_Counter(data,17);
      MSG_Data[0] = 0x53;
      MSG_Data[1] = 0x00;
      for(i = 1; i < 7; i++)
      {
        MSG_Data[i+1] = data[i+16]; 
      }
      data[16]  = E2E_CRC8(MSG_Data,9) + @sysvar::Vehicle_input::Message_CRC::ONEBOX_4_0x24B_CRC3;
    }
     if(@sysvar::Vehicle_input::Message_Counter::ONEBOX_4_0x24B_RC4 ==1)
    {
      int current_counter;
      current_counter++;
      if(current_counter >= @sysvar::Vehicle_input::Message_Counter::Counter_unchange)
      {
        @sysvar::Vehicle_input::Message_Counter::ONEBOX_4_0x24B_RC4 = 0;
        current_counter = 0;
      }
    }
    else
    {
      data[25] = E2E_Counter(data,25);
      MSG_Data[0] = 0x54;
      MSG_Data[1] = 0x00;
      for(i = 1; i < 7; i++)
      {
        MSG_Data[i+1] = data[i+24]; 
      }
      data[24]  = E2E_CRC8(MSG_Data,9) + @sysvar::Vehicle_input::Message_CRC::ONEBOX_4_0x24B_CRC4;
    }
  }
  
  //0x132 SAS_1
  if(aId == 0x132)
  {
    if(@ sysvar::Vehicle_input::Message_Counter::SAS_1_0x132 ==1)
    {
      int current_counter;
      current_counter++;
      if(current_counter >= @sysvar::Vehicle_input::Message_Counter::Counter_unchange)
      {
        @sysvar::Vehicle_input::Message_Counter::SAS_1_0x132 = 0;
        current_counter = 0;
      }
    }
    else
    {
    data[1] = E2E_Counter(data,1);
    MSG_Data[0] = 0x35;
    MSG_Data[1] = 0x00;
    for(i = 1; i < 7; i++)
    {
      MSG_Data[i+1] = data[i]; 
    }
    data[0]  = E2E_CRC8(MSG_Data,9) + @sysvar::Vehicle_input::Message_CRC::SAS_1_0x132;
    }
  }
  
  //ACU_3
  if(aId == 0x21)
  {
    if(@sysvar::Vehicle_input::Message_Counter::ACU_3_0x21 ==1)
    {
      int current_counter;
      current_counter++;
      if(current_counter >= @sysvar::Vehicle_input::Message_Counter::Counter_unchange)
      {
        @sysvar::Vehicle_input::Message_Counter::ACU_3_0x21 = 0;
        current_counter = 0;
      }
    }
    else
    {
    data[1] = E2E_Counter(data,1);
    MSG_Data[0] = 0x02;
    MSG_Data[1] = 0x00;
    for(i = 1; i < 7; i++)
    {
      MSG_Data[i+1] = data[i];
    }
    data[0]  = E2E_CRC8(MSG_Data,9) + @sysvar::Vehicle_input::Message_CRC::ACU_3_0x21 ;
   
    }
  }
  
  //ACU_2
  if(aId == 0x31)
  {
    if(@sysvar::Vehicle_input::Message_Counter::ACU_2_0x31 ==1)
    {
      int current_counter;
      current_counter++;
      if(current_counter >= @sysvar::Vehicle_input::Message_Counter::Counter_unchange)
      {
        @sysvar::Vehicle_input::Message_Counter::ACU_2_0x31 = 0;
        current_counter = 0;
      }
    }
    else
    {
    data[1] = E2E_Counter(data,1);
    MSG_Data[0] = 0x01;
    MSG_Data[1] = 0x00;
    for(i = 1; i < 7; i++)
    {
      MSG_Data[i+1] = data[i];
    }
    data[0]  = E2E_CRC8(MSG_Data,9) + @sysvar::Vehicle_input::Message_CRC::ACU_2_0x31 ;
    }
  }
  //FLZCU_3
  if(aId == 0x460)
  {
    if(@sysvar::Vehicle_input::Message_Counter::FLZCU_3_0x460==1)
    {
      int current_counter;
      current_counter++;
      if(current_counter >= @sysvar::Vehicle_input::Message_Counter::Counter_unchange)
      {
        @sysvar::Vehicle_input::Message_Counter::FLZCU_3_0x460 = 0;
        current_counter = 0;
      }
    }
    else
    {
    data[1] = E2E_Counter(data,1);
    MSG_Data[0] = 0xA4;
    MSG_Data[1] = 0x00;
    for(i = 1; i < 7; i++)
    {
      MSG_Data[i+1] = data[i];
    }
    data[0]  = E2E_CRC8(MSG_Data,9) + @sysvar::Vehicle_input::Message_Counter::FLZCU_3_0x460;
    }
  } 
  //FLZCU_12
  if(aId == 0x406)
  {
    if(@sysvar::Vehicle_input::Message_Counter::FLZCU_12_0x406==1)
    {
      int current_counter;
      current_counter++;
      if(current_counter >= @sysvar::Vehicle_input::Message_Counter::Counter_unchange)
      {
        @sysvar::Vehicle_input::Message_Counter::FLZCU_12_0x406 = 0;
        current_counter = 0;
      }
    }
    else
    {
    data[1] = E2E_Counter(data,1);
    MSG_Data[0] = 0x9B;
    MSG_Data[1] = 0x00;
    for(i = 1; i < 7; i++)
    {
      MSG_Data[i+1] = data[i];
    }
    data[0]  = E2E_CRC8(MSG_Data,9) + @sysvar::Vehicle_input::Message_Counter::FLZCU_12_0x406;
    }
  } 
  //FLZCU_1
  if(aId == 0x23B)
  {
    if(@sysvar::Vehicle_input::Message_Counter::FLZCU_1_0x23B ==1)
    {
      int current_counter;
      current_counter++;
      if(current_counter >= @sysvar::Vehicle_input::Message_Counter::Counter_unchange)
      {
        @sysvar::Vehicle_input::Message_Counter::FLZCU_1_0x23B = 0;
        current_counter = 0;
      }
    }
    else
    {
    data[1] = E2E_Counter(data,1);
    MSG_Data[0] = 0x36;
    MSG_Data[1] = 0x00;
    for(i = 1; i < 7; i++)
    {
      MSG_Data[i+1] = data[i];
    }
    data[0]  = E2E_CRC8(MSG_Data,9) + @sysvar::Vehicle_input::Message_CRC::FLZCU_1_0x23B;
    }
  }
  
  //FRZCU_1
  if(aId == 0x2AB)
  {
    if(@sysvar::Vehicle_input::Message_Counter::FRZCU_1_0x2AB ==1)
    {
      int current_counter;
      current_counter++;
      if(current_counter >= @sysvar::Vehicle_input::Message_Counter::Counter_unchange)
      {
        @ sysvar::Vehicle_input::Message_Counter::FRZCU_1_0x2AB= 0;
        current_counter = 0;
      }
    }
    else
    {
    data[1] = E2E_Counter(data,1);
    MSG_Data[0] = 0x3A;
    MSG_Data[1] = 0x00;
    for(i = 1; i < 7; i++)
    {
      MSG_Data[i+1] = data[i];
    }
    data[0]  = E2E_CRC8(MSG_Data,9) + @ sysvar::Vehicle_input::Message_CRC::FRZCU_1_0x2AB;
    }
  }
  
  //RZCU_2
  if(aId == 0x2BB)
  {
    if(@ sysvar::Vehicle_input::Message_Counter::RZCU_2_0x2BB==1)
    {
      int current_counter;
      current_counter++;
      if(current_counter >= @sysvar::Vehicle_input::Message_Counter::Counter_unchange)
      {
        @ sysvar::Vehicle_input::Message_Counter::RZCU_2_0x2BB= 0;
        current_counter = 0;
      }
    }
    else
    {
    data[1] = E2E_Counter(data,1);
    MSG_Data[0] = 0x3B;
    MSG_Data[1] = 0x00;
    for(i = 1; i < 7; i++)
    {
      MSG_Data[i+1] = data[i];
    }
    data[0]  = E2E_CRC8(MSG_Data,9) + @ sysvar::Vehicle_input::Message_CRC::RZCU_2_0x2BB;
    }
  }
  
  //VCU_2_G
  if(aId == 0x4B9)
  {
    if(@ sysvar::Vehicle_input::Message_Counter::VCU_2_G_0x4B9==1)
    {
      int current_counter;
      current_counter++;
      if(current_counter >= @sysvar::Vehicle_input::Message_Counter::Counter_unchange)
      {
        @sysvar::Vehicle_input::Message_Counter::VCU_2_G_0x4B9 = 0;
        current_counter = 0;
      }
    }
    else
    {
    data[1] = E2E_Counter(data,1);
    MSG_Data[0] = 0x5D;
    MSG_Data[1] = 0x00;
    for(i = 1; i < 7; i++)
    {
      MSG_Data[i+1] = data[i];
    }
    data[0]  = E2E_CRC8(MSG_Data,9) + @sysvar::Vehicle_input::Message_CRC::VCU_2_G_0x4B9 ;
    }
  }  
  
  //VCU_COM_10
  if(aId == 0x038)
  {
    if(@sysvar::Vehicle_input::Message_Counter::VCU_COM_10_0x38==1)
    {
      int current_counter;
      current_counter++;
      if(current_counter >= @sysvar::Vehicle_input::Message_Counter::Counter_unchange)
      {
        @sysvar::Vehicle_input::Message_Counter::VCU_COM_10_0x38 = 0;
        current_counter = 0;
      }
    }
    else
    {
    data[1] = E2E_Counter(data,1);
    MSG_Data[0] = 0x68;
    MSG_Data[1] = 0x00;
    for(i = 1; i < 7; i++)
    {
      MSG_Data[i+1] = data[i];
    }
    data[0]  = E2E_CRC8(MSG_Data,9) + @sysvar::Vehicle_input::Message_CRC::VCU_COM_10_0x38;
    }
  } 
  
//RRCR_2_0x4F7
  if(aId == 0x4F7)
  {
    int CRC4F7;
    if(@sysvar::Vehicle_input::Message_Counter::RRCR_2_0x4F7==1)
    {
      int current_counter;
      current_counter++;
      if(current_counter >= @sysvar::Vehicle_input::Message_Counter::Counter_unchange)
      {
        @sysvar::Vehicle_input::Message_Counter::RRCR_2_0x4F7 = 0;
        current_counter = 0;
      }
    }
    else
    {
    data[1] = E2E_Counter(data,1);
    MSG_Data[0] = 0x47;
    MSG_Data[1] = 0x00;
    for(i = 1; i < 7; i++)
    {
      MSG_Data[i+1] = data[i];
    }
    data[0]  = E2E_CRC8(MSG_Data,9) + @sysvar::Vehicle_input::Message_CRC::RRCR_2_0x4F7;
    CRC4F7 = E2E_CRC8(MSG_Data,9);
    @sysvar::Vehicle_input::Message_CRC::RRCR_2_0x4F7_1 = E2E_CRC8(MSG_Data,9);
    if (CRC4F7 == data[0])
    {
    @sysvar::Vehicle_input::MSG::RRCR_2_0x4F7_LED = 1;
    }
    else 
    {
     @sysvar::Vehicle_input::MSG::RRCR_2_0x4F7_LED = 0;
    } 
   }
  }     
   
  //VCU_ONEBOX_11
  if(aId == 0x03B)
  {
//    byte VCU_ONEBOX_11[65]={
//      0,0,0,0,0,0,0,0,0,0, 
//      0,0,0,0,0,0,0,0,0,0,
//      0,0,0,0,0,0,0,0,0,0,
//      0,0,0,0,0,0,0,0,0,0,
//      0,0,0,0,0,0,0,0,0,0,
//      0,0,0,0,0,0,0,0,0,0,
//      0,0,0,0,0};
    if(@sysvar::Vehicle_input::Message_Counter::VCU_ONEBOX_11_0x3B==1)
    {
      int current_counter;
      current_counter++;
      if(current_counter >= @sysvar::Vehicle_input::Message_Counter::Counter_unchange)
      {
        @sysvar::Vehicle_input::Message_Counter::VCU_ONEBOX_11_0x3B= 0;
        current_counter = 0;
      }
    }
    else  
    {
    data[25] = E2E_Counter(data,25);
//VCU_ONEBOX_11[0] = 0x6C;
//VCU_ONEBOX_11[1] = 0x00;
    MSG_Data[0] = 0x6C;
    MSG_Data[1] = 0x00;
    for(i =1; i < 7; i++)
    {
      MSG_Data[i+1] = data[i+24];  
    }
//      for(i = 25; i < 63; i++)
//    {
//      VCU_ONEBOX_11[i+2] = data[i];
//    }
    data[24]  = E2E_CRC8(MSG_Data,9) + @sysvar::Vehicle_input::Message_CRC::VCU_ONEBOX_11_0x3B;
    }
  } 
  
  return 1; // don't prevent sending of the message
}