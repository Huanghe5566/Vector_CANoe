VERSION "created by canmatrix"

NS_ :

BS_:

BU_: RR LR ADCU

BO_ 328 RR_RDI_138_143: 64 RR
 SG_ RR_AzimuthAng_138 : 39|11@0+ (0.1,-90) [-90|114.7] "deg"  LR,ADCU
 SG_ RR_AzimuthAng_139 : 119|11@0+ (0.1,-90) [-90|114.7] "deg"  LR,ADCU
 SG_ RR_AzimuthAng_140 : 199|11@0+ (0.1,-90) [-90|114.7] "deg"  LR,ADCU
 SG_ RR_AzimuthAng_141 : 279|11@0+ (0.1,-90) [-90|114.7] "deg"  LR,ADCU
 SG_ RR_AzimuthAng_142 : 359|11@0+ (0.1,-90) [-90|114.7] "deg"  LR,ADCU
 SG_ RR_AzimuthAng_143 : 439|11@0+ (0.1,-90) [-90|114.7] "deg"  LR,ADCU
 SG_ RR_AzimuthSNR_138 : 51|7@0+ (0.5,0) [0|63.5] "dB"  LR,ADCU
 SG_ RR_AzimuthSNR_139 : 131|7@0+ (0.5,0) [0|63.5] "dB"  LR,ADCU
 SG_ RR_AzimuthSNR_140 : 211|7@0+ (0.5,0) [0|63.5] "dB"  LR,ADCU
 SG_ RR_AzimuthSNR_141 : 291|7@0+ (0.5,0) [0|63.5] "dB"  LR,ADCU
 SG_ RR_AzimuthSNR_142 : 371|7@0+ (0.5,0) [0|63.5] "dB"  LR,ADCU
 SG_ RR_AzimuthSNR_143 : 451|7@0+ (0.5,0) [0|63.5] "dB"  LR,ADCU
 SG_ RR_ElevationAng_138 : 44|9@0+ (0.1,-25) [-25|26.1] "deg"  LR,ADCU
 SG_ RR_ElevationAng_139 : 124|9@0+ (0.1,-25) [-25|26.1] "deg"  LR,ADCU
 SG_ RR_ElevationAng_140 : 204|9@0+ (0.1,-25) [-25|26.1] "deg"  LR,ADCU
 SG_ RR_ElevationAng_141 : 284|9@0+ (0.1,-25) [-25|26.1] "deg"  LR,ADCU
 SG_ RR_ElevationAng_142 : 364|9@0+ (0.1,-25) [-25|26.1] "deg"  LR,ADCU
 SG_ RR_ElevationAng_143 : 444|9@0+ (0.1,-25) [-25|26.1] "deg"  LR,ADCU
 SG_ RR_ElevationSNR_138 : 60|7@0+ (0.5,0) [0|63.5] "dB"  LR,ADCU
 SG_ RR_ElevationSNR_139 : 140|7@0+ (0.5,0) [0|63.5] "dB"  LR,ADCU
 SG_ RR_ElevationSNR_140 : 220|7@0+ (0.5,0) [0|63.5] "dB"  LR,ADCU
 SG_ RR_ElevationSNR_141 : 300|7@0+ (0.5,0) [0|63.5] "dB"  LR,ADCU
 SG_ RR_ElevationSNR_142 : 380|7@0+ (0.5,0) [0|63.5] "dB"  LR,ADCU
 SG_ RR_ElevationSNR_143 : 460|7@0+ (0.5,0) [0|63.5] "dB"  LR,ADCU
 SG_ RR_Range_138 : 7|12@0+ (0.0625,0) [0|255.9375] "m"  LR,ADCU
 SG_ RR_Range_139 : 87|12@0+ (0.0625,0) [0|255.9375] "m"  LR,ADCU
 SG_ RR_Range_140 : 167|12@0+ (0.0625,0) [0|255.9375] "m"  LR,ADCU
 SG_ RR_Range_141 : 247|12@0+ (0.0625,0) [0|255.9375] "m"  LR,ADCU
 SG_ RR_Range_142 : 327|12@0+ (0.0625,0) [0|255.9375] "m"  LR,ADCU
 SG_ RR_Range_143 : 407|12@0+ (0.0625,0) [0|255.9375] "m"  LR,ADCU
 SG_ RR_RCS_138 : 16|9@0+ (0.2,-51.1) [-51.1|51.1] "dBsm"  LR,ADCU
 SG_ RR_RCS_139 : 96|9@0+ (0.2,-51.1) [-51.1|51.1] "dBsm"  LR,ADCU
 SG_ RR_RCS_140 : 176|9@0+ (0.2,-51.1) [-51.1|51.1] "dBsm"  LR,ADCU
 SG_ RR_RCS_141 : 256|9@0+ (0.2,-51.1) [-51.1|51.1] "dBsm"  LR,ADCU
 SG_ RR_RCS_142 : 336|9@0+ (0.2,-51.1) [-51.1|51.1] "dBsm"  LR,ADCU
 SG_ RR_RCS_143 : 416|9@0+ (0.2,-51.1) [-51.1|51.1] "dBsm"  LR,ADCU
 SG_ RR_RDI_138_143_AliveCounter : 499|4@0+ (1,0) [0|15] ""  LR,ADCU
 SG_ RR_RDI_138_143_CheckSum : 511|8@0+ (1,0) [0|255] ""  LR,ADCU
 SG_ RR_Status_138 : 79|8@0+ (1,0) [0|255] ""  ADCU
 SG_ RR_Status_139 : 159|8@0+ (1,0) [0|255] ""  ADCU
 SG_ RR_Status_140 : 239|8@0+ (1,0) [0|255] ""  ADCU
 SG_ RR_Status_141 : 319|8@0+ (1,0) [0|255] ""  ADCU
 SG_ RR_Status_142 : 399|8@0+ (1,0) [0|255] ""  ADCU
 SG_ RR_Status_143 : 479|8@0+ (1,0) [0|255] ""  ADCU
 SG_ RR_Tbd_138 : 69|6@0+ (1,0) [0|63] ""  ADCU
 SG_ RR_Tbd_139 : 149|6@0+ (1,0) [0|63] ""  ADCU
 SG_ RR_Tbd_140 : 229|6@0+ (1,0) [0|63] ""  ADCU
 SG_ RR_Tbd_141 : 309|6@0+ (1,0) [0|63] ""  ADCU
 SG_ RR_Tbd_142 : 389|6@0+ (1,0) [0|63] ""  ADCU
 SG_ RR_Tbd_143 : 469|6@0+ (1,0) [0|63] ""  ADCU
 SG_ RR_Velocity_138 : 11|11@0+ (0.05,-60) [-60|42.35] "m/s"  LR,ADCU
 SG_ RR_Velocity_139 : 91|11@0+ (0.05,-60) [-60|42.35] "m/s"  LR,ADCU
 SG_ RR_Velocity_140 : 171|11@0+ (0.05,-60) [-60|42.35] "m/s"  LR,ADCU
 SG_ RR_Velocity_141 : 251|11@0+ (0.05,-60) [-60|42.35] "m/s"  LR,ADCU
 SG_ RR_Velocity_142 : 331|11@0+ (0.05,-60) [-60|42.35] "m/s"  LR,ADCU
 SG_ RR_Velocity_143 : 411|11@0+ (0.05,-60) [-60|42.35] "m/s"  LR,ADCU

BO_ 329 RR_RDI_144_149: 64 RR
 SG_ RR_AzimuthAng_144 : 39|11@0+ (0.1,-90) [-90|114.7] "deg"  LR,ADCU
 SG_ RR_AzimuthAng_145 : 119|11@0+ (0.1,-90) [-90|114.7] "deg"  LR,ADCU
 SG_ RR_AzimuthAng_146 : 199|11@0+ (0.1,-90) [-90|114.7] "deg"  LR,ADCU
 SG_ RR_AzimuthAng_147 : 279|11@0+ (0.1,-90) [-90|114.7] "deg"  LR,ADCU
 SG_ RR_AzimuthAng_148 : 359|11@0+ (0.1,-90) [-90|114.7] "deg"  LR,ADCU
 SG_ RR_AzimuthAng_149 : 439|11@0+ (0.1,-90) [-90|114.7] "deg"  LR,ADCU
 SG_ RR_AzimuthSNR_144 : 51|7@0+ (0.5,0) [0|63.5] "dB"  LR,ADCU
 SG_ RR_AzimuthSNR_145 : 131|7@0+ (0.5,0) [0|63.5] "dB"  LR,ADCU
 SG_ RR_AzimuthSNR_146 : 211|7@0+ (0.5,0) [0|63.5] "dB"  LR,ADCU
 SG_ RR_AzimuthSNR_147 : 291|7@0+ (0.5,0) [0|63.5] "dB"  LR,ADCU
 SG_ RR_AzimuthSNR_148 : 371|7@0+ (0.5,0) [0|63.5] "dB"  LR,ADCU
 SG_ RR_AzimuthSNR_149 : 451|7@0+ (0.5,0) [0|63.5] "dB"  LR,ADCU
 SG_ RR_ElevationAng_144 : 44|9@0+ (0.1,-25) [-25|26.1] "deg"  LR,ADCU
 SG_ RR_ElevationAng_145 : 124|9@0+ (0.1,-25) [-25|26.1] "deg"  LR,ADCU
 SG_ RR_ElevationAng_146 : 204|9@0+ (0.1,-25) [-25|26.1] "deg"  LR,ADCU
 SG_ RR_ElevationAng_147 : 284|9@0+ (0.1,-25) [-25|26.1] "deg"  LR,ADCU
 SG_ RR_ElevationAng_148 : 364|9@0+ (0.1,-25) [-25|26.1] "deg"  LR,ADCU
 SG_ RR_ElevationAng_149 : 444|9@0+ (0.1,-25) [-25|26.1] "deg"  LR,ADCU
 SG_ RR_ElevationSNR_144 : 60|7@0+ (0.5,0) [0|63.5] "dB"  LR,ADCU
 SG_ RR_ElevationSNR_145 : 140|7@0+ (0.5,0) [0|63.5] "dB"  LR,ADCU
 SG_ RR_ElevationSNR_146 : 220|7@0+ (0.5,0) [0|63.5] "dB"  LR,ADCU
 SG_ RR_ElevationSNR_147 : 300|7@0+ (0.5,0) [0|63.5] "dB"  LR,ADCU
 SG_ RR_ElevationSNR_148 : 380|7@0+ (0.5,0) [0|63.5] "dB"  LR,ADCU
 SG_ RR_ElevationSNR_149 : 460|7@0+ (0.5,0) [0|63.5] "dB"  LR,ADCU
 SG_ RR_Range_144 : 7|12@0+ (0.0625,0) [0|255.9375] "m"  LR,ADCU
 SG_ RR_Range_145 : 87|12@0+ (0.0625,0) [0|255.9375] "m"  LR,ADCU
 SG_ RR_Range_146 : 167|12@0+ (0.0625,0) [0|255.9375] "m"  LR,ADCU
 SG_ RR_Range_147 : 247|12@0+ (0.0625,0) [0|255.9375] "m"  LR,ADCU
 SG_ RR_Range_148 : 327|12@0+ (0.0625,0) [0|255.9375] "m"  LR,ADCU
 SG_ RR_Range_149 : 407|12@0+ (0.0625,0) [0|255.9375] "m"  LR,ADCU
 SG_ RR_RCS_144 : 16|9@0+ (0.2,-51.1) [-51.1|51.1] "dBsm"  LR,ADCU
 SG_ RR_RCS_145 : 96|9@0+ (0.2,-51.1) [-51.1|51.1] "dBsm"  LR,ADCU
 SG_ RR_RCS_146 : 176|9@0+ (0.2,-51.1) [-51.1|51.1] "dBsm"  LR,ADCU
 SG_ RR_RCS_147 : 256|9@0+ (0.2,-51.1) [-51.1|51.1] "dBsm"  LR,ADCU
 SG_ RR_RCS_148 : 336|9@0+ (0.2,-51.1) [-51.1|51.1] "dBsm"  LR,ADCU
 SG_ RR_RCS_149 : 416|9@0+ (0.2,-51.1) [-51.1|51.1] "dBsm"  LR,ADCU
 SG_ RR_RDI_144_149_AliveCounter : 499|4@0+ (1,0) [0|15] ""  LR,ADCU
 SG_ RR_RDI_144_149_CheckSum : 511|8@0+ (1,0) [0|255] ""  LR,ADCU
 SG_ RR_Status_144 : 79|8@0+ (1,0) [0|255] ""  ADCU
 SG_ RR_Status_145 : 159|8@0+ (1,0) [0|255] ""  ADCU
 SG_ RR_Status_146 : 239|8@0+ (1,0) [0|255] ""  ADCU
 SG_ RR_Status_147 : 319|8@0+ (1,0) [0|255] ""  ADCU
 SG_ RR_Status_148 : 399|8@0+ (1,0) [0|255] ""  ADCU
 SG_ RR_Status_149 : 479|8@0+ (1,0) [0|255] ""  ADCU
 SG_ RR_Tbd_144 : 69|6@0+ (1,0) [0|63] ""  ADCU
 SG_ RR_Tbd_145 : 149|6@0+ (1,0) [0|63] ""  ADCU
 SG_ RR_Tbd_146 : 229|6@0+ (1,0) [0|63] ""  ADCU
 SG_ RR_Tbd_147 : 309|6@0+ (1,0) [0|63] ""  ADCU
 SG_ RR_Tbd_148 : 389|6@0+ (1,0) [0|63] ""  ADCU
 SG_ RR_Tbd_149 : 469|6@0+ (1,0) [0|63] ""  ADCU
 SG_ RR_Velocity_144 : 11|11@0+ (0.05,-60) [-60|42.35] "m/s"  LR,ADCU
 SG_ RR_Velocity_145 : 91|11@0+ (0.05,-60) [-60|42.35] "m/s"  LR,ADCU
 SG_ RR_Velocity_146 : 171|11@0+ (0.05,-60) [-60|42.35] "m/s"  LR,ADCU
 SG_ RR_Velocity_147 : 251|11@0+ (0.05,-60) [-60|42.35] "m/s"  LR,ADCU
 SG_ RR_Velocity_148 : 331|11@0+ (0.05,-60) [-60|42.35] "m/s"  LR,ADCU
 SG_ RR_Velocity_149 : 411|11@0+ (0.05,-60) [-60|42.35] "m/s"  LR,ADCU

BO_ 330 RR_RDI_150_155: 64 RR
 SG_ RR_AzimuthAng_150 : 39|11@0+ (0.1,-90) [-90|114.7] "deg"  LR,ADCU
 SG_ RR_AzimuthAng_151 : 119|11@0+ (0.1,-90) [-90|114.7] "deg"  LR,ADCU
 SG_ RR_AzimuthAng_152 : 199|11@0+ (0.1,-90) [-90|114.7] "deg"  LR,ADCU
 SG_ RR_AzimuthAng_153 : 279|11@0+ (0.1,-90) [-90|114.7] "deg"  LR,ADCU
 SG_ RR_AzimuthAng_154 : 359|11@0+ (0.1,-90) [-90|114.7] "deg"  LR,ADCU
 SG_ RR_AzimuthAng_155 : 439|11@0+ (0.1,-90) [-90|114.7] "deg"  LR,ADCU
 SG_ RR_AzimuthSNR_150 : 51|7@0+ (0.5,0) [0|63.5] "dB"  LR,ADCU
 SG_ RR_AzimuthSNR_151 : 131|7@0+ (0.5,0) [0|63.5] "dB"  LR,ADCU
 SG_ RR_AzimuthSNR_152 : 211|7@0+ (0.5,0) [0|63.5] "dB"  LR,ADCU
 SG_ RR_AzimuthSNR_153 : 291|7@0+ (0.5,0) [0|63.5] "dB"  LR,ADCU
 SG_ RR_AzimuthSNR_154 : 371|7@0+ (0.5,0) [0|63.5] "dB"  LR,ADCU
 SG_ RR_AzimuthSNR_155 : 451|7@0+ (0.5,0) [0|63.5] "dB"  LR,ADCU
 SG_ RR_ElevationAng_150 : 44|9@0+ (0.1,-25) [-25|26.1] "deg"  LR,ADCU
 SG_ RR_ElevationAng_151 : 124|9@0+ (0.1,-25) [-25|26.1] "deg"  LR,ADCU
 SG_ RR_ElevationAng_152 : 204|9@0+ (0.1,-25) [-25|26.1] "deg"  LR,ADCU
 SG_ RR_ElevationAng_153 : 284|9@0+ (0.1,-25) [-25|26.1] "deg"  LR,ADCU
 SG_ RR_ElevationAng_154 : 364|9@0+ (0.1,-25) [-25|26.1] "deg"  LR,ADCU
 SG_ RR_ElevationAng_155 : 444|9@0+ (0.1,-25) [-25|26.1] "deg"  LR,ADCU
 SG_ RR_ElevationSNR_150 : 60|7@0+ (0.5,0) [0|63.5] "dB"  LR,ADCU
 SG_ RR_ElevationSNR_151 : 140|7@0+ (0.5,0) [0|63.5] "dB"  LR,ADCU
 SG_ RR_ElevationSNR_152 : 220|7@0+ (0.5,0) [0|63.5] "dB"  LR,ADCU
 SG_ RR_ElevationSNR_153 : 300|7@0+ (0.5,0) [0|63.5] "dB"  LR,ADCU
 SG_ RR_ElevationSNR_154 : 380|7@0+ (0.5,0) [0|63.5] "dB"  LR,ADCU
 SG_ RR_ElevationSNR_155 : 460|7@0+ (0.5,0) [0|63.5] "dB"  LR,ADCU
 SG_ RR_Range_150 : 7|12@0+ (0.0625,0) [0|255.9375] "m"  LR,ADCU
 SG_ RR_Range_151 : 87|12@0+ (0.0625,0) [0|255.9375] "m"  LR,ADCU
 SG_ RR_Range_152 : 167|12@0+ (0.0625,0) [0|255.9375] "m"  LR,ADCU
 SG_ RR_Range_153 : 247|12@0+ (0.0625,0) [0|255.9375] "m"  LR,ADCU
 SG_ RR_Range_154 : 327|12@0+ (0.0625,0) [0|255.9375] "m"  LR,ADCU
 SG_ RR_Range_155 : 407|12@0+ (0.0625,0) [0|255.9375] "m"  LR,ADCU
 SG_ RR_RCS_150 : 16|9@0+ (0.2,-51.1) [-51.1|51.1] "dBsm"  LR,ADCU
 SG_ RR_RCS_151 : 96|9@0+ (0.2,-51.1) [-51.1|51.1] "dBsm"  LR,ADCU
 SG_ RR_RCS_152 : 176|9@0+ (0.2,-51.1) [-51.1|51.1] "dBsm"  LR,ADCU
 SG_ RR_RCS_153 : 256|9@0+ (0.2,-51.1) [-51.1|51.1] "dBsm"  LR,ADCU
 SG_ RR_RCS_154 : 336|9@0+ (0.2,-51.1) [-51.1|51.1] "dBsm"  LR,ADCU
 SG_ RR_RCS_155 : 416|9@0+ (0.2,-51.1) [-51.1|51.1] "dBsm"  LR,ADCU
 SG_ RR_RDI_150_155_AliveCounter : 499|4@0+ (1,0) [0|15] ""  LR,ADCU
 SG_ RR_RDI_150_155_CheckSum : 511|8@0+ (1,0) [0|255] ""  LR,ADCU
 SG_ RR_Status_150 : 79|8@0+ (1,0) [0|255] ""  ADCU
 SG_ RR_Status_151 : 159|8@0+ (1,0) [0|255] ""  ADCU
 SG_ RR_Status_152 : 239|8@0+ (1,0) [0|255] ""  ADCU
 SG_ RR_Status_153 : 319|8@0+ (1,0) [0|255] ""  ADCU
 SG_ RR_Status_154 : 399|8@0+ (1,0) [0|255] ""  ADCU
 SG_ RR_Status_155 : 479|8@0+ (1,0) [0|255] ""  ADCU
 SG_ RR_Tbd_150 : 69|6@0+ (1,0) [0|63] ""  ADCU
 SG_ RR_Tbd_151 : 149|6@0+ (1,0) [0|63] ""  ADCU
 SG_ RR_Tbd_152 : 229|6@0+ (1,0) [0|63] ""  ADCU
 SG_ RR_Tbd_153 : 309|6@0+ (1,0) [0|63] ""  ADCU
 SG_ RR_Tbd_154 : 389|6@0+ (1,0) [0|63] ""  ADCU
 SG_ RR_Tbd_155 : 469|6@0+ (1,0) [0|63] ""  ADCU
 SG_ RR_Velocity_150 : 11|11@0+ (0.05,-60) [-60|42.35] "m/s"  LR,ADCU
 SG_ RR_Velocity_151 : 91|11@0+ (0.05,-60) [-60|42.35] "m/s"  LR,ADCU
 SG_ RR_Velocity_152 : 171|11@0+ (0.05,-60) [-60|42.35] "m/s"  LR,ADCU
 SG_ RR_Velocity_153 : 251|11@0+ (0.05,-60) [-60|42.35] "m/s"  LR,ADCU
 SG_ RR_Velocity_154 : 331|11@0+ (0.05,-60) [-60|42.35] "m/s"  LR,ADCU
 SG_ RR_Velocity_155 : 411|11@0+ (0.05,-60) [-60|42.35] "m/s"  LR,ADCU

BO_ 331 RR_RDI_156_161: 64 RR
 SG_ RR_AzimuthAng_156 : 39|11@0+ (0.1,-90) [-90|114.7] "deg"  LR,ADCU
 SG_ RR_AzimuthAng_157 : 119|11@0+ (0.1,-90) [-90|114.7] "deg"  LR,ADCU
 SG_ RR_AzimuthAng_158 : 199|11@0+ (0.1,-90) [-90|114.7] "deg"  LR,ADCU
 SG_ RR_AzimuthAng_159 : 279|11@0+ (0.1,-90) [-90|114.7] "deg"  LR,ADCU
 SG_ RR_AzimuthAng_160 : 359|11@0+ (0.1,-90) [-90|114.7] "deg"  LR,ADCU
 SG_ RR_AzimuthAng_161 : 439|11@0+ (0.1,-90) [-90|114.7] "deg"  LR,ADCU
 SG_ RR_AzimuthSNR_156 : 51|7@0+ (0.5,0) [0|63.5] "dB"  LR,ADCU
 SG_ RR_AzimuthSNR_157 : 131|7@0+ (0.5,0) [0|63.5] "dB"  LR,ADCU
 SG_ RR_AzimuthSNR_158 : 211|7@0+ (0.5,0) [0|63.5] "dB"  LR,ADCU
 SG_ RR_AzimuthSNR_159 : 291|7@0+ (0.5,0) [0|63.5] "dB"  LR,ADCU
 SG_ RR_AzimuthSNR_160 : 371|7@0+ (0.5,0) [0|63.5] "dB"  LR,ADCU
 SG_ RR_AzimuthSNR_161 : 451|7@0+ (0.5,0) [0|63.5] "dB"  LR,ADCU
 SG_ RR_ElevationAng_156 : 44|9@0+ (0.1,-25) [-25|26.1] "deg"  LR,ADCU
 SG_ RR_ElevationAng_157 : 124|9@0+ (0.1,-25) [-25|26.1] "deg"  LR,ADCU
 SG_ RR_ElevationAng_158 : 204|9@0+ (0.1,-25) [-25|26.1] "deg"  LR,ADCU
 SG_ RR_ElevationAng_159 : 284|9@0+ (0.1,-25) [-25|26.1] "deg"  LR,ADCU
 SG_ RR_ElevationAng_160 : 364|9@0+ (0.1,-25) [-25|26.1] "deg"  LR,ADCU
 SG_ RR_ElevationAng_161 : 444|9@0+ (0.1,-25) [-25|26.1] "deg"  LR,ADCU
 SG_ RR_ElevationSNR_156 : 60|7@0+ (0.5,0) [0|63.5] "dB"  LR,ADCU
 SG_ RR_ElevationSNR_157 : 140|7@0+ (0.5,0) [0|63.5] "dB"  LR,ADCU
 SG_ RR_ElevationSNR_158 : 220|7@0+ (0.5,0) [0|63.5] "dB"  LR,ADCU
 SG_ RR_ElevationSNR_159 : 300|7@0+ (0.5,0) [0|63.5] "dB"  LR,ADCU
 SG_ RR_ElevationSNR_160 : 380|7@0+ (0.5,0) [0|63.5] "dB"  LR,ADCU
 SG_ RR_ElevationSNR_161 : 460|7@0+ (0.5,0) [0|63.5] "dB"  LR,ADCU
 SG_ RR_Range_156 : 7|12@0+ (0.0625,0) [0|255.9375] "m"  LR,ADCU
 SG_ RR_Range_157 : 87|12@0+ (0.0625,0) [0|255.9375] "m"  LR,ADCU
 SG_ RR_Range_158 : 167|12@0+ (0.0625,0) [0|255.9375] "m"  LR,ADCU
 SG_ RR_Range_159 : 247|12@0+ (0.0625,0) [0|255.9375] "m"  LR,ADCU
 SG_ RR_Range_160 : 327|12@0+ (0.0625,0) [0|255.9375] "m"  LR,ADCU
 SG_ RR_Range_161 : 407|12@0+ (0.0625,0) [0|255.9375] "m"  LR,ADCU
 SG_ RR_RCS_156 : 16|9@0+ (0.2,-51.1) [-51.1|51.1] "dBsm"  LR,ADCU
 SG_ RR_RCS_157 : 96|9@0+ (0.2,-51.1) [-51.1|51.1] "dBsm"  LR,ADCU
 SG_ RR_RCS_158 : 176|9@0+ (0.2,-51.1) [-51.1|51.1] "dBsm"  LR,ADCU
 SG_ RR_RCS_159 : 256|9@0+ (0.2,-51.1) [-51.1|51.1] "dBsm"  LR,ADCU
 SG_ RR_RCS_160 : 336|9@0+ (0.2,-51.1) [-51.1|51.1] "dBsm"  LR,ADCU
 SG_ RR_RCS_161 : 416|9@0+ (0.2,-51.1) [-51.1|51.1] "dBsm"  LR,ADCU
 SG_ RR_RDI_156_161_AliveCounter : 499|4@0+ (1,0) [0|15] ""  LR,ADCU
 SG_ RR_RDI_156_161_CheckSum : 511|8@0+ (1,0) [0|255] ""  LR,ADCU
 SG_ RR_Status_156 : 79|8@0+ (1,0) [0|255] ""  ADCU
 SG_ RR_Status_157 : 159|8@0+ (1,0) [0|255] ""  ADCU
 SG_ RR_Status_158 : 239|8@0+ (1,0) [0|255] ""  ADCU
 SG_ RR_Status_159 : 319|8@0+ (1,0) [0|255] ""  ADCU
 SG_ RR_Status_160 : 399|8@0+ (1,0) [0|255] ""  ADCU
 SG_ RR_Status_161 : 479|8@0+ (1,0) [0|255] ""  ADCU
 SG_ RR_Tbd_156 : 69|6@0+ (1,0) [0|63] ""  ADCU
 SG_ RR_Tbd_157 : 149|6@0+ (1,0) [0|63] ""  ADCU
 SG_ RR_Tbd_158 : 229|6@0+ (1,0) [0|63] ""  ADCU
 SG_ RR_Tbd_159 : 309|6@0+ (1,0) [0|63] ""  ADCU
 SG_ RR_Tbd_160 : 389|6@0+ (1,0) [0|63] ""  ADCU
 SG_ RR_Tbd_161 : 469|6@0+ (1,0) [0|63] ""  ADCU
 SG_ RR_Velocity_156 : 11|11@0+ (0.05,-60) [-60|42.35] "m/s"  LR,ADCU
 SG_ RR_Velocity_157 : 91|11@0+ (0.05,-60) [-60|42.35] "m/s"  LR,ADCU
 SG_ RR_Velocity_158 : 171|11@0+ (0.05,-60) [-60|42.35] "m/s"  LR,ADCU
 SG_ RR_Velocity_159 : 251|11@0+ (0.05,-60) [-60|42.35] "m/s"  LR,ADCU
 SG_ RR_Velocity_160 : 331|11@0+ (0.05,-60) [-60|42.35] "m/s"  LR,ADCU
 SG_ RR_Velocity_161 : 411|11@0+ (0.05,-60) [-60|42.35] "m/s"  LR,ADCU

BO_ 332 RR_RDI_162_167: 64 RR
 SG_ RR_AzimuthAng_162 : 39|11@0+ (0.1,-90) [-90|114.7] "deg"  LR,ADCU
 SG_ RR_AzimuthAng_163 : 119|11@0+ (0.1,-90) [-90|114.7] "deg"  LR,ADCU
 SG_ RR_AzimuthAng_164 : 199|11@0+ (0.1,-90) [-90|114.7] "deg"  LR,ADCU
 SG_ RR_AzimuthAng_165 : 279|11@0+ (0.1,-90) [-90|114.7] "deg"  LR,ADCU
 SG_ RR_AzimuthAng_166 : 359|11@0+ (0.1,-90) [-90|114.7] "deg"  LR,ADCU
 SG_ RR_AzimuthAng_167 : 439|11@0+ (0.1,-90) [-90|114.7] "deg"  LR,ADCU
 SG_ RR_AzimuthSNR_162 : 51|7@0+ (0.5,0) [0|63.5] "dB"  LR,ADCU
 SG_ RR_AzimuthSNR_163 : 131|7@0+ (0.5,0) [0|63.5] "dB"  LR,ADCU
 SG_ RR_AzimuthSNR_164 : 211|7@0+ (0.5,0) [0|63.5] "dB"  LR,ADCU
 SG_ RR_AzimuthSNR_165 : 291|7@0+ (0.5,0) [0|63.5] "dB"  LR,ADCU
 SG_ RR_AzimuthSNR_166 : 371|7@0+ (0.5,0) [0|63.5] "dB"  LR,ADCU
 SG_ RR_AzimuthSNR_167 : 451|7@0+ (0.5,0) [0|63.5] "dB"  LR,ADCU
 SG_ RR_ElevationAng_162 : 44|9@0+ (0.1,-25) [-25|26.1] "deg"  LR,ADCU
 SG_ RR_ElevationAng_163 : 124|9@0+ (0.1,-25) [-25|26.1] "deg"  LR,ADCU
 SG_ RR_ElevationAng_164 : 204|9@0+ (0.1,-25) [-25|26.1] "deg"  LR,ADCU
 SG_ RR_ElevationAng_165 : 284|9@0+ (0.1,-25) [-25|26.1] "deg"  LR,ADCU
 SG_ RR_ElevationAng_166 : 364|9@0+ (0.1,-25) [-25|26.1] "deg"  LR,ADCU
 SG_ RR_ElevationAng_167 : 444|9@0+ (0.1,-25) [-25|26.1] "deg"  LR,ADCU
 SG_ RR_ElevationSNR_162 : 60|7@0+ (0.5,0) [0|63.5] "dB"  LR,ADCU
 SG_ RR_ElevationSNR_163 : 140|7@0+ (0.5,0) [0|63.5] "dB"  LR,ADCU
 SG_ RR_ElevationSNR_164 : 220|7@0+ (0.5,0) [0|63.5] "dB"  LR,ADCU
 SG_ RR_ElevationSNR_165 : 300|7@0+ (0.5,0) [0|63.5] "dB"  LR,ADCU
 SG_ RR_ElevationSNR_166 : 380|7@0+ (0.5,0) [0|63.5] "dB"  LR,ADCU
 SG_ RR_ElevationSNR_167 : 460|7@0+ (0.5,0) [0|63.5] "dB"  LR,ADCU
 SG_ RR_Range_162 : 7|12@0+ (0.0625,0) [0|255.9375] "m"  LR,ADCU
 SG_ RR_Range_163 : 87|12@0+ (0.0625,0) [0|255.9375] "m"  LR,ADCU
 SG_ RR_Range_164 : 167|12@0+ (0.0625,0) [0|255.9375] "m"  LR,ADCU
 SG_ RR_Range_165 : 247|12@0+ (0.0625,0) [0|255.9375] "m"  LR,ADCU
 SG_ RR_Range_166 : 327|12@0+ (0.0625,0) [0|255.9375] "m"  LR,ADCU
 SG_ RR_Range_167 : 407|12@0+ (0.0625,0) [0|255.9375] "m"  LR,ADCU
 SG_ RR_RCS_162 : 16|9@0+ (0.2,-51.1) [-51.1|51.1] "dBsm"  LR,ADCU
 SG_ RR_RCS_163 : 96|9@0+ (0.2,-51.1) [-51.1|51.1] "dBsm"  LR,ADCU
 SG_ RR_RCS_164 : 176|9@0+ (0.2,-51.1) [-51.1|51.1] "dBsm"  LR,ADCU
 SG_ RR_RCS_165 : 256|9@0+ (0.2,-51.1) [-51.1|51.1] "dBsm"  LR,ADCU
 SG_ RR_RCS_166 : 336|9@0+ (0.2,-51.1) [-51.1|51.1] "dBsm"  LR,ADCU
 SG_ RR_RCS_167 : 416|9@0+ (0.2,-51.1) [-51.1|51.1] "dBsm"  LR,ADCU
 SG_ RR_RDI_162_167_AliveCounter : 499|4@0+ (1,0) [0|15] ""  LR,ADCU
 SG_ RR_RDI_162_167_CheckSum : 511|8@0+ (1,0) [0|255] ""  LR,ADCU
 SG_ RR_Status_162 : 79|8@0+ (1,0) [0|255] ""  ADCU
 SG_ RR_Status_163 : 159|8@0+ (1,0) [0|255] ""  ADCU
 SG_ RR_Status_164 : 239|8@0+ (1,0) [0|255] ""  ADCU
 SG_ RR_Status_165 : 319|8@0+ (1,0) [0|255] ""  ADCU
 SG_ RR_Status_166 : 399|8@0+ (1,0) [0|255] ""  ADCU
 SG_ RR_Status_167 : 479|8@0+ (1,0) [0|255] ""  ADCU
 SG_ RR_Tbd_162 : 69|6@0+ (1,0) [0|63] ""  ADCU
 SG_ RR_Tbd_163 : 149|6@0+ (1,0) [0|63] ""  ADCU
 SG_ RR_Tbd_164 : 229|6@0+ (1,0) [0|63] ""  ADCU
 SG_ RR_Tbd_165 : 309|6@0+ (1,0) [0|63] ""  ADCU
 SG_ RR_Tbd_166 : 389|6@0+ (1,0) [0|63] ""  ADCU
 SG_ RR_Tbd_167 : 469|6@0+ (1,0) [0|63] ""  ADCU
 SG_ RR_Velocity_162 : 11|11@0+ (0.05,-60) [-60|42.35] "m/s"  LR,ADCU
 SG_ RR_Velocity_163 : 91|11@0+ (0.05,-60) [-60|42.35] "m/s"  LR,ADCU
 SG_ RR_Velocity_164 : 171|11@0+ (0.05,-60) [-60|42.35] "m/s"  LR,ADCU
 SG_ RR_Velocity_165 : 251|11@0+ (0.05,-60) [-60|42.35] "m/s"  LR,ADCU
 SG_ RR_Velocity_166 : 331|11@0+ (0.05,-60) [-60|42.35] "m/s"  LR,ADCU
 SG_ RR_Velocity_167 : 411|11@0+ (0.05,-60) [-60|42.35] "m/s"  LR,ADCU

BO_ 333 RR_RDI_168_173: 64 RR
 SG_ RR_AzimuthAng_168 : 39|11@0+ (0.1,-90) [-90|114.7] "deg"  LR,ADCU
 SG_ RR_AzimuthAng_169 : 119|11@0+ (0.1,-90) [-90|114.7] "deg"  LR,ADCU
 SG_ RR_AzimuthAng_170 : 199|11@0+ (0.1,-90) [-90|114.7] "deg"  LR,ADCU
 SG_ RR_AzimuthAng_171 : 279|11@0+ (0.1,-90) [-90|114.7] "deg"  LR,ADCU
 SG_ RR_AzimuthAng_172 : 359|11@0+ (0.1,-90) [-90|114.7] "deg"  LR,ADCU
 SG_ RR_AzimuthAng_173 : 439|11@0+ (0.1,-90) [-90|114.7] "deg"  LR,ADCU
 SG_ RR_AzimuthSNR_168 : 51|7@0+ (0.5,0) [0|63.5] "dB"  LR,ADCU
 SG_ RR_AzimuthSNR_169 : 131|7@0+ (0.5,0) [0|63.5] "dB"  LR,ADCU
 SG_ RR_AzimuthSNR_170 : 211|7@0+ (0.5,0) [0|63.5] "dB"  LR,ADCU
 SG_ RR_AzimuthSNR_171 : 291|7@0+ (0.5,0) [0|63.5] "dB"  LR,ADCU
 SG_ RR_AzimuthSNR_172 : 371|7@0+ (0.5,0) [0|63.5] "dB"  LR,ADCU
 SG_ RR_AzimuthSNR_173 : 451|7@0+ (0.5,0) [0|63.5] "dB"  LR,ADCU
 SG_ RR_ElevationAng_168 : 44|9@0+ (0.1,-25) [-25|26.1] "deg"  LR,ADCU
 SG_ RR_ElevationAng_169 : 124|9@0+ (0.1,-25) [-25|26.1] "deg"  LR,ADCU
 SG_ RR_ElevationAng_170 : 204|9@0+ (0.1,-25) [-25|26.1] "deg"  LR,ADCU
 SG_ RR_ElevationAng_171 : 284|9@0+ (0.1,-25) [-25|26.1] "deg"  LR,ADCU
 SG_ RR_ElevationAng_172 : 364|9@0+ (0.1,-25) [-25|26.1] "deg"  LR,ADCU
 SG_ RR_ElevationAng_173 : 444|9@0+ (0.1,-25) [-25|26.1] "deg"  LR,ADCU
 SG_ RR_ElevationSNR_168 : 60|7@0+ (0.5,0) [0|63.5] "dB"  LR,ADCU
 SG_ RR_ElevationSNR_169 : 140|7@0+ (0.5,0) [0|63.5] "dB"  LR,ADCU
 SG_ RR_ElevationSNR_170 : 220|7@0+ (0.5,0) [0|63.5] "dB"  LR,ADCU
 SG_ RR_ElevationSNR_171 : 300|7@0+ (0.5,0) [0|63.5] "dB"  LR,ADCU
 SG_ RR_ElevationSNR_172 : 380|7@0+ (0.5,0) [0|63.5] "dB"  LR,ADCU
 SG_ RR_ElevationSNR_173 : 460|7@0+ (0.5,0) [0|63.5] "dB"  LR,ADCU
 SG_ RR_Range_168 : 7|12@0+ (0.0625,0) [0|255.9375] "m"  LR,ADCU
 SG_ RR_Range_169 : 87|12@0+ (0.0625,0) [0|255.9375] "m"  LR,ADCU
 SG_ RR_Range_170 : 167|12@0+ (0.0625,0) [0|255.9375] "m"  LR,ADCU
 SG_ RR_Range_171 : 247|12@0+ (0.0625,0) [0|255.9375] "m"  LR,ADCU
 SG_ RR_Range_172 : 327|12@0+ (0.0625,0) [0|255.9375] "m"  LR,ADCU
 SG_ RR_Range_173 : 407|12@0+ (0.0625,0) [0|255.9375] "m"  LR,ADCU
 SG_ RR_RCS_168 : 16|9@0+ (0.2,-51.1) [-51.1|51.1] "dBsm"  LR,ADCU
 SG_ RR_RCS_169 : 96|9@0+ (0.2,-51.1) [-51.1|51.1] "dBsm"  LR,ADCU
 SG_ RR_RCS_170 : 176|9@0+ (0.2,-51.1) [-51.1|51.1] "dBsm"  LR,ADCU
 SG_ RR_RCS_171 : 256|9@0+ (0.2,-51.1) [-51.1|51.1] "dBsm"  LR,ADCU
 SG_ RR_RCS_172 : 336|9@0+ (0.2,-51.1) [-51.1|51.1] "dBsm"  LR,ADCU
 SG_ RR_RCS_173 : 416|9@0+ (0.2,-51.1) [-51.1|51.1] "dBsm"  LR,ADCU
 SG_ RR_RDI_168_173_AliveCounter : 499|4@0+ (1,0) [0|15] ""  LR,ADCU
 SG_ RR_RDI_168_173_CheckSum : 511|8@0+ (1,0) [0|255] ""  LR,ADCU
 SG_ RR_Status_168 : 79|8@0+ (1,0) [0|255] ""  ADCU
 SG_ RR_Status_169 : 159|8@0+ (1,0) [0|255] ""  ADCU
 SG_ RR_Status_170 : 239|8@0+ (1,0) [0|255] ""  ADCU
 SG_ RR_Status_171 : 319|8@0+ (1,0) [0|255] ""  ADCU
 SG_ RR_Status_172 : 399|8@0+ (1,0) [0|255] ""  ADCU
 SG_ RR_Status_173 : 479|8@0+ (1,0) [0|255] ""  ADCU
 SG_ RR_Tbd_168 : 69|6@0+ (1,0) [0|63] ""  ADCU
 SG_ RR_Tbd_169 : 149|6@0+ (1,0) [0|63] ""  ADCU
 SG_ RR_Tbd_170 : 229|6@0+ (1,0) [0|63] ""  ADCU
 SG_ RR_Tbd_171 : 309|6@0+ (1,0) [0|63] ""  ADCU
 SG_ RR_Tbd_172 : 389|6@0+ (1,0) [0|63] ""  ADCU
 SG_ RR_Tbd_173 : 469|6@0+ (1,0) [0|63] ""  ADCU
 SG_ RR_Velocity_168 : 11|11@0+ (0.05,-60) [-60|42.35] "m/s"  LR,ADCU
 SG_ RR_Velocity_169 : 91|11@0+ (0.05,-60) [-60|42.35] "m/s"  LR,ADCU
 SG_ RR_Velocity_170 : 171|11@0+ (0.05,-60) [-60|42.35] "m/s"  LR,ADCU
 SG_ RR_Velocity_171 : 251|11@0+ (0.05,-60) [-60|42.35] "m/s"  LR,ADCU
 SG_ RR_Velocity_172 : 331|11@0+ (0.05,-60) [-60|42.35] "m/s"  LR,ADCU
 SG_ RR_Velocity_173 : 411|11@0+ (0.05,-60) [-60|42.35] "m/s"  LR,ADCU

BO_ 334 RR_RDI_174_179: 64 RR
 SG_ RR_AzimuthAng_174 : 39|11@0+ (0.1,-90) [-90|114.7] "deg"  LR,ADCU
 SG_ RR_AzimuthAng_175 : 119|11@0+ (0.1,-90) [-90|114.7] "deg"  LR,ADCU
 SG_ RR_AzimuthAng_176 : 199|11@0+ (0.1,-90) [-90|114.7] "deg"  LR,ADCU
 SG_ RR_AzimuthAng_177 : 279|11@0+ (0.1,-90) [-90|114.7] "deg"  LR,ADCU
 SG_ RR_AzimuthAng_178 : 359|11@0+ (0.1,-90) [-90|114.7] "deg"  LR,ADCU
 SG_ RR_AzimuthAng_179 : 439|11@0+ (0.1,-90) [-90|114.7] "deg"  LR,ADCU
 SG_ RR_AzimuthSNR_174 : 51|7@0+ (0.5,0) [0|63.5] "dB"  LR,ADCU
 SG_ RR_AzimuthSNR_175 : 131|7@0+ (0.5,0) [0|63.5] "dB"  LR,ADCU
 SG_ RR_AzimuthSNR_176 : 211|7@0+ (0.5,0) [0|63.5] "dB"  LR,ADCU
 SG_ RR_AzimuthSNR_177 : 291|7@0+ (0.5,0) [0|63.5] "dB"  LR,ADCU
 SG_ RR_AzimuthSNR_178 : 371|7@0+ (0.5,0) [0|63.5] "dB"  LR,ADCU
 SG_ RR_AzimuthSNR_179 : 451|7@0+ (0.5,0) [0|63.5] "dB"  LR,ADCU
 SG_ RR_ElevationAng_174 : 44|9@0+ (0.1,-25) [-25|26.1] "deg"  LR,ADCU
 SG_ RR_ElevationAng_175 : 124|9@0+ (0.1,-25) [-25|26.1] "deg"  LR,ADCU
 SG_ RR_ElevationAng_176 : 204|9@0+ (0.1,-25) [-25|26.1] "deg"  LR,ADCU
 SG_ RR_ElevationAng_177 : 284|9@0+ (0.1,-25) [-25|26.1] "deg"  LR,ADCU
 SG_ RR_ElevationAng_178 : 364|9@0+ (0.1,-25) [-25|26.1] "deg"  LR,ADCU
 SG_ RR_ElevationAng_179 : 444|9@0+ (0.1,-25) [-25|26.1] "deg"  LR,ADCU
 SG_ RR_ElevationSNR_174 : 60|7@0+ (0.5,0) [0|63.5] "dB"  LR,ADCU
 SG_ RR_ElevationSNR_175 : 140|7@0+ (0.5,0) [0|63.5] "dB"  LR,ADCU
 SG_ RR_ElevationSNR_176 : 220|7@0+ (0.5,0) [0|63.5] "dB"  LR,ADCU
 SG_ RR_ElevationSNR_177 : 300|7@0+ (0.5,0) [0|63.5] "dB"  LR,ADCU
 SG_ RR_ElevationSNR_178 : 380|7@0+ (0.5,0) [0|63.5] "dB"  LR,ADCU
 SG_ RR_ElevationSNR_179 : 460|7@0+ (0.5,0) [0|63.5] "dB"  LR,ADCU
 SG_ RR_Range_174 : 7|12@0+ (0.0625,0) [0|255.9375] "m"  LR,ADCU
 SG_ RR_Range_175 : 87|12@0+ (0.0625,0) [0|255.9375] "m"  LR,ADCU
 SG_ RR_Range_176 : 167|12@0+ (0.0625,0) [0|255.9375] "m"  LR,ADCU
 SG_ RR_Range_177 : 247|12@0+ (0.0625,0) [0|255.9375] "m"  LR,ADCU
 SG_ RR_Range_178 : 327|12@0+ (0.0625,0) [0|255.9375] "m"  LR,ADCU
 SG_ RR_Range_179 : 407|12@0+ (0.0625,0) [0|255.9375] "m"  LR,ADCU
 SG_ RR_RCS_174 : 16|9@0+ (0.2,-51.1) [-51.1|51.1] "dBsm"  LR,ADCU
 SG_ RR_RCS_175 : 96|9@0+ (0.2,-51.1) [-51.1|51.1] "dBsm"  LR,ADCU
 SG_ RR_RCS_176 : 176|9@0+ (0.2,-51.1) [-51.1|51.1] "dBsm"  LR,ADCU
 SG_ RR_RCS_177 : 256|9@0+ (0.2,-51.1) [-51.1|51.1] "dBsm"  LR,ADCU
 SG_ RR_RCS_178 : 336|9@0+ (0.2,-51.1) [-51.1|51.1] "dBsm"  LR,ADCU
 SG_ RR_RCS_179 : 416|9@0+ (0.2,-51.1) [-51.1|51.1] "dBsm"  LR,ADCU
 SG_ RR_RDI_174_179_AliveCounter : 499|4@0+ (1,0) [0|15] ""  LR,ADCU
 SG_ RR_RDI_174_179_CheckSum : 511|8@0+ (1,0) [0|255] ""  LR,ADCU
 SG_ RR_Status_174 : 79|8@0+ (1,0) [0|255] ""  ADCU
 SG_ RR_Status_175 : 159|8@0+ (1,0) [0|255] ""  ADCU
 SG_ RR_Status_176 : 239|8@0+ (1,0) [0|255] ""  ADCU
 SG_ RR_Status_177 : 319|8@0+ (1,0) [0|255] ""  ADCU
 SG_ RR_Status_178 : 399|8@0+ (1,0) [0|255] ""  ADCU
 SG_ RR_Status_179 : 479|8@0+ (1,0) [0|255] ""  ADCU
 SG_ RR_Tbd_174 : 69|6@0+ (1,0) [0|63] ""  ADCU
 SG_ RR_Tbd_175 : 149|6@0+ (1,0) [0|63] ""  ADCU
 SG_ RR_Tbd_176 : 229|6@0+ (1,0) [0|63] ""  ADCU
 SG_ RR_Tbd_177 : 309|6@0+ (1,0) [0|63] ""  ADCU
 SG_ RR_Tbd_178 : 389|6@0+ (1,0) [0|63] ""  ADCU
 SG_ RR_Tbd_179 : 469|6@0+ (1,0) [0|63] ""  ADCU
 SG_ RR_Velocity_174 : 11|11@0+ (0.05,-60) [-60|42.35] "m/s"  LR,ADCU
 SG_ RR_Velocity_175 : 91|11@0+ (0.05,-60) [-60|42.35] "m/s"  LR,ADCU
 SG_ RR_Velocity_176 : 171|11@0+ (0.05,-60) [-60|42.35] "m/s"  LR,ADCU
 SG_ RR_Velocity_177 : 251|11@0+ (0.05,-60) [-60|42.35] "m/s"  LR,ADCU
 SG_ RR_Velocity_178 : 331|11@0+ (0.05,-60) [-60|42.35] "m/s"  LR,ADCU
 SG_ RR_Velocity_179 : 411|11@0+ (0.05,-60) [-60|42.35] "m/s"  LR,ADCU

BO_ 335 RR_RDI_180_185: 64 RR
 SG_ RR_AzimuthAng_180 : 39|11@0+ (0.1,-90) [-90|114.7] "deg"  LR,ADCU
 SG_ RR_AzimuthAng_181 : 119|11@0+ (0.1,-90) [-90|114.7] "deg"  LR,ADCU
 SG_ RR_AzimuthAng_182 : 199|11@0+ (0.1,-90) [-90|114.7] "deg"  LR,ADCU
 SG_ RR_AzimuthAng_183 : 279|11@0+ (0.1,-90) [-90|114.7] "deg"  LR,ADCU
 SG_ RR_AzimuthAng_184 : 359|11@0+ (0.1,-90) [-90|114.7] "deg"  LR,ADCU
 SG_ RR_AzimuthAng_185 : 439|11@0+ (0.1,-90) [-90|114.7] "deg"  LR,ADCU
 SG_ RR_AzimuthSNR_180 : 51|7@0+ (0.5,0) [0|63.5] "dB"  LR,ADCU
 SG_ RR_AzimuthSNR_181 : 131|7@0+ (0.5,0) [0|63.5] "dB"  LR,ADCU
 SG_ RR_AzimuthSNR_182 : 211|7@0+ (0.5,0) [0|63.5] "dB"  LR,ADCU
 SG_ RR_AzimuthSNR_183 : 291|7@0+ (0.5,0) [0|63.5] "dB"  LR,ADCU
 SG_ RR_AzimuthSNR_184 : 371|7@0+ (0.5,0) [0|63.5] "dB"  LR,ADCU
 SG_ RR_AzimuthSNR_185 : 451|7@0+ (0.5,0) [0|63.5] "dB"  LR,ADCU
 SG_ RR_ElevationAng_180 : 44|9@0+ (0.1,-25) [-25|26.1] "deg"  LR,ADCU
 SG_ RR_ElevationAng_181 : 124|9@0+ (0.1,-25) [-25|26.1] "deg"  LR,ADCU
 SG_ RR_ElevationAng_182 : 204|9@0+ (0.1,-25) [-25|26.1] "deg"  LR,ADCU
 SG_ RR_ElevationAng_183 : 284|9@0+ (0.1,-25) [-25|26.1] "deg"  LR,ADCU
 SG_ RR_ElevationAng_184 : 364|9@0+ (0.1,-25) [-25|26.1] "deg"  LR,ADCU
 SG_ RR_ElevationAng_185 : 444|9@0+ (0.1,-25) [-25|26.1] "deg"  LR,ADCU
 SG_ RR_ElevationSNR_180 : 60|7@0+ (0.5,0) [0|63.5] "dB"  LR,ADCU
 SG_ RR_ElevationSNR_181 : 140|7@0+ (0.5,0) [0|63.5] "dB"  LR,ADCU
 SG_ RR_ElevationSNR_182 : 220|7@0+ (0.5,0) [0|63.5] "dB"  LR,ADCU
 SG_ RR_ElevationSNR_183 : 300|7@0+ (0.5,0) [0|63.5] "dB"  LR,ADCU
 SG_ RR_ElevationSNR_184 : 380|7@0+ (0.5,0) [0|63.5] "dB"  LR,ADCU
 SG_ RR_ElevationSNR_185 : 460|7@0+ (0.5,0) [0|63.5] "dB"  LR,ADCU
 SG_ RR_Range_180 : 7|12@0+ (0.0625,0) [0|255.9375] "m"  LR,ADCU
 SG_ RR_Range_181 : 87|12@0+ (0.0625,0) [0|255.9375] "m"  LR,ADCU
 SG_ RR_Range_182 : 167|12@0+ (0.0625,0) [0|255.9375] "m"  LR,ADCU
 SG_ RR_Range_183 : 247|12@0+ (0.0625,0) [0|255.9375] "m"  LR,ADCU
 SG_ RR_Range_184 : 327|12@0+ (0.0625,0) [0|255.9375] "m"  LR,ADCU
 SG_ RR_Range_185 : 407|12@0+ (0.0625,0) [0|255.9375] "m"  LR,ADCU
 SG_ RR_RCS_180 : 16|9@0+ (0.2,-51.1) [-51.1|51.1] "dBsm"  LR,ADCU
 SG_ RR_RCS_181 : 96|9@0+ (0.2,-51.1) [-51.1|51.1] "dBsm"  LR,ADCU
 SG_ RR_RCS_182 : 176|9@0+ (0.2,-51.1) [-51.1|51.1] "dBsm"  LR,ADCU
 SG_ RR_RCS_183 : 256|9@0+ (0.2,-51.1) [-51.1|51.1] "dBsm"  LR,ADCU
 SG_ RR_RCS_184 : 336|9@0+ (0.2,-51.1) [-51.1|51.1] "dBsm"  LR,ADCU
 SG_ RR_RCS_185 : 416|9@0+ (0.2,-51.1) [-51.1|51.1] "dBsm"  LR,ADCU
 SG_ RR_RDI_180_185_AliveCounter : 499|4@0+ (1,0) [0|15] ""  LR,ADCU
 SG_ RR_RDI_180_185_CheckSum : 511|8@0+ (1,0) [0|255] ""  LR,ADCU
 SG_ RR_Status_180 : 79|8@0+ (1,0) [0|255] ""  ADCU
 SG_ RR_Status_181 : 159|8@0+ (1,0) [0|255] ""  ADCU
 SG_ RR_Status_182 : 239|8@0+ (1,0) [0|255] ""  ADCU
 SG_ RR_Status_183 : 319|8@0+ (1,0) [0|255] ""  ADCU
 SG_ RR_Status_184 : 399|8@0+ (1,0) [0|255] ""  ADCU
 SG_ RR_Status_185 : 479|8@0+ (1,0) [0|255] ""  ADCU
 SG_ RR_Tbd_180 : 69|6@0+ (1,0) [0|63] ""  ADCU
 SG_ RR_Tbd_181 : 149|6@0+ (1,0) [0|63] ""  ADCU
 SG_ RR_Tbd_182 : 229|6@0+ (1,0) [0|63] ""  ADCU
 SG_ RR_Tbd_183 : 309|6@0+ (1,0) [0|63] ""  ADCU
 SG_ RR_Tbd_184 : 389|6@0+ (1,0) [0|63] ""  ADCU
 SG_ RR_Tbd_185 : 469|6@0+ (1,0) [0|63] ""  ADCU
 SG_ RR_Velocity_180 : 11|11@0+ (0.05,-60) [-60|42.35] "m/s"  LR,ADCU
 SG_ RR_Velocity_181 : 91|11@0+ (0.05,-60) [-60|42.35] "m/s"  LR,ADCU
 SG_ RR_Velocity_182 : 171|11@0+ (0.05,-60) [-60|42.35] "m/s"  LR,ADCU
 SG_ RR_Velocity_183 : 251|11@0+ (0.05,-60) [-60|42.35] "m/s"  LR,ADCU
 SG_ RR_Velocity_184 : 331|11@0+ (0.05,-60) [-60|42.35] "m/s"  LR,ADCU
 SG_ RR_Velocity_185 : 411|11@0+ (0.05,-60) [-60|42.35] "m/s"  LR,ADCU

BO_ 336 RR_RDI_E_000_020: 64 RR
 SG_ RR_P00_Pxx_000 : 7|8@0+ (1,0) [0|255] ""  LR,ADCU
 SG_ RR_P00_Pxx_001 : 15|8@0+ (1,0) [0|255] ""  LR,ADCU
 SG_ RR_P00_Pxx_002 : 23|8@0+ (1,0) [0|255] ""  LR,ADCU
 SG_ RR_P00_Pxx_003 : 31|8@0+ (1,0) [0|255] ""  LR,ADCU
 SG_ RR_P00_Pxx_004 : 39|8@0+ (1,0) [0|255] ""  LR,ADCU
 SG_ RR_P00_Pxx_005 : 47|8@0+ (1,0) [0|255] ""  LR,ADCU
 SG_ RR_P00_Pxx_006 : 55|8@0+ (1,0) [0|255] ""  LR,ADCU
 SG_ RR_P00_Pxx_007 : 63|8@0+ (1,0) [0|255] ""  LR,ADCU
 SG_ RR_P00_Pxx_008 : 71|8@0+ (1,0) [0|255] ""  LR,ADCU
 SG_ RR_P00_Pxx_009 : 79|8@0+ (1,0) [0|255] ""  LR,ADCU
 SG_ RR_P00_Pxx_010 : 87|8@0+ (1,0) [0|255] ""  LR,ADCU
 SG_ RR_P00_Pxx_011 : 95|8@0+ (1,0) [0|255] ""  LR,ADCU
 SG_ RR_P00_Pxx_012 : 103|8@0+ (1,0) [0|255] ""  LR,ADCU
 SG_ RR_P00_Pxx_013 : 111|8@0+ (1,0) [0|255] ""  LR,ADCU
 SG_ RR_P00_Pxx_014 : 119|8@0+ (1,0) [0|255] ""  LR,ADCU
 SG_ RR_P00_Pxx_015 : 127|8@0+ (1,0) [0|255] ""  LR,ADCU
 SG_ RR_P00_Pxx_016 : 135|8@0+ (1,0) [0|255] ""  LR,ADCU
 SG_ RR_P00_Pxx_017 : 143|8@0+ (1,0) [0|255] ""  LR,ADCU
 SG_ RR_P00_Pxx_018 : 151|8@0+ (1,0) [0|255] ""  LR,ADCU
 SG_ RR_P00_Pxx_019 : 159|8@0+ (1,0) [0|255] ""  LR,ADCU
 SG_ RR_P00_Pxx_020 : 167|8@0+ (1,0) [0|255] ""  LR,ADCU
 SG_ RR_P12_Pxx_000 : 175|8@0+ (1,0) [0|255] ""  LR,ADCU
 SG_ RR_P12_Pxx_001 : 183|8@0+ (1,0) [0|255] ""  LR,ADCU
 SG_ RR_P12_Pxx_002 : 191|8@0+ (1,0) [0|255] ""  LR,ADCU
 SG_ RR_P12_Pxx_003 : 199|8@0+ (1,0) [0|255] ""  LR,ADCU
 SG_ RR_P12_Pxx_004 : 207|8@0+ (1,0) [0|255] ""  LR,ADCU
 SG_ RR_P12_Pxx_005 : 215|8@0+ (1,0) [0|255] ""  LR,ADCU
 SG_ RR_P12_Pxx_006 : 223|8@0+ (1,0) [0|255] ""  LR,ADCU
 SG_ RR_P12_Pxx_007 : 231|8@0+ (1,0) [0|255] ""  LR,ADCU
 SG_ RR_P12_Pxx_008 : 239|8@0+ (1,0) [0|255] ""  LR,ADCU
 SG_ RR_P12_Pxx_009 : 247|8@0+ (1,0) [0|255] ""  LR,ADCU
 SG_ RR_P12_Pxx_010 : 255|8@0+ (1,0) [0|255] ""  LR,ADCU
 SG_ RR_P12_Pxx_011 : 263|8@0+ (1,0) [0|255] ""  LR,ADCU
 SG_ RR_P12_Pxx_012 : 271|8@0+ (1,0) [0|255] ""  LR,ADCU
 SG_ RR_P12_Pxx_013 : 279|8@0+ (1,0) [0|255] ""  LR,ADCU
 SG_ RR_P12_Pxx_014 : 287|8@0+ (1,0) [0|255] ""  LR,ADCU
 SG_ RR_P12_Pxx_015 : 295|8@0+ (1,0) [0|255] ""  LR,ADCU
 SG_ RR_P12_Pxx_016 : 303|8@0+ (1,0) [0|255] ""  LR,ADCU
 SG_ RR_P12_Pxx_017 : 311|8@0+ (1,0) [0|255] ""  LR,ADCU
 SG_ RR_P12_Pxx_018 : 319|8@0+ (1,0) [0|255] ""  LR,ADCU
 SG_ RR_P12_Pxx_019 : 327|8@0+ (1,0) [0|255] ""  LR,ADCU
 SG_ RR_P12_Pxx_020 : 335|8@0+ (1,0) [0|255] ""  LR,ADCU
 SG_ RR_P1_P2_000 : 343|8@0+ (1,0) [0|255] ""  LR,ADCU
 SG_ RR_P1_P2_001 : 351|8@0+ (1,0) [0|255] ""  LR,ADCU
 SG_ RR_P1_P2_002 : 359|8@0+ (1,0) [0|255] ""  LR,ADCU
 SG_ RR_P1_P2_003 : 367|8@0+ (1,0) [0|255] ""  LR,ADCU
 SG_ RR_P1_P2_004 : 375|8@0+ (1,0) [0|255] ""  LR,ADCU
 SG_ RR_P1_P2_005 : 383|8@0+ (1,0) [0|255] ""  LR,ADCU
 SG_ RR_P1_P2_006 : 391|8@0+ (1,0) [0|255] ""  LR,ADCU
 SG_ RR_P1_P2_007 : 399|8@0+ (1,0) [0|255] ""  LR,ADCU
 SG_ RR_P1_P2_008 : 407|8@0+ (1,0) [0|255] ""  LR,ADCU
 SG_ RR_P1_P2_009 : 415|8@0+ (1,0) [0|255] ""  LR,ADCU
 SG_ RR_P1_P2_010 : 423|8@0+ (1,0) [0|255] ""  LR,ADCU
 SG_ RR_P1_P2_011 : 431|8@0+ (1,0) [0|255] ""  LR,ADCU
 SG_ RR_P1_P2_012 : 439|8@0+ (1,0) [0|255] ""  LR,ADCU
 SG_ RR_P1_P2_013 : 447|8@0+ (1,0) [0|255] ""  LR,ADCU
 SG_ RR_P1_P2_014 : 455|8@0+ (1,0) [0|255] ""  LR,ADCU
 SG_ RR_P1_P2_015 : 463|8@0+ (1,0) [0|255] ""  LR,ADCU
 SG_ RR_P1_P2_016 : 471|8@0+ (1,0) [0|255] ""  LR,ADCU
 SG_ RR_P1_P2_017 : 479|8@0+ (1,0) [0|255] ""  LR,ADCU
 SG_ RR_P1_P2_018 : 487|8@0+ (1,0) [0|255] ""  LR,ADCU
 SG_ RR_P1_P2_019 : 495|8@0+ (1,0) [0|255] ""  LR,ADCU
 SG_ RR_P1_P2_020 : 503|8@0+ (1,0) [0|255] ""  LR,ADCU
 SG_ RR_RDI_E_000_020_AliveCounter : 511|4@0+ (1,0) [0|15] ""  RR,ADCU
 SG_ RR_RDI_E_000_020_CheckSum : 507|4@0+ (1,0) [0|15] ""  RR,ADCU

BO_ 337 RR_RDI_E_021_041: 64 RR
 SG_ RR_P00_Pxx_021 : 7|8@0+ (1,0) [0|255] ""  LR,ADCU
 SG_ RR_P00_Pxx_022 : 15|8@0+ (1,0) [0|255] ""  LR,ADCU
 SG_ RR_P00_Pxx_023 : 23|8@0+ (1,0) [0|255] ""  LR,ADCU
 SG_ RR_P00_Pxx_024 : 31|8@0+ (1,0) [0|255] ""  LR,ADCU
 SG_ RR_P00_Pxx_025 : 39|8@0+ (1,0) [0|255] ""  LR,ADCU
 SG_ RR_P00_Pxx_026 : 47|8@0+ (1,0) [0|255] ""  LR,ADCU
 SG_ RR_P00_Pxx_027 : 55|8@0+ (1,0) [0|255] ""  LR,ADCU
 SG_ RR_P00_Pxx_028 : 63|8@0+ (1,0) [0|255] ""  LR,ADCU
 SG_ RR_P00_Pxx_029 : 71|8@0+ (1,0) [0|255] ""  LR,ADCU
 SG_ RR_P00_Pxx_030 : 79|8@0+ (1,0) [0|255] ""  LR,ADCU
 SG_ RR_P00_Pxx_031 : 87|8@0+ (1,0) [0|255] ""  LR,ADCU
 SG_ RR_P00_Pxx_032 : 95|8@0+ (1,0) [0|255] ""  LR,ADCU
 SG_ RR_P00_Pxx_033 : 103|8@0+ (1,0) [0|255] ""  LR,ADCU
 SG_ RR_P00_Pxx_034 : 111|8@0+ (1,0) [0|255] ""  LR,ADCU
 SG_ RR_P00_Pxx_035 : 119|8@0+ (1,0) [0|255] ""  LR,ADCU
 SG_ RR_P00_Pxx_036 : 127|8@0+ (1,0) [0|255] ""  LR,ADCU
 SG_ RR_P00_Pxx_037 : 135|8@0+ (1,0) [0|255] ""  LR,ADCU
 SG_ RR_P00_Pxx_038 : 143|8@0+ (1,0) [0|255] ""  LR,ADCU
 SG_ RR_P00_Pxx_039 : 151|8@0+ (1,0) [0|255] ""  LR,ADCU
 SG_ RR_P00_Pxx_040 : 159|8@0+ (1,0) [0|255] ""  LR,ADCU
 SG_ RR_P00_Pxx_041 : 167|8@0+ (1,0) [0|255] ""  LR,ADCU
 SG_ RR_P12_Pxx_021 : 175|8@0+ (1,0) [0|255] ""  LR,ADCU
 SG_ RR_P12_Pxx_022 : 183|8@0+ (1,0) [0|255] ""  LR,ADCU
 SG_ RR_P12_Pxx_023 : 191|8@0+ (1,0) [0|255] ""  LR,ADCU
 SG_ RR_P12_Pxx_024 : 199|8@0+ (1,0) [0|255] ""  LR,ADCU
 SG_ RR_P12_Pxx_025 : 207|8@0+ (1,0) [0|255] ""  LR,ADCU
 SG_ RR_P12_Pxx_026 : 215|8@0+ (1,0) [0|255] ""  LR,ADCU
 SG_ RR_P12_Pxx_027 : 223|8@0+ (1,0) [0|255] ""  LR,ADCU
 SG_ RR_P12_Pxx_028 : 231|8@0+ (1,0) [0|255] ""  LR,ADCU
 SG_ RR_P12_Pxx_029 : 239|8@0+ (1,0) [0|255] ""  LR,ADCU
 SG_ RR_P12_Pxx_030 : 247|8@0+ (1,0) [0|255] ""  LR,ADCU
 SG_ RR_P12_Pxx_031 : 255|8@0+ (1,0) [0|255] ""  LR,ADCU
 SG_ RR_P12_Pxx_032 : 263|8@0+ (1,0) [0|255] ""  LR,ADCU
 SG_ RR_P12_Pxx_033 : 271|8@0+ (1,0) [0|255] ""  LR,ADCU
 SG_ RR_P12_Pxx_034 : 279|8@0+ (1,0) [0|255] ""  LR,ADCU
 SG_ RR_P12_Pxx_035 : 287|8@0+ (1,0) [0|255] ""  LR,ADCU
 SG_ RR_P12_Pxx_036 : 295|8@0+ (1,0) [0|255] ""  LR,ADCU
 SG_ RR_P12_Pxx_037 : 303|8@0+ (1,0) [0|255] ""  LR,ADCU
 SG_ RR_P12_Pxx_038 : 311|8@0+ (1,0) [0|255] ""  LR,ADCU
 SG_ RR_P12_Pxx_039 : 319|8@0+ (1,0) [0|255] ""  LR,ADCU
 SG_ RR_P12_Pxx_040 : 327|8@0+ (1,0) [0|255] ""  LR,ADCU
 SG_ RR_P12_Pxx_041 : 335|8@0+ (1,0) [0|255] ""  LR,ADCU
 SG_ RR_P1_P2_021 : 343|8@0+ (1,0) [0|255] ""  LR,ADCU
 SG_ RR_P1_P2_022 : 351|8@0+ (1,0) [0|255] ""  LR,ADCU
 SG_ RR_P1_P2_023 : 359|8@0+ (1,0) [0|255] ""  LR,ADCU
 SG_ RR_P1_P2_024 : 367|8@0+ (1,0) [0|255] ""  LR,ADCU
 SG_ RR_P1_P2_025 : 375|8@0+ (1,0) [0|255] ""  LR,ADCU
 SG_ RR_P1_P2_026 : 383|8@0+ (1,0) [0|255] ""  LR,ADCU
 SG_ RR_P1_P2_027 : 391|8@0+ (1,0) [0|255] ""  LR,ADCU
 SG_ RR_P1_P2_028 : 399|8@0+ (1,0) [0|255] ""  LR,ADCU
 SG_ RR_P1_P2_029 : 407|8@0+ (1,0) [0|255] ""  LR,ADCU
 SG_ RR_P1_P2_030 : 415|8@0+ (1,0) [0|255] ""  LR,ADCU
 SG_ RR_P1_P2_031 : 423|8@0+ (1,0) [0|255] ""  LR,ADCU
 SG_ RR_P1_P2_032 : 431|8@0+ (1,0) [0|255] ""  LR,ADCU
 SG_ RR_P1_P2_033 : 439|8@0+ (1,0) [0|255] ""  LR,ADCU
 SG_ RR_P1_P2_034 : 447|8@0+ (1,0) [0|255] ""  LR,ADCU
 SG_ RR_P1_P2_035 : 455|8@0+ (1,0) [0|255] ""  LR,ADCU
 SG_ RR_P1_P2_036 : 463|8@0+ (1,0) [0|255] ""  LR,ADCU
 SG_ RR_P1_P2_037 : 471|8@0+ (1,0) [0|255] ""  LR,ADCU
 SG_ RR_P1_P2_038 : 479|8@0+ (1,0) [0|255] ""  LR,ADCU
 SG_ RR_P1_P2_039 : 487|8@0+ (1,0) [0|255] ""  LR,ADCU
 SG_ RR_P1_P2_040 : 495|8@0+ (1,0) [0|255] ""  LR,ADCU
 SG_ RR_P1_P2_041 : 503|8@0+ (1,0) [0|255] ""  LR,ADCU
 SG_ RR_RDI_E_021_041_AliveCounter : 511|4@0+ (1,0) [0|15] ""  RR,ADCU
 SG_ RR_RDI_E_021_041_CheckSum : 507|4@0+ (1,0) [0|15] ""  RR,ADCU

BO_ 338 RR_RDI_E_042_062: 64 RR
 SG_ RR_P00_Pxx_042 : 7|8@0+ (1,0) [0|255] ""  LR,ADCU
 SG_ RR_P00_Pxx_043 : 15|8@0+ (1,0) [0|255] ""  LR,ADCU
 SG_ RR_P00_Pxx_044 : 23|8@0+ (1,0) [0|255] ""  LR,ADCU
 SG_ RR_P00_Pxx_045 : 31|8@0+ (1,0) [0|255] ""  LR,ADCU
 SG_ RR_P00_Pxx_046 : 39|8@0+ (1,0) [0|255] ""  LR,ADCU
 SG_ RR_P00_Pxx_047 : 47|8@0+ (1,0) [0|255] ""  LR,ADCU
 SG_ RR_P00_Pxx_048 : 55|8@0+ (1,0) [0|255] ""  LR,ADCU
 SG_ RR_P00_Pxx_049 : 63|8@0+ (1,0) [0|255] ""  LR,ADCU
 SG_ RR_P00_Pxx_050 : 71|8@0+ (1,0) [0|255] ""  LR,ADCU
 SG_ RR_P00_Pxx_051 : 79|8@0+ (1,0) [0|255] ""  LR,ADCU
 SG_ RR_P00_Pxx_052 : 87|8@0+ (1,0) [0|255] ""  LR,ADCU
 SG_ RR_P00_Pxx_053 : 95|8@0+ (1,0) [0|255] ""  LR,ADCU
 SG_ RR_P00_Pxx_054 : 103|8@0+ (1,0) [0|255] ""  LR,ADCU
 SG_ RR_P00_Pxx_055 : 111|8@0+ (1,0) [0|255] ""  LR,ADCU
 SG_ RR_P00_Pxx_056 : 119|8@0+ (1,0) [0|255] ""  LR,ADCU
 SG_ RR_P00_Pxx_057 : 127|8@0+ (1,0) [0|255] ""  LR,ADCU
 SG_ RR_P00_Pxx_058 : 135|8@0+ (1,0) [0|255] ""  LR,ADCU
 SG_ RR_P00_Pxx_059 : 143|8@0+ (1,0) [0|255] ""  LR,ADCU
 SG_ RR_P00_Pxx_060 : 151|8@0+ (1,0) [0|255] ""  LR,ADCU
 SG_ RR_P00_Pxx_061 : 159|8@0+ (1,0) [0|255] ""  LR,ADCU
 SG_ RR_P00_Pxx_062 : 167|8@0+ (1,0) [0|255] ""  LR,ADCU
 SG_ RR_P12_Pxx_042 : 175|8@0+ (1,0) [0|255] ""  LR,ADCU
 SG_ RR_P12_Pxx_043 : 183|8@0+ (1,0) [0|255] ""  LR,ADCU
 SG_ RR_P12_Pxx_044 : 191|8@0+ (1,0) [0|255] ""  LR,ADCU
 SG_ RR_P12_Pxx_045 : 199|8@0+ (1,0) [0|255] ""  LR,ADCU
 SG_ RR_P12_Pxx_046 : 207|8@0+ (1,0) [0|255] ""  LR,ADCU
 SG_ RR_P12_Pxx_047 : 215|8@0+ (1,0) [0|255] ""  LR,ADCU
 SG_ RR_P12_Pxx_048 : 223|8@0+ (1,0) [0|255] ""  LR,ADCU
 SG_ RR_P12_Pxx_049 : 231|8@0+ (1,0) [0|255] ""  LR,ADCU
 SG_ RR_P12_Pxx_050 : 239|8@0+ (1,0) [0|255] ""  LR,ADCU
 SG_ RR_P12_Pxx_051 : 247|8@0+ (1,0) [0|255] ""  LR,ADCU
 SG_ RR_P12_Pxx_052 : 255|8@0+ (1,0) [0|255] ""  LR,ADCU
 SG_ RR_P12_Pxx_053 : 263|8@0+ (1,0) [0|255] ""  LR,ADCU
 SG_ RR_P12_Pxx_054 : 271|8@0+ (1,0) [0|255] ""  LR,ADCU
 SG_ RR_P12_Pxx_055 : 279|8@0+ (1,0) [0|255] ""  LR,ADCU
 SG_ RR_P12_Pxx_056 : 287|8@0+ (1,0) [0|255] ""  LR,ADCU
 SG_ RR_P12_Pxx_057 : 295|8@0+ (1,0) [0|255] ""  LR,ADCU
 SG_ RR_P12_Pxx_058 : 303|8@0+ (1,0) [0|255] ""  LR,ADCU
 SG_ RR_P12_Pxx_059 : 311|8@0+ (1,0) [0|255] ""  LR,ADCU
 SG_ RR_P12_Pxx_060 : 319|8@0+ (1,0) [0|255] ""  LR,ADCU
 SG_ RR_P12_Pxx_061 : 327|8@0+ (1,0) [0|255] ""  LR,ADCU
 SG_ RR_P12_Pxx_062 : 335|8@0+ (1,0) [0|255] ""  LR,ADCU
 SG_ RR_P1_P2_042 : 343|8@0+ (1,0) [0|255] ""  LR,ADCU
 SG_ RR_P1_P2_043 : 351|8@0+ (1,0) [0|255] ""  LR,ADCU
 SG_ RR_P1_P2_044 : 359|8@0+ (1,0) [0|255] ""  LR,ADCU
 SG_ RR_P1_P2_045 : 367|8@0+ (1,0) [0|255] ""  LR,ADCU
 SG_ RR_P1_P2_046 : 375|8@0+ (1,0) [0|255] ""  LR,ADCU
 SG_ RR_P1_P2_047 : 383|8@0+ (1,0) [0|255] ""  LR,ADCU
 SG_ RR_P1_P2_048 : 391|8@0+ (1,0) [0|255] ""  LR,ADCU
 SG_ RR_P1_P2_049 : 399|8@0+ (1,0) [0|255] ""  LR,ADCU
 SG_ RR_P1_P2_050 : 407|8@0+ (1,0) [0|255] ""  LR,ADCU
 SG_ RR_P1_P2_051 : 415|8@0+ (1,0) [0|255] ""  LR,ADCU
 SG_ RR_P1_P2_052 : 423|8@0+ (1,0) [0|255] ""  LR,ADCU
 SG_ RR_P1_P2_053 : 431|8@0+ (1,0) [0|255] ""  LR,ADCU
 SG_ RR_P1_P2_054 : 439|8@0+ (1,0) [0|255] ""  LR,ADCU
 SG_ RR_P1_P2_055 : 447|8@0+ (1,0) [0|255] ""  LR,ADCU
 SG_ RR_P1_P2_056 : 455|8@0+ (1,0) [0|255] ""  LR,ADCU
 SG_ RR_P1_P2_057 : 463|8@0+ (1,0) [0|255] ""  LR,ADCU
 SG_ RR_P1_P2_058 : 471|8@0+ (1,0) [0|255] ""  LR,ADCU
 SG_ RR_P1_P2_059 : 479|8@0+ (1,0) [0|255] ""  LR,ADCU
 SG_ RR_P1_P2_060 : 487|8@0+ (1,0) [0|255] ""  LR,ADCU
 SG_ RR_P1_P2_061 : 495|8@0+ (1,0) [0|255] ""  LR,ADCU
 SG_ RR_P1_P2_062 : 503|8@0+ (1,0) [0|255] ""  LR,ADCU
 SG_ RR_RDI_E_042_062_AliveCounter : 511|4@0+ (1,0) [0|15] ""  RR,ADCU
 SG_ RR_RDI_E_042_062_CheckSum : 507|4@0+ (1,0) [0|15] ""  RR,ADCU

BO_ 339 RR_RDI_E_063_083: 64 RR
 SG_ RR_P00_Pxx_063 : 7|8@0+ (1,0) [0|255] ""  LR,ADCU
 SG_ RR_P00_Pxx_064 : 15|8@0+ (1,0) [0|255] ""  LR,ADCU
 SG_ RR_P00_Pxx_065 : 23|8@0+ (1,0) [0|255] ""  LR,ADCU
 SG_ RR_P00_Pxx_066 : 31|8@0+ (1,0) [0|255] ""  LR,ADCU
 SG_ RR_P00_Pxx_067 : 39|8@0+ (1,0) [0|255] ""  LR,ADCU
 SG_ RR_P00_Pxx_068 : 47|8@0+ (1,0) [0|255] ""  LR,ADCU
 SG_ RR_P00_Pxx_069 : 55|8@0+ (1,0) [0|255] ""  LR,ADCU
 SG_ RR_P00_Pxx_070 : 63|8@0+ (1,0) [0|255] ""  LR,ADCU
 SG_ RR_P00_Pxx_071 : 71|8@0+ (1,0) [0|255] ""  LR,ADCU
 SG_ RR_P00_Pxx_072 : 79|8@0+ (1,0) [0|255] ""  LR,ADCU
 SG_ RR_P00_Pxx_073 : 87|8@0+ (1,0) [0|255] ""  LR,ADCU
 SG_ RR_P00_Pxx_074 : 95|8@0+ (1,0) [0|255] ""  LR,ADCU
 SG_ RR_P00_Pxx_075 : 103|8@0+ (1,0) [0|255] ""  LR,ADCU
 SG_ RR_P00_Pxx_076 : 111|8@0+ (1,0) [0|255] ""  LR,ADCU
 SG_ RR_P00_Pxx_077 : 119|8@0+ (1,0) [0|255] ""  LR,ADCU
 SG_ RR_P00_Pxx_078 : 127|8@0+ (1,0) [0|255] ""  LR,ADCU
 SG_ RR_P00_Pxx_079 : 135|8@0+ (1,0) [0|255] ""  LR,ADCU
 SG_ RR_P00_Pxx_080 : 143|8@0+ (1,0) [0|255] ""  LR,ADCU
 SG_ RR_P00_Pxx_081 : 151|8@0+ (1,0) [0|255] ""  LR,ADCU
 SG_ RR_P00_Pxx_082 : 159|8@0+ (1,0) [0|255] ""  LR,ADCU
 SG_ RR_P00_Pxx_083 : 167|8@0+ (1,0) [0|255] ""  LR,ADCU
 SG_ RR_P12_Pxx_063 : 175|8@0+ (1,0) [0|255] ""  LR,ADCU
 SG_ RR_P12_Pxx_064 : 183|8@0+ (1,0) [0|255] ""  LR,ADCU
 SG_ RR_P12_Pxx_065 : 191|8@0+ (1,0) [0|255] ""  LR,ADCU
 SG_ RR_P12_Pxx_066 : 199|8@0+ (1,0) [0|255] ""  LR,ADCU
 SG_ RR_P12_Pxx_067 : 207|8@0+ (1,0) [0|255] ""  LR,ADCU
 SG_ RR_P12_Pxx_068 : 215|8@0+ (1,0) [0|255] ""  LR,ADCU
 SG_ RR_P12_Pxx_069 : 223|8@0+ (1,0) [0|255] ""  LR,ADCU
 SG_ RR_P12_Pxx_070 : 231|8@0+ (1,0) [0|255] ""  LR,ADCU
 SG_ RR_P12_Pxx_071 : 239|8@0+ (1,0) [0|255] ""  LR,ADCU
 SG_ RR_P12_Pxx_072 : 247|8@0+ (1,0) [0|255] ""  LR,ADCU
 SG_ RR_P12_Pxx_073 : 255|8@0+ (1,0) [0|255] ""  LR,ADCU
 SG_ RR_P12_Pxx_074 : 263|8@0+ (1,0) [0|255] ""  LR,ADCU
 SG_ RR_P12_Pxx_075 : 271|8@0+ (1,0) [0|255] ""  LR,ADCU
 SG_ RR_P12_Pxx_076 : 279|8@0+ (1,0) [0|255] ""  LR,ADCU
 SG_ RR_P12_Pxx_077 : 287|8@0+ (1,0) [0|255] ""  LR,ADCU
 SG_ RR_P12_Pxx_078 : 295|8@0+ (1,0) [0|255] ""  LR,ADCU
 SG_ RR_P12_Pxx_079 : 303|8@0+ (1,0) [0|255] ""  LR,ADCU
 SG_ RR_P12_Pxx_080 : 311|8@0+ (1,0) [0|255] ""  LR,ADCU
 SG_ RR_P12_Pxx_081 : 319|8@0+ (1,0) [0|255] ""  LR,ADCU
 SG_ RR_P12_Pxx_082 : 327|8@0+ (1,0) [0|255] ""  LR,ADCU
 SG_ RR_P12_Pxx_083 : 335|8@0+ (1,0) [0|255] ""  LR,ADCU
 SG_ RR_P1_P2_063 : 343|8@0+ (1,0) [0|255] ""  LR,ADCU
 SG_ RR_P1_P2_064 : 351|8@0+ (1,0) [0|255] ""  LR,ADCU
 SG_ RR_P1_P2_065 : 359|8@0+ (1,0) [0|255] ""  LR,ADCU
 SG_ RR_P1_P2_066 : 367|8@0+ (1,0) [0|255] ""  LR,ADCU
 SG_ RR_P1_P2_067 : 375|8@0+ (1,0) [0|255] ""  LR,ADCU
 SG_ RR_P1_P2_068 : 383|8@0+ (1,0) [0|255] ""  LR,ADCU
 SG_ RR_P1_P2_069 : 391|8@0+ (1,0) [0|255] ""  LR,ADCU
 SG_ RR_P1_P2_070 : 399|8@0+ (1,0) [0|255] ""  LR,ADCU
 SG_ RR_P1_P2_071 : 407|8@0+ (1,0) [0|255] ""  LR,ADCU
 SG_ RR_P1_P2_072 : 415|8@0+ (1,0) [0|255] ""  LR,ADCU
 SG_ RR_P1_P2_073 : 423|8@0+ (1,0) [0|255] ""  LR,ADCU
 SG_ RR_P1_P2_074 : 431|8@0+ (1,0) [0|255] ""  LR,ADCU
 SG_ RR_P1_P2_075 : 439|8@0+ (1,0) [0|255] ""  LR,ADCU
 SG_ RR_P1_P2_076 : 447|8@0+ (1,0) [0|255] ""  LR,ADCU
 SG_ RR_P1_P2_077 : 455|8@0+ (1,0) [0|255] ""  LR,ADCU
 SG_ RR_P1_P2_078 : 463|8@0+ (1,0) [0|255] ""  LR,ADCU
 SG_ RR_P1_P2_079 : 471|8@0+ (1,0) [0|255] ""  LR,ADCU
 SG_ RR_P1_P2_080 : 479|8@0+ (1,0) [0|255] ""  LR,ADCU
 SG_ RR_P1_P2_081 : 487|8@0+ (1,0) [0|255] ""  LR,ADCU
 SG_ RR_P1_P2_082 : 495|8@0+ (1,0) [0|255] ""  LR,ADCU
 SG_ RR_P1_P2_083 : 503|8@0+ (1,0) [0|255] ""  LR,ADCU
 SG_ RR_RDI_E_063_083_AliveCounter : 511|4@0+ (1,0) [0|15] ""  RR,ADCU
 SG_ RR_RDI_E_063_083_CheckSum : 507|4@0+ (1,0) [0|15] ""  RR,ADCU

BO_ 340 RR_RDI_E_084_104: 64 RR
 SG_ RR_P00_Pxx_084 : 7|8@0+ (1,0) [0|255] ""  LR,ADCU
 SG_ RR_P00_Pxx_085 : 15|8@0+ (1,0) [0|255] ""  LR,ADCU
 SG_ RR_P00_Pxx_086 : 23|8@0+ (1,0) [0|255] ""  LR,ADCU
 SG_ RR_P00_Pxx_087 : 31|8@0+ (1,0) [0|255] ""  LR,ADCU
 SG_ RR_P00_Pxx_088 : 39|8@0+ (1,0) [0|255] ""  LR,ADCU
 SG_ RR_P00_Pxx_089 : 47|8@0+ (1,0) [0|255] ""  LR,ADCU
 SG_ RR_P00_Pxx_090 : 55|8@0+ (1,0) [0|255] ""  LR,ADCU
 SG_ RR_P00_Pxx_091 : 63|8@0+ (1,0) [0|255] ""  LR,ADCU
 SG_ RR_P00_Pxx_092 : 71|8@0+ (1,0) [0|255] ""  LR,ADCU
 SG_ RR_P00_Pxx_093 : 79|8@0+ (1,0) [0|255] ""  LR,ADCU
 SG_ RR_P00_Pxx_094 : 87|8@0+ (1,0) [0|255] ""  LR,ADCU
 SG_ RR_P00_Pxx_095 : 95|8@0+ (1,0) [0|255] ""  LR,ADCU
 SG_ RR_P00_Pxx_096 : 103|8@0+ (1,0) [0|255] ""  LR,ADCU
 SG_ RR_P00_Pxx_097 : 111|8@0+ (1,0) [0|255] ""  LR,ADCU
 SG_ RR_P00_Pxx_098 : 119|8@0+ (1,0) [0|255] ""  LR,ADCU
 SG_ RR_P00_Pxx_099 : 127|8@0+ (1,0) [0|255] ""  LR,ADCU
 SG_ RR_P00_Pxx_100 : 135|8@0+ (1,0) [0|255] ""  LR,ADCU
 SG_ RR_P00_Pxx_101 : 143|8@0+ (1,0) [0|255] ""  LR,ADCU
 SG_ RR_P00_Pxx_102 : 151|8@0+ (1,0) [0|255] ""  LR,ADCU
 SG_ RR_P00_Pxx_103 : 159|8@0+ (1,0) [0|255] ""  LR,ADCU
 SG_ RR_P00_Pxx_104 : 167|8@0+ (1,0) [0|255] ""  LR,ADCU
 SG_ RR_P12_Pxx_084 : 175|8@0+ (1,0) [0|255] ""  LR,ADCU
 SG_ RR_P12_Pxx_085 : 183|8@0+ (1,0) [0|255] ""  LR,ADCU
 SG_ RR_P12_Pxx_086 : 191|8@0+ (1,0) [0|255] ""  LR,ADCU
 SG_ RR_P12_Pxx_087 : 199|8@0+ (1,0) [0|255] ""  LR,ADCU
 SG_ RR_P12_Pxx_088 : 207|8@0+ (1,0) [0|255] ""  LR,ADCU
 SG_ RR_P12_Pxx_089 : 215|8@0+ (1,0) [0|255] ""  LR,ADCU
 SG_ RR_P12_Pxx_090 : 223|8@0+ (1,0) [0|255] ""  LR,ADCU
 SG_ RR_P12_Pxx_091 : 231|8@0+ (1,0) [0|255] ""  LR,ADCU
 SG_ RR_P12_Pxx_092 : 239|8@0+ (1,0) [0|255] ""  LR,ADCU
 SG_ RR_P12_Pxx_093 : 247|8@0+ (1,0) [0|255] ""  LR,ADCU
 SG_ RR_P12_Pxx_094 : 255|8@0+ (1,0) [0|255] ""  LR,ADCU
 SG_ RR_P12_Pxx_095 : 263|8@0+ (1,0) [0|255] ""  LR,ADCU
 SG_ RR_P12_Pxx_096 : 271|8@0+ (1,0) [0|255] ""  LR,ADCU
 SG_ RR_P12_Pxx_097 : 279|8@0+ (1,0) [0|255] ""  LR,ADCU
 SG_ RR_P12_Pxx_098 : 287|8@0+ (1,0) [0|255] ""  LR,ADCU
 SG_ RR_P12_Pxx_099 : 295|8@0+ (1,0) [0|255] ""  LR,ADCU
 SG_ RR_P12_Pxx_100 : 303|8@0+ (1,0) [0|255] ""  LR,ADCU
 SG_ RR_P12_Pxx_101 : 311|8@0+ (1,0) [0|255] ""  LR,ADCU
 SG_ RR_P12_Pxx_102 : 319|8@0+ (1,0) [0|255] ""  LR,ADCU
 SG_ RR_P12_Pxx_103 : 327|8@0+ (1,0) [0|255] ""  LR,ADCU
 SG_ RR_P12_Pxx_104 : 335|8@0+ (1,0) [0|255] ""  LR,ADCU
 SG_ RR_P1_P2_084 : 343|8@0+ (1,0) [0|255] ""  LR,ADCU
 SG_ RR_P1_P2_085 : 351|8@0+ (1,0) [0|255] ""  LR,ADCU
 SG_ RR_P1_P2_086 : 359|8@0+ (1,0) [0|255] ""  LR,ADCU
 SG_ RR_P1_P2_087 : 367|8@0+ (1,0) [0|255] ""  LR,ADCU
 SG_ RR_P1_P2_088 : 375|8@0+ (1,0) [0|255] ""  LR,ADCU
 SG_ RR_P1_P2_089 : 383|8@0+ (1,0) [0|255] ""  LR,ADCU
 SG_ RR_P1_P2_090 : 391|8@0+ (1,0) [0|255] ""  LR,ADCU
 SG_ RR_P1_P2_091 : 399|8@0+ (1,0) [0|255] ""  LR,ADCU
 SG_ RR_P1_P2_092 : 407|8@0+ (1,0) [0|255] ""  LR,ADCU
 SG_ RR_P1_P2_093 : 415|8@0+ (1,0) [0|255] ""  LR,ADCU
 SG_ RR_P1_P2_094 : 423|8@0+ (1,0) [0|255] ""  LR,ADCU
 SG_ RR_P1_P2_095 : 431|8@0+ (1,0) [0|255] ""  LR,ADCU
 SG_ RR_P1_P2_096 : 439|8@0+ (1,0) [0|255] ""  LR,ADCU
 SG_ RR_P1_P2_097 : 447|8@0+ (1,0) [0|255] ""  LR,ADCU
 SG_ RR_P1_P2_098 : 455|8@0+ (1,0) [0|255] ""  LR,ADCU
 SG_ RR_P1_P2_099 : 463|8@0+ (1,0) [0|255] ""  LR,ADCU
 SG_ RR_P1_P2_100 : 471|8@0+ (1,0) [0|255] ""  LR,ADCU
 SG_ RR_P1_P2_101 : 479|8@0+ (1,0) [0|255] ""  LR,ADCU
 SG_ RR_P1_P2_102 : 487|8@0+ (1,0) [0|255] ""  LR,ADCU
 SG_ RR_P1_P2_103 : 495|8@0+ (1,0) [0|255] ""  LR,ADCU
 SG_ RR_P1_P2_104 : 503|8@0+ (1,0) [0|255] ""  LR,ADCU
 SG_ RR_RDI_E_084_104_AliveCounter : 511|4@0+ (1,0) [0|15] ""  RR,ADCU
 SG_ RR_RDI_E_084_104_CheckSum : 507|4@0+ (1,0) [0|15] ""  RR,ADCU

BO_ 341 RR_RDI_E_105_125: 64 RR
 SG_ RR_P00_Pxx_105 : 7|8@0+ (1,0) [0|255] ""  LR,ADCU
 SG_ RR_P00_Pxx_106 : 15|8@0+ (1,0) [0|255] ""  LR,ADCU
 SG_ RR_P00_Pxx_107 : 23|8@0+ (1,0) [0|255] ""  LR,ADCU
 SG_ RR_P00_Pxx_108 : 31|8@0+ (1,0) [0|255] ""  LR,ADCU
 SG_ RR_P00_Pxx_109 : 39|8@0+ (1,0) [0|255] ""  LR,ADCU
 SG_ RR_P00_Pxx_110 : 47|8@0+ (1,0) [0|255] ""  LR,ADCU
 SG_ RR_P00_Pxx_111 : 55|8@0+ (1,0) [0|255] ""  LR,ADCU
 SG_ RR_P00_Pxx_112 : 63|8@0+ (1,0) [0|255] ""  LR,ADCU
 SG_ RR_P00_Pxx_113 : 71|8@0+ (1,0) [0|255] ""  LR,ADCU
 SG_ RR_P00_Pxx_114 : 79|8@0+ (1,0) [0|255] ""  LR,ADCU
 SG_ RR_P00_Pxx_115 : 87|8@0+ (1,0) [0|255] ""  LR,ADCU
 SG_ RR_P00_Pxx_116 : 95|8@0+ (1,0) [0|255] ""  LR,ADCU
 SG_ RR_P00_Pxx_117 : 103|8@0+ (1,0) [0|255] ""  LR,ADCU
 SG_ RR_P00_Pxx_118 : 111|8@0+ (1,0) [0|255] ""  LR,ADCU
 SG_ RR_P00_Pxx_119 : 119|8@0+ (1,0) [0|255] ""  LR,ADCU
 SG_ RR_P00_Pxx_120 : 127|8@0+ (1,0) [0|255] ""  LR,ADCU
 SG_ RR_P00_Pxx_121 : 135|8@0+ (1,0) [0|255] ""  LR,ADCU
 SG_ RR_P00_Pxx_122 : 143|8@0+ (1,0) [0|255] ""  LR,ADCU
 SG_ RR_P00_Pxx_123 : 151|8@0+ (1,0) [0|255] ""  LR,ADCU
 SG_ RR_P00_Pxx_124 : 159|8@0+ (1,0) [0|255] ""  LR,ADCU
 SG_ RR_P00_Pxx_125 : 167|8@0+ (1,0) [0|255] ""  LR,ADCU
 SG_ RR_P12_Pxx_105 : 175|8@0+ (1,0) [0|255] ""  LR,ADCU
 SG_ RR_P12_Pxx_106 : 183|8@0+ (1,0) [0|255] ""  LR,ADCU
 SG_ RR_P12_Pxx_107 : 191|8@0+ (1,0) [0|255] ""  LR,ADCU
 SG_ RR_P12_Pxx_108 : 199|8@0+ (1,0) [0|255] ""  LR,ADCU
 SG_ RR_P12_Pxx_109 : 207|8@0+ (1,0) [0|255] ""  LR,ADCU
 SG_ RR_P12_Pxx_110 : 215|8@0+ (1,0) [0|255] ""  LR,ADCU
 SG_ RR_P12_Pxx_111 : 223|8@0+ (1,0) [0|255] ""  LR,ADCU
 SG_ RR_P12_Pxx_112 : 231|8@0+ (1,0) [0|255] ""  LR,ADCU
 SG_ RR_P12_Pxx_113 : 239|8@0+ (1,0) [0|255] ""  LR,ADCU
 SG_ RR_P12_Pxx_114 : 247|8@0+ (1,0) [0|255] ""  LR,ADCU
 SG_ RR_P12_Pxx_115 : 255|8@0+ (1,0) [0|255] ""  LR,ADCU
 SG_ RR_P12_Pxx_116 : 263|8@0+ (1,0) [0|255] ""  LR,ADCU
 SG_ RR_P12_Pxx_117 : 271|8@0+ (1,0) [0|255] ""  LR,ADCU
 SG_ RR_P12_Pxx_118 : 279|8@0+ (1,0) [0|255] ""  LR,ADCU
 SG_ RR_P12_Pxx_119 : 287|8@0+ (1,0) [0|255] ""  LR,ADCU
 SG_ RR_P12_Pxx_120 : 295|8@0+ (1,0) [0|255] ""  LR,ADCU
 SG_ RR_P12_Pxx_121 : 303|8@0+ (1,0) [0|255] ""  LR,ADCU
 SG_ RR_P12_Pxx_122 : 311|8@0+ (1,0) [0|255] ""  LR,ADCU
 SG_ RR_P12_Pxx_123 : 319|8@0+ (1,0) [0|255] ""  LR,ADCU
 SG_ RR_P12_Pxx_124 : 327|8@0+ (1,0) [0|255] ""  LR,ADCU
 SG_ RR_P12_Pxx_125 : 335|8@0+ (1,0) [0|255] ""  LR,ADCU
 SG_ RR_P1_P2_105 : 343|8@0+ (1,0) [0|255] ""  LR,ADCU
 SG_ RR_P1_P2_106 : 351|8@0+ (1,0) [0|255] ""  LR,ADCU
 SG_ RR_P1_P2_107 : 359|8@0+ (1,0) [0|255] ""  LR,ADCU
 SG_ RR_P1_P2_108 : 367|8@0+ (1,0) [0|255] ""  LR,ADCU
 SG_ RR_P1_P2_109 : 375|8@0+ (1,0) [0|255] ""  LR,ADCU
 SG_ RR_P1_P2_110 : 383|8@0+ (1,0) [0|255] ""  LR,ADCU
 SG_ RR_P1_P2_111 : 391|8@0+ (1,0) [0|255] ""  LR,ADCU
 SG_ RR_P1_P2_112 : 399|8@0+ (1,0) [0|255] ""  LR,ADCU
 SG_ RR_P1_P2_113 : 407|8@0+ (1,0) [0|255] ""  LR,ADCU
 SG_ RR_P1_P2_114 : 415|8@0+ (1,0) [0|255] ""  LR,ADCU
 SG_ RR_P1_P2_115 : 423|8@0+ (1,0) [0|255] ""  LR,ADCU
 SG_ RR_P1_P2_116 : 431|8@0+ (1,0) [0|255] ""  LR,ADCU
 SG_ RR_P1_P2_117 : 439|8@0+ (1,0) [0|255] ""  LR,ADCU
 SG_ RR_P1_P2_118 : 447|8@0+ (1,0) [0|255] ""  LR,ADCU
 SG_ RR_P1_P2_119 : 455|8@0+ (1,0) [0|255] ""  LR,ADCU
 SG_ RR_P1_P2_120 : 463|8@0+ (1,0) [0|255] ""  LR,ADCU
 SG_ RR_P1_P2_121 : 471|8@0+ (1,0) [0|255] ""  LR,ADCU
 SG_ RR_P1_P2_122 : 479|8@0+ (1,0) [0|255] ""  LR,ADCU
 SG_ RR_P1_P2_123 : 487|8@0+ (1,0) [0|255] ""  LR,ADCU
 SG_ RR_P1_P2_124 : 495|8@0+ (1,0) [0|255] ""  LR,ADCU
 SG_ RR_P1_P2_125 : 503|8@0+ (1,0) [0|255] ""  LR,ADCU
 SG_ RR_RDI_E_105_125_AliveCounter : 511|4@0+ (1,0) [0|15] ""  RR,ADCU
 SG_ RR_RDI_E_105_125_CheckSum : 507|4@0+ (1,0) [0|15] ""  RR,ADCU

BO_ 342 RR_RDI_E_126_146: 64 RR
 SG_ RR_P00_Pxx_126 : 7|8@0+ (1,0) [0|255] ""  LR,ADCU
 SG_ RR_P00_Pxx_127 : 15|8@0+ (1,0) [0|255] ""  LR,ADCU
 SG_ RR_P00_Pxx_128 : 23|8@0+ (1,0) [0|255] ""  LR,ADCU
 SG_ RR_P00_Pxx_129 : 31|8@0+ (1,0) [0|255] ""  LR,ADCU
 SG_ RR_P00_Pxx_130 : 39|8@0+ (1,0) [0|255] ""  LR,ADCU
 SG_ RR_P00_Pxx_131 : 47|8@0+ (1,0) [0|255] ""  LR,ADCU
 SG_ RR_P00_Pxx_132 : 55|8@0+ (1,0) [0|255] ""  LR,ADCU
 SG_ RR_P00_Pxx_133 : 63|8@0+ (1,0) [0|255] ""  LR,ADCU
 SG_ RR_P00_Pxx_134 : 71|8@0+ (1,0) [0|255] ""  LR,ADCU
 SG_ RR_P00_Pxx_135 : 79|8@0+ (1,0) [0|255] ""  LR,ADCU
 SG_ RR_P00_Pxx_136 : 87|8@0+ (1,0) [0|255] ""  LR,ADCU
 SG_ RR_P00_Pxx_137 : 95|8@0+ (1,0) [0|255] ""  LR,ADCU
 SG_ RR_P00_Pxx_138 : 103|8@0+ (1,0) [0|255] ""  LR,ADCU
 SG_ RR_P00_Pxx_139 : 111|8@0+ (1,0) [0|255] ""  LR,ADCU
 SG_ RR_P00_Pxx_140 : 119|8@0+ (1,0) [0|255] ""  LR,ADCU
 SG_ RR_P00_Pxx_141 : 127|8@0+ (1,0) [0|255] ""  LR,ADCU
 SG_ RR_P00_Pxx_142 : 135|8@0+ (1,0) [0|255] ""  LR,ADCU
 SG_ RR_P00_Pxx_143 : 143|8@0+ (1,0) [0|255] ""  LR,ADCU
 SG_ RR_P00_Pxx_144 : 151|8@0+ (1,0) [0|255] ""  LR,ADCU
 SG_ RR_P00_Pxx_145 : 159|8@0+ (1,0) [0|255] ""  LR,ADCU
 SG_ RR_P00_Pxx_146 : 167|8@0+ (1,0) [0|255] ""  LR,ADCU
 SG_ RR_P12_Pxx_126 : 175|8@0+ (1,0) [0|255] ""  LR,ADCU
 SG_ RR_P12_Pxx_127 : 183|8@0+ (1,0) [0|255] ""  LR,ADCU
 SG_ RR_P12_Pxx_128 : 191|8@0+ (1,0) [0|255] ""  LR,ADCU
 SG_ RR_P12_Pxx_129 : 199|8@0+ (1,0) [0|255] ""  LR,ADCU
 SG_ RR_P12_Pxx_130 : 207|8@0+ (1,0) [0|255] ""  LR,ADCU
 SG_ RR_P12_Pxx_131 : 215|8@0+ (1,0) [0|255] ""  LR,ADCU
 SG_ RR_P12_Pxx_132 : 223|8@0+ (1,0) [0|255] ""  LR,ADCU
 SG_ RR_P12_Pxx_133 : 231|8@0+ (1,0) [0|255] ""  LR,ADCU
 SG_ RR_P12_Pxx_134 : 239|8@0+ (1,0) [0|255] ""  LR,ADCU
 SG_ RR_P12_Pxx_135 : 247|8@0+ (1,0) [0|255] ""  LR,ADCU
 SG_ RR_P12_Pxx_136 : 255|8@0+ (1,0) [0|255] ""  LR,ADCU
 SG_ RR_P12_Pxx_137 : 263|8@0+ (1,0) [0|255] ""  LR,ADCU
 SG_ RR_P12_Pxx_138 : 271|8@0+ (1,0) [0|255] ""  LR,ADCU
 SG_ RR_P12_Pxx_139 : 279|8@0+ (1,0) [0|255] ""  LR,ADCU
 SG_ RR_P12_Pxx_140 : 287|8@0+ (1,0) [0|255] ""  LR,ADCU
 SG_ RR_P12_Pxx_141 : 295|8@0+ (1,0) [0|255] ""  LR,ADCU
 SG_ RR_P12_Pxx_142 : 303|8@0+ (1,0) [0|255] ""  LR,ADCU
 SG_ RR_P12_Pxx_143 : 311|8@0+ (1,0) [0|255] ""  LR,ADCU
 SG_ RR_P12_Pxx_144 : 319|8@0+ (1,0) [0|255] ""  LR,ADCU
 SG_ RR_P12_Pxx_145 : 327|8@0+ (1,0) [0|255] ""  LR,ADCU
 SG_ RR_P12_Pxx_146 : 335|8@0+ (1,0) [0|255] ""  LR,ADCU
 SG_ RR_P1_P2_126 : 343|8@0+ (1,0) [0|255] ""  LR,ADCU
 SG_ RR_P1_P2_127 : 351|8@0+ (1,0) [0|255] ""  LR,ADCU
 SG_ RR_P1_P2_128 : 359|8@0+ (1,0) [0|255] ""  LR,ADCU
 SG_ RR_P1_P2_129 : 367|8@0+ (1,0) [0|255] ""  LR,ADCU
 SG_ RR_P1_P2_130 : 375|8@0+ (1,0) [0|255] ""  LR,ADCU
 SG_ RR_P1_P2_131 : 383|8@0+ (1,0) [0|255] ""  LR,ADCU
 SG_ RR_P1_P2_132 : 391|8@0+ (1,0) [0|255] ""  LR,ADCU
 SG_ RR_P1_P2_133 : 399|8@0+ (1,0) [0|255] ""  LR,ADCU
 SG_ RR_P1_P2_134 : 407|8@0+ (1,0) [0|255] ""  LR,ADCU
 SG_ RR_P1_P2_135 : 415|8@0+ (1,0) [0|255] ""  LR,ADCU
 SG_ RR_P1_P2_136 : 423|8@0+ (1,0) [0|255] ""  LR,ADCU
 SG_ RR_P1_P2_137 : 431|8@0+ (1,0) [0|255] ""  LR,ADCU
 SG_ RR_P1_P2_138 : 439|8@0+ (1,0) [0|255] ""  LR,ADCU
 SG_ RR_P1_P2_139 : 447|8@0+ (1,0) [0|255] ""  LR,ADCU
 SG_ RR_P1_P2_140 : 455|8@0+ (1,0) [0|255] ""  LR,ADCU
 SG_ RR_P1_P2_141 : 463|8@0+ (1,0) [0|255] ""  LR,ADCU
 SG_ RR_P1_P2_142 : 471|8@0+ (1,0) [0|255] ""  LR,ADCU
 SG_ RR_P1_P2_143 : 479|8@0+ (1,0) [0|255] ""  LR,ADCU
 SG_ RR_P1_P2_144 : 487|8@0+ (1,0) [0|255] ""  LR,ADCU
 SG_ RR_P1_P2_145 : 495|8@0+ (1,0) [0|255] ""  LR,ADCU
 SG_ RR_P1_P2_146 : 503|8@0+ (1,0) [0|255] ""  LR,ADCU
 SG_ RR_RDI_E_126_146_AliveCounter : 511|4@0+ (1,0) [0|15] ""  RR,ADCU
 SG_ RR_RDI_E_126_146_CheckSum : 507|4@0+ (1,0) [0|15] ""  RR,ADCU

BO_ 343 RR_RDI_E_147_167: 64 RR
 SG_ RR_P00_Pxx_147 : 7|8@0+ (1,0) [0|255] ""  LR,ADCU
 SG_ RR_P00_Pxx_148 : 15|8@0+ (1,0) [0|255] ""  LR,ADCU
 SG_ RR_P00_Pxx_149 : 23|8@0+ (1,0) [0|255] ""  LR,ADCU
 SG_ RR_P00_Pxx_150 : 31|8@0+ (1,0) [0|255] ""  LR,ADCU
 SG_ RR_P00_Pxx_151 : 39|8@0+ (1,0) [0|255] ""  LR,ADCU
 SG_ RR_P00_Pxx_152 : 47|8@0+ (1,0) [0|255] ""  LR,ADCU
 SG_ RR_P00_Pxx_153 : 55|8@0+ (1,0) [0|255] ""  LR,ADCU
 SG_ RR_P00_Pxx_154 : 63|8@0+ (1,0) [0|255] ""  LR,ADCU
 SG_ RR_P00_Pxx_155 : 71|8@0+ (1,0) [0|255] ""  LR,ADCU
 SG_ RR_P00_Pxx_156 : 79|8@0+ (1,0) [0|255] ""  LR,ADCU
 SG_ RR_P00_Pxx_157 : 87|8@0+ (1,0) [0|255] ""  LR,ADCU
 SG_ RR_P00_Pxx_158 : 95|8@0+ (1,0) [0|255] ""  LR,ADCU
 SG_ RR_P00_Pxx_159 : 103|8@0+ (1,0) [0|255] ""  LR,ADCU
 SG_ RR_P00_Pxx_160 : 111|8@0+ (1,0) [0|255] ""  LR,ADCU
 SG_ RR_P00_Pxx_161 : 119|8@0+ (1,0) [0|255] ""  LR,ADCU
 SG_ RR_P00_Pxx_162 : 127|8@0+ (1,0) [0|255] ""  LR,ADCU
 SG_ RR_P00_Pxx_163 : 135|8@0+ (1,0) [0|255] ""  LR,ADCU
 SG_ RR_P00_Pxx_164 : 143|8@0+ (1,0) [0|255] ""  LR,ADCU
 SG_ RR_P00_Pxx_165 : 151|8@0+ (1,0) [0|255] ""  LR,ADCU
 SG_ RR_P00_Pxx_166 : 159|8@0+ (1,0) [0|255] ""  LR,ADCU
 SG_ RR_P00_Pxx_167 : 167|8@0+ (1,0) [0|255] ""  LR,ADCU
 SG_ RR_P12_Pxx_147 : 175|8@0+ (1,0) [0|255] ""  LR,ADCU
 SG_ RR_P12_Pxx_148 : 183|8@0+ (1,0) [0|255] ""  LR,ADCU
 SG_ RR_P12_Pxx_149 : 191|8@0+ (1,0) [0|255] ""  LR,ADCU
 SG_ RR_P12_Pxx_150 : 199|8@0+ (1,0) [0|255] ""  LR,ADCU
 SG_ RR_P12_Pxx_151 : 207|8@0+ (1,0) [0|255] ""  LR,ADCU
 SG_ RR_P12_Pxx_152 : 215|8@0+ (1,0) [0|255] ""  LR,ADCU
 SG_ RR_P12_Pxx_153 : 223|8@0+ (1,0) [0|255] ""  LR,ADCU
 SG_ RR_P12_Pxx_154 : 231|8@0+ (1,0) [0|255] ""  LR,ADCU
 SG_ RR_P12_Pxx_155 : 239|8@0+ (1,0) [0|255] ""  LR,ADCU
 SG_ RR_P12_Pxx_156 : 247|8@0+ (1,0) [0|255] ""  LR,ADCU
 SG_ RR_P12_Pxx_157 : 255|8@0+ (1,0) [0|255] ""  LR,ADCU
 SG_ RR_P12_Pxx_158 : 263|8@0+ (1,0) [0|255] ""  LR,ADCU
 SG_ RR_P12_Pxx_159 : 271|8@0+ (1,0) [0|255] ""  LR,ADCU
 SG_ RR_P12_Pxx_160 : 279|8@0+ (1,0) [0|255] ""  LR,ADCU
 SG_ RR_P12_Pxx_161 : 287|8@0+ (1,0) [0|255] ""  LR,ADCU
 SG_ RR_P12_Pxx_162 : 295|8@0+ (1,0) [0|255] ""  LR,ADCU
 SG_ RR_P12_Pxx_163 : 303|8@0+ (1,0) [0|255] ""  LR,ADCU
 SG_ RR_P12_Pxx_164 : 311|8@0+ (1,0) [0|255] ""  LR,ADCU
 SG_ RR_P12_Pxx_165 : 319|8@0+ (1,0) [0|255] ""  LR,ADCU
 SG_ RR_P12_Pxx_166 : 327|8@0+ (1,0) [0|255] ""  LR,ADCU
 SG_ RR_P12_Pxx_167 : 335|8@0+ (1,0) [0|255] ""  LR,ADCU
 SG_ RR_P1_P2_147 : 343|8@0+ (1,0) [0|255] ""  LR,ADCU
 SG_ RR_P1_P2_148 : 351|8@0+ (1,0) [0|255] ""  LR,ADCU
 SG_ RR_P1_P2_149 : 359|8@0+ (1,0) [0|255] ""  LR,ADCU
 SG_ RR_P1_P2_150 : 367|8@0+ (1,0) [0|255] ""  LR,ADCU
 SG_ RR_P1_P2_151 : 375|8@0+ (1,0) [0|255] ""  LR,ADCU
 SG_ RR_P1_P2_152 : 383|8@0+ (1,0) [0|255] ""  LR,ADCU
 SG_ RR_P1_P2_153 : 391|8@0+ (1,0) [0|255] ""  LR,ADCU
 SG_ RR_P1_P2_154 : 399|8@0+ (1,0) [0|255] ""  LR,ADCU
 SG_ RR_P1_P2_155 : 407|8@0+ (1,0) [0|255] ""  LR,ADCU
 SG_ RR_P1_P2_156 : 415|8@0+ (1,0) [0|255] ""  LR,ADCU
 SG_ RR_P1_P2_157 : 423|8@0+ (1,0) [0|255] ""  LR,ADCU
 SG_ RR_P1_P2_158 : 431|8@0+ (1,0) [0|255] ""  LR,ADCU
 SG_ RR_P1_P2_159 : 439|8@0+ (1,0) [0|255] ""  LR,ADCU
 SG_ RR_P1_P2_160 : 447|8@0+ (1,0) [0|255] ""  LR,ADCU
 SG_ RR_P1_P2_161 : 455|8@0+ (1,0) [0|255] ""  LR,ADCU
 SG_ RR_P1_P2_162 : 463|8@0+ (1,0) [0|255] ""  LR,ADCU
 SG_ RR_P1_P2_163 : 471|8@0+ (1,0) [0|255] ""  LR,ADCU
 SG_ RR_P1_P2_164 : 479|8@0+ (1,0) [0|255] ""  LR,ADCU
 SG_ RR_P1_P2_165 : 487|8@0+ (1,0) [0|255] ""  LR,ADCU
 SG_ RR_P1_P2_166 : 495|8@0+ (1,0) [0|255] ""  LR,ADCU
 SG_ RR_P1_P2_167 : 503|8@0+ (1,0) [0|255] ""  LR,ADCU
 SG_ RR_RDI_E_147_167_AliveCounter : 511|4@0+ (1,0) [0|15] ""  RR,ADCU
 SG_ RR_RDI_E_147_167_CheckSum : 507|4@0+ (1,0) [0|15] ""  RR,ADCU

BO_ 344 RR_RDI_E_168_185: 64 RR
 SG_ RR_P00_Pxx_168 : 7|8@0+ (1,0) [0|255] ""  LR,ADCU
 SG_ RR_P00_Pxx_169 : 15|8@0+ (1,0) [0|255] ""  LR,ADCU
 SG_ RR_P00_Pxx_170 : 23|8@0+ (1,0) [0|255] ""  LR,ADCU
 SG_ RR_P00_Pxx_171 : 31|8@0+ (1,0) [0|255] ""  LR,ADCU
 SG_ RR_P00_Pxx_172 : 39|8@0+ (1,0) [0|255] ""  LR,ADCU
 SG_ RR_P00_Pxx_173 : 47|8@0+ (1,0) [0|255] ""  LR,ADCU
 SG_ RR_P00_Pxx_174 : 55|8@0+ (1,0) [0|255] ""  LR,ADCU
 SG_ RR_P00_Pxx_175 : 63|8@0+ (1,0) [0|255] ""  LR,ADCU
 SG_ RR_P00_Pxx_176 : 71|8@0+ (1,0) [0|255] ""  LR,ADCU
 SG_ RR_P00_Pxx_177 : 79|8@0+ (1,0) [0|255] ""  LR,ADCU
 SG_ RR_P00_Pxx_178 : 87|8@0+ (1,0) [0|255] ""  LR,ADCU
 SG_ RR_P00_Pxx_179 : 95|8@0+ (1,0) [0|255] ""  LR,ADCU
 SG_ RR_P00_Pxx_180 : 103|8@0+ (1,0) [0|255] ""  LR,ADCU
 SG_ RR_P00_Pxx_181 : 111|8@0+ (1,0) [0|255] ""  LR,ADCU
 SG_ RR_P00_Pxx_182 : 119|8@0+ (1,0) [0|255] ""  LR,ADCU
 SG_ RR_P00_Pxx_183 : 127|8@0+ (1,0) [0|255] ""  LR,ADCU
 SG_ RR_P00_Pxx_184 : 135|8@0+ (1,0) [0|255] ""  LR,ADCU
 SG_ RR_P00_Pxx_185 : 143|8@0+ (1,0) [0|255] ""  LR,ADCU
 SG_ RR_P12_Pxx_168 : 151|8@0+ (1,0) [0|255] ""  LR,ADCU
 SG_ RR_P12_Pxx_169 : 159|8@0+ (1,0) [0|255] ""  LR,ADCU
 SG_ RR_P12_Pxx_170 : 167|8@0+ (1,0) [0|255] ""  LR,ADCU
 SG_ RR_P12_Pxx_171 : 175|8@0+ (1,0) [0|255] ""  LR,ADCU
 SG_ RR_P12_Pxx_172 : 183|8@0+ (1,0) [0|255] ""  LR,ADCU
 SG_ RR_P12_Pxx_173 : 191|8@0+ (1,0) [0|255] ""  LR,ADCU
 SG_ RR_P12_Pxx_174 : 199|8@0+ (1,0) [0|255] ""  LR,ADCU
 SG_ RR_P12_Pxx_175 : 207|8@0+ (1,0) [0|255] ""  LR,ADCU
 SG_ RR_P12_Pxx_176 : 215|8@0+ (1,0) [0|255] ""  LR,ADCU
 SG_ RR_P12_Pxx_177 : 223|8@0+ (1,0) [0|255] ""  LR,ADCU
 SG_ RR_P12_Pxx_178 : 231|8@0+ (1,0) [0|255] ""  LR,ADCU
 SG_ RR_P12_Pxx_179 : 239|8@0+ (1,0) [0|255] ""  LR,ADCU
 SG_ RR_P12_Pxx_180 : 247|8@0+ (1,0) [0|255] ""  LR,ADCU
 SG_ RR_P12_Pxx_181 : 255|8@0+ (1,0) [0|255] ""  LR,ADCU
 SG_ RR_P12_Pxx_182 : 263|8@0+ (1,0) [0|255] ""  LR,ADCU
 SG_ RR_P12_Pxx_183 : 271|8@0+ (1,0) [0|255] ""  LR,ADCU
 SG_ RR_P12_Pxx_184 : 279|8@0+ (1,0) [0|255] ""  LR,ADCU
 SG_ RR_P12_Pxx_185 : 287|8@0+ (1,0) [0|255] ""  LR,ADCU
 SG_ RR_P1_P2_168 : 295|8@0+ (1,0) [0|255] ""  LR,ADCU
 SG_ RR_P1_P2_169 : 303|8@0+ (1,0) [0|255] ""  LR,ADCU
 SG_ RR_P1_P2_170 : 311|8@0+ (1,0) [0|255] ""  LR,ADCU
 SG_ RR_P1_P2_171 : 319|8@0+ (1,0) [0|255] ""  LR,ADCU
 SG_ RR_P1_P2_172 : 327|8@0+ (1,0) [0|255] ""  LR,ADCU
 SG_ RR_P1_P2_173 : 335|8@0+ (1,0) [0|255] ""  LR,ADCU
 SG_ RR_P1_P2_174 : 343|8@0+ (1,0) [0|255] ""  LR,ADCU
 SG_ RR_P1_P2_175 : 351|8@0+ (1,0) [0|255] ""  LR,ADCU
 SG_ RR_P1_P2_176 : 359|8@0+ (1,0) [0|255] ""  LR,ADCU
 SG_ RR_P1_P2_177 : 367|8@0+ (1,0) [0|255] ""  LR,ADCU
 SG_ RR_P1_P2_178 : 375|8@0+ (1,0) [0|255] ""  LR,ADCU
 SG_ RR_P1_P2_179 : 383|8@0+ (1,0) [0|255] ""  LR,ADCU
 SG_ RR_P1_P2_180 : 391|8@0+ (1,0) [0|255] ""  LR,ADCU
 SG_ RR_P1_P2_181 : 399|8@0+ (1,0) [0|255] ""  LR,ADCU
 SG_ RR_P1_P2_182 : 407|8@0+ (1,0) [0|255] ""  LR,ADCU
 SG_ RR_P1_P2_183 : 415|8@0+ (1,0) [0|255] ""  LR,ADCU
 SG_ RR_P1_P2_184 : 423|8@0+ (1,0) [0|255] ""  LR,ADCU
 SG_ RR_P1_P2_185 : 431|8@0+ (1,0) [0|255] ""  LR,ADCU
 SG_ RR_RDI_E_168_185_AliveCounter : 511|4@0+ (1,0) [0|15] ""  RR,ADCU
 SG_ RR_RDI_E_168_185_CheckSum : 507|4@0+ (1,0) [0|15] ""  RR,ADCU

BO_ 512 LR_Object_Header: 32 LR
 SG_ CRC16_Checksum_Header : 247|16@0+ (1,0) [0|65535] ""  ADCU
 SG_ CycleCounter : 119|16@0+ (1,0) [0|65535] ""  ADCU
 SG_ EgoAcceleration : 168|9@0+ (0.125,-31.875) [-31.875|32] "m/s^2"  ADCU
 SG_ EgoCurvature : 191|8@0+ (0.001,0) [0|0.255] "1/m"  ADCU
 SG_ EgoVelocity : 148|11@0+ (0.125,-128) [-128|127.875] "m/s"  ADCU
 SG_ EgoVelocityStd : 175|7@0+ (0.1,0) [0|12.7] "m/s"  ADCU
 SG_ EgoYawRate : 153|10@0+ (0.001,-0.511) [-0.511|0.512] "rad/s"  ADCU
 SG_ ExtendedCycleFlag : 128|1@0+ (1,0) [0|1] ""  ADCU
 SG_ Latency : 143|11@0+ (0.1,80) [0|284.7] "ms"  ADCU
 SG_ MeasCounter : 103|16@0+ (1,0) [0|65535] ""  ADCU
 SG_ MsgCounter_Header : 239|8@0+ (1,0) [0|255] ""  ADCU
 SG_ NumOfObjects : 135|6@0+ (1,0) [0|63] ""  ADCU
 SG_ TaskValidFlag : 129|1@0+ (1,0) [0|1] ""  ADCU
 SG_ TimeStampGlobNanoSec : 39|32@0+ (1,0) [0|4294967295] "ns"  ADCU
 SG_ TimeStampGlobSec : 7|32@0+ (1,0) [0|4294967295] "s"  ADCU
 SG_ TimeStampLocal : 71|32@0+ (1,0) [0|4294967295] "ns"  ADCU

BO_ 513 LR_Object_00_01: 64 LR
 SG_ AabsX_Obj_00 : 16|9@0+ (0.125,-31.875) [-31.875|32] "m/s^2"  ADCU
 SG_ AabsX_Obj_01 : 248|9@0+ (0.125,-31.875) [-31.875|32] "m/s^2"  ADCU
 SG_ AabsXStd_Obj_00 : 89|7@0+ (0.25,0) [0|31.75] "m/s^2"  ADCU
 SG_ AabsXStd_Obj_01 : 321|7@0+ (0.25,0) [0|31.75] "m/s^2"  ADCU
 SG_ AabsY_Obj_00 : 48|9@0+ (0.125,-31.875) [-31.875|32] "m/s^2"  ADCU
 SG_ AabsY_Obj_01 : 280|9@0+ (0.125,-31.875) [-31.875|32] "m/s^2"  ADCU
 SG_ AabsYStd_Obj_00 : 111|8@0+ (0.25,0) [0|63.75] "m/s^2"  ADCU
 SG_ AabsYStd_Obj_01 : 343|8@0+ (0.25,0) [0|63.75] "m/s^2"  ADCU
 SG_ ClassConf_Obj_00 : 119|7@0+ (1,0) [0|127] "%"  ADCU
 SG_ ClassConf_Obj_01 : 351|7@0+ (1,0) [0|127] "%"  ADCU
 SG_ Classification_Obj_00 : 98|3@0+ (1,0) [0|7] ""  ADCU
 SG_ Classification_Obj_01 : 330|3@0+ (1,0) [0|7] ""  ADCU
 SG_ CRC16_Checksum_Obj_00_01 : 503|16@0+ (1,0) [0|65535] ""  ADCU
 SG_ DistX_Obj_00 : 7|12@0+ (0.1,-200) [-200|209.5] "m"  ADCU
 SG_ DistX_Obj_01 : 239|12@0+ (0.1,-200) [-200|209.5] "m"  ADCU
 SG_ DistXStd_Obj_00 : 71|8@0+ (0.05,0) [0|12.75] "m"  ADCU
 SG_ DistXStd_Obj_01 : 303|8@0+ (0.05,0) [0|12.75] "m"  ADCU
 SG_ DistY_Obj_00 : 39|12@0+ (0.1,-200) [-200|209.5] "m"  ADCU
 SG_ DistY_Obj_01 : 271|12@0+ (0.1,-200) [-200|209.5] "m"  ADCU
 SG_ DistYStd_Obj_00 : 79|8@0+ (0.1,0) [0|25.5] "m"  ADCU
 SG_ DistYStd_Obj_01 : 311|8@0+ (0.1,0) [0|25.5] "m"  ADCU
 SG_ DynConf_Obj_00 : 121|7@0+ (1,0) [0|127] "%"  ADCU
 SG_ DynConf_Obj_01 : 353|7@0+ (1,0) [0|127] "%"  ADCU
 SG_ DynProp_Obj_00 : 130|3@0+ (1,0) [0|7] ""  ADCU
 SG_ DynProp_Obj_01 : 362|3@0+ (1,0) [0|7] ""  ADCU
 SG_ ID_Obj_00 : 209|8@0+ (1,0) [0|255] ""  ADCU
 SG_ ID_Obj_01 : 441|8@0+ (1,0) [0|255] ""  ADCU
 SG_ Length_Obj_00 : 136|7@0+ (0.2,0) [0|25.4] "m"  ADCU
 SG_ Length_Obj_01 : 368|7@0+ (0.2,0) [0|25.4] "m"  ADCU
 SG_ LifeCycle_Obj_00 : 193|16@0+ (1,0) [0|65535] ""  ADCU
 SG_ LifeCycle_Obj_01 : 425|16@0+ (1,0) [0|65535] ""  ADCU
 SG_ MaintenanceState_Obj_00 : 145|2@0+ (1,0) [0|3] ""  ADCU
 SG_ MaintenanceState_Obj_01 : 377|2@0+ (1,0) [0|3] ""  ADCU
 SG_ MicroDopplerFlag_00 : 472|1@0+ (1,0) [0|1] ""  ADCU
 SG_ MicroDopplerFlag_01 : 480|1@0+ (1,0) [0|1] ""  ADCU
 SG_ MirrorProb_Obj_00 : 143|7@0+ (1,0) [0|127] "%"  ADCU
 SG_ MirrorProb_Obj_01 : 375|7@0+ (1,0) [0|127] "%"  ADCU
 SG_ MsgCounter_Obj_00_01 : 495|8@0+ (1,0) [0|255] ""  ADCU
 SG_ ObstacleProb_Obj_00 : 479|7@0+ (1,0) [0|127] "%"  ADCU
 SG_ ObstacleProb_Obj_01 : 487|7@0+ (1,0) [0|127] "%"  ADCU
 SG_ Orientation_Obj_00 : 175|10@0+ (0.01,-5.11) [-5.11|5.12] "rad"  ADCU
 SG_ Orientation_Obj_01 : 407|10@0+ (0.01,-5.11) [-5.11|5.12] "rad"  ADCU
 SG_ OrientationStd_Obj_00 : 471|4@0+ (0.002,0) [0|0.03] "rad"  ADCU
 SG_ OrientationStd_Obj_01 : 467|4@0+ (0.002,0) [0|0.03] "rad"  ADCU
 SG_ ProbOfExist_Obj_00 : 112|7@0+ (1,0) [0|127] "%"  ADCU
 SG_ ProbOfExist_Obj_01 : 344|7@0+ (1,0) [0|127] "%"  ADCU
 SG_ RCS_Obj_00 : 152|9@0+ (0.2,-51.1) [-51.1|51.1] "dBsm"  ADCU
 SG_ RCS_Obj_01 : 384|9@0+ (0.2,-51.1) [-51.1|51.1] "dBsm"  ADCU
 SG_ RefPoint_Obj_00 : 217|4@0+ (1,0) [0|15] ""  ADCU
 SG_ RefPoint_Obj_01 : 449|4@0+ (1,0) [0|15] ""  ADCU
 SG_ VabsX_Obj_00 : 11|11@0+ (0.125,-128) [-128|127.875] "m/s"  ADCU
 SG_ VabsX_Obj_01 : 243|11@0+ (0.125,-128) [-128|127.875] "m/s"  ADCU
 SG_ VabsXStd_Obj_00 : 87|7@0+ (0.1,0) [0|12.7] "m/s"  ADCU
 SG_ VabsXStd_Obj_01 : 319|7@0+ (0.1,0) [0|12.7] "m/s"  ADCU
 SG_ VabsY_Obj_00 : 43|11@0+ (0.125,-128) [-128|127.875] "m/s"  ADCU
 SG_ VabsY_Obj_01 : 275|11@0+ (0.125,-128) [-128|127.875] "m/s"  ADCU
 SG_ VabsYStd_Obj_00 : 80|7@0+ (0.2,0) [0|25.4] "m/s"  ADCU
 SG_ VabsYStd_Obj_01 : 312|7@0+ (0.2,0) [0|25.4] "m/s"  ADCU
 SG_ Valid_Obj_00 : 229|1@0+ (1,0) [0|1] ""  ADCU
 SG_ Valid_Obj_01 : 461|1@0+ (1,0) [0|1] ""  ADCU
 SG_ Width_Obj_00 : 159|7@0+ (0.2,0) [0|25.4] "m"  ADCU
 SG_ Width_Obj_01 : 391|7@0+ (0.2,0) [0|25.4] "m"  ADCU
 SG_ YawRateAbs_Obj_00 : 181|10@0+ (0.001,-0.511) [-0.511|0.512] "rad/s"  ADCU
 SG_ YawRateAbs_Obj_01 : 413|10@0+ (0.001,-0.511) [-0.511|0.512] "rad/s"  ADCU
 SG_ YawRateAbsStd_Obj_00 : 187|10@0+ (0.0001,0) [0|0.1023] "rad/s"  ADCU
 SG_ YawRateAbsStd_Obj_01 : 419|10@0+ (0.0001,0) [0|0.1023] "rad/s"  ADCU

BO_ 514 LR_Object_02_03: 64 LR
 SG_ AabsX_Obj_02 : 16|9@0+ (0.125,-31.875) [-31.875|32] "m/s^2"  ADCU
 SG_ AabsX_Obj_03 : 248|9@0+ (0.125,-31.875) [-31.875|32] "m/s^2"  ADCU
 SG_ AabsXStd_Obj_02 : 89|7@0+ (0.25,0) [0|31.75] "m/s^2"  ADCU
 SG_ AabsXStd_Obj_03 : 321|7@0+ (0.25,0) [0|31.75] "m/s^2"  ADCU
 SG_ AabsY_Obj_02 : 48|9@0+ (0.125,-31.875) [-31.875|32] "m/s^2"  ADCU
 SG_ AabsY_Obj_03 : 280|9@0+ (0.125,-31.875) [-31.875|32] "m/s^2"  ADCU
 SG_ AabsYStd_Obj_02 : 111|8@0+ (0.25,0) [0|63.75] "m/s^2"  ADCU
 SG_ AabsYStd_Obj_03 : 343|8@0+ (0.25,0) [0|63.75] "m/s^2"  ADCU
 SG_ ClassConf_Obj_02 : 119|7@0+ (1,0) [0|127] "%"  ADCU
 SG_ ClassConf_Obj_03 : 351|7@0+ (1,0) [0|127] "%"  ADCU
 SG_ Classification_Obj_02 : 98|3@0+ (1,0) [0|7] ""  ADCU
 SG_ Classification_Obj_03 : 330|3@0+ (1,0) [0|7] ""  ADCU
 SG_ CRC16_Checksum_Obj_02_03 : 503|16@0+ (1,0) [0|65535] ""  ADCU
 SG_ DistX_Obj_02 : 7|12@0+ (0.1,-200) [-200|209.5] "m"  ADCU
 SG_ DistX_Obj_03 : 239|12@0+ (0.1,-200) [-200|209.5] "m"  ADCU
 SG_ DistXStd_Obj_02 : 71|8@0+ (0.05,0) [0|12.75] "m"  ADCU
 SG_ DistXStd_Obj_03 : 303|8@0+ (0.05,0) [0|12.75] "m"  ADCU
 SG_ DistY_Obj_02 : 39|12@0+ (0.1,-200) [-200|209.5] "m"  ADCU
 SG_ DistY_Obj_03 : 271|12@0+ (0.1,-200) [-200|209.5] "m"  ADCU
 SG_ DistYStd_Obj_02 : 79|8@0+ (0.1,0) [0|25.5] "m"  ADCU
 SG_ DistYStd_Obj_03 : 311|8@0+ (0.1,0) [0|25.5] "m"  ADCU
 SG_ DynConf_Obj_02 : 121|7@0+ (1,0) [0|127] "%"  ADCU
 SG_ DynConf_Obj_03 : 353|7@0+ (1,0) [0|127] "%"  ADCU
 SG_ DynProp_Obj_02 : 130|3@0+ (1,0) [0|7] ""  ADCU
 SG_ DynProp_Obj_03 : 362|3@0+ (1,0) [0|7] ""  ADCU
 SG_ ID_Obj_02 : 209|8@0+ (1,0) [0|255] ""  ADCU
 SG_ ID_Obj_03 : 441|8@0+ (1,0) [0|255] ""  ADCU
 SG_ Length_Obj_02 : 136|7@0+ (0.2,0) [0|25.4] "m"  ADCU
 SG_ Length_Obj_03 : 368|7@0+ (0.2,0) [0|25.4] "m"  ADCU
 SG_ LifeCycle_Obj_02 : 193|16@0+ (1,0) [0|65535] ""  ADCU
 SG_ LifeCycle_Obj_03 : 425|16@0+ (1,0) [0|65535] ""  ADCU
 SG_ MaintenanceState_Obj_02 : 145|2@0+ (1,0) [0|3] ""  ADCU
 SG_ MaintenanceState_Obj_03 : 377|2@0+ (1,0) [0|3] ""  ADCU
 SG_ MicroDopplerFlag_02 : 472|1@0+ (1,0) [0|1] ""  ADCU
 SG_ MicroDopplerFlag_03 : 480|1@0+ (1,0) [0|1] ""  ADCU
 SG_ MirrorProb_Obj_02 : 143|7@0+ (1,0) [0|127] "%"  ADCU
 SG_ MirrorProb_Obj_03 : 375|7@0+ (1,0) [0|127] "%"  ADCU
 SG_ MsgCounter_Obj_00_03 : 495|8@0+ (1,0) [0|255] ""  ADCU
 SG_ ObstacleProb_Obj_02 : 479|7@0+ (1,0) [0|127] "%"  ADCU
 SG_ ObstacleProb_Obj_03 : 487|7@0+ (1,0) [0|127] "%"  ADCU
 SG_ Orientation_Obj_02 : 175|10@0+ (0.01,-5.11) [-5.11|5.12] "rad"  ADCU
 SG_ Orientation_Obj_03 : 407|10@0+ (0.01,-5.11) [-5.11|5.12] "rad"  ADCU
 SG_ OrientationStd_Obj_02 : 471|4@0+ (0.002,0) [0|0.03] "rad"  ADCU
 SG_ OrientationStd_Obj_03 : 467|4@0+ (0.002,0) [0|0.03] "rad"  ADCU
 SG_ ProbOfExist_Obj_02 : 112|7@0+ (1,0) [0|127] "%"  ADCU
 SG_ ProbOfExist_Obj_03 : 344|7@0+ (1,0) [0|127] "%"  ADCU
 SG_ RCS_Obj_02 : 152|9@0+ (0.2,-51.1) [-51.1|51.1] "dBsm"  ADCU
 SG_ RCS_Obj_03 : 384|9@0+ (0.2,-51.1) [-51.1|51.1] "dBsm"  ADCU
 SG_ RefPoint_Obj_02 : 217|4@0+ (1,0) [0|15] ""  ADCU
 SG_ RefPoint_Obj_03 : 449|4@0+ (1,0) [0|15] ""  ADCU
 SG_ VabsX_Obj_02 : 11|11@0+ (0.125,-128) [-128|127.875] "m/s"  ADCU
 SG_ VabsX_Obj_03 : 243|11@0+ (0.125,-128) [-128|127.875] "m/s"  ADCU
 SG_ VabsXStd_Obj_02 : 87|7@0+ (0.1,0) [0|12.7] "m/s"  ADCU
 SG_ VabsXStd_Obj_03 : 319|7@0+ (0.1,0) [0|12.7] "m/s"  ADCU
 SG_ VabsY_Obj_02 : 43|11@0+ (0.125,-128) [-128|127.875] "m/s"  ADCU
 SG_ VabsY_Obj_03 : 275|11@0+ (0.125,-128) [-128|127.875] "m/s"  ADCU
 SG_ VabsYStd_Obj_02 : 80|7@0+ (0.2,0) [0|25.4] "m/s"  ADCU
 SG_ VabsYStd_Obj_03 : 312|7@0+ (0.2,0) [0|25.4] "m/s"  ADCU
 SG_ Valid_Obj_02 : 229|1@0+ (1,0) [0|1] ""  ADCU
 SG_ Valid_Obj_03 : 461|1@0+ (1,0) [0|1] ""  ADCU
 SG_ Width_Obj_02 : 159|7@0+ (0.2,0) [0|25.4] "m"  ADCU
 SG_ Width_Obj_03 : 391|7@0+ (0.2,0) [0|25.4] "m"  ADCU
 SG_ YawRateAbs_Obj_02 : 181|10@0+ (0.001,-0.511) [-0.511|0.512] "rad/s"  ADCU
 SG_ YawRateAbs_Obj_03 : 413|10@0+ (0.001,-0.511) [-0.511|0.512] "rad/s"  ADCU
 SG_ YawRateAbsStd_Obj_02 : 187|10@0+ (0.0001,0) [0|0.1023] "rad/s"  ADCU
 SG_ YawRateAbsStd_Obj_03 : 419|10@0+ (0.0001,0) [0|0.1023] "rad/s"  ADCU

BO_ 515 LR_Object_04_05: 64 LR
 SG_ AabsX_Obj_04 : 16|9@0+ (0.125,-31.875) [-31.875|32] "m/s^2"  ADCU
 SG_ AabsX_Obj_05 : 248|9@0+ (0.125,-31.875) [-31.875|32] "m/s^2"  ADCU
 SG_ AabsXStd_Obj_04 : 89|7@0+ (0.25,0) [0|31.75] "m/s^2"  ADCU
 SG_ AabsXStd_Obj_05 : 321|7@0+ (0.25,0) [0|31.75] "m/s^2"  ADCU
 SG_ AabsY_Obj_04 : 48|9@0+ (0.125,-31.875) [-31.875|32] "m/s^2"  ADCU
 SG_ AabsY_Obj_05 : 280|9@0+ (0.125,-31.875) [-31.875|32] "m/s^2"  ADCU
 SG_ AabsYStd_Obj_04 : 111|8@0+ (0.25,0) [0|63.75] "m/s^2"  ADCU
 SG_ AabsYStd_Obj_05 : 343|8@0+ (0.25,0) [0|63.75] "m/s^2"  ADCU
 SG_ ClassConf_Obj_04 : 119|7@0+ (1,0) [0|127] "%"  ADCU
 SG_ ClassConf_Obj_05 : 351|7@0+ (1,0) [0|127] "%"  ADCU
 SG_ Classification_Obj_04 : 98|3@0+ (1,0) [0|7] ""  ADCU
 SG_ Classification_Obj_05 : 330|3@0+ (1,0) [0|7] ""  ADCU
 SG_ CRC16_Checksum_Obj_04_05 : 503|16@0+ (1,0) [0|65535] ""  ADCU
 SG_ DistX_Obj_04 : 7|12@0+ (0.1,-200) [-200|209.5] "m"  ADCU
 SG_ DistX_Obj_05 : 239|12@0+ (0.1,-200) [-200|209.5] "m"  ADCU
 SG_ DistXStd_Obj_04 : 71|8@0+ (0.05,0) [0|12.75] "m"  ADCU
 SG_ DistXStd_Obj_05 : 303|8@0+ (0.05,0) [0|12.75] "m"  ADCU
 SG_ DistY_Obj_04 : 39|12@0+ (0.1,-200) [-200|209.5] "m"  ADCU
 SG_ DistY_Obj_05 : 271|12@0+ (0.1,-200) [-200|209.5] "m"  ADCU
 SG_ DistYStd_Obj_04 : 79|8@0+ (0.1,0) [0|25.5] "m"  ADCU
 SG_ DistYStd_Obj_05 : 311|8@0+ (0.1,0) [0|25.5] "m"  ADCU
 SG_ DynConf_Obj_04 : 121|7@0+ (1,0) [0|127] "%"  ADCU
 SG_ DynConf_Obj_05 : 353|7@0+ (1,0) [0|127] "%"  ADCU
 SG_ DynProp_Obj_04 : 130|3@0+ (1,0) [0|7] ""  ADCU
 SG_ DynProp_Obj_05 : 362|3@0+ (1,0) [0|7] ""  ADCU
 SG_ ID_Obj_04 : 209|8@0+ (1,0) [0|255] ""  ADCU
 SG_ ID_Obj_05 : 441|8@0+ (1,0) [0|255] ""  ADCU
 SG_ Length_Obj_04 : 136|7@0+ (0.2,0) [0|25.4] "m"  ADCU
 SG_ Length_Obj_05 : 368|7@0+ (0.2,0) [0|25.4] "m"  ADCU
 SG_ LifeCycle_Obj_04 : 193|16@0+ (1,0) [0|65535] ""  ADCU
 SG_ LifeCycle_Obj_05 : 425|16@0+ (1,0) [0|65535] ""  ADCU
 SG_ MaintenanceState_Obj_04 : 145|2@0+ (1,0) [0|3] ""  ADCU
 SG_ MaintenanceState_Obj_05 : 377|2@0+ (1,0) [0|3] ""  ADCU
 SG_ MicroDopplerFlag_04 : 472|1@0+ (1,0) [0|1] ""  ADCU
 SG_ MicroDopplerFlag_05 : 480|1@0+ (1,0) [0|1] ""  ADCU
 SG_ MirrorProb_Obj_04 : 143|7@0+ (1,0) [0|127] "%"  ADCU
 SG_ MirrorProb_Obj_05 : 375|7@0+ (1,0) [0|127] "%"  ADCU
 SG_ MsgCounter_Obj_04_05 : 495|8@0+ (1,0) [0|255] ""  ADCU
 SG_ ObstacleProb_Obj_04 : 479|7@0+ (1,0) [0|127] "%"  ADCU
 SG_ ObstacleProb_Obj_05 : 487|7@0+ (1,0) [0|127] "%"  ADCU
 SG_ Orientation_Obj_04 : 175|10@0+ (0.01,-5.11) [-5.11|5.12] "rad"  ADCU
 SG_ Orientation_Obj_05 : 407|10@0+ (0.01,-5.11) [-5.11|5.12] "rad"  ADCU
 SG_ OrientationStd_Obj_04 : 471|4@0+ (0.002,0) [0|0.03] "rad"  ADCU
 SG_ OrientationStd_Obj_05 : 467|4@0+ (0.002,0) [0|0.03] "rad"  ADCU
 SG_ ProbOfExist_Obj_04 : 112|7@0+ (1,0) [0|127] "%"  ADCU
 SG_ ProbOfExist_Obj_05 : 344|7@0+ (1,0) [0|127] "%"  ADCU
 SG_ RCS_Obj_04 : 152|9@0+ (0.2,-51.1) [-51.1|51.1] "dBsm"  ADCU
 SG_ RCS_Obj_05 : 384|9@0+ (0.2,-51.1) [-51.1|51.1] "dBsm"  ADCU
 SG_ RefPoint_Obj_04 : 217|4@0+ (1,0) [0|15] ""  ADCU
 SG_ RefPoint_Obj_05 : 449|4@0+ (1,0) [0|15] ""  ADCU
 SG_ VabsX_Obj_04 : 11|11@0+ (0.125,-128) [-128|127.875] "m/s"  ADCU
 SG_ VabsX_Obj_05 : 243|11@0+ (0.125,-128) [-128|127.875] "m/s"  ADCU
 SG_ VabsXStd_Obj_04 : 87|7@0+ (0.1,0) [0|12.7] "m/s"  ADCU
 SG_ VabsXStd_Obj_05 : 319|7@0+ (0.1,0) [0|12.7] "m/s"  ADCU
 SG_ VabsY_Obj_04 : 43|11@0+ (0.125,-128) [-128|127.875] "m/s"  ADCU
 SG_ VabsY_Obj_05 : 275|11@0+ (0.125,-128) [-128|127.875] "m/s"  ADCU
 SG_ VabsYStd_Obj_04 : 80|7@0+ (0.2,0) [0|25.4] "m/s"  ADCU
 SG_ VabsYStd_Obj_05 : 312|7@0+ (0.2,0) [0|25.4] "m/s"  ADCU
 SG_ Valid_Obj_04 : 229|1@0+ (1,0) [0|1] ""  ADCU
 SG_ Valid_Obj_05 : 461|1@0+ (1,0) [0|1] ""  ADCU
 SG_ Width_Obj_04 : 159|7@0+ (0.2,0) [0|25.4] "m"  ADCU
 SG_ Width_Obj_05 : 391|7@0+ (0.2,0) [0|25.4] "m"  ADCU
 SG_ YawRateAbs_Obj_04 : 181|10@0+ (0.001,-0.511) [-0.511|0.512] "rad/s"  ADCU
 SG_ YawRateAbs_Obj_05 : 413|10@0+ (0.001,-0.511) [-0.511|0.512] "rad/s"  ADCU
 SG_ YawRateAbsStd_Obj_04 : 187|10@0+ (0.0001,0) [0|0.1023] "rad/s"  ADCU
 SG_ YawRateAbsStd_Obj_05 : 419|10@0+ (0.0001,0) [0|0.1023] "rad/s"  ADCU

BO_ 516 LR_Object_06_07: 64 LR
 SG_ AabsX_Obj_06 : 16|9@0+ (0.125,-31.875) [-31.875|32] "m/s^2"  ADCU
 SG_ AabsX_Obj_07 : 248|9@0+ (0.125,-31.875) [-31.875|32] "m/s^2"  ADCU
 SG_ AabsXStd_Obj_06 : 89|7@0+ (0.25,0) [0|31.75] "m/s^2"  ADCU
 SG_ AabsXStd_Obj_07 : 321|7@0+ (0.25,0) [0|31.75] "m/s^2"  ADCU
 SG_ AabsY_Obj_06 : 48|9@0+ (0.125,-31.875) [-31.875|32] "m/s^2"  ADCU
 SG_ AabsY_Obj_07 : 280|9@0+ (0.125,-31.875) [-31.875|32] "m/s^2"  ADCU
 SG_ AabsYStd_Obj_06 : 111|8@0+ (0.25,0) [0|63.75] "m/s^2"  ADCU
 SG_ AabsYStd_Obj_07 : 343|8@0+ (0.25,0) [0|63.75] "m/s^2"  ADCU
 SG_ ClassConf_Obj_06 : 119|7@0+ (1,0) [0|127] "%"  ADCU
 SG_ ClassConf_Obj_07 : 351|7@0+ (1,0) [0|127] "%"  ADCU
 SG_ Classification_Obj_06 : 98|3@0+ (1,0) [0|7] ""  ADCU
 SG_ Classification_Obj_07 : 330|3@0+ (1,0) [0|7] ""  ADCU
 SG_ CRC16_Checksum_Obj_06_07 : 503|16@0+ (1,0) [0|65535] ""  ADCU
 SG_ DistX_Obj_06 : 7|12@0+ (0.1,-200) [-200|209.5] "m"  ADCU
 SG_ DistX_Obj_07 : 239|12@0+ (0.1,-200) [-200|209.5] "m"  ADCU
 SG_ DistXStd_Obj_06 : 71|8@0+ (0.05,0) [0|12.75] "m"  ADCU
 SG_ DistXStd_Obj_07 : 303|8@0+ (0.05,0) [0|12.75] "m"  ADCU
 SG_ DistY_Obj_06 : 39|12@0+ (0.1,-200) [-200|209.5] "m"  ADCU
 SG_ DistY_Obj_07 : 271|12@0+ (0.1,-200) [-200|209.5] "m"  ADCU
 SG_ DistYStd_Obj_06 : 79|8@0+ (0.1,0) [0|25.5] "m"  ADCU
 SG_ DistYStd_Obj_07 : 311|8@0+ (0.1,0) [0|25.5] "m"  ADCU
 SG_ DynConf_Obj_06 : 121|7@0+ (1,0) [0|127] "%"  ADCU
 SG_ DynConf_Obj_07 : 353|7@0+ (1,0) [0|127] "%"  ADCU
 SG_ DynProp_Obj_06 : 130|3@0+ (1,0) [0|7] ""  ADCU
 SG_ DynProp_Obj_07 : 362|3@0+ (1,0) [0|7] ""  ADCU
 SG_ ID_Obj_06 : 209|8@0+ (1,0) [0|255] ""  ADCU
 SG_ ID_Obj_07 : 441|8@0+ (1,0) [0|255] ""  ADCU
 SG_ Length_Obj_06 : 136|7@0+ (0.2,0) [0|25.4] "m"  ADCU
 SG_ Length_Obj_07 : 368|7@0+ (0.2,0) [0|25.4] "m"  ADCU
 SG_ LifeCycle_Obj_06 : 193|16@0+ (1,0) [0|65535] ""  ADCU
 SG_ LifeCycle_Obj_07 : 425|16@0+ (1,0) [0|65535] ""  ADCU
 SG_ MaintenanceState_Obj_06 : 145|2@0+ (1,0) [0|3] ""  ADCU
 SG_ MaintenanceState_Obj_07 : 377|2@0+ (1,0) [0|3] ""  ADCU
 SG_ MicroDopplerFlag_06 : 472|1@0+ (1,0) [0|1] ""  ADCU
 SG_ MicroDopplerFlag_07 : 480|1@0+ (1,0) [0|1] ""  ADCU
 SG_ MirrorProb_Obj_06 : 143|7@0+ (1,0) [0|127] "%"  ADCU
 SG_ MirrorProb_Obj_07 : 375|7@0+ (1,0) [0|127] "%"  ADCU
 SG_ MsgCounter_Obj_06_07 : 495|8@0+ (1,0) [0|255] ""  ADCU
 SG_ ObstacleProb_Obj_06 : 479|7@0+ (1,0) [0|127] "%"  ADCU
 SG_ ObstacleProb_Obj_07 : 487|7@0+ (1,0) [0|127] "%"  ADCU
 SG_ Orientation_Obj_06 : 175|10@0+ (0.01,-5.11) [-5.11|5.12] "rad"  ADCU
 SG_ Orientation_Obj_07 : 407|10@0+ (0.01,-5.11) [-5.11|5.12] "rad"  ADCU
 SG_ OrientationStd_Obj_06 : 471|4@0+ (0.002,0) [0|0.03] "rad"  ADCU
 SG_ OrientationStd_Obj_07 : 467|4@0+ (0.002,0) [0|0.03] "rad"  ADCU
 SG_ ProbOfExist_Obj_06 : 112|7@0+ (1,0) [0|127] "%"  ADCU
 SG_ ProbOfExist_Obj_07 : 344|7@0+ (1,0) [0|127] "%"  ADCU
 SG_ RCS_Obj_06 : 152|9@0+ (0.2,-51.1) [-51.1|51.1] "dBsm"  ADCU
 SG_ RCS_Obj_07 : 384|9@0+ (0.2,-51.1) [-51.1|51.1] "dBsm"  ADCU
 SG_ RefPoint_Obj_06 : 217|4@0+ (1,0) [0|15] ""  ADCU
 SG_ RefPoint_Obj_07 : 449|4@0+ (1,0) [0|15] ""  ADCU
 SG_ VabsX_Obj_06 : 11|11@0+ (0.125,-128) [-128|127.875] "m/s"  ADCU
 SG_ VabsX_Obj_07 : 243|11@0+ (0.125,-128) [-128|127.875] "m/s"  ADCU
 SG_ VabsXStd_Obj_06 : 87|7@0+ (0.1,0) [0|12.7] "m/s"  ADCU
 SG_ VabsXStd_Obj_07 : 319|7@0+ (0.1,0) [0|12.7] "m/s"  ADCU
 SG_ VabsY_Obj_06 : 43|11@0+ (0.125,-128) [-128|127.875] "m/s"  ADCU
 SG_ VabsY_Obj_07 : 275|11@0+ (0.125,-128) [-128|127.875] "m/s"  ADCU
 SG_ VabsYStd_Obj_06 : 80|7@0+ (0.2,0) [0|25.4] "m/s"  ADCU
 SG_ VabsYStd_Obj_07 : 312|7@0+ (0.2,0) [0|25.4] "m/s"  ADCU
 SG_ Valid_Obj_06 : 229|1@0+ (1,0) [0|1] ""  ADCU
 SG_ Valid_Obj_07 : 461|1@0+ (1,0) [0|1] ""  ADCU
 SG_ Width_Obj_06 : 159|7@0+ (0.2,0) [0|25.4] "m"  ADCU
 SG_ Width_Obj_07 : 391|7@0+ (0.2,0) [0|25.4] "m"  ADCU
 SG_ YawRateAbs_Obj_06 : 181|10@0+ (0.001,-0.511) [-0.511|0.512] "rad/s"  ADCU
 SG_ YawRateAbs_Obj_07 : 413|10@0+ (0.001,-0.511) [-0.511|0.512] "rad/s"  ADCU
 SG_ YawRateAbsStd_Obj_06 : 187|10@0+ (0.0001,0) [0|0.1023] "rad/s"  ADCU
 SG_ YawRateAbsStd_Obj_07 : 419|10@0+ (0.0001,0) [0|0.1023] "rad/s"  ADCU

BO_ 517 LR_Object_08_09: 64 LR
 SG_ AabsX_Obj_08 : 16|9@0+ (0.125,-31.875) [-31.875|32] "m/s^2"  ADCU
 SG_ AabsX_Obj_09 : 248|9@0+ (0.125,-31.875) [-31.875|32] "m/s^2"  ADCU
 SG_ AabsXStd_Obj_08 : 89|7@0+ (0.25,0) [0|31.75] "m/s^2"  ADCU
 SG_ AabsXStd_Obj_09 : 321|7@0+ (0.25,0) [0|31.75] "m/s^2"  ADCU
 SG_ AabsY_Obj_08 : 48|9@0+ (0.125,-31.875) [-31.875|32] "m/s^2"  ADCU
 SG_ AabsY_Obj_09 : 280|9@0+ (0.125,-31.875) [-31.875|32] "m/s^2"  ADCU
 SG_ AabsYStd_Obj_08 : 111|8@0+ (0.25,0) [0|63.75] "m/s^2"  ADCU
 SG_ AabsYStd_Obj_09 : 343|8@0+ (0.25,0) [0|63.75] "m/s^2"  ADCU
 SG_ ClassConf_Obj_08 : 119|7@0+ (1,0) [0|127] "%"  ADCU
 SG_ ClassConf_Obj_09 : 351|7@0+ (1,0) [0|127] "%"  ADCU
 SG_ Classification_Obj_08 : 98|3@0+ (1,0) [0|7] ""  ADCU
 SG_ Classification_Obj_09 : 330|3@0+ (1,0) [0|7] ""  ADCU
 SG_ CRC16_Checksum_Obj_08_09 : 503|16@0+ (1,0) [0|65535] ""  ADCU
 SG_ DistX_Obj_08 : 7|12@0+ (0.1,-200) [-200|209.5] "m"  ADCU
 SG_ DistX_Obj_09 : 239|12@0+ (0.1,-200) [-200|209.5] "m"  ADCU
 SG_ DistXStd_Obj_08 : 71|8@0+ (0.05,0) [0|12.75] "m"  ADCU
 SG_ DistXStd_Obj_09 : 303|8@0+ (0.05,0) [0|12.75] "m"  ADCU
 SG_ DistY_Obj_08 : 39|12@0+ (0.1,-200) [-200|209.5] "m"  ADCU
 SG_ DistY_Obj_09 : 271|12@0+ (0.1,-200) [-200|209.5] "m"  ADCU
 SG_ DistYStd_Obj_08 : 79|8@0+ (0.1,0) [0|25.5] "m"  ADCU
 SG_ DistYStd_Obj_09 : 311|8@0+ (0.1,0) [0|25.5] "m"  ADCU
 SG_ DynConf_Obj_08 : 121|7@0+ (1,0) [0|127] "%"  ADCU
 SG_ DynConf_Obj_09 : 353|7@0+ (1,0) [0|127] "%"  ADCU
 SG_ DynProp_Obj_08 : 130|3@0+ (1,0) [0|7] ""  ADCU
 SG_ DynProp_Obj_09 : 362|3@0+ (1,0) [0|7] ""  ADCU
 SG_ ID_Obj_08 : 209|8@0+ (1,0) [0|255] ""  ADCU
 SG_ ID_Obj_09 : 441|8@0+ (1,0) [0|255] ""  ADCU
 SG_ Length_Obj_08 : 136|7@0+ (0.2,0) [0|25.4] "m"  ADCU
 SG_ Length_Obj_09 : 368|7@0+ (0.2,0) [0|25.4] "m"  ADCU
 SG_ LifeCycle_Obj_08 : 193|16@0+ (1,0) [0|65535] ""  ADCU
 SG_ LifeCycle_Obj_09 : 425|16@0+ (1,0) [0|65535] ""  ADCU
 SG_ MaintenanceState_Obj_08 : 145|2@0+ (1,0) [0|3] ""  ADCU
 SG_ MaintenanceState_Obj_09 : 377|2@0+ (1,0) [0|3] ""  ADCU
 SG_ MicroDopplerFlag_08 : 472|1@0+ (1,0) [0|1] ""  ADCU
 SG_ MicroDopplerFlag_09 : 480|1@0+ (1,0) [0|1] ""  ADCU
 SG_ MirrorProb_Obj_08 : 143|7@0+ (1,0) [0|127] "%"  ADCU
 SG_ MirrorProb_Obj_09 : 375|7@0+ (1,0) [0|127] "%"  ADCU
 SG_ MsgCounter_Obj_08_09 : 495|8@0+ (1,0) [0|255] ""  ADCU
 SG_ ObstacleProb_Obj_08 : 479|7@0+ (1,0) [0|127] "%"  ADCU
 SG_ ObstacleProb_Obj_09 : 487|7@0+ (1,0) [0|127] "%"  ADCU
 SG_ Orientation_Obj_08 : 175|10@0+ (0.01,-5.11) [-5.11|5.12] "rad"  ADCU
 SG_ Orientation_Obj_09 : 407|10@0+ (0.01,-5.11) [-5.11|5.12] "rad"  ADCU
 SG_ OrientationStd_Obj_08 : 471|4@0+ (0.002,0) [0|0.03] "rad"  ADCU
 SG_ OrientationStd_Obj_09 : 467|4@0+ (0.002,0) [0|0.03] "rad"  ADCU
 SG_ ProbOfExist_Obj_08 : 112|7@0+ (1,0) [0|127] "%"  ADCU
 SG_ ProbOfExist_Obj_09 : 344|7@0+ (1,0) [0|127] "%"  ADCU
 SG_ RCS_Obj_08 : 152|9@0+ (0.2,-51.1) [-51.1|51.1] "dBsm"  ADCU
 SG_ RCS_Obj_09 : 384|9@0+ (0.2,-51.1) [-51.1|51.1] "dBsm"  ADCU
 SG_ RefPoint_Obj_08 : 217|4@0+ (1,0) [0|15] ""  ADCU
 SG_ RefPoint_Obj_09 : 449|4@0+ (1,0) [0|15] ""  ADCU
 SG_ VabsX_Obj_08 : 11|11@0+ (0.125,-128) [-128|127.875] "m/s"  ADCU
 SG_ VabsX_Obj_09 : 243|11@0+ (0.125,-128) [-128|127.875] "m/s"  ADCU
 SG_ VabsXStd_Obj_08 : 87|7@0+ (0.1,0) [0|12.7] "m/s"  ADCU
 SG_ VabsXStd_Obj_09 : 319|7@0+ (0.1,0) [0|12.7] "m/s"  ADCU
 SG_ VabsY_Obj_08 : 43|11@0+ (0.125,-128) [-128|127.875] "m/s"  ADCU
 SG_ VabsY_Obj_09 : 275|11@0+ (0.125,-128) [-128|127.875] "m/s"  ADCU
 SG_ VabsYStd_Obj_08 : 80|7@0+ (0.2,0) [0|25.4] "m/s"  ADCU
 SG_ VabsYStd_Obj_09 : 312|7@0+ (0.2,0) [0|25.4] "m/s"  ADCU
 SG_ Valid_Obj_08 : 229|1@0+ (1,0) [0|1] ""  ADCU
 SG_ Valid_Obj_09 : 461|1@0+ (1,0) [0|1] ""  ADCU
 SG_ Width_Obj_08 : 159|7@0+ (0.2,0) [0|25.4] "m"  ADCU
 SG_ Width_Obj_09 : 391|7@0+ (0.2,0) [0|25.4] "m"  ADCU
 SG_ YawRateAbs_Obj_08 : 181|10@0+ (0.001,-0.511) [-0.511|0.512] "rad/s"  ADCU
 SG_ YawRateAbs_Obj_09 : 413|10@0+ (0.001,-0.511) [-0.511|0.512] "rad/s"  ADCU
 SG_ YawRateAbsStd_Obj_08 : 187|10@0+ (0.0001,0) [0|0.1023] "rad/s"  ADCU
 SG_ YawRateAbsStd_Obj_09 : 419|10@0+ (0.0001,0) [0|0.1023] "rad/s"  ADCU

BO_ 518 LR_Object_10_11: 64 LR
 SG_ AabsX_Obj_10 : 16|9@0+ (0.125,-31.875) [-31.875|32] "m/s^2"  ADCU
 SG_ AabsX_Obj_11 : 248|9@0+ (0.125,-31.875) [-31.875|32] "m/s^2"  ADCU
 SG_ AabsXStd_Obj_10 : 89|7@0+ (0.25,0) [0|31.75] "m/s^2"  ADCU
 SG_ AabsXStd_Obj_11 : 321|7@0+ (0.25,0) [0|31.75] "m/s^2"  ADCU
 SG_ AabsY_Obj_10 : 48|9@0+ (0.125,-31.875) [-31.875|32] "m/s^2"  ADCU
 SG_ AabsY_Obj_11 : 280|9@0+ (0.125,-31.875) [-31.875|32] "m/s^2"  ADCU
 SG_ AabsYStd_Obj_10 : 111|8@0+ (0.25,0) [0|63.75] "m/s^2"  ADCU
 SG_ AabsYStd_Obj_11 : 343|8@0+ (0.25,0) [0|63.75] "m/s^2"  ADCU
 SG_ ClassConf_Obj_10 : 119|7@0+ (1,0) [0|127] "%"  ADCU
 SG_ ClassConf_Obj_11 : 351|7@0+ (1,0) [0|127] "%"  ADCU
 SG_ Classification_Obj_10 : 98|3@0+ (1,0) [0|7] ""  ADCU
 SG_ Classification_Obj_11 : 330|3@0+ (1,0) [0|7] ""  ADCU
 SG_ CRC16_Checksum_Obj_10_11 : 503|16@0+ (1,0) [0|65535] ""  ADCU
 SG_ DistX_Obj_10 : 7|12@0+ (0.1,-200) [-200|209.5] "m"  ADCU
 SG_ DistX_Obj_11 : 239|12@0+ (0.1,-200) [-200|209.5] "m"  ADCU
 SG_ DistXStd_Obj_10 : 71|8@0+ (0.05,0) [0|12.75] "m"  ADCU
 SG_ DistXStd_Obj_11 : 303|8@0+ (0.05,0) [0|12.75] "m"  ADCU
 SG_ DistY_Obj_10 : 39|12@0+ (0.1,-200) [-200|209.5] "m"  ADCU
 SG_ DistY_Obj_11 : 271|12@0+ (0.1,-200) [-200|209.5] "m"  ADCU
 SG_ DistYStd_Obj_10 : 79|8@0+ (0.1,0) [0|25.5] "m"  ADCU
 SG_ DistYStd_Obj_11 : 311|8@0+ (0.1,0) [0|25.5] "m"  ADCU
 SG_ DynConf_Obj_10 : 121|7@0+ (1,0) [0|127] "%"  ADCU
 SG_ DynConf_Obj_11 : 353|7@0+ (1,0) [0|127] "%"  ADCU
 SG_ DynProp_Obj_10 : 130|3@0+ (1,0) [0|7] ""  ADCU
 SG_ DynProp_Obj_11 : 362|3@0+ (1,0) [0|7] ""  ADCU
 SG_ ID_Obj_10 : 209|8@0+ (1,0) [0|255] ""  ADCU
 SG_ ID_Obj_11 : 441|8@0+ (1,0) [0|255] ""  ADCU
 SG_ Length_Obj_10 : 136|7@0+ (0.2,0) [0|25.4] "m"  ADCU
 SG_ Length_Obj_11 : 368|7@0+ (0.2,0) [0|25.4] "m"  ADCU
 SG_ LifeCycle_Obj_10 : 193|16@0+ (1,0) [0|65535] ""  ADCU
 SG_ LifeCycle_Obj_11 : 425|16@0+ (1,0) [0|65535] ""  ADCU
 SG_ MaintenanceState_Obj_10 : 145|2@0+ (1,0) [0|3] ""  ADCU
 SG_ MaintenanceState_Obj_11 : 377|2@0+ (1,0) [0|3] ""  ADCU
 SG_ MicroDopplerFlag_10 : 472|1@0+ (1,0) [0|1] ""  ADCU
 SG_ MicroDopplerFlag_11 : 480|1@0+ (1,0) [0|1] ""  ADCU
 SG_ MirrorProb_Obj_10 : 143|7@0+ (1,0) [0|127] "%"  ADCU
 SG_ MirrorProb_Obj_11 : 375|7@0+ (1,0) [0|127] "%"  ADCU
 SG_ MsgCounter_Obj_10_11 : 495|8@0+ (1,0) [0|255] ""  ADCU
 SG_ ObstacleProb_Obj_10 : 479|7@0+ (1,0) [0|127] "%"  ADCU
 SG_ ObstacleProb_Obj_11 : 487|7@0+ (1,0) [0|127] "%"  ADCU
 SG_ Orientation_Obj_10 : 175|10@0+ (0.01,-5.11) [-5.11|5.12] "rad"  ADCU
 SG_ Orientation_Obj_11 : 407|10@0+ (0.01,-5.11) [-5.11|5.12] "rad"  ADCU
 SG_ OrientationStd_Obj_10 : 471|4@0+ (0.002,0) [0|0.03] "rad"  ADCU
 SG_ OrientationStd_Obj_11 : 467|4@0+ (0.002,0) [0|0.03] "rad"  ADCU
 SG_ ProbOfExist_Obj_10 : 112|7@0+ (1,0) [0|127] "%"  ADCU
 SG_ ProbOfExist_Obj_11 : 344|7@0+ (1,0) [0|127] "%"  ADCU
 SG_ RCS_Obj_10 : 152|9@0+ (0.2,-51.1) [-51.1|51.1] "dBsm"  ADCU
 SG_ RCS_Obj_11 : 384|9@0+ (0.2,-51.1) [-51.1|51.1] "dBsm"  ADCU
 SG_ RefPoint_Obj_10 : 217|4@0+ (1,0) [0|15] ""  ADCU
 SG_ RefPoint_Obj_11 : 449|4@0+ (1,0) [0|15] ""  ADCU
 SG_ VabsX_Obj_10 : 11|11@0+ (0.125,-128) [-128|127.875] "m/s"  ADCU
 SG_ VabsX_Obj_11 : 243|11@0+ (0.125,-128) [-128|127.875] "m/s"  ADCU
 SG_ VabsXStd_Obj_10 : 87|7@0+ (0.1,0) [0|12.7] "m/s"  ADCU
 SG_ VabsXStd_Obj_11 : 319|7@0+ (0.1,0) [0|12.7] "m/s"  ADCU
 SG_ VabsY_Obj_10 : 43|11@0+ (0.125,-128) [-128|127.875] "m/s"  ADCU
 SG_ VabsY_Obj_11 : 275|11@0+ (0.125,-128) [-128|127.875] "m/s"  ADCU
 SG_ VabsYStd_Obj_10 : 80|7@0+ (0.2,0) [0|25.4] "m/s"  ADCU
 SG_ VabsYStd_Obj_11 : 312|7@0+ (0.2,0) [0|25.4] "m/s"  ADCU
 SG_ Valid_Obj_10 : 229|1@0+ (1,0) [0|1] ""  ADCU
 SG_ Valid_Obj_11 : 461|1@0+ (1,0) [0|1] ""  ADCU
 SG_ Width_Obj_10 : 159|7@0+ (0.2,0) [0|25.4] "m"  ADCU
 SG_ Width_Obj_11 : 391|7@0+ (0.2,0) [0|25.4] "m"  ADCU
 SG_ YawRateAbs_Obj_10 : 181|10@0+ (0.001,-0.511) [-0.511|0.512] "rad/s"  ADCU
 SG_ YawRateAbs_Obj_11 : 413|10@0+ (0.001,-0.511) [-0.511|0.512] "rad/s"  ADCU
 SG_ YawRateAbsStd_Obj_10 : 187|10@0+ (0.0001,0) [0|0.1023] "rad/s"  ADCU
 SG_ YawRateAbsStd_Obj_11 : 419|10@0+ (0.0001,0) [0|0.1023] "rad/s"  ADCU

BO_ 519 LR_Object_12_13: 64 LR
 SG_ AabsX_Obj_12 : 16|9@0+ (0.125,-31.875) [-31.875|32] "m/s^2"  ADCU
 SG_ AabsX_Obj_13 : 248|9@0+ (0.125,-31.875) [-31.875|32] "m/s^2"  ADCU
 SG_ AabsXStd_Obj_12 : 89|7@0+ (0.25,0) [0|31.75] "m/s^2"  ADCU
 SG_ AabsXStd_Obj_13 : 321|7@0+ (0.25,0) [0|31.75] "m/s^2"  ADCU
 SG_ AabsY_Obj_12 : 48|9@0+ (0.125,-31.875) [-31.875|32] "m/s^2"  ADCU
 SG_ AabsY_Obj_13 : 280|9@0+ (0.125,-31.875) [-31.875|32] "m/s^2"  ADCU
 SG_ AabsYStd_Obj_12 : 111|8@0+ (0.25,0) [0|63.75] "m/s^2"  ADCU
 SG_ AabsYStd_Obj_13 : 343|8@0+ (0.25,0) [0|63.75] "m/s^2"  ADCU
 SG_ ClassConf_Obj_12 : 119|7@0+ (1,0) [0|127] "%"  ADCU
 SG_ ClassConf_Obj_13 : 351|7@0+ (1,0) [0|127] "%"  ADCU
 SG_ Classification_Obj_12 : 98|3@0+ (1,0) [0|7] ""  ADCU
 SG_ Classification_Obj_13 : 330|3@0+ (1,0) [0|7] ""  ADCU
 SG_ CRC16_Checksum_Obj_12_13 : 503|16@0+ (1,0) [0|65535] ""  ADCU
 SG_ DistX_Obj_12 : 7|12@0+ (0.1,-200) [-200|209.5] "m"  ADCU
 SG_ DistX_Obj_13 : 239|12@0+ (0.1,-200) [-200|209.5] "m"  ADCU
 SG_ DistXStd_Obj_12 : 71|8@0+ (0.05,0) [0|12.75] "m"  ADCU
 SG_ DistXStd_Obj_13 : 303|8@0+ (0.05,0) [0|12.75] "m"  ADCU
 SG_ DistY_Obj_12 : 39|12@0+ (0.1,-200) [-200|209.5] "m"  ADCU
 SG_ DistY_Obj_13 : 271|12@0+ (0.1,-200) [-200|209.5] "m"  ADCU
 SG_ DistYStd_Obj_12 : 79|8@0+ (0.1,0) [0|25.5] "m"  ADCU
 SG_ DistYStd_Obj_13 : 311|8@0+ (0.1,0) [0|25.5] "m"  ADCU
 SG_ DynConf_Obj_12 : 121|7@0+ (1,0) [0|127] "%"  ADCU
 SG_ DynConf_Obj_13 : 353|7@0+ (1,0) [0|127] "%"  ADCU
 SG_ DynProp_Obj_12 : 130|3@0+ (1,0) [0|7] ""  ADCU
 SG_ DynProp_Obj_13 : 362|3@0+ (1,0) [0|7] ""  ADCU
 SG_ ID_Obj_12 : 209|8@0+ (1,0) [0|255] ""  ADCU
 SG_ ID_Obj_13 : 441|8@0+ (1,0) [0|255] ""  ADCU
 SG_ Length_Obj_12 : 136|7@0+ (0.2,0) [0|25.4] "m"  ADCU
 SG_ Length_Obj_13 : 368|7@0+ (0.2,0) [0|25.4] "m"  ADCU
 SG_ LifeCycle_Obj_12 : 193|16@0+ (1,0) [0|65535] ""  ADCU
 SG_ LifeCycle_Obj_13 : 425|16@0+ (1,0) [0|65535] ""  ADCU
 SG_ MaintenanceState_Obj_12 : 145|2@0+ (1,0) [0|3] ""  ADCU
 SG_ MaintenanceState_Obj_13 : 377|2@0+ (1,0) [0|3] ""  ADCU
 SG_ MicroDopplerFlag_12 : 472|1@0+ (1,0) [0|1] ""  ADCU
 SG_ MicroDopplerFlag_13 : 480|1@0+ (1,0) [0|1] ""  ADCU
 SG_ MirrorProb_Obj_12 : 143|7@0+ (1,0) [0|127] "%"  ADCU
 SG_ MirrorProb_Obj_13 : 375|7@0+ (1,0) [0|127] "%"  ADCU
 SG_ MsgCounter_Obj_00_13 : 495|8@0+ (1,0) [0|255] ""  ADCU
 SG_ ObstacleProb_Obj_12 : 479|7@0+ (1,0) [0|127] "%"  ADCU
 SG_ ObstacleProb_Obj_13 : 487|7@0+ (1,0) [0|127] "%"  ADCU
 SG_ Orientation_Obj_12 : 175|10@0+ (0.01,-5.11) [-5.11|5.12] "rad"  ADCU
 SG_ Orientation_Obj_13 : 407|10@0+ (0.01,-5.11) [-5.11|5.12] "rad"  ADCU
 SG_ OrientationStd_Obj_12 : 471|4@0+ (0.002,0) [0|0.03] "rad"  ADCU
 SG_ OrientationStd_Obj_13 : 467|4@0+ (0.002,0) [0|0.03] "rad"  ADCU
 SG_ ProbOfExist_Obj_12 : 112|7@0+ (1,0) [0|127] "%"  ADCU
 SG_ ProbOfExist_Obj_13 : 344|7@0+ (1,0) [0|127] "%"  ADCU
 SG_ RCS_Obj_12 : 152|9@0+ (0.2,-51.1) [-51.1|51.1] "dBsm"  ADCU
 SG_ RCS_Obj_13 : 384|9@0+ (0.2,-51.1) [-51.1|51.1] "dBsm"  ADCU
 SG_ RefPoint_Obj_12 : 217|4@0+ (1,0) [0|15] ""  ADCU
 SG_ RefPoint_Obj_13 : 449|4@0+ (1,0) [0|15] ""  ADCU
 SG_ VabsX_Obj_12 : 11|11@0+ (0.125,-128) [-128|127.875] "m/s"  ADCU
 SG_ VabsX_Obj_13 : 243|11@0+ (0.125,-128) [-128|127.875] "m/s"  ADCU
 SG_ VabsXStd_Obj_12 : 87|7@0+ (0.1,0) [0|12.7] "m/s"  ADCU
 SG_ VabsXStd_Obj_13 : 319|7@0+ (0.1,0) [0|12.7] "m/s"  ADCU
 SG_ VabsY_Obj_12 : 43|11@0+ (0.125,-128) [-128|127.875] "m/s"  ADCU
 SG_ VabsY_Obj_13 : 275|11@0+ (0.125,-128) [-128|127.875] "m/s"  ADCU
 SG_ VabsYStd_Obj_12 : 80|7@0+ (0.2,0) [0|25.4] "m/s"  ADCU
 SG_ VabsYStd_Obj_13 : 312|7@0+ (0.2,0) [0|25.4] "m/s"  ADCU
 SG_ Valid_Obj_12 : 229|1@0+ (1,0) [0|1] ""  ADCU
 SG_ Valid_Obj_13 : 461|1@0+ (1,0) [0|1] ""  ADCU
 SG_ Width_Obj_12 : 159|7@0+ (0.2,0) [0|25.4] "m"  ADCU
 SG_ Width_Obj_13 : 391|7@0+ (0.2,0) [0|25.4] "m"  ADCU
 SG_ YawRateAbs_Obj_12 : 181|10@0+ (0.001,-0.511) [-0.511|0.512] "rad/s"  ADCU
 SG_ YawRateAbs_Obj_13 : 413|10@0+ (0.001,-0.511) [-0.511|0.512] "rad/s"  ADCU
 SG_ YawRateAbsStd_Obj_12 : 187|10@0+ (0.0001,0) [0|0.1023] "rad/s"  ADCU
 SG_ YawRateAbsStd_Obj_13 : 419|10@0+ (0.0001,0) [0|0.1023] "rad/s"  ADCU

BO_ 520 LR_Object_14_15: 64 LR
 SG_ AabsX_Obj_14 : 16|9@0+ (0.125,-31.875) [-31.875|32] "m/s^2"  ADCU
 SG_ AabsX_Obj_15 : 248|9@0+ (0.125,-31.875) [-31.875|32] "m/s^2"  ADCU
 SG_ AabsXStd_Obj_14 : 89|7@0+ (0.25,0) [0|31.75] "m/s^2"  ADCU
 SG_ AabsXStd_Obj_15 : 321|7@0+ (0.25,0) [0|31.75] "m/s^2"  ADCU
 SG_ AabsY_Obj_14 : 48|9@0+ (0.125,-31.875) [-31.875|32] "m/s^2"  ADCU
 SG_ AabsY_Obj_15 : 280|9@0+ (0.125,-31.875) [-31.875|32] "m/s^2"  ADCU
 SG_ AabsYStd_Obj_14 : 111|8@0+ (0.25,0) [0|63.75] "m/s^2"  ADCU
 SG_ AabsYStd_Obj_15 : 343|8@0+ (0.25,0) [0|63.75] "m/s^2"  ADCU
 SG_ ClassConf_Obj_14 : 119|7@0+ (1,0) [0|127] "%"  ADCU
 SG_ ClassConf_Obj_15 : 351|7@0+ (1,0) [0|127] "%"  ADCU
 SG_ Classification_Obj_14 : 98|3@0+ (1,0) [0|7] ""  ADCU
 SG_ Classification_Obj_15 : 330|3@0+ (1,0) [0|7] ""  ADCU
 SG_ CRC16_Checksum_Obj_14_15 : 503|16@0+ (1,0) [0|65535] ""  ADCU
 SG_ DistX_Obj_14 : 7|12@0+ (0.1,-200) [-200|209.5] "m"  ADCU
 SG_ DistX_Obj_15 : 239|12@0+ (0.1,-200) [-200|209.5] "m"  ADCU
 SG_ DistXStd_Obj_14 : 71|8@0+ (0.05,0) [0|12.75] "m"  ADCU
 SG_ DistXStd_Obj_15 : 303|8@0+ (0.05,0) [0|12.75] "m"  ADCU
 SG_ DistY_Obj_14 : 39|12@0+ (0.1,-200) [-200|209.5] "m"  ADCU
 SG_ DistY_Obj_15 : 271|12@0+ (0.1,-200) [-200|209.5] "m"  ADCU
 SG_ DistYStd_Obj_14 : 79|8@0+ (0.1,0) [0|25.5] "m"  ADCU
 SG_ DistYStd_Obj_15 : 311|8@0+ (0.1,0) [0|25.5] "m"  ADCU
 SG_ DynConf_Obj_14 : 121|7@0+ (1,0) [0|127] "%"  ADCU
 SG_ DynConf_Obj_15 : 353|7@0+ (1,0) [0|127] "%"  ADCU
 SG_ DynProp_Obj_14 : 130|3@0+ (1,0) [0|7] ""  ADCU
 SG_ DynProp_Obj_15 : 362|3@0+ (1,0) [0|7] ""  ADCU
 SG_ ID_Obj_14 : 209|8@0+ (1,0) [0|255] ""  ADCU
 SG_ ID_Obj_15 : 441|8@0+ (1,0) [0|255] ""  ADCU
 SG_ Length_Obj_14 : 136|7@0+ (0.2,0) [0|25.4] "m"  ADCU
 SG_ Length_Obj_15 : 368|7@0+ (0.2,0) [0|25.4] "m"  ADCU
 SG_ LifeCycle_Obj_14 : 193|16@0+ (1,0) [0|65535] ""  ADCU
 SG_ LifeCycle_Obj_15 : 425|16@0+ (1,0) [0|65535] ""  ADCU
 SG_ MaintenanceState_Obj_14 : 145|2@0+ (1,0) [0|3] ""  ADCU
 SG_ MaintenanceState_Obj_15 : 377|2@0+ (1,0) [0|3] ""  ADCU
 SG_ MicroDopplerFlag_14 : 472|1@0+ (1,0) [0|1] ""  ADCU
 SG_ MicroDopplerFlag_15 : 480|1@0+ (1,0) [0|1] ""  ADCU
 SG_ MirrorProb_Obj_14 : 143|7@0+ (1,0) [0|127] "%"  ADCU
 SG_ MirrorProb_Obj_15 : 375|7@0+ (1,0) [0|127] "%"  ADCU
 SG_ MsgCounter_Obj_14_15 : 495|8@0+ (1,0) [0|255] ""  ADCU
 SG_ ObstacleProb_Obj_14 : 479|7@0+ (1,0) [0|127] "%"  ADCU
 SG_ ObstacleProb_Obj_15 : 487|7@0+ (1,0) [0|127] "%"  ADCU
 SG_ Orientation_Obj_14 : 175|10@0+ (0.01,-5.11) [-5.11|5.12] "rad"  ADCU
 SG_ Orientation_Obj_15 : 407|10@0+ (0.01,-5.11) [-5.11|5.12] "rad"  ADCU
 SG_ OrientationStd_Obj_14 : 471|4@0+ (0.002,0) [0|0.03] "rad"  ADCU
 SG_ OrientationStd_Obj_15 : 467|4@0+ (0.002,0) [0|0.03] "rad"  ADCU
 SG_ ProbOfExist_Obj_14 : 112|7@0+ (1,0) [0|127] "%"  ADCU
 SG_ ProbOfExist_Obj_15 : 344|7@0+ (1,0) [0|127] "%"  ADCU
 SG_ RCS_Obj_14 : 152|9@0+ (0.2,-51.1) [-51.1|51.1] "dBsm"  ADCU
 SG_ RCS_Obj_15 : 384|9@0+ (0.2,-51.1) [-51.1|51.1] "dBsm"  ADCU
 SG_ RefPoint_Obj_14 : 217|4@0+ (1,0) [0|15] ""  ADCU
 SG_ RefPoint_Obj_15 : 449|4@0+ (1,0) [0|15] ""  ADCU
 SG_ VabsX_Obj_14 : 11|11@0+ (0.125,-128) [-128|127.875] "m/s"  ADCU
 SG_ VabsX_Obj_15 : 243|11@0+ (0.125,-128) [-128|127.875] "m/s"  ADCU
 SG_ VabsXStd_Obj_14 : 87|7@0+ (0.1,0) [0|12.7] "m/s"  ADCU
 SG_ VabsXStd_Obj_15 : 319|7@0+ (0.1,0) [0|12.7] "m/s"  ADCU
 SG_ VabsY_Obj_14 : 43|11@0+ (0.125,-128) [-128|127.875] "m/s"  ADCU
 SG_ VabsY_Obj_15 : 275|11@0+ (0.125,-128) [-128|127.875] "m/s"  ADCU
 SG_ VabsYStd_Obj_14 : 80|7@0+ (0.2,0) [0|25.4] "m/s"  ADCU
 SG_ VabsYStd_Obj_15 : 312|7@0+ (0.2,0) [0|25.4] "m/s"  ADCU
 SG_ Valid_Obj_14 : 229|1@0+ (1,0) [0|1] ""  ADCU
 SG_ Valid_Obj_15 : 461|1@0+ (1,0) [0|1] ""  ADCU
 SG_ Width_Obj_14 : 159|7@0+ (0.2,0) [0|25.4] "m"  ADCU
 SG_ Width_Obj_15 : 391|7@0+ (0.2,0) [0|25.4] "m"  ADCU
 SG_ YawRateAbs_Obj_14 : 181|10@0+ (0.001,-0.511) [-0.511|0.512] "rad/s"  ADCU
 SG_ YawRateAbs_Obj_15 : 413|10@0+ (0.001,-0.511) [-0.511|0.512] "rad/s"  ADCU
 SG_ YawRateAbsStd_Obj_14 : 187|10@0+ (0.0001,0) [0|0.1023] "rad/s"  ADCU
 SG_ YawRateAbsStd_Obj_15 : 419|10@0+ (0.0001,0) [0|0.1023] "rad/s"  ADCU

CM_ SG_ 328 RR_AzimuthAng_138 "Azimuth angle of point_138";
CM_ SG_ 328 RR_AzimuthAng_139 "Azimuth angle of point_139";
CM_ SG_ 328 RR_AzimuthAng_140 "Azimuth angle of point_140";
CM_ SG_ 328 RR_AzimuthAng_141 "Azimuth angle of point_141";
CM_ SG_ 328 RR_AzimuthAng_142 "Azimuth angle of point_142";
CM_ SG_ 328 RR_AzimuthAng_143 "Azimuth angle of point_143";
CM_ SG_ 328 RR_AzimuthSNR_138 "Azimuth SNR of point_138";
CM_ SG_ 328 RR_AzimuthSNR_139 "Azimuth SNR of point_139";
CM_ SG_ 328 RR_AzimuthSNR_140 "Azimuth SNR of point_140";
CM_ SG_ 328 RR_AzimuthSNR_141 "Azimuth SNR of point_141";
CM_ SG_ 328 RR_AzimuthSNR_142 "Azimuth SNR of point_142";
CM_ SG_ 328 RR_AzimuthSNR_143 "Azimuth SNR of point_143";
CM_ SG_ 328 RR_ElevationAng_138 "Elevation angle of point_138";
CM_ SG_ 328 RR_ElevationAng_139 "Elevation angle of point_139";
CM_ SG_ 328 RR_ElevationAng_140 "Elevation angle of point_140";
CM_ SG_ 328 RR_ElevationAng_141 "Elevation angle of point_141";
CM_ SG_ 328 RR_ElevationAng_142 "Elevation angle of point_142";
CM_ SG_ 328 RR_ElevationAng_143 "Elevation angle of point_143";
CM_ SG_ 328 RR_ElevationSNR_138 "Elevation SNR of point_138";
CM_ SG_ 328 RR_ElevationSNR_139 "Elevation SNR of point_139";
CM_ SG_ 328 RR_ElevationSNR_140 "Elevation SNR of point_140";
CM_ SG_ 328 RR_ElevationSNR_141 "Elevation SNR of point_141";
CM_ SG_ 328 RR_ElevationSNR_142 "Elevation SNR of point_142";
CM_ SG_ 328 RR_ElevationSNR_143 "Elevation SNR of point_143";
CM_ SG_ 328 RR_Range_138 "Range of point_138";
CM_ SG_ 328 RR_Range_139 "Range of point_139";
CM_ SG_ 328 RR_Range_140 "Range of point_140";
CM_ SG_ 328 RR_Range_141 "Range of point_141";
CM_ SG_ 328 RR_Range_142 "Range of point_142";
CM_ SG_ 328 RR_Range_143 "Range of point_143";
CM_ SG_ 328 RR_RCS_138 "RCS of point_138";
CM_ SG_ 328 RR_RCS_139 "RCS of point_139";
CM_ SG_ 328 RR_RCS_140 "RCS of point_140";
CM_ SG_ 328 RR_RCS_141 "RCS of point_141";
CM_ SG_ 328 RR_RCS_142 "RCS of point_142";
CM_ SG_ 328 RR_RCS_143 "RCS of point_143";
CM_ SG_ 328 RR_Status_138 "Status of point_138";
CM_ SG_ 328 RR_Status_139 "Status of point_139";
CM_ SG_ 328 RR_Status_140 "Status of point_140";
CM_ SG_ 328 RR_Status_141 "Status of point_141";
CM_ SG_ 328 RR_Status_142 "Status of point_142";
CM_ SG_ 328 RR_Status_143 "Status of point_143";
CM_ SG_ 328 RR_Tbd_138 "To be defined";
CM_ SG_ 328 RR_Tbd_139 "To be defined";
CM_ SG_ 328 RR_Tbd_140 "To be defined";
CM_ SG_ 328 RR_Tbd_141 "To be defined";
CM_ SG_ 328 RR_Tbd_142 "To be defined";
CM_ SG_ 328 RR_Tbd_143 "To be defined";
CM_ SG_ 328 RR_Velocity_138 "Relative radial velocity of point_138";
CM_ SG_ 328 RR_Velocity_139 "Relative radial velocity of point_139";
CM_ SG_ 328 RR_Velocity_140 "Relative radial velocity of point_140";
CM_ SG_ 328 RR_Velocity_141 "Relative radial velocity of point_141";
CM_ SG_ 328 RR_Velocity_142 "Relative radial velocity of point_142";
CM_ SG_ 328 RR_Velocity_143 "Relative radial velocity of point_143";
CM_ SG_ 329 RR_AzimuthAng_144 "Azimuth angle of point_144";
CM_ SG_ 329 RR_AzimuthAng_145 "Azimuth angle of point_145";
CM_ SG_ 329 RR_AzimuthAng_146 "Azimuth angle of point_146";
CM_ SG_ 329 RR_AzimuthAng_147 "Azimuth angle of point_147";
CM_ SG_ 329 RR_AzimuthAng_148 "Azimuth angle of point_148";
CM_ SG_ 329 RR_AzimuthAng_149 "Azimuth angle of point_149";
CM_ SG_ 329 RR_AzimuthSNR_144 "Azimuth SNR of point_144";
CM_ SG_ 329 RR_AzimuthSNR_145 "Azimuth SNR of point_145";
CM_ SG_ 329 RR_AzimuthSNR_146 "Azimuth SNR of point_146";
CM_ SG_ 329 RR_AzimuthSNR_147 "Azimuth SNR of point_147";
CM_ SG_ 329 RR_AzimuthSNR_148 "Azimuth SNR of point_148";
CM_ SG_ 329 RR_AzimuthSNR_149 "Azimuth SNR of point_149";
CM_ SG_ 329 RR_ElevationAng_144 "Elevation angle of point_144";
CM_ SG_ 329 RR_ElevationAng_145 "Elevation angle of point_145";
CM_ SG_ 329 RR_ElevationAng_146 "Elevation angle of point_146";
CM_ SG_ 329 RR_ElevationAng_147 "Elevation angle of point_147";
CM_ SG_ 329 RR_ElevationAng_148 "Elevation angle of point_148";
CM_ SG_ 329 RR_ElevationAng_149 "Elevation angle of point_149";
CM_ SG_ 329 RR_ElevationSNR_144 "Elevation SNR of point_144";
CM_ SG_ 329 RR_ElevationSNR_145 "Elevation SNR of point_145";
CM_ SG_ 329 RR_ElevationSNR_146 "Elevation SNR of point_146";
CM_ SG_ 329 RR_ElevationSNR_147 "Elevation SNR of point_147";
CM_ SG_ 329 RR_ElevationSNR_148 "Elevation SNR of point_148";
CM_ SG_ 329 RR_ElevationSNR_149 "Elevation SNR of point_149";
CM_ SG_ 329 RR_Range_144 "Range of point_144";
CM_ SG_ 329 RR_Range_145 "Range of point_145";
CM_ SG_ 329 RR_Range_146 "Range of point_146";
CM_ SG_ 329 RR_Range_147 "Range of point_147";
CM_ SG_ 329 RR_Range_148 "Range of point_148";
CM_ SG_ 329 RR_Range_149 "Range of point_149";
CM_ SG_ 329 RR_RCS_144 "RCS of point_144";
CM_ SG_ 329 RR_RCS_145 "RCS of point_145";
CM_ SG_ 329 RR_RCS_146 "RCS of point_146";
CM_ SG_ 329 RR_RCS_147 "RCS of point_147";
CM_ SG_ 329 RR_RCS_148 "RCS of point_148";
CM_ SG_ 329 RR_RCS_149 "RCS of point_149";
CM_ SG_ 329 RR_Status_144 "Status of point_144";
CM_ SG_ 329 RR_Status_145 "Status of point_145";
CM_ SG_ 329 RR_Status_146 "Status of point_146";
CM_ SG_ 329 RR_Status_147 "Status of point_147";
CM_ SG_ 329 RR_Status_148 "Status of point_148";
CM_ SG_ 329 RR_Status_149 "Status of point_149";
CM_ SG_ 329 RR_Tbd_144 "To be defined";
CM_ SG_ 329 RR_Tbd_145 "To be defined";
CM_ SG_ 329 RR_Tbd_146 "To be defined";
CM_ SG_ 329 RR_Tbd_147 "To be defined";
CM_ SG_ 329 RR_Tbd_148 "To be defined";
CM_ SG_ 329 RR_Tbd_149 "To be defined";
CM_ SG_ 329 RR_Velocity_144 "Relative radial velocity of point_144";
CM_ SG_ 329 RR_Velocity_145 "Relative radial velocity of point_145";
CM_ SG_ 329 RR_Velocity_146 "Relative radial velocity of point_146";
CM_ SG_ 329 RR_Velocity_147 "Relative radial velocity of point_147";
CM_ SG_ 329 RR_Velocity_148 "Relative radial velocity of point_148";
CM_ SG_ 329 RR_Velocity_149 "Relative radial velocity of point_149";
CM_ SG_ 330 RR_AzimuthAng_150 "Azimuth angle of point_150";
CM_ SG_ 330 RR_AzimuthAng_151 "Azimuth angle of point_151";
CM_ SG_ 330 RR_AzimuthAng_152 "Azimuth angle of point_152";
CM_ SG_ 330 RR_AzimuthAng_153 "Azimuth angle of point_153";
CM_ SG_ 330 RR_AzimuthAng_154 "Azimuth angle of point_154";
CM_ SG_ 330 RR_AzimuthAng_155 "Azimuth angle of point_155";
CM_ SG_ 330 RR_AzimuthSNR_150 "Azimuth SNR of point_150";
CM_ SG_ 330 RR_AzimuthSNR_151 "Azimuth SNR of point_151";
CM_ SG_ 330 RR_AzimuthSNR_152 "Azimuth SNR of point_152";
CM_ SG_ 330 RR_AzimuthSNR_153 "Azimuth SNR of point_153";
CM_ SG_ 330 RR_AzimuthSNR_154 "Azimuth SNR of point_154";
CM_ SG_ 330 RR_AzimuthSNR_155 "Azimuth SNR of point_155";
CM_ SG_ 330 RR_ElevationAng_150 "Elevation angle of point_150";
CM_ SG_ 330 RR_ElevationAng_151 "Elevation angle of point_151";
CM_ SG_ 330 RR_ElevationAng_152 "Elevation angle of point_152";
CM_ SG_ 330 RR_ElevationAng_153 "Elevation angle of point_153";
CM_ SG_ 330 RR_ElevationAng_154 "Elevation angle of point_154";
CM_ SG_ 330 RR_ElevationAng_155 "Elevation angle of point_155";
CM_ SG_ 330 RR_ElevationSNR_150 "Elevation SNR of point_150";
CM_ SG_ 330 RR_ElevationSNR_151 "Elevation SNR of point_151";
CM_ SG_ 330 RR_ElevationSNR_152 "Elevation SNR of point_152";
CM_ SG_ 330 RR_ElevationSNR_153 "Elevation SNR of point_153";
CM_ SG_ 330 RR_ElevationSNR_154 "Elevation SNR of point_154";
CM_ SG_ 330 RR_ElevationSNR_155 "Elevation SNR of point_155";
CM_ SG_ 330 RR_Range_150 "Range of point_150";
CM_ SG_ 330 RR_Range_151 "Range of point_151";
CM_ SG_ 330 RR_Range_152 "Range of point_152";
CM_ SG_ 330 RR_Range_153 "Range of point_153";
CM_ SG_ 330 RR_Range_154 "Range of point_154";
CM_ SG_ 330 RR_Range_155 "Range of point_155";
CM_ SG_ 330 RR_RCS_150 "RCS of point_150";
CM_ SG_ 330 RR_RCS_151 "RCS of point_151";
CM_ SG_ 330 RR_RCS_152 "RCS of point_152";
CM_ SG_ 330 RR_RCS_153 "RCS of point_153";
CM_ SG_ 330 RR_RCS_154 "RCS of point_154";
CM_ SG_ 330 RR_RCS_155 "RCS of point_155";
CM_ SG_ 330 RR_Status_150 "Status of point_150";
CM_ SG_ 330 RR_Status_151 "Status of point_151";
CM_ SG_ 330 RR_Status_152 "Status of point_152";
CM_ SG_ 330 RR_Status_153 "Status of point_153";
CM_ SG_ 330 RR_Status_154 "Status of point_154";
CM_ SG_ 330 RR_Status_155 "Status of point_155";
CM_ SG_ 330 RR_Tbd_150 "To be defined";
CM_ SG_ 330 RR_Tbd_151 "To be defined";
CM_ SG_ 330 RR_Tbd_152 "To be defined";
CM_ SG_ 330 RR_Tbd_153 "To be defined";
CM_ SG_ 330 RR_Tbd_154 "To be defined";
CM_ SG_ 330 RR_Tbd_155 "To be defined";
CM_ SG_ 330 RR_Velocity_150 "Relative radial velocity of point_150";
CM_ SG_ 330 RR_Velocity_151 "Relative radial velocity of point_151";
CM_ SG_ 330 RR_Velocity_152 "Relative radial velocity of point_152";
CM_ SG_ 330 RR_Velocity_153 "Relative radial velocity of point_153";
CM_ SG_ 330 RR_Velocity_154 "Relative radial velocity of point_154";
CM_ SG_ 330 RR_Velocity_155 "Relative radial velocity of point_155";
CM_ SG_ 331 RR_AzimuthAng_156 "Azimuth angle of point_156";
CM_ SG_ 331 RR_AzimuthAng_157 "Azimuth angle of point_157";
CM_ SG_ 331 RR_AzimuthAng_158 "Azimuth angle of point_158";
CM_ SG_ 331 RR_AzimuthAng_159 "Azimuth angle of point_159";
CM_ SG_ 331 RR_AzimuthAng_160 "Azimuth angle of point_160";
CM_ SG_ 331 RR_AzimuthAng_161 "Azimuth angle of point_161";
CM_ SG_ 331 RR_AzimuthSNR_156 "Azimuth SNR of point_156";
CM_ SG_ 331 RR_AzimuthSNR_157 "Azimuth SNR of point_157";
CM_ SG_ 331 RR_AzimuthSNR_158 "Azimuth SNR of point_158";
CM_ SG_ 331 RR_AzimuthSNR_159 "Azimuth SNR of point_159";
CM_ SG_ 331 RR_AzimuthSNR_160 "Azimuth SNR of point_160";
CM_ SG_ 331 RR_AzimuthSNR_161 "Azimuth SNR of point_161";
CM_ SG_ 331 RR_ElevationAng_156 "Elevation angle of point_156";
CM_ SG_ 331 RR_ElevationAng_157 "Elevation angle of point_157";
CM_ SG_ 331 RR_ElevationAng_158 "Elevation angle of point_158";
CM_ SG_ 331 RR_ElevationAng_159 "Elevation angle of point_159";
CM_ SG_ 331 RR_ElevationAng_160 "Elevation angle of point_160";
CM_ SG_ 331 RR_ElevationAng_161 "Elevation angle of point_161";
CM_ SG_ 331 RR_ElevationSNR_156 "Elevation SNR of point_156";
CM_ SG_ 331 RR_ElevationSNR_157 "Elevation SNR of point_157";
CM_ SG_ 331 RR_ElevationSNR_158 "Elevation SNR of point_158";
CM_ SG_ 331 RR_ElevationSNR_159 "Elevation SNR of point_159";
CM_ SG_ 331 RR_ElevationSNR_160 "Elevation SNR of point_160";
CM_ SG_ 331 RR_ElevationSNR_161 "Elevation SNR of point_161";
CM_ SG_ 331 RR_Range_156 "Range of point_156";
CM_ SG_ 331 RR_Range_157 "Range of point_157";
CM_ SG_ 331 RR_Range_158 "Range of point_158";
CM_ SG_ 331 RR_Range_159 "Range of point_159";
CM_ SG_ 331 RR_Range_160 "Range of point_160";
CM_ SG_ 331 RR_Range_161 "Range of point_161";
CM_ SG_ 331 RR_RCS_156 "RCS of point_156";
CM_ SG_ 331 RR_RCS_157 "RCS of point_157";
CM_ SG_ 331 RR_RCS_158 "RCS of point_158";
CM_ SG_ 331 RR_RCS_159 "RCS of point_159";
CM_ SG_ 331 RR_RCS_160 "RCS of point_160";
CM_ SG_ 331 RR_RCS_161 "RCS of point_161";
CM_ SG_ 331 RR_Status_156 "Status of point_156";
CM_ SG_ 331 RR_Status_157 "Status of point_157";
CM_ SG_ 331 RR_Status_158 "Status of point_158";
CM_ SG_ 331 RR_Status_159 "Status of point_159";
CM_ SG_ 331 RR_Status_160 "Status of point_160";
CM_ SG_ 331 RR_Status_161 "Status of point_161";
CM_ SG_ 331 RR_Tbd_156 "To be defined";
CM_ SG_ 331 RR_Tbd_157 "To be defined";
CM_ SG_ 331 RR_Tbd_158 "To be defined";
CM_ SG_ 331 RR_Tbd_159 "To be defined";
CM_ SG_ 331 RR_Tbd_160 "To be defined";
CM_ SG_ 331 RR_Tbd_161 "To be defined";
CM_ SG_ 331 RR_Velocity_156 "Relative radial velocity of point_156";
CM_ SG_ 331 RR_Velocity_157 "Relative radial velocity of point_157";
CM_ SG_ 331 RR_Velocity_158 "Relative radial velocity of point_158";
CM_ SG_ 331 RR_Velocity_159 "Relative radial velocity of point_159";
CM_ SG_ 331 RR_Velocity_160 "Relative radial velocity of point_160";
CM_ SG_ 331 RR_Velocity_161 "Relative radial velocity of point_161";
CM_ SG_ 332 RR_AzimuthAng_162 "Azimuth angle of point_162";
CM_ SG_ 332 RR_AzimuthAng_163 "Azimuth angle of point_163";
CM_ SG_ 332 RR_AzimuthAng_164 "Azimuth angle of point_164";
CM_ SG_ 332 RR_AzimuthAng_165 "Azimuth angle of point_165";
CM_ SG_ 332 RR_AzimuthAng_166 "Azimuth angle of point_166";
CM_ SG_ 332 RR_AzimuthAng_167 "Azimuth angle of point_167";
CM_ SG_ 332 RR_AzimuthSNR_162 "Azimuth SNR of point_162";
CM_ SG_ 332 RR_AzimuthSNR_163 "Azimuth SNR of point_163";
CM_ SG_ 332 RR_AzimuthSNR_164 "Azimuth SNR of point_164";
CM_ SG_ 332 RR_AzimuthSNR_165 "Azimuth SNR of point_165";
CM_ SG_ 332 RR_AzimuthSNR_166 "Azimuth SNR of point_166";
CM_ SG_ 332 RR_AzimuthSNR_167 "Azimuth SNR of point_167";
CM_ SG_ 332 RR_ElevationAng_162 "Elevation angle of point_162";
CM_ SG_ 332 RR_ElevationAng_163 "Elevation angle of point_163";
CM_ SG_ 332 RR_ElevationAng_164 "Elevation angle of point_164";
CM_ SG_ 332 RR_ElevationAng_165 "Elevation angle of point_165";
CM_ SG_ 332 RR_ElevationAng_166 "Elevation angle of point_166";
CM_ SG_ 332 RR_ElevationAng_167 "Elevation angle of point_167";
CM_ SG_ 332 RR_ElevationSNR_162 "Elevation SNR of point_162";
CM_ SG_ 332 RR_ElevationSNR_163 "Elevation SNR of point_163";
CM_ SG_ 332 RR_ElevationSNR_164 "Elevation SNR of point_164";
CM_ SG_ 332 RR_ElevationSNR_165 "Elevation SNR of point_165";
CM_ SG_ 332 RR_ElevationSNR_166 "Elevation SNR of point_166";
CM_ SG_ 332 RR_ElevationSNR_167 "Elevation SNR of point_167";
CM_ SG_ 332 RR_Range_162 "Range of point_162";
CM_ SG_ 332 RR_Range_163 "Range of point_163";
CM_ SG_ 332 RR_Range_164 "Range of point_164";
CM_ SG_ 332 RR_Range_165 "Range of point_165";
CM_ SG_ 332 RR_Range_166 "Range of point_166";
CM_ SG_ 332 RR_Range_167 "Range of point_167";
CM_ SG_ 332 RR_RCS_162 "RCS of point_162";
CM_ SG_ 332 RR_RCS_163 "RCS of point_163";
CM_ SG_ 332 RR_RCS_164 "RCS of point_164";
CM_ SG_ 332 RR_RCS_165 "RCS of point_165";
CM_ SG_ 332 RR_RCS_166 "RCS of point_166";
CM_ SG_ 332 RR_RCS_167 "RCS of point_167";
CM_ SG_ 332 RR_Status_162 "Status of point_162";
CM_ SG_ 332 RR_Status_163 "Status of point_163";
CM_ SG_ 332 RR_Status_164 "Status of point_164";
CM_ SG_ 332 RR_Status_165 "Status of point_165";
CM_ SG_ 332 RR_Status_166 "Status of point_166";
CM_ SG_ 332 RR_Status_167 "Status of point_167";
CM_ SG_ 332 RR_Tbd_162 "To be defined";
CM_ SG_ 332 RR_Tbd_163 "To be defined";
CM_ SG_ 332 RR_Tbd_164 "To be defined";
CM_ SG_ 332 RR_Tbd_165 "To be defined";
CM_ SG_ 332 RR_Tbd_166 "To be defined";
CM_ SG_ 332 RR_Tbd_167 "To be defined";
CM_ SG_ 332 RR_Velocity_162 "Relative radial velocity of point_162";
CM_ SG_ 332 RR_Velocity_163 "Relative radial velocity of point_163";
CM_ SG_ 332 RR_Velocity_164 "Relative radial velocity of point_164";
CM_ SG_ 332 RR_Velocity_165 "Relative radial velocity of point_165";
CM_ SG_ 332 RR_Velocity_166 "Relative radial velocity of point_166";
CM_ SG_ 332 RR_Velocity_167 "Relative radial velocity of point_167";
CM_ SG_ 333 RR_AzimuthAng_168 "Azimuth angle of point_168";
CM_ SG_ 333 RR_AzimuthAng_169 "Azimuth angle of point_169";
CM_ SG_ 333 RR_AzimuthAng_170 "Azimuth angle of point_170";
CM_ SG_ 333 RR_AzimuthAng_171 "Azimuth angle of point_171";
CM_ SG_ 333 RR_AzimuthAng_172 "Azimuth angle of point_172";
CM_ SG_ 333 RR_AzimuthAng_173 "Azimuth angle of point_173";
CM_ SG_ 333 RR_AzimuthSNR_168 "Azimuth SNR of point_168";
CM_ SG_ 333 RR_AzimuthSNR_169 "Azimuth SNR of point_169";
CM_ SG_ 333 RR_AzimuthSNR_170 "Azimuth SNR of point_170";
CM_ SG_ 333 RR_AzimuthSNR_171 "Azimuth SNR of point_171";
CM_ SG_ 333 RR_AzimuthSNR_172 "Azimuth SNR of point_172";
CM_ SG_ 333 RR_AzimuthSNR_173 "Azimuth SNR of point_173";
CM_ SG_ 333 RR_ElevationAng_168 "Elevation angle of point_168";
CM_ SG_ 333 RR_ElevationAng_169 "Elevation angle of point_169";
CM_ SG_ 333 RR_ElevationAng_170 "Elevation angle of point_170";
CM_ SG_ 333 RR_ElevationAng_171 "Elevation angle of point_171";
CM_ SG_ 333 RR_ElevationAng_172 "Elevation angle of point_172";
CM_ SG_ 333 RR_ElevationAng_173 "Elevation angle of point_173";
CM_ SG_ 333 RR_ElevationSNR_168 "Elevation SNR of point_168";
CM_ SG_ 333 RR_ElevationSNR_169 "Elevation SNR of point_169";
CM_ SG_ 333 RR_ElevationSNR_170 "Elevation SNR of point_170";
CM_ SG_ 333 RR_ElevationSNR_171 "Elevation SNR of point_171";
CM_ SG_ 333 RR_ElevationSNR_172 "Elevation SNR of point_172";
CM_ SG_ 333 RR_ElevationSNR_173 "Elevation SNR of point_173";
CM_ SG_ 333 RR_Range_168 "Range of point_168";
CM_ SG_ 333 RR_Range_169 "Range of point_169";
CM_ SG_ 333 RR_Range_170 "Range of point_170";
CM_ SG_ 333 RR_Range_171 "Range of point_171";
CM_ SG_ 333 RR_Range_172 "Range of point_172";
CM_ SG_ 333 RR_Range_173 "Range of point_173";
CM_ SG_ 333 RR_RCS_168 "RCS of point_168";
CM_ SG_ 333 RR_RCS_169 "RCS of point_169";
CM_ SG_ 333 RR_RCS_170 "RCS of point_170";
CM_ SG_ 333 RR_RCS_171 "RCS of point_171";
CM_ SG_ 333 RR_RCS_172 "RCS of point_172";
CM_ SG_ 333 RR_RCS_173 "RCS of point_173";
CM_ SG_ 333 RR_Status_168 "Status of point_168";
CM_ SG_ 333 RR_Status_169 "Status of point_169";
CM_ SG_ 333 RR_Status_170 "Status of point_170";
CM_ SG_ 333 RR_Status_171 "Status of point_171";
CM_ SG_ 333 RR_Status_172 "Status of point_172";
CM_ SG_ 333 RR_Status_173 "Status of point_173";
CM_ SG_ 333 RR_Tbd_168 "To be defined";
CM_ SG_ 333 RR_Tbd_169 "To be defined";
CM_ SG_ 333 RR_Tbd_170 "To be defined";
CM_ SG_ 333 RR_Tbd_171 "To be defined";
CM_ SG_ 333 RR_Tbd_172 "To be defined";
CM_ SG_ 333 RR_Tbd_173 "To be defined";
CM_ SG_ 333 RR_Velocity_168 "Relative radial velocity of point_168";
CM_ SG_ 333 RR_Velocity_169 "Relative radial velocity of point_169";
CM_ SG_ 333 RR_Velocity_170 "Relative radial velocity of point_170";
CM_ SG_ 333 RR_Velocity_171 "Relative radial velocity of point_171";
CM_ SG_ 333 RR_Velocity_172 "Relative radial velocity of point_172";
CM_ SG_ 333 RR_Velocity_173 "Relative radial velocity of point_173";
CM_ SG_ 334 RR_AzimuthAng_174 "Azimuth angle of point_174";
CM_ SG_ 334 RR_AzimuthAng_175 "Azimuth angle of point_175";
CM_ SG_ 334 RR_AzimuthAng_176 "Azimuth angle of point_176";
CM_ SG_ 334 RR_AzimuthAng_177 "Azimuth angle of point_177";
CM_ SG_ 334 RR_AzimuthAng_178 "Azimuth angle of point_178";
CM_ SG_ 334 RR_AzimuthAng_179 "Azimuth angle of point_179";
CM_ SG_ 334 RR_AzimuthSNR_174 "Azimuth SNR of point_174";
CM_ SG_ 334 RR_AzimuthSNR_175 "Azimuth SNR of point_175";
CM_ SG_ 334 RR_AzimuthSNR_176 "Azimuth SNR of point_176";
CM_ SG_ 334 RR_AzimuthSNR_177 "Azimuth SNR of point_177";
CM_ SG_ 334 RR_AzimuthSNR_178 "Azimuth SNR of point_178";
CM_ SG_ 334 RR_AzimuthSNR_179 "Azimuth SNR of point_179";
CM_ SG_ 334 RR_ElevationAng_174 "Elevation angle of point_174";
CM_ SG_ 334 RR_ElevationAng_175 "Elevation angle of point_175";
CM_ SG_ 334 RR_ElevationAng_176 "Elevation angle of point_176";
CM_ SG_ 334 RR_ElevationAng_177 "Elevation angle of point_177";
CM_ SG_ 334 RR_ElevationAng_178 "Elevation angle of point_178";
CM_ SG_ 334 RR_ElevationAng_179 "Elevation angle of point_179";
CM_ SG_ 334 RR_ElevationSNR_174 "Elevation SNR of point_174";
CM_ SG_ 334 RR_ElevationSNR_175 "Elevation SNR of point_175";
CM_ SG_ 334 RR_ElevationSNR_176 "Elevation SNR of point_176";
CM_ SG_ 334 RR_ElevationSNR_177 "Elevation SNR of point_177";
CM_ SG_ 334 RR_ElevationSNR_178 "Elevation SNR of point_178";
CM_ SG_ 334 RR_ElevationSNR_179 "Elevation SNR of point_179";
CM_ SG_ 334 RR_Range_174 "Range of point_174";
CM_ SG_ 334 RR_Range_175 "Range of point_175";
CM_ SG_ 334 RR_Range_176 "Range of point_176";
CM_ SG_ 334 RR_Range_177 "Range of point_177";
CM_ SG_ 334 RR_Range_178 "Range of point_178";
CM_ SG_ 334 RR_Range_179 "Range of point_179";
CM_ SG_ 334 RR_RCS_174 "RCS of point_174";
CM_ SG_ 334 RR_RCS_175 "RCS of point_175";
CM_ SG_ 334 RR_RCS_176 "RCS of point_176";
CM_ SG_ 334 RR_RCS_177 "RCS of point_177";
CM_ SG_ 334 RR_RCS_178 "RCS of point_178";
CM_ SG_ 334 RR_RCS_179 "RCS of point_179";
CM_ SG_ 334 RR_Status_174 "Status of point_174";
CM_ SG_ 334 RR_Status_175 "Status of point_175";
CM_ SG_ 334 RR_Status_176 "Status of point_176";
CM_ SG_ 334 RR_Status_177 "Status of point_177";
CM_ SG_ 334 RR_Status_178 "Status of point_178";
CM_ SG_ 334 RR_Status_179 "Status of point_179";
CM_ SG_ 334 RR_Tbd_174 "To be defined";
CM_ SG_ 334 RR_Tbd_175 "To be defined";
CM_ SG_ 334 RR_Tbd_176 "To be defined";
CM_ SG_ 334 RR_Tbd_177 "To be defined";
CM_ SG_ 334 RR_Tbd_178 "To be defined";
CM_ SG_ 334 RR_Tbd_179 "To be defined";
CM_ SG_ 334 RR_Velocity_174 "Relative radial velocity of point_174";
CM_ SG_ 334 RR_Velocity_175 "Relative radial velocity of point_175";
CM_ SG_ 334 RR_Velocity_176 "Relative radial velocity of point_176";
CM_ SG_ 334 RR_Velocity_177 "Relative radial velocity of point_177";
CM_ SG_ 334 RR_Velocity_178 "Relative radial velocity of point_178";
CM_ SG_ 334 RR_Velocity_179 "Relative radial velocity of point_179";
CM_ SG_ 335 RR_AzimuthAng_180 "Azimuth angle of point_180";
CM_ SG_ 335 RR_AzimuthAng_181 "Azimuth angle of point_181";
CM_ SG_ 335 RR_AzimuthAng_182 "Azimuth angle of point_182";
CM_ SG_ 335 RR_AzimuthAng_183 "Azimuth angle of point_183";
CM_ SG_ 335 RR_AzimuthAng_184 "Azimuth angle of point_184";
CM_ SG_ 335 RR_AzimuthAng_185 "Azimuth angle of point_185";
CM_ SG_ 335 RR_AzimuthSNR_180 "Azimuth SNR of point_180";
CM_ SG_ 335 RR_AzimuthSNR_181 "Azimuth SNR of point_181";
CM_ SG_ 335 RR_AzimuthSNR_182 "Azimuth SNR of point_182";
CM_ SG_ 335 RR_AzimuthSNR_183 "Azimuth SNR of point_183";
CM_ SG_ 335 RR_AzimuthSNR_184 "Azimuth SNR of point_184";
CM_ SG_ 335 RR_AzimuthSNR_185 "Azimuth SNR of point_185";
CM_ SG_ 335 RR_ElevationAng_180 "Elevation angle of point_180";
CM_ SG_ 335 RR_ElevationAng_181 "Elevation angle of point_181";
CM_ SG_ 335 RR_ElevationAng_182 "Elevation angle of point_182";
CM_ SG_ 335 RR_ElevationAng_183 "Elevation angle of point_183";
CM_ SG_ 335 RR_ElevationAng_184 "Elevation angle of point_184";
CM_ SG_ 335 RR_ElevationAng_185 "Elevation angle of point_185";
CM_ SG_ 335 RR_ElevationSNR_180 "Elevation SNR of point_180";
CM_ SG_ 335 RR_ElevationSNR_181 "Elevation SNR of point_181";
CM_ SG_ 335 RR_ElevationSNR_182 "Elevation SNR of point_182";
CM_ SG_ 335 RR_ElevationSNR_183 "Elevation SNR of point_183";
CM_ SG_ 335 RR_ElevationSNR_184 "Elevation SNR of point_184";
CM_ SG_ 335 RR_ElevationSNR_185 "Elevation SNR of point_185";
CM_ SG_ 335 RR_Range_180 "Range of point_180";
CM_ SG_ 335 RR_Range_181 "Range of point_181";
CM_ SG_ 335 RR_Range_182 "Range of point_182";
CM_ SG_ 335 RR_Range_183 "Range of point_183";
CM_ SG_ 335 RR_Range_184 "Range of point_184";
CM_ SG_ 335 RR_Range_185 "Range of point_185";
CM_ SG_ 335 RR_RCS_180 "RCS of point_180";
CM_ SG_ 335 RR_RCS_181 "RCS of point_181";
CM_ SG_ 335 RR_RCS_182 "RCS of point_182";
CM_ SG_ 335 RR_RCS_183 "RCS of point_183";
CM_ SG_ 335 RR_RCS_184 "RCS of point_184";
CM_ SG_ 335 RR_RCS_185 "RCS of point_185";
CM_ SG_ 335 RR_Status_180 "Status of point_180";
CM_ SG_ 335 RR_Status_181 "Status of point_181";
CM_ SG_ 335 RR_Status_182 "Status of point_182";
CM_ SG_ 335 RR_Status_183 "Status of point_183";
CM_ SG_ 335 RR_Status_184 "Status of point_184";
CM_ SG_ 335 RR_Status_185 "Status of point_185";
CM_ SG_ 335 RR_Tbd_180 "To be defined";
CM_ SG_ 335 RR_Tbd_181 "To be defined";
CM_ SG_ 335 RR_Tbd_182 "To be defined";
CM_ SG_ 335 RR_Tbd_183 "To be defined";
CM_ SG_ 335 RR_Tbd_184 "To be defined";
CM_ SG_ 335 RR_Tbd_185 "To be defined";
CM_ SG_ 335 RR_Velocity_180 "Relative radial velocity of point_180";
CM_ SG_ 335 RR_Velocity_181 "Relative radial velocity of point_181";
CM_ SG_ 335 RR_Velocity_182 "Relative radial velocity of point_182";
CM_ SG_ 335 RR_Velocity_183 "Relative radial velocity of point_183";
CM_ SG_ 335 RR_Velocity_184 "Relative radial velocity of point_184";
CM_ SG_ 335 RR_Velocity_185 "Relative radial velocity of point_185";
CM_ SG_ 512 CRC16_Checksum_Header "CRC16 of Message Header";
CM_ SG_ 512 CycleCounter "Internal coutner that increments if RDI task executes once";
CM_ SG_ 512 EgoAcceleration "Ego acceleration filtered by Radar Algorithm";
CM_ SG_ 512 EgoCurvature "Ego curvature filtered by Radar Algorithm";
CM_ SG_ 512 EgoVelocity "EgoVelocity";
CM_ SG_ 512 EgoVelocityStd "Ego velocity standard deviation filtered by Radar Algorithm";
CM_ SG_ 512 EgoYawRate "Ego yaw rate filtered by Radar Algorithm";
CM_ SG_ 512 ExtendedCycleFlag "Flag indicates OD task takes two cycles time to execute";
CM_ SG_ 512 Latency "Time difference between RF task and RDI task (signal processing time)";
CM_ SG_ 512 MeasCounter "Internal counter that increments if RF task executes once";
CM_ SG_ 512 MsgCounter_Header "Counter of Message Header";
CM_ SG_ 512 NumOfObjects "Number of objects";
CM_ SG_ 512 TaskValidFlag "Flag indicates OD task is valid";
CM_ SG_ 512 TimeStampGlobNanoSec "Synchronized global timestamp when OD-task corresponding RF task is done  (nannosecond)";
CM_ SG_ 512 TimeStampGlobSec "Synchronized global timestamp when OD-task corresponding RF task is done (second)";
CM_ SG_ 512 TimeStampLocal "Unsynchronized local timestamp when OD-task corresponding RF task is done";
CM_ SG_ 513 AabsX_Obj_00 "Longitudinal absolution acceleration over ground of object_00";
CM_ SG_ 513 AabsX_Obj_01 "Longitudinal absolution acceleration over ground of object_01";
CM_ SG_ 513 AabsXStd_Obj_00 "Longitudinal absolution acceleration standard deviation of object_00";
CM_ SG_ 513 AabsXStd_Obj_01 "Longitudinal absolution acceleration standard deviation of object_01";
CM_ SG_ 513 AabsY_Obj_00 "Lateral absolution acceleration over ground of object_00";
CM_ SG_ 513 AabsY_Obj_01 "Lateral absolution acceleration over ground of object_01";
CM_ SG_ 513 AabsYStd_Obj_00 "Lateral absolution acceleration standard deviation of object_00";
CM_ SG_ 513 AabsYStd_Obj_01 "Lateral absolution acceleration standard deviation of object_01";
CM_ SG_ 513 ClassConf_Obj_00 "Classification confidence of object_00";
CM_ SG_ 513 ClassConf_Obj_01 "Classification confidence of object_01";
CM_ SG_ 513 Classification_Obj_00 "Classification of object_00";
CM_ SG_ 513 Classification_Obj_01 "Classification of object_01";
CM_ SG_ 513 DistX_Obj_00 "Longitudinal distance of object_00";
CM_ SG_ 513 DistX_Obj_01 "Longitudinal distance of object_01";
CM_ SG_ 513 DistXStd_Obj_00 "Longitudinal distance standard deviation of object_00";
CM_ SG_ 513 DistXStd_Obj_01 "Longitudinal distance standard deviation of object_01";
CM_ SG_ 513 DistY_Obj_00 "Lateral distance of object_00";
CM_ SG_ 513 DistY_Obj_01 "Lateral distance of object_01";
CM_ SG_ 513 DistYStd_Obj_00 "Lateral distance standard deviation of object_00";
CM_ SG_ 513 DistYStd_Obj_01 "Lateral distance standard deviation of object_01";
CM_ SG_ 513 DynConf_Obj_00 "Dynamic property confidence of object_00";
CM_ SG_ 513 DynConf_Obj_01 "Dynamic property confidence of object_01";
CM_ SG_ 513 DynProp_Obj_00 "Dynamic property of object_00";
CM_ SG_ 513 DynProp_Obj_01 "Dynamic property of object_01";
CM_ SG_ 513 ID_Obj_00 "ID of object_00";
CM_ SG_ 513 ID_Obj_01 "ID of object_01";
CM_ SG_ 513 Length_Obj_00 "Length of object_00";
CM_ SG_ 513 Length_Obj_01 "Length of object_01";
CM_ SG_ 513 LifeCycle_Obj_00 "Life cycle of object_00";
CM_ SG_ 513 LifeCycle_Obj_01 "Life cycle of object_01";
CM_ SG_ 513 MaintenanceState_Obj_00 "Maintenance state of object_00";
CM_ SG_ 513 MaintenanceState_Obj_01 "Maintenance state of object_01";
CM_ SG_ 513 MicroDopplerFlag_00 "Micro-Doppler flag of object_00";
CM_ SG_ 513 MicroDopplerFlag_01 "Micro-Doppler flag of object_01";
CM_ SG_ 513 MirrorProb_Obj_00 "Mirror probability of object_00";
CM_ SG_ 513 MirrorProb_Obj_01 "Mirror probability of object_01";
CM_ SG_ 513 ObstacleProb_Obj_00 "Obstacle probability of object_00";
CM_ SG_ 513 ObstacleProb_Obj_01 "Obstacle probability of object_01";
CM_ SG_ 513 Orientation_Obj_00 "Orientation of object_00";
CM_ SG_ 513 Orientation_Obj_01 "Orientation of object_01";
CM_ SG_ 513 OrientationStd_Obj_00 "Orientation standard deviation of object_00";
CM_ SG_ 513 OrientationStd_Obj_01 "Orientation standard deviation of object_01";
CM_ SG_ 513 ProbOfExist_Obj_00 "Existence probability of object_00";
CM_ SG_ 513 ProbOfExist_Obj_01 "Existence probability of object_01";
CM_ SG_ 513 RCS_Obj_00 "RCS of object_00";
CM_ SG_ 513 RCS_Obj_01 "RCS of object_01";
CM_ SG_ 513 RefPoint_Obj_00 "Reference point of object_00";
CM_ SG_ 513 RefPoint_Obj_01 "Reference point of object_01";
CM_ SG_ 513 VabsX_Obj_00 "Longitudinal absolution velocity over ground of object_00";
CM_ SG_ 513 VabsX_Obj_01 "Longitudinal absolution velocity over ground of object_01";
CM_ SG_ 513 VabsXStd_Obj_00 "Longitudinal absolution velocity standard deviation of object_00";
CM_ SG_ 513 VabsXStd_Obj_01 "Longitudinal absolution velocity standard deviation of object_01";
CM_ SG_ 513 VabsY_Obj_00 "Lateral absolution velocity over ground of object_00";
CM_ SG_ 513 VabsY_Obj_01 "Lateral absolution velocity over ground of object_01";
CM_ SG_ 513 VabsYStd_Obj_00 "Lateral absolution velocity standard deviation of object_00";
CM_ SG_ 513 VabsYStd_Obj_01 "Lateral absolution velocity standard deviation of object_01";
CM_ SG_ 513 Valid_Obj_00 "Valid flag of object_00";
CM_ SG_ 513 Valid_Obj_01 "Valid flag of object_01";
CM_ SG_ 513 Width_Obj_00 "Width of object_00";
CM_ SG_ 513 Width_Obj_01 "Width of object_01";
CM_ SG_ 513 YawRateAbs_Obj_00 "Yaw rate of object_00";
CM_ SG_ 513 YawRateAbs_Obj_01 "Yaw rate of object_01";
CM_ SG_ 513 YawRateAbsStd_Obj_00 "Yaw rate standard deviation of object_00";
CM_ SG_ 513 YawRateAbsStd_Obj_01 "Yaw rate standard deviation of object_01";
CM_ SG_ 514 AabsX_Obj_02 "Longitudinal absolution acceleration over ground of object_02";
CM_ SG_ 514 AabsX_Obj_03 "Longitudinal absolution acceleration over ground of object_03";
CM_ SG_ 514 AabsXStd_Obj_02 "Longitudinal absolution acceleration standard deviation of object_02";
CM_ SG_ 514 AabsXStd_Obj_03 "Longitudinal absolution acceleration standard deviation of object_03";
CM_ SG_ 514 AabsY_Obj_02 "Lateral absolution acceleration over ground of object_02";
CM_ SG_ 514 AabsY_Obj_03 "Lateral absolution acceleration over ground of object_03";
CM_ SG_ 514 AabsYStd_Obj_02 "Lateral absolution acceleration standard deviation of object_02";
CM_ SG_ 514 AabsYStd_Obj_03 "Lateral absolution acceleration standard deviation of object_03";
CM_ SG_ 514 ClassConf_Obj_02 "Classification confidence of object_02";
CM_ SG_ 514 ClassConf_Obj_03 "Classification confidence of object_03";
CM_ SG_ 514 Classification_Obj_02 "Classification of object_02";
CM_ SG_ 514 Classification_Obj_03 "Classification of object_03";
CM_ SG_ 514 DistX_Obj_02 "Longitudinal distance of object_02";
CM_ SG_ 514 DistX_Obj_03 "Longitudinal distance of object_03";
CM_ SG_ 514 DistXStd_Obj_02 "Longitudinal distance standard deviation of object_02";
CM_ SG_ 514 DistXStd_Obj_03 "Longitudinal distance standard deviation of object_03";
CM_ SG_ 514 DistY_Obj_02 "Lateral distance of object_02";
CM_ SG_ 514 DistY_Obj_03 "Lateral distance of object_03";
CM_ SG_ 514 DistYStd_Obj_02 "Lateral distance standard deviation of object_02";
CM_ SG_ 514 DistYStd_Obj_03 "Lateral distance standard deviation of object_03";
CM_ SG_ 514 DynConf_Obj_02 "Dynamic property confidence of object_02";
CM_ SG_ 514 DynConf_Obj_03 "Dynamic property confidence of object_03";
CM_ SG_ 514 DynProp_Obj_02 "Dynamic property of object_02";
CM_ SG_ 514 DynProp_Obj_03 "Dynamic property of object_03";
CM_ SG_ 514 ID_Obj_02 "ID of object_02";
CM_ SG_ 514 ID_Obj_03 "ID of object_03";
CM_ SG_ 514 Length_Obj_02 "Length of object_02";
CM_ SG_ 514 Length_Obj_03 "Length of object_03";
CM_ SG_ 514 LifeCycle_Obj_02 "Life cycle of object_02";
CM_ SG_ 514 LifeCycle_Obj_03 "Life cycle of object_03";
CM_ SG_ 514 MaintenanceState_Obj_02 "Maintenance state of object_02";
CM_ SG_ 514 MaintenanceState_Obj_03 "Maintenance state of object_03";
CM_ SG_ 514 MicroDopplerFlag_02 "Micro-Doppler flag of object_02";
CM_ SG_ 514 MicroDopplerFlag_03 "Micro-Doppler flag of object_03";
CM_ SG_ 514 MirrorProb_Obj_02 "Mirror probability of object_02";
CM_ SG_ 514 MirrorProb_Obj_03 "Mirror probability of object_03";
CM_ SG_ 514 ObstacleProb_Obj_02 "Obstacle probability of object_02";
CM_ SG_ 514 ObstacleProb_Obj_03 "Obstacle probability of object_03";
CM_ SG_ 514 Orientation_Obj_02 "Orientation of object_02";
CM_ SG_ 514 Orientation_Obj_03 "Orientation of object_03";
CM_ SG_ 514 OrientationStd_Obj_02 "Orientation standard deviation of object_02";
CM_ SG_ 514 OrientationStd_Obj_03 "Orientation standard deviation of object_03";
CM_ SG_ 514 ProbOfExist_Obj_02 "Existence probability of object_02";
CM_ SG_ 514 ProbOfExist_Obj_03 "Existence probability of object_03";
CM_ SG_ 514 RCS_Obj_02 "RCS of object_02";
CM_ SG_ 514 RCS_Obj_03 "RCS of object_03";
CM_ SG_ 514 RefPoint_Obj_02 "Reference point of object_02";
CM_ SG_ 514 RefPoint_Obj_03 "Reference point of object_03";
CM_ SG_ 514 VabsX_Obj_02 "Longitudinal absolution velocity over ground of object_02";
CM_ SG_ 514 VabsX_Obj_03 "Longitudinal absolution velocity over ground of object_03";
CM_ SG_ 514 VabsXStd_Obj_02 "Longitudinal absolution velocity standard deviation of object_02";
CM_ SG_ 514 VabsXStd_Obj_03 "Longitudinal absolution velocity standard deviation of object_03";
CM_ SG_ 514 VabsY_Obj_02 "Lateral absolution velocity over ground of object_02";
CM_ SG_ 514 VabsY_Obj_03 "Lateral absolution velocity over ground of object_03";
CM_ SG_ 514 VabsYStd_Obj_02 "Lateral absolution velocity standard deviation of object_02";
CM_ SG_ 514 VabsYStd_Obj_03 "Lateral absolution velocity standard deviation of object_03";
CM_ SG_ 514 Valid_Obj_02 "Valid flag of object_02";
CM_ SG_ 514 Valid_Obj_03 "Valid flag of object_03";
CM_ SG_ 514 Width_Obj_02 "Width of object_02";
CM_ SG_ 514 Width_Obj_03 "Width of object_03";
CM_ SG_ 514 YawRateAbs_Obj_02 "Yaw rate of object_02";
CM_ SG_ 514 YawRateAbs_Obj_03 "Yaw rate of object_03";
CM_ SG_ 514 YawRateAbsStd_Obj_02 "Yaw rate standard deviation of object_02";
CM_ SG_ 514 YawRateAbsStd_Obj_03 "Yaw rate standard deviation of object_03";
CM_ SG_ 515 AabsX_Obj_04 "Longitudinal absolution acceleration over ground of object_04";
CM_ SG_ 515 AabsX_Obj_05 "Longitudinal absolution acceleration over ground of object_05";
CM_ SG_ 515 AabsXStd_Obj_04 "Longitudinal absolution acceleration standard deviation of object_04";
CM_ SG_ 515 AabsXStd_Obj_05 "Longitudinal absolution acceleration standard deviation of object_05";
CM_ SG_ 515 AabsY_Obj_04 "Lateral absolution acceleration over ground of object_04";
CM_ SG_ 515 AabsY_Obj_05 "Lateral absolution acceleration over ground of object_05";
CM_ SG_ 515 AabsYStd_Obj_04 "Lateral absolution acceleration standard deviation of object_04";
CM_ SG_ 515 AabsYStd_Obj_05 "Lateral absolution acceleration standard deviation of object_05";
CM_ SG_ 515 ClassConf_Obj_04 "Classification confidence of object_04";
CM_ SG_ 515 ClassConf_Obj_05 "Classification confidence of object_05";
CM_ SG_ 515 Classification_Obj_04 "Classification of object_04";
CM_ SG_ 515 Classification_Obj_05 "Classification of object_05";
CM_ SG_ 515 DistX_Obj_04 "Longitudinal distance of object_04";
CM_ SG_ 515 DistX_Obj_05 "Longitudinal distance of object_05";
CM_ SG_ 515 DistXStd_Obj_04 "Longitudinal distance standard deviation of object_04";
CM_ SG_ 515 DistXStd_Obj_05 "Longitudinal distance standard deviation of object_05";
CM_ SG_ 515 DistY_Obj_04 "Lateral distance of object_04";
CM_ SG_ 515 DistY_Obj_05 "Lateral distance of object_05";
CM_ SG_ 515 DistYStd_Obj_04 "Lateral distance standard deviation of object_04";
CM_ SG_ 515 DistYStd_Obj_05 "Lateral distance standard deviation of object_05";
CM_ SG_ 515 DynConf_Obj_04 "Dynamic property confidence of object_04";
CM_ SG_ 515 DynConf_Obj_05 "Dynamic property confidence of object_05";
CM_ SG_ 515 DynProp_Obj_04 "Dynamic property of object_04";
CM_ SG_ 515 DynProp_Obj_05 "Dynamic property of object_05";
CM_ SG_ 515 ID_Obj_04 "ID of object_04";
CM_ SG_ 515 ID_Obj_05 "ID of object_05";
CM_ SG_ 515 Length_Obj_04 "Length of object_04";
CM_ SG_ 515 Length_Obj_05 "Length of object_05";
CM_ SG_ 515 LifeCycle_Obj_04 "Life cycle of object_04";
CM_ SG_ 515 LifeCycle_Obj_05 "Life cycle of object_05";
CM_ SG_ 515 MaintenanceState_Obj_04 "Maintenance state of object_04";
CM_ SG_ 515 MaintenanceState_Obj_05 "Maintenance state of object_05";
CM_ SG_ 515 MicroDopplerFlag_04 "Micro-Doppler flag of object_04";
CM_ SG_ 515 MicroDopplerFlag_05 "Micro-Doppler flag of object_05";
CM_ SG_ 515 MirrorProb_Obj_04 "Mirror probability of object_04";
CM_ SG_ 515 MirrorProb_Obj_05 "Mirror probability of object_05";
CM_ SG_ 515 ObstacleProb_Obj_04 "Obstacle probability of object_04";
CM_ SG_ 515 ObstacleProb_Obj_05 "Obstacle probability of object_05";
CM_ SG_ 515 Orientation_Obj_04 "Orientation of object_04";
CM_ SG_ 515 Orientation_Obj_05 "Orientation of object_05";
CM_ SG_ 515 OrientationStd_Obj_04 "Orientation standard deviation of object_04";
CM_ SG_ 515 OrientationStd_Obj_05 "Orientation standard deviation of object_05";
CM_ SG_ 515 ProbOfExist_Obj_04 "Existence probability of object_04";
CM_ SG_ 515 ProbOfExist_Obj_05 "Existence probability of object_05";
CM_ SG_ 515 RCS_Obj_04 "RCS of object_04";
CM_ SG_ 515 RCS_Obj_05 "RCS of object_05";
CM_ SG_ 515 RefPoint_Obj_04 "Reference point of object_04";
CM_ SG_ 515 RefPoint_Obj_05 "Reference point of object_05";
CM_ SG_ 515 VabsX_Obj_04 "Longitudinal absolution velocity over ground of object_04";
CM_ SG_ 515 VabsX_Obj_05 "Longitudinal absolution velocity over ground of object_05";
CM_ SG_ 515 VabsXStd_Obj_04 "Longitudinal absolution velocity standard deviation of object_04";
CM_ SG_ 515 VabsXStd_Obj_05 "Longitudinal absolution velocity standard deviation of object_05";
CM_ SG_ 515 VabsY_Obj_04 "Lateral absolution velocity over ground of object_04";
CM_ SG_ 515 VabsY_Obj_05 "Lateral absolution velocity over ground of object_05";
CM_ SG_ 515 VabsYStd_Obj_04 "Lateral absolution velocity standard deviation of object_04";
CM_ SG_ 515 VabsYStd_Obj_05 "Lateral absolution velocity standard deviation of object_05";
CM_ SG_ 515 Valid_Obj_04 "Valid flag of object_04";
CM_ SG_ 515 Valid_Obj_05 "Valid flag of object_05";
CM_ SG_ 515 Width_Obj_04 "Width of object_04";
CM_ SG_ 515 Width_Obj_05 "Width of object_05";
CM_ SG_ 515 YawRateAbs_Obj_04 "Yaw rate of object_04";
CM_ SG_ 515 YawRateAbs_Obj_05 "Yaw rate of object_05";
CM_ SG_ 515 YawRateAbsStd_Obj_04 "Yaw rate standard deviation of object_04";
CM_ SG_ 515 YawRateAbsStd_Obj_05 "Yaw rate standard deviation of object_05";
CM_ SG_ 516 AabsX_Obj_06 "Longitudinal absolution acceleration over ground of object_06";
CM_ SG_ 516 AabsX_Obj_07 "Longitudinal absolution acceleration over ground of object_07";
CM_ SG_ 516 AabsXStd_Obj_06 "Longitudinal absolution acceleration standard deviation of object_06";
CM_ SG_ 516 AabsXStd_Obj_07 "Longitudinal absolution acceleration standard deviation of object_07";
CM_ SG_ 516 AabsY_Obj_06 "Lateral absolution acceleration over ground of object_06";
CM_ SG_ 516 AabsY_Obj_07 "Lateral absolution acceleration over ground of object_07";
CM_ SG_ 516 AabsYStd_Obj_06 "Lateral absolution acceleration standard deviation of object_06";
CM_ SG_ 516 AabsYStd_Obj_07 "Lateral absolution acceleration standard deviation of object_07";
CM_ SG_ 516 ClassConf_Obj_06 "Classification confidence of object_06";
CM_ SG_ 516 ClassConf_Obj_07 "Classification confidence of object_07";
CM_ SG_ 516 Classification_Obj_06 "Classification of object_06";
CM_ SG_ 516 Classification_Obj_07 "Classification of object_07";
CM_ SG_ 516 DistX_Obj_06 "Longitudinal distance of object_06";
CM_ SG_ 516 DistX_Obj_07 "Longitudinal distance of object_07";
CM_ SG_ 516 DistXStd_Obj_06 "Longitudinal distance standard deviation of object_06";
CM_ SG_ 516 DistXStd_Obj_07 "Longitudinal distance standard deviation of object_07";
CM_ SG_ 516 DistY_Obj_06 "Lateral distance of object_06";
CM_ SG_ 516 DistY_Obj_07 "Lateral distance of object_07";
CM_ SG_ 516 DistYStd_Obj_06 "Lateral distance standard deviation of object_06";
CM_ SG_ 516 DistYStd_Obj_07 "Lateral distance standard deviation of object_07";
CM_ SG_ 516 DynConf_Obj_06 "Dynamic property confidence of object_06";
CM_ SG_ 516 DynConf_Obj_07 "Dynamic property confidence of object_07";
CM_ SG_ 516 DynProp_Obj_06 "Dynamic property of object_06";
CM_ SG_ 516 DynProp_Obj_07 "Dynamic property of object_07";
CM_ SG_ 516 ID_Obj_06 "ID of object_06";
CM_ SG_ 516 ID_Obj_07 "ID of object_07";
CM_ SG_ 516 Length_Obj_06 "Length of object_06";
CM_ SG_ 516 Length_Obj_07 "Length of object_07";
CM_ SG_ 516 LifeCycle_Obj_06 "Life cycle of object_06";
CM_ SG_ 516 LifeCycle_Obj_07 "Life cycle of object_07";
CM_ SG_ 516 MaintenanceState_Obj_06 "Maintenance state of object_06";
CM_ SG_ 516 MaintenanceState_Obj_07 "Maintenance state of object_07";
CM_ SG_ 516 MicroDopplerFlag_06 "Micro-Doppler flag of object_06";
CM_ SG_ 516 MicroDopplerFlag_07 "Micro-Doppler flag of object_07";
CM_ SG_ 516 MirrorProb_Obj_06 "Mirror probability of object_06";
CM_ SG_ 516 MirrorProb_Obj_07 "Mirror probability of object_07";
CM_ SG_ 516 ObstacleProb_Obj_06 "Obstacle probability of object_06";
CM_ SG_ 516 ObstacleProb_Obj_07 "Obstacle probability of object_07";
CM_ SG_ 516 Orientation_Obj_06 "Orientation of object_06";
CM_ SG_ 516 Orientation_Obj_07 "Orientation of object_07";
CM_ SG_ 516 OrientationStd_Obj_06 "Orientation standard deviation of object_06";
CM_ SG_ 516 OrientationStd_Obj_07 "Orientation standard deviation of object_07";
CM_ SG_ 516 ProbOfExist_Obj_06 "Existence probability of object_06";
CM_ SG_ 516 ProbOfExist_Obj_07 "Existence probability of object_07";
CM_ SG_ 516 RCS_Obj_06 "RCS of object_06";
CM_ SG_ 516 RCS_Obj_07 "RCS of object_07";
CM_ SG_ 516 RefPoint_Obj_06 "Reference point of object_06";
CM_ SG_ 516 RefPoint_Obj_07 "Reference point of object_07";
CM_ SG_ 516 VabsX_Obj_06 "Longitudinal absolution velocity over ground of object_06";
CM_ SG_ 516 VabsX_Obj_07 "Longitudinal absolution velocity over ground of object_07";
CM_ SG_ 516 VabsXStd_Obj_06 "Longitudinal absolution velocity standard deviation of object_06";
CM_ SG_ 516 VabsXStd_Obj_07 "Longitudinal absolution velocity standard deviation of object_07";
CM_ SG_ 516 VabsY_Obj_06 "Lateral absolution velocity over ground of object_06";
CM_ SG_ 516 VabsY_Obj_07 "Lateral absolution velocity over ground of object_07";
CM_ SG_ 516 VabsYStd_Obj_06 "Lateral absolution velocity standard deviation of object_06";
CM_ SG_ 516 VabsYStd_Obj_07 "Lateral absolution velocity standard deviation of object_07";
CM_ SG_ 516 Valid_Obj_06 "Valid flag of object_06";
CM_ SG_ 516 Valid_Obj_07 "Valid flag of object_07";
CM_ SG_ 516 Width_Obj_06 "Width of object_06";
CM_ SG_ 516 Width_Obj_07 "Width of object_07";
CM_ SG_ 516 YawRateAbs_Obj_06 "Yaw rate of object_06";
CM_ SG_ 516 YawRateAbs_Obj_07 "Yaw rate of object_07";
CM_ SG_ 516 YawRateAbsStd_Obj_06 "Yaw rate standard deviation of object_06";
CM_ SG_ 516 YawRateAbsStd_Obj_07 "Yaw rate standard deviation of object_07";
CM_ SG_ 517 AabsX_Obj_08 "Longitudinal absolution acceleration over ground of object_08";
CM_ SG_ 517 AabsX_Obj_09 "Longitudinal absolution acceleration over ground of object_09";
CM_ SG_ 517 AabsXStd_Obj_08 "Longitudinal absolution acceleration standard deviation of object_08";
CM_ SG_ 517 AabsXStd_Obj_09 "Longitudinal absolution acceleration standard deviation of object_09";
CM_ SG_ 517 AabsY_Obj_08 "Lateral absolution acceleration over ground of object_08";
CM_ SG_ 517 AabsY_Obj_09 "Lateral absolution acceleration over ground of object_09";
CM_ SG_ 517 AabsYStd_Obj_08 "Lateral absolution acceleration standard deviation of object_08";
CM_ SG_ 517 AabsYStd_Obj_09 "Lateral absolution acceleration standard deviation of object_09";
CM_ SG_ 517 ClassConf_Obj_08 "Classification confidence of object_08";
CM_ SG_ 517 ClassConf_Obj_09 "Classification confidence of object_09";
CM_ SG_ 517 Classification_Obj_08 "Classification of object_08";
CM_ SG_ 517 Classification_Obj_09 "Classification of object_09";
CM_ SG_ 517 DistX_Obj_08 "Longitudinal distance of object_08";
CM_ SG_ 517 DistX_Obj_09 "Longitudinal distance of object_09";
CM_ SG_ 517 DistXStd_Obj_08 "Longitudinal distance standard deviation of object_08";
CM_ SG_ 517 DistXStd_Obj_09 "Longitudinal distance standard deviation of object_09";
CM_ SG_ 517 DistY_Obj_08 "Lateral distance of object_08";
CM_ SG_ 517 DistY_Obj_09 "Lateral distance of object_09";
CM_ SG_ 517 DistYStd_Obj_08 "Lateral distance standard deviation of object_08";
CM_ SG_ 517 DistYStd_Obj_09 "Lateral distance standard deviation of object_09";
CM_ SG_ 517 DynConf_Obj_08 "Dynamic property confidence of object_08";
CM_ SG_ 517 DynConf_Obj_09 "Dynamic property confidence of object_09";
CM_ SG_ 517 DynProp_Obj_08 "Dynamic property of object_08";
CM_ SG_ 517 DynProp_Obj_09 "Dynamic property of object_09";
CM_ SG_ 517 ID_Obj_08 "ID of object_08";
CM_ SG_ 517 ID_Obj_09 "ID of object_09";
CM_ SG_ 517 Length_Obj_08 "Length of object_08";
CM_ SG_ 517 Length_Obj_09 "Length of object_09";
CM_ SG_ 517 LifeCycle_Obj_08 "Life cycle of object_08";
CM_ SG_ 517 LifeCycle_Obj_09 "Life cycle of object_09";
CM_ SG_ 517 MaintenanceState_Obj_08 "Maintenance state of object_08";
CM_ SG_ 517 MaintenanceState_Obj_09 "Maintenance state of object_09";
CM_ SG_ 517 MicroDopplerFlag_08 "Micro-Doppler flag of object_08";
CM_ SG_ 517 MicroDopplerFlag_09 "Micro-Doppler flag of object_09";
CM_ SG_ 517 MirrorProb_Obj_08 "Mirror probability of object_08";
CM_ SG_ 517 MirrorProb_Obj_09 "Mirror probability of object_09";
CM_ SG_ 517 ObstacleProb_Obj_08 "Obstacle probability of object_08";
CM_ SG_ 517 ObstacleProb_Obj_09 "Obstacle probability of object_09";
CM_ SG_ 517 Orientation_Obj_08 "Orientation of object_08";
CM_ SG_ 517 Orientation_Obj_09 "Orientation of object_09";
CM_ SG_ 517 OrientationStd_Obj_08 "Orientation standard deviation of object_08";
CM_ SG_ 517 OrientationStd_Obj_09 "Orientation standard deviation of object_09";
CM_ SG_ 517 ProbOfExist_Obj_08 "Existence probability of object_08";
CM_ SG_ 517 ProbOfExist_Obj_09 "Existence probability of object_09";
CM_ SG_ 517 RCS_Obj_08 "RCS of object_08";
CM_ SG_ 517 RCS_Obj_09 "RCS of object_09";
CM_ SG_ 517 RefPoint_Obj_08 "Reference point of object_08";
CM_ SG_ 517 RefPoint_Obj_09 "Reference point of object_09";
CM_ SG_ 517 VabsX_Obj_08 "Longitudinal absolution velocity over ground of object_08";
CM_ SG_ 517 VabsX_Obj_09 "Longitudinal absolution velocity over ground of object_09";
CM_ SG_ 517 VabsXStd_Obj_08 "Longitudinal absolution velocity standard deviation of object_08";
CM_ SG_ 517 VabsXStd_Obj_09 "Longitudinal absolution velocity standard deviation of object_09";
CM_ SG_ 517 VabsY_Obj_08 "Lateral absolution velocity over ground of object_08";
CM_ SG_ 517 VabsY_Obj_09 "Lateral absolution velocity over ground of object_09";
CM_ SG_ 517 VabsYStd_Obj_08 "Lateral absolution velocity standard deviation of object_08";
CM_ SG_ 517 VabsYStd_Obj_09 "Lateral absolution velocity standard deviation of object_09";
CM_ SG_ 517 Valid_Obj_08 "Valid flag of object_08";
CM_ SG_ 517 Valid_Obj_09 "Valid flag of object_09";
CM_ SG_ 517 Width_Obj_08 "Width of object_08";
CM_ SG_ 517 Width_Obj_09 "Width of object_09";
CM_ SG_ 517 YawRateAbs_Obj_08 "Yaw rate of object_08";
CM_ SG_ 517 YawRateAbs_Obj_09 "Yaw rate of object_09";
CM_ SG_ 517 YawRateAbsStd_Obj_08 "Yaw rate standard deviation of object_08";
CM_ SG_ 517 YawRateAbsStd_Obj_09 "Yaw rate standard deviation of object_09";
CM_ SG_ 518 AabsX_Obj_10 "Longitudinal absolution acceleration over ground of object_10";
CM_ SG_ 518 AabsX_Obj_11 "Longitudinal absolution acceleration over ground of object_11";
CM_ SG_ 518 AabsXStd_Obj_10 "Longitudinal absolution acceleration standard deviation of object_10";
CM_ SG_ 518 AabsXStd_Obj_11 "Longitudinal absolution acceleration standard deviation of object_11";
CM_ SG_ 518 AabsY_Obj_10 "Lateral absolution acceleration over ground of object_10";
CM_ SG_ 518 AabsY_Obj_11 "Lateral absolution acceleration over ground of object_11";
CM_ SG_ 518 AabsYStd_Obj_10 "Lateral absolution acceleration standard deviation of object_10";
CM_ SG_ 518 AabsYStd_Obj_11 "Lateral absolution acceleration standard deviation of object_11";
CM_ SG_ 518 ClassConf_Obj_10 "Classification confidence of object_10";
CM_ SG_ 518 ClassConf_Obj_11 "Classification confidence of object_11";
CM_ SG_ 518 Classification_Obj_10 "Classification of object_10";
CM_ SG_ 518 Classification_Obj_11 "Classification of object_11";
CM_ SG_ 518 DistX_Obj_10 "Longitudinal distance of object_10";
CM_ SG_ 518 DistX_Obj_11 "Longitudinal distance of object_11";
CM_ SG_ 518 DistXStd_Obj_10 "Longitudinal distance standard deviation of object_10";
CM_ SG_ 518 DistXStd_Obj_11 "Longitudinal distance standard deviation of object_11";
CM_ SG_ 518 DistY_Obj_10 "Lateral distance of object_10";
CM_ SG_ 518 DistY_Obj_11 "Lateral distance of object_11";
CM_ SG_ 518 DistYStd_Obj_10 "Lateral distance standard deviation of object_10";
CM_ SG_ 518 DistYStd_Obj_11 "Lateral distance standard deviation of object_11";
CM_ SG_ 518 DynConf_Obj_10 "Dynamic property confidence of object_10";
CM_ SG_ 518 DynConf_Obj_11 "Dynamic property confidence of object_11";
CM_ SG_ 518 DynProp_Obj_10 "Dynamic property of object_10";
CM_ SG_ 518 DynProp_Obj_11 "Dynamic property of object_11";
CM_ SG_ 518 ID_Obj_10 "ID of object_10";
CM_ SG_ 518 ID_Obj_11 "ID of object_11";
CM_ SG_ 518 Length_Obj_10 "Length of object_10";
CM_ SG_ 518 Length_Obj_11 "Length of object_11";
CM_ SG_ 518 LifeCycle_Obj_10 "Life cycle of object_10";
CM_ SG_ 518 LifeCycle_Obj_11 "Life cycle of object_11";
CM_ SG_ 518 MaintenanceState_Obj_10 "Maintenance state of object_10";
CM_ SG_ 518 MaintenanceState_Obj_11 "Maintenance state of object_11";
CM_ SG_ 518 MicroDopplerFlag_10 "Micro-Doppler flag of object_10";
CM_ SG_ 518 MicroDopplerFlag_11 "Micro-Doppler flag of object_11";
CM_ SG_ 518 MirrorProb_Obj_10 "Mirror probability of object_10";
CM_ SG_ 518 MirrorProb_Obj_11 "Mirror probability of object_11";
CM_ SG_ 518 ObstacleProb_Obj_10 "Obstacle probability of object_10";
CM_ SG_ 518 ObstacleProb_Obj_11 "Obstacle probability of object_11";
CM_ SG_ 518 Orientation_Obj_10 "Orientation of object_10";
CM_ SG_ 518 Orientation_Obj_11 "Orientation of object_11";
CM_ SG_ 518 OrientationStd_Obj_10 "Orientation standard deviation of object_10";
CM_ SG_ 518 OrientationStd_Obj_11 "Orientation standard deviation of object_11";
CM_ SG_ 518 ProbOfExist_Obj_10 "Existence probability of object_10";
CM_ SG_ 518 ProbOfExist_Obj_11 "Existence probability of object_11";
CM_ SG_ 518 RCS_Obj_10 "RCS of object_10";
CM_ SG_ 518 RCS_Obj_11 "RCS of object_11";
CM_ SG_ 518 RefPoint_Obj_10 "Reference point of object_10";
CM_ SG_ 518 RefPoint_Obj_11 "Reference point of object_11";
CM_ SG_ 518 VabsX_Obj_10 "Longitudinal absolution velocity over ground of object_10";
CM_ SG_ 518 VabsX_Obj_11 "Longitudinal absolution velocity over ground of object_11";
CM_ SG_ 518 VabsXStd_Obj_10 "Longitudinal absolution velocity standard deviation of object_10";
CM_ SG_ 518 VabsXStd_Obj_11 "Longitudinal absolution velocity standard deviation of object_11";
CM_ SG_ 518 VabsY_Obj_10 "Lateral absolution velocity over ground of object_10";
CM_ SG_ 518 VabsY_Obj_11 "Lateral absolution velocity over ground of object_11";
CM_ SG_ 518 VabsYStd_Obj_10 "Lateral absolution velocity standard deviation of object_10";
CM_ SG_ 518 VabsYStd_Obj_11 "Lateral absolution velocity standard deviation of object_11";
CM_ SG_ 518 Valid_Obj_10 "Valid flag of object_10";
CM_ SG_ 518 Valid_Obj_11 "Valid flag of object_11";
CM_ SG_ 518 Width_Obj_10 "Width of object_10";
CM_ SG_ 518 Width_Obj_11 "Width of object_11";
CM_ SG_ 518 YawRateAbs_Obj_10 "Yaw rate of object_10";
CM_ SG_ 518 YawRateAbs_Obj_11 "Yaw rate of object_11";
CM_ SG_ 518 YawRateAbsStd_Obj_10 "Yaw rate standard deviation of object_10";
CM_ SG_ 518 YawRateAbsStd_Obj_11 "Yaw rate standard deviation of object_11";
CM_ SG_ 519 AabsX_Obj_12 "Longitudinal absolution acceleration over ground of object_12";
CM_ SG_ 519 AabsX_Obj_13 "Longitudinal absolution acceleration over ground of object_13";
CM_ SG_ 519 AabsXStd_Obj_12 "Longitudinal absolution acceleration standard deviation of object_12";
CM_ SG_ 519 AabsXStd_Obj_13 "Longitudinal absolution acceleration standard deviation of object_13";
CM_ SG_ 519 AabsY_Obj_12 "Lateral absolution acceleration over ground of object_12";
CM_ SG_ 519 AabsY_Obj_13 "Lateral absolution acceleration over ground of object_13";
CM_ SG_ 519 AabsYStd_Obj_12 "Lateral absolution acceleration standard deviation of object_12";
CM_ SG_ 519 AabsYStd_Obj_13 "Lateral absolution acceleration standard deviation of object_13";
CM_ SG_ 519 ClassConf_Obj_12 "Classification confidence of object_12";
CM_ SG_ 519 ClassConf_Obj_13 "Classification confidence of object_13";
CM_ SG_ 519 Classification_Obj_12 "Classification of object_12";
CM_ SG_ 519 Classification_Obj_13 "Classification of object_13";
CM_ SG_ 519 DistX_Obj_12 "Longitudinal distance of object_12";
CM_ SG_ 519 DistX_Obj_13 "Longitudinal distance of object_13";
CM_ SG_ 519 DistXStd_Obj_12 "Longitudinal distance standard deviation of object_12";
CM_ SG_ 519 DistXStd_Obj_13 "Longitudinal distance standard deviation of object_13";
CM_ SG_ 519 DistY_Obj_12 "Lateral distance of object_12";
CM_ SG_ 519 DistY_Obj_13 "Lateral distance of object_13";
CM_ SG_ 519 DistYStd_Obj_12 "Lateral distance standard deviation of object_12";
CM_ SG_ 519 DistYStd_Obj_13 "Lateral distance standard deviation of object_13";
CM_ SG_ 519 DynConf_Obj_12 "Dynamic property confidence of object_12";
CM_ SG_ 519 DynConf_Obj_13 "Dynamic property confidence of object_13";
CM_ SG_ 519 DynProp_Obj_12 "Dynamic property of object_12";
CM_ SG_ 519 DynProp_Obj_13 "Dynamic property of object_13";
CM_ SG_ 519 ID_Obj_12 "ID of object_12";
CM_ SG_ 519 ID_Obj_13 "ID of object_13";
CM_ SG_ 519 Length_Obj_12 "Length of object_12";
CM_ SG_ 519 Length_Obj_13 "Length of object_13";
CM_ SG_ 519 LifeCycle_Obj_12 "Life cycle of object_12";
CM_ SG_ 519 LifeCycle_Obj_13 "Life cycle of object_13";
CM_ SG_ 519 MaintenanceState_Obj_12 "Maintenance state of object_12";
CM_ SG_ 519 MaintenanceState_Obj_13 "Maintenance state of object_13";
CM_ SG_ 519 MicroDopplerFlag_12 "Micro-Doppler flag of object_12";
CM_ SG_ 519 MicroDopplerFlag_13 "Micro-Doppler flag of object_13";
CM_ SG_ 519 MirrorProb_Obj_12 "Mirror probability of object_12";
CM_ SG_ 519 MirrorProb_Obj_13 "Mirror probability of object_13";
CM_ SG_ 519 ObstacleProb_Obj_12 "Obstacle probability of object_12";
CM_ SG_ 519 ObstacleProb_Obj_13 "Obstacle probability of object_13";
CM_ SG_ 519 Orientation_Obj_12 "Orientation of object_12";
CM_ SG_ 519 Orientation_Obj_13 "Orientation of object_13";
CM_ SG_ 519 OrientationStd_Obj_12 "Orientation standard deviation of object_12";
CM_ SG_ 519 OrientationStd_Obj_13 "Orientation standard deviation of object_13";
CM_ SG_ 519 ProbOfExist_Obj_12 "Existence probability of object_12";
CM_ SG_ 519 ProbOfExist_Obj_13 "Existence probability of object_13";
CM_ SG_ 519 RCS_Obj_12 "RCS of object_12";
CM_ SG_ 519 RCS_Obj_13 "RCS of object_13";
CM_ SG_ 519 RefPoint_Obj_12 "Reference point of object_12";
CM_ SG_ 519 RefPoint_Obj_13 "Reference point of object_13";
CM_ SG_ 519 VabsX_Obj_12 "Longitudinal absolution velocity over ground of object_12";
CM_ SG_ 519 VabsX_Obj_13 "Longitudinal absolution velocity over ground of object_13";
CM_ SG_ 519 VabsXStd_Obj_12 "Longitudinal absolution velocity standard deviation of object_12";
CM_ SG_ 519 VabsXStd_Obj_13 "Longitudinal absolution velocity standard deviation of object_13";
CM_ SG_ 519 VabsY_Obj_12 "Lateral absolution velocity over ground of object_12";
CM_ SG_ 519 VabsY_Obj_13 "Lateral absolution velocity over ground of object_13";
CM_ SG_ 519 VabsYStd_Obj_12 "Lateral absolution velocity standard deviation of object_12";
CM_ SG_ 519 VabsYStd_Obj_13 "Lateral absolution velocity standard deviation of object_13";
CM_ SG_ 519 Valid_Obj_12 "Valid flag of object_12";
CM_ SG_ 519 Valid_Obj_13 "Valid flag of object_13";
CM_ SG_ 519 Width_Obj_12 "Width of object_12";
CM_ SG_ 519 Width_Obj_13 "Width of object_13";
CM_ SG_ 519 YawRateAbs_Obj_12 "Yaw rate of object_12";
CM_ SG_ 519 YawRateAbs_Obj_13 "Yaw rate of object_13";
CM_ SG_ 519 YawRateAbsStd_Obj_12 "Yaw rate standard deviation of object_12";
CM_ SG_ 519 YawRateAbsStd_Obj_13 "Yaw rate standard deviation of object_13";
CM_ SG_ 520 AabsX_Obj_14 "Longitudinal absolution acceleration over ground of object_14";
CM_ SG_ 520 AabsX_Obj_15 "Longitudinal absolution acceleration over ground of object_15";
CM_ SG_ 520 AabsXStd_Obj_14 "Longitudinal absolution acceleration standard deviation of object_14";
CM_ SG_ 520 AabsXStd_Obj_15 "Longitudinal absolution acceleration standard deviation of object_15";
CM_ SG_ 520 AabsY_Obj_14 "Lateral absolution acceleration over ground of object_14";
CM_ SG_ 520 AabsY_Obj_15 "Lateral absolution acceleration over ground of object_15";
CM_ SG_ 520 AabsYStd_Obj_14 "Lateral absolution acceleration standard deviation of object_14";
CM_ SG_ 520 AabsYStd_Obj_15 "Lateral absolution acceleration standard deviation of object_15";
CM_ SG_ 520 ClassConf_Obj_14 "Classification confidence of object_14";
CM_ SG_ 520 ClassConf_Obj_15 "Classification confidence of object_15";
CM_ SG_ 520 Classification_Obj_14 "Classification of object_14";
CM_ SG_ 520 Classification_Obj_15 "Classification of object_15";
CM_ SG_ 520 DistX_Obj_14 "Longitudinal distance of object_14";
CM_ SG_ 520 DistX_Obj_15 "Longitudinal distance of object_15";
CM_ SG_ 520 DistXStd_Obj_14 "Longitudinal distance standard deviation of object_14";
CM_ SG_ 520 DistXStd_Obj_15 "Longitudinal distance standard deviation of object_15";
CM_ SG_ 520 DistY_Obj_14 "Lateral distance of object_14";
CM_ SG_ 520 DistY_Obj_15 "Lateral distance of object_15";
CM_ SG_ 520 DistYStd_Obj_14 "Lateral distance standard deviation of object_14";
CM_ SG_ 520 DistYStd_Obj_15 "Lateral distance standard deviation of object_15";
CM_ SG_ 520 DynConf_Obj_14 "Dynamic property confidence of object_14";
CM_ SG_ 520 DynConf_Obj_15 "Dynamic property confidence of object_15";
CM_ SG_ 520 DynProp_Obj_14 "Dynamic property of object_14";
CM_ SG_ 520 DynProp_Obj_15 "Dynamic property of object_15";
CM_ SG_ 520 ID_Obj_14 "ID of object_14";
CM_ SG_ 520 ID_Obj_15 "ID of object_15";
CM_ SG_ 520 Length_Obj_14 "Length of object_14";
CM_ SG_ 520 Length_Obj_15 "Length of object_15";
CM_ SG_ 520 LifeCycle_Obj_14 "Life cycle of object_14";
CM_ SG_ 520 LifeCycle_Obj_15 "Life cycle of object_15";
CM_ SG_ 520 MaintenanceState_Obj_14 "Maintenance state of object_14";
CM_ SG_ 520 MaintenanceState_Obj_15 "Maintenance state of object_15";
CM_ SG_ 520 MicroDopplerFlag_14 "Micro-Doppler flag of object_14";
CM_ SG_ 520 MicroDopplerFlag_15 "Micro-Doppler flag of object_15";
CM_ SG_ 520 MirrorProb_Obj_14 "Mirror probability of object_14";
CM_ SG_ 520 MirrorProb_Obj_15 "Mirror probability of object_15";
CM_ SG_ 520 ObstacleProb_Obj_14 "Obstacle probability of object_14";
CM_ SG_ 520 ObstacleProb_Obj_15 "Obstacle probability of object_15";
CM_ SG_ 520 Orientation_Obj_14 "Orientation of object_14";
CM_ SG_ 520 Orientation_Obj_15 "Orientation of object_15";
CM_ SG_ 520 OrientationStd_Obj_14 "Orientation standard deviation of object_14";
CM_ SG_ 520 OrientationStd_Obj_15 "Orientation standard deviation of object_15";
CM_ SG_ 520 ProbOfExist_Obj_14 "Existence probability of object_14";
CM_ SG_ 520 ProbOfExist_Obj_15 "Existence probability of object_15";
CM_ SG_ 520 RCS_Obj_14 "RCS of object_14";
CM_ SG_ 520 RCS_Obj_15 "RCS of object_15";
CM_ SG_ 520 RefPoint_Obj_14 "Reference point of object_14";
CM_ SG_ 520 RefPoint_Obj_15 "Reference point of object_15";
CM_ SG_ 520 VabsX_Obj_14 "Longitudinal absolution velocity over ground of object_14";
CM_ SG_ 520 VabsX_Obj_15 "Longitudinal absolution velocity over ground of object_15";
CM_ SG_ 520 VabsXStd_Obj_14 "Longitudinal absolution velocity standard deviation of object_14";
CM_ SG_ 520 VabsXStd_Obj_15 "Longitudinal absolution velocity standard deviation of object_15";
CM_ SG_ 520 VabsY_Obj_14 "Lateral absolution velocity over ground of object_14";
CM_ SG_ 520 VabsY_Obj_15 "Lateral absolution velocity over ground of object_15";
CM_ SG_ 520 VabsYStd_Obj_14 "Lateral absolution velocity standard deviation of object_14";
CM_ SG_ 520 VabsYStd_Obj_15 "Lateral absolution velocity standard deviation of object_15";
CM_ SG_ 520 Valid_Obj_14 "Valid flag of object_14";
CM_ SG_ 520 Valid_Obj_15 "Valid flag of object_15";
CM_ SG_ 520 Width_Obj_14 "Width of object_14";
CM_ SG_ 520 Width_Obj_15 "Width of object_15";
CM_ SG_ 520 YawRateAbs_Obj_14 "Yaw rate of object_14";
CM_ SG_ 520 YawRateAbs_Obj_15 "Yaw rate of object_15";
CM_ SG_ 520 YawRateAbsStd_Obj_14 "Yaw rate standard deviation of object_14";
CM_ SG_ 520 YawRateAbsStd_Obj_15 "Yaw rate standard deviation of object_15";
BA_DEF_ BO_  "GenMsgCycleTime" INT 0 0;
BA_DEF_ BO_  "GenMsgSendType" ENUM  "Cyclic","NotUsed","Event","NotUsed","NotUsed","NotUsed","NotUsed","IfActive","NoMsgSendType","NotUsed";
BA_DEF_ BO_  "VFrameFormat" ENUM  "StandardCAN","ExtendedCAN","reserved","reserved","reserved","reserved","reserved","reserved","reserved","reserved","reserved","reserved","reserved","reserved","StandardCAN_FD","ExtendedCAN_FD";
BA_DEF_ BO_  "GenSigSendType" ENUM  "Cyclic","OnWrite","OnWriteWithRepetition","OnChange","OnChangeWithRepetition";
BA_DEF_ SG_  "GenSigStartValue" INT 0 0;
BA_DEF_ BO_  "CANFD_BRS" ENUM  "0","1";
BA_DEF_DEF_  "GenMsgCycleTime" 0;
BA_DEF_DEF_  "GenMsgSendType" "Cyclic";
BA_DEF_DEF_  "VFrameFormat" "ExtendedCAN_FD";
BA_DEF_DEF_  "GenSigSendType" "Cyclic";
BA_DEF_DEF_  "GenSigStartValue" 0;
BA_DEF_DEF_  "CANFD_BRS" "1";
BA_ "GenMsgSendType" BO_ 328 2;
BA_ "VFrameFormat" BO_ 328 14;
BA_ "GenMsgSendType" BO_ 329 2;
BA_ "VFrameFormat" BO_ 329 14;
BA_ "GenMsgSendType" BO_ 330 2;
BA_ "VFrameFormat" BO_ 330 14;
BA_ "GenMsgSendType" BO_ 331 2;
BA_ "VFrameFormat" BO_ 331 14;
BA_ "GenMsgSendType" BO_ 332 2;
BA_ "VFrameFormat" BO_ 332 14;
BA_ "GenMsgSendType" BO_ 333 2;
BA_ "VFrameFormat" BO_ 333 14;
BA_ "GenMsgSendType" BO_ 334 2;
BA_ "VFrameFormat" BO_ 334 14;
BA_ "GenMsgSendType" BO_ 335 2;
BA_ "VFrameFormat" BO_ 335 14;
BA_ "GenMsgSendType" BO_ 336 2;
BA_ "VFrameFormat" BO_ 336 14;
BA_ "GenMsgSendType" BO_ 337 2;
BA_ "VFrameFormat" BO_ 337 14;
BA_ "GenMsgSendType" BO_ 338 2;
BA_ "VFrameFormat" BO_ 338 14;
BA_ "GenMsgSendType" BO_ 339 2;
BA_ "VFrameFormat" BO_ 339 14;
BA_ "GenMsgSendType" BO_ 340 2;
BA_ "VFrameFormat" BO_ 340 14;
BA_ "GenMsgSendType" BO_ 341 2;
BA_ "VFrameFormat" BO_ 341 14;
BA_ "GenMsgSendType" BO_ 342 2;
BA_ "VFrameFormat" BO_ 342 14;
BA_ "GenMsgSendType" BO_ 343 2;
BA_ "VFrameFormat" BO_ 343 14;
BA_ "GenMsgSendType" BO_ 344 2;
BA_ "VFrameFormat" BO_ 344 14;
BA_ "GenMsgSendType" BO_ 512 2;
BA_ "VFrameFormat" BO_ 512 14;
BA_ "GenMsgSendType" BO_ 513 2;
BA_ "VFrameFormat" BO_ 513 14;
BA_ "GenMsgSendType" BO_ 514 2;
BA_ "VFrameFormat" BO_ 514 14;
BA_ "GenMsgSendType" BO_ 515 2;
BA_ "VFrameFormat" BO_ 515 14;
BA_ "GenMsgSendType" BO_ 516 2;
BA_ "VFrameFormat" BO_ 516 14;
BA_ "GenMsgSendType" BO_ 517 2;
BA_ "VFrameFormat" BO_ 517 14;
BA_ "GenMsgSendType" BO_ 518 2;
BA_ "VFrameFormat" BO_ 518 14;
BA_ "GenMsgSendType" BO_ 519 2;
BA_ "VFrameFormat" BO_ 519 14;
BA_ "GenMsgSendType" BO_ 520 2;
BA_ "VFrameFormat" BO_ 520 14;
VAL_ 512 ExtendedCycleFlag 0 " FALS" 1 " TRU" ;
VAL_ 512 TaskValidFlag 0 " INVALI" 1 " VALI" ;
VAL_ 513 Classification_Obj_00 0 "POINT" 1 "CAR" 2 "TRUCK" 3 "PEDESTRIAN" 4 "MOTORCYCLE" 5 "BICYCLE" 6 "WIDE" 7 "UNCLASSIFIED" ;
VAL_ 513 Classification_Obj_01 0 "POINT" 1 "CAR" 2 "TRUCK" 3 "PEDESTRIAN" 4 "MOTORCYCLE" 5 "BICYCLE" 6 "WIDE" 7 "UNCLASSIFIED" ;
VAL_ 513 DynProp_Obj_00 0 "MOVING" 1 "STATIONARY" 2 "ONCOMING" 3 "CROSSING_LEFT2RIGHT" 4 "CROSSING_RIGHT2LEFT" 5 "UNKNOWN" 6 "STOPPED" 7 "RESERVED" ;
VAL_ 513 DynProp_Obj_01 0 "STATIONAR" 1 "MOVIN" 2 "ONCOMING" 3 "STOPPE" 4 "CROSSING_LEFT2RIGH" 5 "CROSSING_RIGHT2LEF" 6 "RESERVE" 7 "RESERVED" ;
VAL_ 513 MaintenanceState_Obj_00 0 "INVALID" 1 "NEW" 2 "MEASURED" 3 "PREDICTED" ;
VAL_ 513 MaintenanceState_Obj_01 0 "INVALID" 1 "NEW" 2 "MEASURED" 3 "PREDICTED" ;
VAL_ 513 MicroDopplerFlag_00 0 "FALSE" 1 "TRUE" ;
VAL_ 513 MicroDopplerFlag_01 0 "FALSE" 1 "TRUE" ;
VAL_ 513 RefPoint_Obj_00 5 "Description for the value '0x5'" 4 "RearCenter" 0 "kRefPoint_FrontLeft" 1 "kRefPoint_FrontCenter" 2 "kRefPoint_FrontRight" 3 "RearRight" ;
VAL_ 513 RefPoint_Obj_01 0 "REAR" 1 "LEFT" 2 "FRONT" 3 "RIGHT" ;
VAL_ 514 Classification_Obj_02 0 "POINT" 1 "CAR" 2 "TRUCK" 3 "PEDESTRIAN" 4 "MOTORCYCLE" 5 "BICYCLE" 6 "WIDE" 7 "UNCLASSIFIED" ;
VAL_ 514 Classification_Obj_03 0 "POINT" 1 "CAR" 2 "TRUCK" 3 "PEDESTRIAN" 4 "MOTORCYCLE" 5 "BICYCLE" 6 "WIDE" 7 "UNCLASSIFIED" ;
VAL_ 514 DynProp_Obj_02 0 "MOVING" 1 "STATIONARY" 2 "ONCOMING" 3 "CROSSING_LEFT2RIGHT" 4 "CROSSING_RIGHT2LEFT" 5 "UNKNOWN" 6 "STOPPED" 7 "RESERVED" ;
VAL_ 514 DynProp_Obj_03 0 "STATIONAR" 1 "MOVIN" 2 "ONCOMING" 3 "STOPPE" 4 "CROSSING_LEFT2RIGH" 5 "CROSSING_RIGHT2LEF" 6 "RESERVE" 7 "RESERVED" ;
VAL_ 514 MaintenanceState_Obj_02 0 "INVALID" 1 "NEW" 2 "MEASURED" 3 "PREDICTED" ;
VAL_ 514 MaintenanceState_Obj_03 0 "INVALID" 1 "NEW" 2 "MEASURED" 3 "PREDICTED" ;
VAL_ 514 MicroDopplerFlag_02 0 "FALSE" 1 "TRUE" ;
VAL_ 514 MicroDopplerFlag_03 0 "FALSE" 1 "TRUE" ;
VAL_ 514 RefPoint_Obj_02 0 "REAR" 1 "LEFT" 2 "FRONT" 3 "RIGHT" ;
VAL_ 514 RefPoint_Obj_03 0 "REAR" 1 "LEFT" 2 "FRONT" 3 "RIGHT" ;
VAL_ 515 Classification_Obj_04 0 "POINT" 1 "CAR" 2 "TRUCK" 3 "PEDESTRIAN" 4 "MOTORCYCLE" 5 "BICYCLE" 6 "WIDE" 7 "UNCLASSIFIED" ;
VAL_ 515 Classification_Obj_05 0 "POINT" 1 "CAR" 2 "TRUCK" 3 "PEDESTRIAN" 4 "MOTORCYCLE" 5 "BICYCLE" 6 "WIDE" 7 "UNCLASSIFIED" ;
VAL_ 515 DynProp_Obj_04 0 "MOVING" 1 "STATIONARY" 2 "ONCOMING" 3 "CROSSING_LEFT2RIGHT" 4 "CROSSING_RIGHT2LEFT" 5 "UNKNOWN" 6 "STOPPED" 7 "RESERVED" ;
VAL_ 515 DynProp_Obj_05 0 "STATIONAR" 1 "MOVIN" 2 "ONCOMING" 3 "STOPPE" 4 "CROSSING_LEFT2RIGH" 5 "CROSSING_RIGHT2LEF" 6 "RESERVE" 7 "RESERVED" ;
VAL_ 515 MaintenanceState_Obj_04 0 "INVALID" 1 "NEW" 2 "MEASURED" 3 "PREDICTED" ;
VAL_ 515 MaintenanceState_Obj_05 0 "INVALID" 1 "NEW" 2 "MEASURED" 3 "PREDICTED" ;
VAL_ 515 MicroDopplerFlag_04 0 "FALSE" 1 "TRUE" ;
VAL_ 515 MicroDopplerFlag_05 0 "FALSE" 1 "TRUE" ;
VAL_ 515 RefPoint_Obj_04 0 "REAR" 1 "LEFT" 2 "FRONT" 3 "RIGHT" ;
VAL_ 515 RefPoint_Obj_05 0 "REAR" 1 "LEFT" 2 "FRONT" 3 "RIGHT" ;
VAL_ 516 Classification_Obj_06 0 "POINT" 1 "CAR" 2 "TRUCK" 3 "PEDESTRIAN" 4 "MOTORCYCLE" 5 "BICYCLE" 6 "WIDE" 7 "UNCLASSIFIED" ;
VAL_ 516 Classification_Obj_07 0 "POINT" 1 "CAR" 2 "TRUCK" 3 "PEDESTRIAN" 4 "MOTORCYCLE" 5 "BICYCLE" 6 "WIDE" 7 "UNCLASSIFIED" ;
VAL_ 516 DynProp_Obj_06 0 "MOVING" 1 "STATIONARY" 2 "ONCOMING" 3 "CROSSING_LEFT2RIGHT" 4 "CROSSING_RIGHT2LEFT" 5 "UNKNOWN" 6 "STOPPED" 7 "RESERVED" ;
VAL_ 516 DynProp_Obj_07 0 "STATIONAR" 1 "MOVIN" 2 "ONCOMING" 3 "STOPPE" 4 "CROSSING_LEFT2RIGH" 5 "CROSSING_RIGHT2LEF" 6 "RESERVE" 7 "RESERVED" ;
VAL_ 516 MaintenanceState_Obj_06 0 "INVALID" 1 "NEW" 2 "MEASURED" 3 "PREDICTED" ;
VAL_ 516 MaintenanceState_Obj_07 0 "INVALID" 1 "NEW" 2 "MEASURED" 3 "PREDICTED" ;
VAL_ 516 MicroDopplerFlag_06 0 "FALSE" 1 "TRUE" ;
VAL_ 516 MicroDopplerFlag_07 0 "FALSE" 1 "TRUE" ;
VAL_ 516 RefPoint_Obj_06 0 "REAR" 1 "LEFT" 2 "FRONT" 3 "RIGHT" ;
VAL_ 516 RefPoint_Obj_07 0 "REAR" 1 "LEFT" 2 "FRONT" 3 "RIGHT" ;
VAL_ 517 Classification_Obj_08 0 "POINT" 1 "CAR" 2 "TRUCK" 3 "PEDESTRIAN" 4 "MOTORCYCLE" 5 "BICYCLE" 6 "WIDE" 7 "UNCLASSIFIED" ;
VAL_ 517 Classification_Obj_09 0 "POINT" 1 "CAR" 2 "TRUCK" 3 "PEDESTRIAN" 4 "MOTORCYCLE" 5 "BICYCLE" 6 "WIDE" 7 "UNCLASSIFIED" ;
VAL_ 517 DynProp_Obj_08 0 "MOVING" 1 "STATIONARY" 2 "ONCOMING" 3 "CROSSING_LEFT2RIGHT" 4 "CROSSING_RIGHT2LEFT" 5 "UNKNOWN" 6 "STOPPED" 7 "RESERVED" ;
VAL_ 517 DynProp_Obj_09 0 "STATIONAR" 1 "MOVIN" 2 "ONCOMING" 3 "STOPPE" 4 "CROSSING_LEFT2RIGH" 5 "CROSSING_RIGHT2LEF" 6 "RESERVE" 7 "RESERVED" ;
VAL_ 517 MaintenanceState_Obj_08 0 "INVALID" 1 "NEW" 2 "MEASURED" 3 "PREDICTED" ;
VAL_ 517 MaintenanceState_Obj_09 0 "INVALID" 1 "NEW" 2 "MEASURED" 3 "PREDICTED" ;
VAL_ 517 MicroDopplerFlag_08 0 "FALSE" 1 "TRUE" ;
VAL_ 517 MicroDopplerFlag_09 0 "FALSE" 1 "TRUE" ;
VAL_ 517 RefPoint_Obj_08 0 "REAR" 1 "LEFT" 2 "FRONT" 3 "RIGHT" ;
VAL_ 517 RefPoint_Obj_09 0 "REAR" 1 "LEFT" 2 "FRONT" 3 "RIGHT" ;
VAL_ 518 Classification_Obj_10 0 "POINT" 1 "CAR" 2 "TRUCK" 3 "PEDESTRIAN" 4 "MOTORCYCLE" 5 "BICYCLE" 6 "WIDE" 7 "UNCLASSIFIED" ;
VAL_ 518 Classification_Obj_11 0 "POINT" 1 "CAR" 2 "TRUCK" 3 "PEDESTRIAN" 4 "MOTORCYCLE" 5 "BICYCLE" 6 "WIDE" 7 "UNCLASSIFIED" ;
VAL_ 518 DynProp_Obj_10 0 "MOVING" 1 "STATIONARY" 2 "ONCOMING" 3 "CROSSING_LEFT2RIGHT" 4 "CROSSING_RIGHT2LEFT" 5 "UNKNOWN" 6 "STOPPED" 7 "RESERVED" ;
VAL_ 518 DynProp_Obj_11 0 "STATIONAR" 1 "MOVIN" 2 "ONCOMING" 3 "STOPPE" 4 "CROSSING_LEFT2RIGH" 5 "CROSSING_RIGHT2LEF" 6 "RESERVE" 7 "RESERVED" ;
VAL_ 518 MaintenanceState_Obj_10 0 "INVALID" 1 "NEW" 2 "MEASURED" 3 "PREDICTED" ;
VAL_ 518 MaintenanceState_Obj_11 0 "INVALID" 1 "NEW" 2 "MEASURED" 3 "PREDICTED" ;
VAL_ 518 MicroDopplerFlag_10 0 "FALSE" 1 "TRUE" ;
VAL_ 518 MicroDopplerFlag_11 0 "FALSE" 1 "TRUE" ;
VAL_ 518 RefPoint_Obj_10 0 "REAR" 1 "LEFT" 2 "FRONT" 3 "RIGHT" ;
VAL_ 518 RefPoint_Obj_11 0 "REAR" 1 "LEFT" 2 "FRONT" 3 "RIGHT" ;
VAL_ 519 Classification_Obj_12 0 "POINT" 1 "CAR" 2 "TRUCK" 3 "PEDESTRIAN" 4 "MOTORCYCLE" 5 "BICYCLE" 6 "WIDE" 7 "UNCLASSIFIED" ;
VAL_ 519 Classification_Obj_13 0 "POINT" 1 "CAR" 2 "TRUCK" 3 "PEDESTRIAN" 4 "MOTORCYCLE" 5 "BICYCLE" 6 "WIDE" 7 "UNCLASSIFIED" ;
VAL_ 519 DynProp_Obj_12 0 "MOVING" 1 "STATIONARY" 2 "ONCOMING" 3 "CROSSING_LEFT2RIGHT" 4 "CROSSING_RIGHT2LEFT" 5 "UNKNOWN" 6 "STOPPED" 7 "RESERVED" ;
VAL_ 519 DynProp_Obj_13 0 "STATIONAR" 1 "MOVIN" 2 "ONCOMING" 3 "STOPPE" 4 "CROSSING_LEFT2RIGH" 5 "CROSSING_RIGHT2LEF" 6 "RESERVE" 7 "RESERVED" ;
VAL_ 519 MaintenanceState_Obj_12 0 "INVALID" 1 "NEW" 2 "MEASURED" 3 "PREDICTED" ;
VAL_ 519 MaintenanceState_Obj_13 0 "INVALID" 1 "NEW" 2 "MEASURED" 3 "PREDICTED" ;
VAL_ 519 MicroDopplerFlag_12 0 "FALSE" 1 "TRUE" ;
VAL_ 519 MicroDopplerFlag_13 0 "FALSE" 1 "TRUE" ;
VAL_ 519 RefPoint_Obj_12 0 "REAR" 1 "LEFT" 2 "FRONT" 3 "RIGHT" ;
VAL_ 519 RefPoint_Obj_13 0 "REAR" 1 "LEFT" 2 "FRONT" 3 "RIGHT" ;
VAL_ 520 Classification_Obj_14 0 "POINT" 1 "CAR" 2 "TRUCK" 3 "PEDESTRIAN" 4 "MOTORCYCLE" 5 "BICYCLE" 6 "WIDE" 7 "UNCLASSIFIED" ;
VAL_ 520 Classification_Obj_15 0 "POINT" 1 "CAR" 2 "TRUCK" 3 "PEDESTRIAN" 4 "MOTORCYCLE" 5 "BICYCLE" 6 "WIDE" 7 "UNCLASSIFIED" ;
VAL_ 520 DynProp_Obj_14 0 "MOVING" 1 "STATIONARY" 2 "ONCOMING" 3 "CROSSING_LEFT2RIGHT" 4 "CROSSING_RIGHT2LEFT" 5 "UNKNOWN" 6 "STOPPED" 7 "RESERVED" ;
VAL_ 520 DynProp_Obj_15 0 "STATIONAR" 1 "MOVIN" 2 "ONCOMING" 3 "STOPPE" 4 "CROSSING_LEFT2RIGH" 5 "CROSSING_RIGHT2LEF" 6 "RESERVE" 7 "RESERVED" ;
VAL_ 520 MaintenanceState_Obj_14 0 "INVALID" 1 "NEW" 2 "MEASURED" 3 "PREDICTED" ;
VAL_ 520 MaintenanceState_Obj_15 0 "INVALID" 1 "NEW" 2 "MEASURED" 3 "PREDICTED" ;
VAL_ 520 MicroDopplerFlag_14 0 "FALSE" 1 "TRUE" ;
VAL_ 520 MicroDopplerFlag_15 0 "FALSE" 1 "TRUE" ;
VAL_ 520 RefPoint_Obj_14 0 "REAR" 1 "LEFT" 2 "FRONT" 3 "RIGHT" ;
VAL_ 520 RefPoint_Obj_15 0 "REAR" 1 "LEFT" 2 "FRONT" 3 "RIGHT" ;
