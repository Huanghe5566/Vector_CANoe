VERSION "created by canmatrix"

NS_ :

BS_:

BU_: RR LR ADCU

BO_ 295 LR_RDI_E_147_167: 64 LR
 SG_ LR_P00_Pxx_147 : 7|8@0+ (1,0) [0|255] ""  RR,ADCU
 SG_ LR_P00_Pxx_148 : 15|8@0+ (1,0) [0|255] ""  RR,ADCU
 SG_ LR_P00_Pxx_149 : 23|8@0+ (1,0) [0|255] ""  RR,ADCU
 SG_ LR_P00_Pxx_150 : 31|8@0+ (1,0) [0|255] ""  RR,ADCU
 SG_ LR_P00_Pxx_151 : 39|8@0+ (1,0) [0|255] ""  RR,ADCU
 SG_ LR_P00_Pxx_152 : 47|8@0+ (1,0) [0|255] ""  RR,ADCU
 SG_ LR_P00_Pxx_153 : 55|8@0+ (1,0) [0|255] ""  RR,ADCU
 SG_ LR_P00_Pxx_154 : 63|8@0+ (1,0) [0|255] ""  RR,ADCU
 SG_ LR_P00_Pxx_155 : 71|8@0+ (1,0) [0|255] ""  RR,ADCU
 SG_ LR_P00_Pxx_156 : 79|8@0+ (1,0) [0|255] ""  RR,ADCU
 SG_ LR_P00_Pxx_157 : 87|8@0+ (1,0) [0|255] ""  RR,ADCU
 SG_ LR_P00_Pxx_158 : 95|8@0+ (1,0) [0|255] ""  RR,ADCU
 SG_ LR_P00_Pxx_159 : 103|8@0+ (1,0) [0|255] ""  RR,ADCU
 SG_ LR_P00_Pxx_160 : 111|8@0+ (1,0) [0|255] ""  RR,ADCU
 SG_ LR_P00_Pxx_161 : 119|8@0+ (1,0) [0|255] ""  RR,ADCU
 SG_ LR_P00_Pxx_162 : 127|8@0+ (1,0) [0|255] ""  RR,ADCU
 SG_ LR_P00_Pxx_163 : 135|8@0+ (1,0) [0|255] ""  RR,ADCU
 SG_ LR_P00_Pxx_164 : 143|8@0+ (1,0) [0|255] ""  RR,ADCU
 SG_ LR_P00_Pxx_165 : 151|8@0+ (1,0) [0|255] ""  RR,ADCU
 SG_ LR_P00_Pxx_166 : 159|8@0+ (1,0) [0|255] ""  RR,ADCU
 SG_ LR_P00_Pxx_167 : 167|8@0+ (1,0) [0|255] ""  RR,ADCU
 SG_ LR_P12_Pxx_147 : 175|8@0+ (1,0) [0|255] ""  RR,ADCU
 SG_ LR_P12_Pxx_148 : 183|8@0+ (1,0) [0|255] ""  RR,ADCU
 SG_ LR_P12_Pxx_149 : 191|8@0+ (1,0) [0|255] ""  RR,ADCU
 SG_ LR_P12_Pxx_150 : 199|8@0+ (1,0) [0|255] ""  RR,ADCU
 SG_ LR_P12_Pxx_151 : 207|8@0+ (1,0) [0|255] ""  RR,ADCU
 SG_ LR_P12_Pxx_152 : 215|8@0+ (1,0) [0|255] ""  RR,ADCU
 SG_ LR_P12_Pxx_153 : 223|8@0+ (1,0) [0|255] ""  RR,ADCU
 SG_ LR_P12_Pxx_154 : 231|8@0+ (1,0) [0|255] ""  RR,ADCU
 SG_ LR_P12_Pxx_155 : 239|8@0+ (1,0) [0|255] ""  RR,ADCU
 SG_ LR_P12_Pxx_156 : 247|8@0+ (1,0) [0|255] ""  RR,ADCU
 SG_ LR_P12_Pxx_157 : 255|8@0+ (1,0) [0|255] ""  RR,ADCU
 SG_ LR_P12_Pxx_158 : 263|8@0+ (1,0) [0|255] ""  RR,ADCU
 SG_ LR_P12_Pxx_159 : 271|8@0+ (1,0) [0|255] ""  RR,ADCU
 SG_ LR_P12_Pxx_160 : 279|8@0+ (1,0) [0|255] ""  RR,ADCU
 SG_ LR_P12_Pxx_161 : 287|8@0+ (1,0) [0|255] ""  RR,ADCU
 SG_ LR_P12_Pxx_162 : 295|8@0+ (1,0) [0|255] ""  RR,ADCU
 SG_ LR_P12_Pxx_163 : 303|8@0+ (1,0) [0|255] ""  RR,ADCU
 SG_ LR_P12_Pxx_164 : 311|8@0+ (1,0) [0|255] ""  RR,ADCU
 SG_ LR_P12_Pxx_165 : 319|8@0+ (1,0) [0|255] ""  RR,ADCU
 SG_ LR_P12_Pxx_166 : 327|8@0+ (1,0) [0|255] ""  RR,ADCU
 SG_ LR_P12_Pxx_167 : 335|8@0+ (1,0) [0|255] ""  RR,ADCU
 SG_ LR_P1_P2_147 : 343|8@0+ (1,0) [0|255] ""  RR,ADCU
 SG_ LR_P1_P2_148 : 351|8@0+ (1,0) [0|255] ""  RR,ADCU
 SG_ LR_P1_P2_149 : 359|8@0+ (1,0) [0|255] ""  RR,ADCU
 SG_ LR_P1_P2_150 : 367|8@0+ (1,0) [0|255] ""  RR,ADCU
 SG_ LR_P1_P2_151 : 375|8@0+ (1,0) [0|255] ""  RR,ADCU
 SG_ LR_P1_P2_152 : 383|8@0+ (1,0) [0|255] ""  RR,ADCU
 SG_ LR_P1_P2_153 : 391|8@0+ (1,0) [0|255] ""  RR,ADCU
 SG_ LR_P1_P2_154 : 399|8@0+ (1,0) [0|255] ""  RR,ADCU
 SG_ LR_P1_P2_155 : 407|8@0+ (1,0) [0|255] ""  RR,ADCU
 SG_ LR_P1_P2_156 : 415|8@0+ (1,0) [0|255] ""  RR,ADCU
 SG_ LR_P1_P2_157 : 423|8@0+ (1,0) [0|255] ""  RR,ADCU
 SG_ LR_P1_P2_158 : 431|8@0+ (1,0) [0|255] ""  RR,ADCU
 SG_ LR_P1_P2_159 : 439|8@0+ (1,0) [0|255] ""  RR,ADCU
 SG_ LR_P1_P2_160 : 447|8@0+ (1,0) [0|255] ""  RR,ADCU
 SG_ LR_P1_P2_161 : 455|8@0+ (1,0) [0|255] ""  RR,ADCU
 SG_ LR_P1_P2_162 : 463|8@0+ (1,0) [0|255] ""  RR,ADCU
 SG_ LR_P1_P2_163 : 471|8@0+ (1,0) [0|255] ""  RR,ADCU
 SG_ LR_P1_P2_164 : 479|8@0+ (1,0) [0|255] ""  RR,ADCU
 SG_ LR_P1_P2_165 : 487|8@0+ (1,0) [0|255] ""  RR,ADCU
 SG_ LR_P1_P2_166 : 495|8@0+ (1,0) [0|255] ""  RR,ADCU
 SG_ LR_P1_P2_167 : 503|8@0+ (1,0) [0|255] ""  RR,ADCU
 SG_ LR_RDI_E_147_167_AliveCounter : 511|4@0+ (1,0) [0|15] ""  RR,ADCU
 SG_ LR_RDI_E_147_167_CheckSum : 507|4@0+ (1,0) [0|15] ""  RR,ADCU

BO_ 296 LR_RDI_E_168_185: 64 LR
 SG_ LR_P00_Pxx_168 : 7|8@0+ (1,0) [0|255] ""  RR,ADCU
 SG_ LR_P00_Pxx_169 : 15|8@0+ (1,0) [0|255] ""  RR,ADCU
 SG_ LR_P00_Pxx_170 : 23|8@0+ (1,0) [0|255] ""  RR,ADCU
 SG_ LR_P00_Pxx_171 : 31|8@0+ (1,0) [0|255] ""  RR,ADCU
 SG_ LR_P00_Pxx_172 : 39|8@0+ (1,0) [0|255] ""  RR,ADCU
 SG_ LR_P00_Pxx_173 : 47|8@0+ (1,0) [0|255] ""  RR,ADCU
 SG_ LR_P00_Pxx_174 : 55|8@0+ (1,0) [0|255] ""  RR,ADCU
 SG_ LR_P00_Pxx_175 : 63|8@0+ (1,0) [0|255] ""  RR,ADCU
 SG_ LR_P00_Pxx_176 : 71|8@0+ (1,0) [0|255] ""  RR,ADCU
 SG_ LR_P00_Pxx_177 : 79|8@0+ (1,0) [0|255] ""  RR,ADCU
 SG_ LR_P00_Pxx_178 : 87|8@0+ (1,0) [0|255] ""  RR,ADCU
 SG_ LR_P00_Pxx_179 : 95|8@0+ (1,0) [0|255] ""  RR,ADCU
 SG_ LR_P00_Pxx_180 : 103|8@0+ (1,0) [0|255] ""  RR,ADCU
 SG_ LR_P00_Pxx_181 : 111|8@0+ (1,0) [0|255] ""  RR,ADCU
 SG_ LR_P00_Pxx_182 : 119|8@0+ (1,0) [0|255] ""  RR,ADCU
 SG_ LR_P00_Pxx_183 : 127|8@0+ (1,0) [0|255] ""  RR,ADCU
 SG_ LR_P00_Pxx_184 : 135|8@0+ (1,0) [0|255] ""  RR,ADCU
 SG_ LR_P00_Pxx_185 : 143|8@0+ (1,0) [0|255] ""  RR,ADCU
 SG_ LR_P12_Pxx_168 : 151|8@0+ (1,0) [0|255] ""  RR,ADCU
 SG_ LR_P12_Pxx_169 : 159|8@0+ (1,0) [0|255] ""  RR,ADCU
 SG_ LR_P12_Pxx_170 : 167|8@0+ (1,0) [0|255] ""  RR,ADCU
 SG_ LR_P12_Pxx_171 : 175|8@0+ (1,0) [0|255] ""  RR,ADCU
 SG_ LR_P12_Pxx_172 : 183|8@0+ (1,0) [0|255] ""  RR,ADCU
 SG_ LR_P12_Pxx_173 : 191|8@0+ (1,0) [0|255] ""  RR,ADCU
 SG_ LR_P12_Pxx_174 : 199|8@0+ (1,0) [0|255] ""  RR,ADCU
 SG_ LR_P12_Pxx_175 : 207|8@0+ (1,0) [0|255] ""  RR,ADCU
 SG_ LR_P12_Pxx_176 : 215|8@0+ (1,0) [0|255] ""  RR,ADCU
 SG_ LR_P12_Pxx_177 : 223|8@0+ (1,0) [0|255] ""  RR,ADCU
 SG_ LR_P12_Pxx_178 : 231|8@0+ (1,0) [0|255] ""  RR,ADCU
 SG_ LR_P12_Pxx_179 : 239|8@0+ (1,0) [0|255] ""  RR,ADCU
 SG_ LR_P12_Pxx_180 : 247|8@0+ (1,0) [0|255] ""  RR,ADCU
 SG_ LR_P12_Pxx_181 : 255|8@0+ (1,0) [0|255] ""  RR,ADCU
 SG_ LR_P12_Pxx_182 : 263|8@0+ (1,0) [0|255] ""  RR,ADCU
 SG_ LR_P12_Pxx_183 : 271|8@0+ (1,0) [0|255] ""  RR,ADCU
 SG_ LR_P12_Pxx_184 : 279|8@0+ (1,0) [0|255] ""  RR,ADCU
 SG_ LR_P12_Pxx_185 : 287|8@0+ (1,0) [0|255] ""  RR,ADCU
 SG_ LR_P1_P2_168 : 295|8@0+ (1,0) [0|255] ""  RR,ADCU
 SG_ LR_P1_P2_169 : 303|8@0+ (1,0) [0|255] ""  RR,ADCU
 SG_ LR_P1_P2_170 : 311|8@0+ (1,0) [0|255] ""  RR,ADCU
 SG_ LR_P1_P2_171 : 319|8@0+ (1,0) [0|255] ""  RR,ADCU
 SG_ LR_P1_P2_172 : 327|8@0+ (1,0) [0|255] ""  RR,ADCU
 SG_ LR_P1_P2_173 : 335|8@0+ (1,0) [0|255] ""  RR,ADCU
 SG_ LR_P1_P2_174 : 343|8@0+ (1,0) [0|255] ""  RR,ADCU
 SG_ LR_P1_P2_175 : 351|8@0+ (1,0) [0|255] ""  RR,ADCU
 SG_ LR_P1_P2_176 : 359|8@0+ (1,0) [0|255] ""  RR,ADCU
 SG_ LR_P1_P2_177 : 367|8@0+ (1,0) [0|255] ""  RR,ADCU
 SG_ LR_P1_P2_178 : 375|8@0+ (1,0) [0|255] ""  RR,ADCU
 SG_ LR_P1_P2_179 : 383|8@0+ (1,0) [0|255] ""  RR,ADCU
 SG_ LR_P1_P2_180 : 391|8@0+ (1,0) [0|255] ""  RR,ADCU
 SG_ LR_P1_P2_181 : 399|8@0+ (1,0) [0|255] ""  RR,ADCU
 SG_ LR_P1_P2_182 : 407|8@0+ (1,0) [0|255] ""  RR,ADCU
 SG_ LR_P1_P2_183 : 415|8@0+ (1,0) [0|255] ""  RR,ADCU
 SG_ LR_P1_P2_184 : 423|8@0+ (1,0) [0|255] ""  RR,ADCU
 SG_ LR_P1_P2_185 : 431|8@0+ (1,0) [0|255] ""  RR,ADCU
 SG_ LR_RDI_E_168_185_AliveCounter : 511|4@0+ (1,0) [0|15] ""  RR,ADCU
 SG_ LR_RDI_E_168_185_CheckSum : 507|4@0+ (1,0) [0|15] ""  RR,ADCU

BO_ 304 RR_RDI_Header: 64 RR
 SG_ RR_CRC16_Checksum_Header : 503|16@0+ (1,0) [0|65535] ""  LR,ADCU
 SG_ RR_CycleCounter : 151|16@0+ (1,0) [0|65535] ""  LR,ADCU
 SG_ RR_DPMode : 230|2@0+ (1,0) [0|3] ""  LR,ADCU
 SG_ RR_DynamicCalibPitchDeg : 339|9@0+ (0.1,-25) [-25|26.1] "deg"  LR,ADCU
 SG_ RR_DynamicCalibProgress : 359|7@0+ (1,0) [0|127] ""  LR,ADCU
 SG_ RR_DynamicCalibState : 346|3@0+ (1,0) [0|7] ""  LR,ADCU
 SG_ RR_DynamicCalibYawDeg : 335|12@0+ (0.1,-180) [-180|229.5] "deg"  LR,ADCU
 SG_ RR_EgoAcceleration : 223|9@0+ (0.125,-31.875) [-31.875|32] "m/s^2"  LR,ADCU
 SG_ RR_EgoCurvature : 215|8@0+ (0.001,0) [0|0.255] "1/m"  LR,ADCU
 SG_ RR_EgoGear : 171|4@0+ (1,0) [0|15] ""  LR,ADCU
 SG_ RR_EgoVelocity : 198|15@0+ (0.01,-128) [-128|199.67] "m/s"  LR,ADCU
 SG_ RR_EgoVelocityStd : 189|7@0+ (0.1,0) [0|12.7] "m/s"  LR,ADCU
 SG_ RR_EgoYawRate : 183|10@0+ (0.001,-0.511) [-0.511|0.512] "rad/s"  LR,ADCU
 SG_ RR_Latency : 419|11@0+ (0.1,80) [0|284.7] "ms"  LR,ADCU
 SG_ RR_MaxDetectionRange : 399|8@0+ (1,0) [0|255] "m"  LR,ADCU
 SG_ RR_MaxVelMultiple : 415|12@0+ (0.01,0) [0|40.95] "m/s"  LR,ADCU
 SG_ RR_Measure_Begin_Timestamp_NSec : 39|32@0+ (1,0) [0|4294967295] "ns"  LR,ADCU
 SG_ RR_Measure_Begin_Timestamp_Sec : 7|32@0+ (1,0) [0|4294967295] "s"  LR,ADCU
 SG_ RR_Measure_End_Timestamp_NSec : 103|32@0+ (1,0) [0|4294967295] "ns"  LR,ADCU
 SG_ RR_Measure_End_Timestamp_Sec : 71|32@0+ (1,0) [0|4294967295] "s"  LR,ADCU
 SG_ RR_MsgCounter_Header : 495|8@0+ (1,0) [0|255] ""  LR,ADCU
 SG_ RR_NumOfRDI : 167|9@0+ (1,0) [0|511] ""  LR,ADCU
 SG_ RR_RadarInfo_InstallDirection : 248|1@0+ (1,0) [0|1] "m"  LR,ADCU
 SG_ RR_RadarInfo_InstallPitchDeg : 267|7@0+ (0.1,-5) [-5|7.7] "deg"  LR,ADCU
 SG_ RR_RadarInfo_InstallX : 225|10@0+ (0.01,-5) [-5|5.23] "m"  LR,ADCU
 SG_ RR_RadarInfo_InstallY : 247|8@0+ (0.01,-1.28) [-1.28|1.27] "m"  LR,ADCU
 SG_ RR_RadarInfo_InstallYawDeg : 263|12@0+ (0.1,-180) [-180|229.5] "deg"  LR,ADCU
 SG_ RR_RadarInfo_InstallZ : 255|7@0+ (0.01,0) [0|1.27] "m"  LR,ADCU
 SG_ RR_RadarInfo_LastCalibPitchDeg : 295|7@0+ (0.1,-5) [-5|7.7] "deg"  LR,ADCU
 SG_ RR_RadarInfo_LastCalibValid : 288|1@0+ (1,0) [0|1] ""  LR,ADCU
 SG_ RR_RadarInfo_LastCalibYawDeg : 275|12@0+ (0.1,-180) [-180|229.5] "deg"  LR,ADCU
 SG_ RR_RadarInfo_RadarIndex : 174|3@0+ (1,0) [0|7] ""  LR,ADCU
 SG_ RR_RadarInfo_RadarType : 228|3@0+ (1,0) [0|7] ""  LR,ADCU
 SG_ RR_RangeResolution : 407|7@0+ (0.01,0) [0|1.27] "m"  LR,ADCU
 SG_ RR_SelfCalibPitchDeg : 371|9@0+ (0.1,-25) [-25|26.1] "deg"  LR,ADCU
 SG_ RR_SelfCalibProgress : 391|7@0+ (1,0) [0|127] ""  LR,ADCU
 SG_ RR_SelfCalibState : 378|3@0+ (1,0) [0|7] ""  LR,ADCU
 SG_ RR_SelfCalibYawDeg : 367|12@0+ (0.1,-180) [-180|229.5] "deg"  LR,ADCU
 SG_ RR_StaticCalibPitchDeg : 307|9@0+ (0.1,-25) [-25|26.1] "deg"  LR,ADCU
 SG_ RR_StaticCalibProgress : 327|7@0+ (1,0) [0|127] ""  LR,ADCU
 SG_ RR_StaticCalibState : 314|3@0+ (1,0) [0|7] ""  LR,ADCU
 SG_ RR_StaticCalibYawDeg : 303|12@0+ (0.1,-180) [-180|229.5] "deg"  LR,ADCU
 SG_ RR_SubFrameID : 276|1@0+ (1,0) [0|1] ""  LR,ADCU
 SG_ RR_TimeConsuming : 135|16@0+ (0.1,0) [0|6553.5] "ms"  ADCU

BO_ 305 RR_RDI_000_005: 64 RR
 SG_ RR_AzimuthAng_000 : 39|11@0+ (0.1,-90) [-90|114.7] "deg"  LR,ADCU
 SG_ RR_AzimuthAng_001 : 119|11@0+ (0.1,-90) [-90|114.7] "deg"  LR,ADCU
 SG_ RR_AzimuthAng_002 : 199|11@0+ (0.1,-90) [-90|114.7] "deg"  LR,ADCU
 SG_ RR_AzimuthAng_003 : 279|11@0+ (0.1,-90) [-90|114.7] "deg"  LR,ADCU
 SG_ RR_AzimuthAng_004 : 359|11@0+ (0.1,-90) [-90|114.7] "deg"  LR,ADCU
 SG_ RR_AzimuthAng_005 : 439|11@0+ (0.1,-90) [-90|114.7] "deg"  LR,ADCU
 SG_ RR_AzimuthSNR_000 : 51|7@0+ (0.5,0) [0|63.5] "dB"  LR,ADCU
 SG_ RR_AzimuthSNR_001 : 131|7@0+ (0.5,0) [0|63.5] "dB"  LR,ADCU
 SG_ RR_AzimuthSNR_002 : 211|7@0+ (0.5,0) [0|63.5] "dB"  LR,ADCU
 SG_ RR_AzimuthSNR_003 : 291|7@0+ (0.5,0) [0|63.5] "dB"  LR,ADCU
 SG_ RR_AzimuthSNR_004 : 371|7@0+ (0.5,0) [0|63.5] "dB"  LR,ADCU
 SG_ RR_AzimuthSNR_005 : 451|7@0+ (0.5,0) [0|63.5] "dB"  LR,ADCU
 SG_ RR_ElevationAng_000 : 44|9@0+ (0.1,-25) [-25|26.1] "deg"  LR,ADCU
 SG_ RR_ElevationAng_001 : 124|9@0+ (0.1,-25) [-25|26.1] "deg"  LR,ADCU
 SG_ RR_ElevationAng_002 : 204|9@0+ (0.1,-25) [-25|26.1] "deg"  LR,ADCU
 SG_ RR_ElevationAng_003 : 284|9@0+ (0.1,-25) [-25|26.1] "deg"  LR,ADCU
 SG_ RR_ElevationAng_004 : 364|9@0+ (0.1,-25) [-25|26.1] "deg"  LR,ADCU
 SG_ RR_ElevationAng_005 : 444|9@0+ (0.1,-25) [-25|26.1] "deg"  LR,ADCU
 SG_ RR_ElevationSNR_000 : 60|7@0+ (0.5,0) [0|63.5] "dB"  LR,ADCU
 SG_ RR_ElevationSNR_001 : 140|7@0+ (0.5,0) [0|63.5] "dB"  LR,ADCU
 SG_ RR_ElevationSNR_002 : 220|7@0+ (0.5,0) [0|63.5] "dB"  LR,ADCU
 SG_ RR_ElevationSNR_003 : 300|7@0+ (0.5,0) [0|63.5] "dB"  LR,ADCU
 SG_ RR_ElevationSNR_004 : 380|7@0+ (0.5,0) [0|63.5] "dB"  LR,ADCU
 SG_ RR_ElevationSNR_005 : 460|7@0+ (0.5,0) [0|63.5] "dB"  LR,ADCU
 SG_ RR_Range_000 : 7|12@0+ (0.0625,0) [0|255.9375] "m"  LR,ADCU
 SG_ RR_Range_001 : 87|12@0+ (0.0625,0) [0|255.9375] "m"  LR,ADCU
 SG_ RR_Range_002 : 167|12@0+ (0.0625,0) [0|255.9375] "m"  LR,ADCU
 SG_ RR_Range_003 : 247|12@0+ (0.0625,0) [0|255.9375] "m"  LR,ADCU
 SG_ RR_Range_004 : 327|12@0+ (0.0625,0) [0|255.9375] "m"  LR,ADCU
 SG_ RR_Range_005 : 407|12@0+ (0.0625,0) [0|255.9375] "m"  LR,ADCU
 SG_ RR_RCS_000 : 16|9@0+ (0.2,-51.1) [-51.1|51.1] "dBsm"  LR,ADCU
 SG_ RR_RCS_001 : 96|9@0+ (0.2,-51.1) [-51.1|51.1] "dBsm"  LR,ADCU
 SG_ RR_RCS_002 : 176|9@0+ (0.2,-51.1) [-51.1|51.1] "dBsm"  LR,ADCU
 SG_ RR_RCS_003 : 256|9@0+ (0.2,-51.1) [-51.1|51.1] "dBsm"  LR,ADCU
 SG_ RR_RCS_004 : 336|9@0+ (0.2,-51.1) [-51.1|51.1] "dBsm"  LR,ADCU
 SG_ RR_RCS_005 : 416|9@0+ (0.2,-51.1) [-51.1|51.1] "dBsm"  LR,ADCU
 SG_ RR_RDI_000_005_AliveCounter : 499|4@0+ (1,0) [0|15] ""  LR,ADCU
 SG_ RR_RDI_000_005_CheckSum : 511|8@0+ (1,0) [0|255] ""  LR,ADCU
 SG_ RR_Status_000 : 79|8@0+ (1,0) [0|255] ""  ADCU
 SG_ RR_Status_001 : 159|8@0+ (1,0) [0|255] ""  ADCU
 SG_ RR_Status_002 : 239|8@0+ (1,0) [0|255] ""  ADCU
 SG_ RR_Status_003 : 319|8@0+ (1,0) [0|255] ""  ADCU
 SG_ RR_Status_004 : 399|8@0+ (1,0) [0|255] ""  ADCU
 SG_ RR_Status_005 : 479|8@0+ (1,0) [0|255] ""  ADCU
 SG_ RR_Tbd_000 : 69|6@0+ (1,0) [0|63] ""  ADCU
 SG_ RR_Tbd_001 : 149|6@0+ (1,0) [0|63] ""  ADCU
 SG_ RR_Tbd_002 : 229|6@0+ (1,0) [0|63] ""  ADCU
 SG_ RR_Tbd_003 : 309|6@0+ (1,0) [0|63] ""  ADCU
 SG_ RR_Tbd_004 : 389|6@0+ (1,0) [0|63] ""  ADCU
 SG_ RR_Tbd_005 : 469|6@0+ (1,0) [0|63] ""  ADCU
 SG_ RR_Velocity_000 : 11|11@0+ (0.05,-60) [-60|42.35] "m/s"  ADCU
 SG_ RR_Velocity_001 : 91|11@0+ (0.05,-60) [-60|42.35] "m/s"  ADCU
 SG_ RR_Velocity_002 : 171|11@0+ (0.05,-60) [-60|42.35] "m/s"  ADCU
 SG_ RR_Velocity_003 : 251|11@0+ (0.05,-60) [-60|42.35] "m/s"  ADCU
 SG_ RR_Velocity_004 : 331|11@0+ (0.05,-60) [-60|42.35] "m/s"  ADCU
 SG_ RR_Velocity_005 : 411|11@0+ (0.05,-60) [-60|42.35] "m/s"  ADCU

BO_ 306 RR_RDI_006_011: 64 RR
 SG_ RR_AzimuthAng_006 : 39|11@0+ (0.1,-90) [-90|114.7] "deg"  LR,ADCU
 SG_ RR_AzimuthAng_007 : 119|11@0+ (0.1,-90) [-90|114.7] "deg"  LR,ADCU
 SG_ RR_AzimuthAng_008 : 199|11@0+ (0.1,-90) [-90|114.7] "deg"  LR,ADCU
 SG_ RR_AzimuthAng_009 : 279|11@0+ (0.1,-90) [-90|114.7] "deg"  LR,ADCU
 SG_ RR_AzimuthAng_010 : 359|11@0+ (0.1,-90) [-90|114.7] "deg"  LR,ADCU
 SG_ RR_AzimuthAng_011 : 439|11@0+ (0.1,-90) [-90|114.7] "deg"  LR,ADCU
 SG_ RR_AzimuthSNR_006 : 51|7@0+ (0.5,0) [0|63.5] "dB"  LR,ADCU
 SG_ RR_AzimuthSNR_007 : 131|7@0+ (0.5,0) [0|63.5] "dB"  LR,ADCU
 SG_ RR_AzimuthSNR_008 : 211|7@0+ (0.5,0) [0|63.5] "dB"  LR,ADCU
 SG_ RR_AzimuthSNR_009 : 291|7@0+ (0.5,0) [0|63.5] "dB"  LR,ADCU
 SG_ RR_AzimuthSNR_010 : 371|7@0+ (0.5,0) [0|63.5] "dB"  LR,ADCU
 SG_ RR_AzimuthSNR_011 : 451|7@0+ (0.5,0) [0|63.5] "dB"  LR,ADCU
 SG_ RR_ElevationAng_006 : 44|9@0+ (0.1,-25) [-25|26.1] "deg"  LR,ADCU
 SG_ RR_ElevationAng_007 : 124|9@0+ (0.1,-25) [-25|26.1] "deg"  LR,ADCU
 SG_ RR_ElevationAng_008 : 204|9@0+ (0.1,-25) [-25|26.1] "deg"  LR,ADCU
 SG_ RR_ElevationAng_009 : 284|9@0+ (0.1,-25) [-25|26.1] "deg"  LR,ADCU
 SG_ RR_ElevationAng_010 : 364|9@0+ (0.1,-25) [-25|26.1] "deg"  LR,ADCU
 SG_ RR_ElevationAng_011 : 444|9@0+ (0.1,-25) [-25|26.1] "deg"  LR,ADCU
 SG_ RR_ElevationSNR_006 : 60|7@0+ (0.5,0) [0|63.5] "dB"  LR,ADCU
 SG_ RR_ElevationSNR_007 : 140|7@0+ (0.5,0) [0|63.5] "dB"  LR,ADCU
 SG_ RR_ElevationSNR_008 : 220|7@0+ (0.5,0) [0|63.5] "dB"  LR,ADCU
 SG_ RR_ElevationSNR_009 : 300|7@0+ (0.5,0) [0|63.5] "dB"  LR,ADCU
 SG_ RR_ElevationSNR_010 : 380|7@0+ (0.5,0) [0|63.5] "dB"  LR,ADCU
 SG_ RR_ElevationSNR_011 : 460|7@0+ (0.5,0) [0|63.5] "dB"  LR,ADCU
 SG_ RR_Range_006 : 7|12@0+ (0.0625,0) [0|255.9375] "m"  LR,ADCU
 SG_ RR_Range_007 : 87|12@0+ (0.0625,0) [0|255.9375] "m"  LR,ADCU
 SG_ RR_Range_008 : 167|12@0+ (0.0625,0) [0|255.9375] "m"  LR,ADCU
 SG_ RR_Range_009 : 247|12@0+ (0.0625,0) [0|255.9375] "m"  LR,ADCU
 SG_ RR_Range_010 : 327|12@0+ (0.0625,0) [0|255.9375] "m"  LR,ADCU
 SG_ RR_Range_011 : 407|12@0+ (0.0625,0) [0|255.9375] "m"  LR,ADCU
 SG_ RR_RCS_006 : 16|9@0+ (0.2,-51.1) [-51.1|51.1] "dBsm"  LR,ADCU
 SG_ RR_RCS_007 : 96|9@0+ (0.2,-51.1) [-51.1|51.1] "dBsm"  LR,ADCU
 SG_ RR_RCS_008 : 176|9@0+ (0.2,-51.1) [-51.1|51.1] "dBsm"  LR,ADCU
 SG_ RR_RCS_009 : 256|9@0+ (0.2,-51.1) [-51.1|51.1] "dBsm"  LR,ADCU
 SG_ RR_RCS_010 : 336|9@0+ (0.2,-51.1) [-51.1|51.1] "dBsm"  LR,ADCU
 SG_ RR_RCS_011 : 416|9@0+ (0.2,-51.1) [-51.1|51.1] "dBsm"  LR,ADCU
 SG_ RR_RDI_006_011_AliveCounter : 499|4@0+ (1,0) [0|15] ""  LR,ADCU
 SG_ RR_RDI_006_011_CheckSum : 511|8@0+ (1,0) [0|255] ""  LR,ADCU
 SG_ RR_Status_006 : 79|8@0+ (1,0) [0|255] ""  ADCU
 SG_ RR_Status_007 : 159|8@0+ (1,0) [0|255] ""  ADCU
 SG_ RR_Status_008 : 239|8@0+ (1,0) [0|255] ""  ADCU
 SG_ RR_Status_009 : 319|8@0+ (1,0) [0|255] ""  ADCU
 SG_ RR_Status_010 : 399|8@0+ (1,0) [0|255] ""  ADCU
 SG_ RR_Status_011 : 479|8@0+ (1,0) [0|255] ""  ADCU
 SG_ RR_Tbd_006 : 69|6@0+ (1,0) [0|63] ""  ADCU
 SG_ RR_Tbd_007 : 149|6@0+ (1,0) [0|63] ""  ADCU
 SG_ RR_Tbd_008 : 229|6@0+ (1,0) [0|63] ""  ADCU
 SG_ RR_Tbd_009 : 309|6@0+ (1,0) [0|63] ""  ADCU
 SG_ RR_Tbd_010 : 389|6@0+ (1,0) [0|63] ""  ADCU
 SG_ RR_Tbd_011 : 469|6@0+ (1,0) [0|63] ""  ADCU
 SG_ RR_Velocity_006 : 11|11@0+ (0.05,-60) [-60|42.35] "m/s"  LR,ADCU
 SG_ RR_Velocity_007 : 91|11@0+ (0.05,-60) [-60|42.35] "m/s"  LR,ADCU
 SG_ RR_Velocity_008 : 171|11@0+ (0.05,-60) [-60|42.35] "m/s"  LR,ADCU
 SG_ RR_Velocity_009 : 251|11@0+ (0.05,-60) [-60|42.35] "m/s"  LR,ADCU
 SG_ RR_Velocity_010 : 331|11@0+ (0.05,-60) [-60|42.35] "m/s"  LR,ADCU
 SG_ RR_Velocity_011 : 411|11@0+ (0.05,-60) [-60|42.35] "m/s"  LR,ADCU

BO_ 307 RR_RDI_012_017: 64 RR
 SG_ RR_AzimuthAng_012 : 39|11@0+ (0.1,-90) [-90|114.7] "deg"  LR,ADCU
 SG_ RR_AzimuthAng_013 : 119|11@0+ (0.1,-90) [-90|114.7] "deg"  LR,ADCU
 SG_ RR_AzimuthAng_014 : 199|11@0+ (0.1,-90) [-90|114.7] "deg"  LR,ADCU
 SG_ RR_AzimuthAng_015 : 279|11@0+ (0.1,-90) [-90|114.7] "deg"  LR,ADCU
 SG_ RR_AzimuthAng_016 : 359|11@0+ (0.1,-90) [-90|114.7] "deg"  LR,ADCU
 SG_ RR_AzimuthAng_017 : 439|11@0+ (0.1,-90) [-90|114.7] "deg"  LR,ADCU
 SG_ RR_AzimuthSNR_012 : 51|7@0+ (0.5,0) [0|63.5] "dB"  LR,ADCU
 SG_ RR_AzimuthSNR_013 : 131|7@0+ (0.5,0) [0|63.5] "dB"  LR,ADCU
 SG_ RR_AzimuthSNR_014 : 211|7@0+ (0.5,0) [0|63.5] "dB"  LR,ADCU
 SG_ RR_AzimuthSNR_015 : 291|7@0+ (0.5,0) [0|63.5] "dB"  LR,ADCU
 SG_ RR_AzimuthSNR_016 : 371|7@0+ (0.5,0) [0|63.5] "dB"  LR,ADCU
 SG_ RR_AzimuthSNR_017 : 451|7@0+ (0.5,0) [0|63.5] "dB"  LR,ADCU
 SG_ RR_ElevationAng_012 : 44|9@0+ (0.1,-25) [-25|26.1] "deg"  LR,ADCU
 SG_ RR_ElevationAng_013 : 124|9@0+ (0.1,-25) [-25|26.1] "deg"  LR,ADCU
 SG_ RR_ElevationAng_014 : 204|9@0+ (0.1,-25) [-25|26.1] "deg"  LR,ADCU
 SG_ RR_ElevationAng_015 : 284|9@0+ (0.1,-25) [-25|26.1] "deg"  LR,ADCU
 SG_ RR_ElevationAng_016 : 364|9@0+ (0.1,-25) [-25|26.1] "deg"  LR,ADCU
 SG_ RR_ElevationAng_017 : 444|9@0+ (0.1,-25) [-25|26.1] "deg"  LR,ADCU
 SG_ RR_ElevationSNR_012 : 60|7@0+ (0.5,0) [0|63.5] "dB"  LR,ADCU
 SG_ RR_ElevationSNR_013 : 140|7@0+ (0.5,0) [0|63.5] "dB"  LR,ADCU
 SG_ RR_ElevationSNR_014 : 220|7@0+ (0.5,0) [0|63.5] "dB"  LR,ADCU
 SG_ RR_ElevationSNR_015 : 300|7@0+ (0.5,0) [0|63.5] "dB"  LR,ADCU
 SG_ RR_ElevationSNR_016 : 380|7@0+ (0.5,0) [0|63.5] "dB"  LR,ADCU
 SG_ RR_ElevationSNR_017 : 460|7@0+ (0.5,0) [0|63.5] "dB"  LR,ADCU
 SG_ RR_Range_012 : 7|12@0+ (0.0625,0) [0|255.9375] "m"  LR,ADCU
 SG_ RR_Range_013 : 87|12@0+ (0.0625,0) [0|255.9375] "m"  LR,ADCU
 SG_ RR_Range_014 : 167|12@0+ (0.0625,0) [0|255.9375] "m"  LR,ADCU
 SG_ RR_Range_015 : 247|12@0+ (0.0625,0) [0|255.9375] "m"  LR,ADCU
 SG_ RR_Range_016 : 327|12@0+ (0.0625,0) [0|255.9375] "m"  LR,ADCU
 SG_ RR_Range_017 : 407|12@0+ (0.0625,0) [0|255.9375] "m"  LR,ADCU
 SG_ RR_RCS_012 : 16|9@0+ (0.2,-51.1) [-51.1|51.1] "dBsm"  LR,ADCU
 SG_ RR_RCS_013 : 96|9@0+ (0.2,-51.1) [-51.1|51.1] "dBsm"  LR,ADCU
 SG_ RR_RCS_014 : 176|9@0+ (0.2,-51.1) [-51.1|51.1] "dBsm"  LR,ADCU
 SG_ RR_RCS_015 : 256|9@0+ (0.2,-51.1) [-51.1|51.1] "dBsm"  LR,ADCU
 SG_ RR_RCS_016 : 336|9@0+ (0.2,-51.1) [-51.1|51.1] "dBsm"  LR,ADCU
 SG_ RR_RCS_017 : 416|9@0+ (0.2,-51.1) [-51.1|51.1] "dBsm"  LR,ADCU
 SG_ RR_RDI_012_017_AliveCounter : 499|4@0+ (1,0) [0|15] ""  LR,ADCU
 SG_ RR_RDI_012_017_CheckSum : 511|8@0+ (1,0) [0|255] ""  LR,ADCU
 SG_ RR_Status_012 : 79|8@0+ (1,0) [0|255] ""  ADCU
 SG_ RR_Status_013 : 159|8@0+ (1,0) [0|255] ""  ADCU
 SG_ RR_Status_014 : 239|8@0+ (1,0) [0|255] ""  ADCU
 SG_ RR_Status_015 : 319|8@0+ (1,0) [0|255] ""  ADCU
 SG_ RR_Status_016 : 399|8@0+ (1,0) [0|255] ""  ADCU
 SG_ RR_Status_017 : 479|8@0+ (1,0) [0|255] ""  ADCU
 SG_ RR_Tbd_012 : 69|6@0+ (1,0) [0|63] ""  ADCU
 SG_ RR_Tbd_013 : 149|6@0+ (1,0) [0|63] ""  ADCU
 SG_ RR_Tbd_014 : 229|6@0+ (1,0) [0|63] ""  ADCU
 SG_ RR_Tbd_015 : 309|6@0+ (1,0) [0|63] ""  ADCU
 SG_ RR_Tbd_016 : 389|6@0+ (1,0) [0|63] ""  ADCU
 SG_ RR_Tbd_017 : 469|6@0+ (1,0) [0|63] ""  ADCU
 SG_ RR_Velocity_012 : 11|11@0+ (0.05,-60) [-60|42.35] "m/s"  LR,ADCU
 SG_ RR_Velocity_013 : 91|11@0+ (0.05,-60) [-60|42.35] "m/s"  LR,ADCU
 SG_ RR_Velocity_014 : 171|11@0+ (0.05,-60) [-60|42.35] "m/s"  LR,ADCU
 SG_ RR_Velocity_015 : 251|11@0+ (0.05,-60) [-60|42.35] "m/s"  LR,ADCU
 SG_ RR_Velocity_016 : 331|11@0+ (0.05,-60) [-60|42.35] "m/s"  LR,ADCU
 SG_ RR_Velocity_017 : 411|11@0+ (0.05,-60) [-60|42.35] "m/s"  LR,ADCU

BO_ 308 RR_RDI_018_023: 64 RR
 SG_ RR_AzimuthAng_018 : 39|11@0+ (0.1,-90) [-90|114.7] "deg"  LR,ADCU
 SG_ RR_AzimuthAng_019 : 119|11@0+ (0.1,-90) [-90|114.7] "deg"  LR,ADCU
 SG_ RR_AzimuthAng_020 : 199|11@0+ (0.1,-90) [-90|114.7] "deg"  LR,ADCU
 SG_ RR_AzimuthAng_021 : 279|11@0+ (0.1,-90) [-90|114.7] "deg"  LR,ADCU
 SG_ RR_AzimuthAng_022 : 359|11@0+ (0.1,-90) [-90|114.7] "deg"  LR,ADCU
 SG_ RR_AzimuthAng_023 : 439|11@0+ (0.1,-90) [-90|114.7] "deg"  LR,ADCU
 SG_ RR_AzimuthSNR_018 : 51|7@0+ (0.5,0) [0|63.5] "dB"  LR,ADCU
 SG_ RR_AzimuthSNR_019 : 131|7@0+ (0.5,0) [0|63.5] "dB"  LR,ADCU
 SG_ RR_AzimuthSNR_020 : 211|7@0+ (0.5,0) [0|63.5] "dB"  LR,ADCU
 SG_ RR_AzimuthSNR_021 : 291|7@0+ (0.5,0) [0|63.5] "dB"  LR,ADCU
 SG_ RR_AzimuthSNR_022 : 371|7@0+ (0.5,0) [0|63.5] "dB"  LR,ADCU
 SG_ RR_AzimuthSNR_023 : 451|7@0+ (0.5,0) [0|63.5] "dB"  LR,ADCU
 SG_ RR_ElevationAng_018 : 44|9@0+ (0.1,-25) [-25|26.1] "deg"  LR,ADCU
 SG_ RR_ElevationAng_019 : 124|9@0+ (0.1,-25) [-25|26.1] "deg"  LR,ADCU
 SG_ RR_ElevationAng_020 : 204|9@0+ (0.1,-25) [-25|26.1] "deg"  LR,ADCU
 SG_ RR_ElevationAng_021 : 284|9@0+ (0.1,-25) [-25|26.1] "deg"  LR,ADCU
 SG_ RR_ElevationAng_022 : 364|9@0+ (0.1,-25) [-25|26.1] "deg"  LR,ADCU
 SG_ RR_ElevationAng_023 : 444|9@0+ (0.1,-25) [-25|26.1] "deg"  LR,ADCU
 SG_ RR_ElevationSNR_018 : 60|7@0+ (0.5,0) [0|63.5] "dB"  LR,ADCU
 SG_ RR_ElevationSNR_019 : 140|7@0+ (0.5,0) [0|63.5] "dB"  LR,ADCU
 SG_ RR_ElevationSNR_020 : 220|7@0+ (0.5,0) [0|63.5] "dB"  LR,ADCU
 SG_ RR_ElevationSNR_021 : 300|7@0+ (0.5,0) [0|63.5] "dB"  LR,ADCU
 SG_ RR_ElevationSNR_022 : 380|7@0+ (0.5,0) [0|63.5] "dB"  LR,ADCU
 SG_ RR_ElevationSNR_023 : 460|7@0+ (0.5,0) [0|63.5] "dB"  LR,ADCU
 SG_ RR_Range_018 : 7|12@0+ (0.0625,0) [0|255.9375] "m"  LR,ADCU
 SG_ RR_Range_019 : 87|12@0+ (0.0625,0) [0|255.9375] "m"  LR,ADCU
 SG_ RR_Range_020 : 167|12@0+ (0.0625,0) [0|255.9375] "m"  LR,ADCU
 SG_ RR_Range_021 : 247|12@0+ (0.0625,0) [0|255.9375] "m"  LR,ADCU
 SG_ RR_Range_022 : 327|12@0+ (0.0625,0) [0|255.9375] "m"  LR,ADCU
 SG_ RR_Range_023 : 407|12@0+ (0.0625,0) [0|255.9375] "m"  LR,ADCU
 SG_ RR_RCS_018 : 16|9@0+ (0.2,-51.1) [-51.1|51.1] "dBsm"  LR,ADCU
 SG_ RR_RCS_019 : 96|9@0+ (0.2,-51.1) [-51.1|51.1] "dBsm"  LR,ADCU
 SG_ RR_RCS_020 : 176|9@0+ (0.2,-51.1) [-51.1|51.1] "dBsm"  LR,ADCU
 SG_ RR_RCS_021 : 256|9@0+ (0.2,-51.1) [-51.1|51.1] "dBsm"  LR,ADCU
 SG_ RR_RCS_022 : 336|9@0+ (0.2,-51.1) [-51.1|51.1] "dBsm"  LR,ADCU
 SG_ RR_RCS_023 : 416|9@0+ (0.2,-51.1) [-51.1|51.1] "dBsm"  LR,ADCU
 SG_ RR_RDI_018_023_AliveCounter : 499|4@0+ (1,0) [0|15] ""  LR,ADCU
 SG_ RR_RDI_018_023_CheckSum : 511|8@0+ (1,0) [0|255] ""  LR,ADCU
 SG_ RR_Status_018 : 79|8@0+ (1,0) [0|255] ""  ADCU
 SG_ RR_Status_019 : 159|8@0+ (1,0) [0|255] ""  ADCU
 SG_ RR_Status_020 : 239|8@0+ (1,0) [0|255] ""  ADCU
 SG_ RR_Status_021 : 319|8@0+ (1,0) [0|255] ""  ADCU
 SG_ RR_Status_022 : 399|8@0+ (1,0) [0|255] ""  ADCU
 SG_ RR_Status_023 : 479|8@0+ (1,0) [0|255] ""  ADCU
 SG_ RR_Tbd_018 : 69|6@0+ (1,0) [0|63] ""  ADCU
 SG_ RR_Tbd_019 : 149|6@0+ (1,0) [0|63] ""  ADCU
 SG_ RR_Tbd_020 : 229|6@0+ (1,0) [0|63] ""  ADCU
 SG_ RR_Tbd_021 : 309|6@0+ (1,0) [0|63] ""  ADCU
 SG_ RR_Tbd_022 : 389|6@0+ (1,0) [0|63] ""  ADCU
 SG_ RR_Tbd_023 : 469|6@0+ (1,0) [0|63] ""  ADCU
 SG_ RR_Velocity_018 : 11|11@0+ (0.05,-60) [-60|42.35] "m/s"  LR,ADCU
 SG_ RR_Velocity_019 : 91|11@0+ (0.05,-60) [-60|42.35] "m/s"  LR,ADCU
 SG_ RR_Velocity_020 : 171|11@0+ (0.05,-60) [-60|42.35] "m/s"  LR,ADCU
 SG_ RR_Velocity_021 : 251|11@0+ (0.05,-60) [-60|42.35] "m/s"  LR,ADCU
 SG_ RR_Velocity_022 : 331|11@0+ (0.05,-60) [-60|42.35] "m/s"  LR,ADCU
 SG_ RR_Velocity_023 : 411|11@0+ (0.05,-60) [-60|42.35] "m/s"  LR,ADCU

BO_ 309 RR_RDI_024_029: 64 RR
 SG_ RR_AzimuthAng_024 : 39|11@0+ (0.1,-90) [-90|114.7] "deg"  LR,ADCU
 SG_ RR_AzimuthAng_025 : 119|11@0+ (0.1,-90) [-90|114.7] "deg"  LR,ADCU
 SG_ RR_AzimuthAng_026 : 199|11@0+ (0.1,-90) [-90|114.7] "deg"  LR,ADCU
 SG_ RR_AzimuthAng_027 : 279|11@0+ (0.1,-90) [-90|114.7] "deg"  LR,ADCU
 SG_ RR_AzimuthAng_028 : 359|11@0+ (0.1,-90) [-90|114.7] "deg"  LR,ADCU
 SG_ RR_AzimuthAng_029 : 439|11@0+ (0.1,-90) [-90|114.7] "deg"  LR,ADCU
 SG_ RR_AzimuthSNR_024 : 51|7@0+ (0.5,0) [0|63.5] "dB"  LR,ADCU
 SG_ RR_AzimuthSNR_025 : 131|7@0+ (0.5,0) [0|63.5] "dB"  LR,ADCU
 SG_ RR_AzimuthSNR_026 : 211|7@0+ (0.5,0) [0|63.5] "dB"  LR,ADCU
 SG_ RR_AzimuthSNR_027 : 291|7@0+ (0.5,0) [0|63.5] "dB"  LR,ADCU
 SG_ RR_AzimuthSNR_028 : 371|7@0+ (0.5,0) [0|63.5] "dB"  LR,ADCU
 SG_ RR_AzimuthSNR_029 : 451|7@0+ (0.5,0) [0|63.5] "dB"  LR,ADCU
 SG_ RR_ElevationAng_024 : 44|9@0+ (0.1,-25) [-25|26.1] "deg"  LR,ADCU
 SG_ RR_ElevationAng_025 : 124|9@0+ (0.1,-25) [-25|26.1] "deg"  LR,ADCU
 SG_ RR_ElevationAng_026 : 204|9@0+ (0.1,-25) [-25|26.1] "deg"  LR,ADCU
 SG_ RR_ElevationAng_027 : 284|9@0+ (0.1,-25) [-25|26.1] "deg"  LR,ADCU
 SG_ RR_ElevationAng_028 : 364|9@0+ (0.1,-25) [-25|26.1] "deg"  LR,ADCU
 SG_ RR_ElevationAng_029 : 444|9@0+ (0.1,-25) [-25|26.1] "deg"  LR,ADCU
 SG_ RR_ElevationSNR_024 : 60|7@0+ (0.5,0) [0|63.5] "dB"  LR,ADCU
 SG_ RR_ElevationSNR_025 : 140|7@0+ (0.5,0) [0|63.5] "dB"  LR,ADCU
 SG_ RR_ElevationSNR_026 : 220|7@0+ (0.5,0) [0|63.5] "dB"  LR,ADCU
 SG_ RR_ElevationSNR_027 : 300|7@0+ (0.5,0) [0|63.5] "dB"  LR,ADCU
 SG_ RR_ElevationSNR_028 : 380|7@0+ (0.5,0) [0|63.5] "dB"  LR,ADCU
 SG_ RR_ElevationSNR_029 : 460|7@0+ (0.5,0) [0|63.5] "dB"  LR,ADCU
 SG_ RR_Range_024 : 7|12@0+ (0.0625,0) [0|255.9375] "m"  LR,ADCU
 SG_ RR_Range_025 : 87|12@0+ (0.0625,0) [0|255.9375] "m"  LR,ADCU
 SG_ RR_Range_026 : 167|12@0+ (0.0625,0) [0|255.9375] "m"  LR,ADCU
 SG_ RR_Range_027 : 247|12@0+ (0.0625,0) [0|255.9375] "m"  LR,ADCU
 SG_ RR_Range_028 : 327|12@0+ (0.0625,0) [0|255.9375] "m"  LR,ADCU
 SG_ RR_Range_029 : 407|12@0+ (0.0625,0) [0|255.9375] "m"  LR,ADCU
 SG_ RR_RCS_024 : 16|9@0+ (0.2,-51.1) [-51.1|51.1] "dBsm"  LR,ADCU
 SG_ RR_RCS_025 : 96|9@0+ (0.2,-51.1) [-51.1|51.1] "dBsm"  LR,ADCU
 SG_ RR_RCS_026 : 176|9@0+ (0.2,-51.1) [-51.1|51.1] "dBsm"  LR,ADCU
 SG_ RR_RCS_027 : 256|9@0+ (0.2,-51.1) [-51.1|51.1] "dBsm"  LR,ADCU
 SG_ RR_RCS_028 : 336|9@0+ (0.2,-51.1) [-51.1|51.1] "dBsm"  LR,ADCU
 SG_ RR_RCS_029 : 416|9@0+ (0.2,-51.1) [-51.1|51.1] "dBsm"  LR,ADCU
 SG_ RR_RDI_024_029_AliveCounter : 499|4@0+ (1,0) [0|15] ""  LR,ADCU
 SG_ RR_RDI_024_029_CheckSum : 511|8@0+ (1,0) [0|255] ""  LR,ADCU
 SG_ RR_Status_024 : 79|8@0+ (1,0) [0|255] ""  ADCU
 SG_ RR_Status_025 : 159|8@0+ (1,0) [0|255] ""  ADCU
 SG_ RR_Status_026 : 239|8@0+ (1,0) [0|255] ""  ADCU
 SG_ RR_Status_027 : 319|8@0+ (1,0) [0|255] ""  ADCU
 SG_ RR_Status_028 : 399|8@0+ (1,0) [0|255] ""  ADCU
 SG_ RR_Status_029 : 479|8@0+ (1,0) [0|255] ""  ADCU
 SG_ RR_Tbd_024 : 69|6@0+ (1,0) [0|63] ""  ADCU
 SG_ RR_Tbd_025 : 149|6@0+ (1,0) [0|63] ""  ADCU
 SG_ RR_Tbd_026 : 229|6@0+ (1,0) [0|63] ""  ADCU
 SG_ RR_Tbd_027 : 309|6@0+ (1,0) [0|63] ""  ADCU
 SG_ RR_Tbd_028 : 389|6@0+ (1,0) [0|63] ""  ADCU
 SG_ RR_Tbd_029 : 469|6@0+ (1,0) [0|63] ""  ADCU
 SG_ RR_Velocity_024 : 11|11@0+ (0.05,-60) [-60|42.35] "m/s"  LR,ADCU
 SG_ RR_Velocity_025 : 91|11@0+ (0.05,-60) [-60|42.35] "m/s"  LR,ADCU
 SG_ RR_Velocity_026 : 171|11@0+ (0.05,-60) [-60|42.35] "m/s"  LR,ADCU
 SG_ RR_Velocity_027 : 251|11@0+ (0.05,-60) [-60|42.35] "m/s"  LR,ADCU
 SG_ RR_Velocity_028 : 331|11@0+ (0.05,-60) [-60|42.35] "m/s"  LR,ADCU
 SG_ RR_Velocity_029 : 411|11@0+ (0.05,-60) [-60|42.35] "m/s"  LR,ADCU

BO_ 310 RR_RDI_030_035: 64 RR
 SG_ RR_AzimuthAng_030 : 39|11@0+ (0.1,-90) [-90|114.7] "deg"  LR,ADCU
 SG_ RR_AzimuthAng_031 : 119|11@0+ (0.1,-90) [-90|114.7] "deg"  LR,ADCU
 SG_ RR_AzimuthAng_032 : 199|11@0+ (0.1,-90) [-90|114.7] "deg"  LR,ADCU
 SG_ RR_AzimuthAng_033 : 279|11@0+ (0.1,-90) [-90|114.7] "deg"  LR,ADCU
 SG_ RR_AzimuthAng_034 : 359|11@0+ (0.1,-90) [-90|114.7] "deg"  LR,ADCU
 SG_ RR_AzimuthAng_035 : 439|11@0+ (0.1,-90) [-90|114.7] "deg"  LR,ADCU
 SG_ RR_AzimuthSNR_030 : 51|7@0+ (0.5,0) [0|63.5] "dB"  LR,ADCU
 SG_ RR_AzimuthSNR_031 : 131|7@0+ (0.5,0) [0|63.5] "dB"  LR,ADCU
 SG_ RR_AzimuthSNR_032 : 211|7@0+ (0.5,0) [0|63.5] "dB"  LR,ADCU
 SG_ RR_AzimuthSNR_033 : 291|7@0+ (0.5,0) [0|63.5] "dB"  LR,ADCU
 SG_ RR_AzimuthSNR_034 : 371|7@0+ (0.5,0) [0|63.5] "dB"  LR,ADCU
 SG_ RR_AzimuthSNR_035 : 451|7@0+ (0.5,0) [0|63.5] "dB"  LR,ADCU
 SG_ RR_ElevationAng_030 : 44|9@0+ (0.1,-25) [-25|26.1] "deg"  LR,ADCU
 SG_ RR_ElevationAng_031 : 124|9@0+ (0.1,-25) [-25|26.1] "deg"  LR,ADCU
 SG_ RR_ElevationAng_032 : 204|9@0+ (0.1,-25) [-25|26.1] "deg"  LR,ADCU
 SG_ RR_ElevationAng_033 : 284|9@0+ (0.1,-25) [-25|26.1] "deg"  LR,ADCU
 SG_ RR_ElevationAng_034 : 364|9@0+ (0.1,-25) [-25|26.1] "deg"  LR,ADCU
 SG_ RR_ElevationAng_035 : 444|9@0+ (0.1,-25) [-25|26.1] "deg"  LR,ADCU
 SG_ RR_ElevationSNR_030 : 60|7@0+ (0.5,0) [0|63.5] "dB"  LR,ADCU
 SG_ RR_ElevationSNR_031 : 140|7@0+ (0.5,0) [0|63.5] "dB"  LR,ADCU
 SG_ RR_ElevationSNR_032 : 220|7@0+ (0.5,0) [0|63.5] "dB"  LR,ADCU
 SG_ RR_ElevationSNR_033 : 300|7@0+ (0.5,0) [0|63.5] "dB"  LR,ADCU
 SG_ RR_ElevationSNR_034 : 380|7@0+ (0.5,0) [0|63.5] "dB"  LR,ADCU
 SG_ RR_ElevationSNR_035 : 460|7@0+ (0.5,0) [0|63.5] "dB"  LR,ADCU
 SG_ RR_Range_030 : 7|12@0+ (0.0625,0) [0|255.9375] "m"  LR,ADCU
 SG_ RR_Range_031 : 87|12@0+ (0.0625,0) [0|255.9375] "m"  LR,ADCU
 SG_ RR_Range_032 : 167|12@0+ (0.0625,0) [0|255.9375] "m"  LR,ADCU
 SG_ RR_Range_033 : 247|12@0+ (0.0625,0) [0|255.9375] "m"  LR,ADCU
 SG_ RR_Range_034 : 327|12@0+ (0.0625,0) [0|255.9375] "m"  LR,ADCU
 SG_ RR_Range_035 : 407|12@0+ (0.0625,0) [0|255.9375] "m"  LR,ADCU
 SG_ RR_RCS_030 : 16|9@0+ (0.2,-51.1) [-51.1|51.1] "dBsm"  LR,ADCU
 SG_ RR_RCS_031 : 96|9@0+ (0.2,-51.1) [-51.1|51.1] "dBsm"  LR,ADCU
 SG_ RR_RCS_032 : 176|9@0+ (0.2,-51.1) [-51.1|51.1] "dBsm"  LR,ADCU
 SG_ RR_RCS_033 : 256|9@0+ (0.2,-51.1) [-51.1|51.1] "dBsm"  LR,ADCU
 SG_ RR_RCS_034 : 336|9@0+ (0.2,-51.1) [-51.1|51.1] "dBsm"  LR,ADCU
 SG_ RR_RCS_035 : 416|9@0+ (0.2,-51.1) [-51.1|51.1] "dBsm"  LR,ADCU
 SG_ RR_RDI_030_035_AliveCounter : 499|4@0+ (1,0) [0|15] ""  LR,ADCU
 SG_ RR_RDI_030_035_CheckSum : 511|8@0+ (1,0) [0|255] ""  LR,ADCU
 SG_ RR_Status_030 : 79|8@0+ (1,0) [0|255] ""  ADCU
 SG_ RR_Status_031 : 159|8@0+ (1,0) [0|255] ""  ADCU
 SG_ RR_Status_032 : 239|8@0+ (1,0) [0|255] ""  ADCU
 SG_ RR_Status_033 : 319|8@0+ (1,0) [0|255] ""  ADCU
 SG_ RR_Status_034 : 399|8@0+ (1,0) [0|255] ""  ADCU
 SG_ RR_Status_035 : 479|8@0+ (1,0) [0|255] ""  ADCU
 SG_ RR_Tbd_030 : 69|6@0+ (1,0) [0|63] ""  ADCU
 SG_ RR_Tbd_031 : 149|6@0+ (1,0) [0|63] ""  ADCU
 SG_ RR_Tbd_032 : 229|6@0+ (1,0) [0|63] ""  ADCU
 SG_ RR_Tbd_033 : 309|6@0+ (1,0) [0|63] ""  ADCU
 SG_ RR_Tbd_034 : 389|6@0+ (1,0) [0|63] ""  ADCU
 SG_ RR_Tbd_035 : 469|6@0+ (1,0) [0|63] ""  ADCU
 SG_ RR_Velocity_030 : 11|11@0+ (0.05,-60) [-60|42.35] "m/s"  LR,ADCU
 SG_ RR_Velocity_031 : 91|11@0+ (0.05,-60) [-60|42.35] "m/s"  LR,ADCU
 SG_ RR_Velocity_032 : 171|11@0+ (0.05,-60) [-60|42.35] "m/s"  LR,ADCU
 SG_ RR_Velocity_033 : 251|11@0+ (0.05,-60) [-60|42.35] "m/s"  LR,ADCU
 SG_ RR_Velocity_034 : 331|11@0+ (0.05,-60) [-60|42.35] "m/s"  LR,ADCU
 SG_ RR_Velocity_035 : 411|11@0+ (0.05,-60) [-60|42.35] "m/s"  LR,ADCU

BO_ 311 RR_RDI_036_041: 64 RR
 SG_ RR_AzimuthAng_036 : 39|11@0+ (0.1,-90) [-90|114.7] "deg"  LR,ADCU
 SG_ RR_AzimuthAng_037 : 119|11@0+ (0.1,-90) [-90|114.7] "deg"  LR,ADCU
 SG_ RR_AzimuthAng_038 : 199|11@0+ (0.1,-90) [-90|114.7] "deg"  LR,ADCU
 SG_ RR_AzimuthAng_039 : 279|11@0+ (0.1,-90) [-90|114.7] "deg"  LR,ADCU
 SG_ RR_AzimuthAng_040 : 359|11@0+ (0.1,-90) [-90|114.7] "deg"  LR,ADCU
 SG_ RR_AzimuthAng_041 : 439|11@0+ (0.1,-90) [-90|114.7] "deg"  LR,ADCU
 SG_ RR_AzimuthSNR_036 : 51|7@0+ (0.5,0) [0|63.5] "dB"  LR,ADCU
 SG_ RR_AzimuthSNR_037 : 131|7@0+ (0.5,0) [0|63.5] "dB"  LR,ADCU
 SG_ RR_AzimuthSNR_038 : 211|7@0+ (0.5,0) [0|63.5] "dB"  LR,ADCU
 SG_ RR_AzimuthSNR_039 : 291|7@0+ (0.5,0) [0|63.5] "dB"  LR,ADCU
 SG_ RR_AzimuthSNR_040 : 371|7@0+ (0.5,0) [0|63.5] "dB"  LR,ADCU
 SG_ RR_AzimuthSNR_041 : 451|7@0+ (0.5,0) [0|63.5] "dB"  LR,ADCU
 SG_ RR_ElevationAng_036 : 44|9@0+ (0.1,-25) [-25|26.1] "deg"  LR,ADCU
 SG_ RR_ElevationAng_037 : 124|9@0+ (0.1,-25) [-25|26.1] "deg"  LR,ADCU
 SG_ RR_ElevationAng_038 : 204|9@0+ (0.1,-25) [-25|26.1] "deg"  LR,ADCU
 SG_ RR_ElevationAng_039 : 284|9@0+ (0.1,-25) [-25|26.1] "deg"  LR,ADCU
 SG_ RR_ElevationAng_040 : 364|9@0+ (0.1,-25) [-25|26.1] "deg"  LR,ADCU
 SG_ RR_ElevationAng_041 : 444|9@0+ (0.1,-25) [-25|26.1] "deg"  LR,ADCU
 SG_ RR_ElevationSNR_036 : 60|7@0+ (0.5,0) [0|63.5] "dB"  LR,ADCU
 SG_ RR_ElevationSNR_037 : 140|7@0+ (0.5,0) [0|63.5] "dB"  LR,ADCU
 SG_ RR_ElevationSNR_038 : 220|7@0+ (0.5,0) [0|63.5] "dB"  LR,ADCU
 SG_ RR_ElevationSNR_039 : 300|7@0+ (0.5,0) [0|63.5] "dB"  LR,ADCU
 SG_ RR_ElevationSNR_040 : 380|7@0+ (0.5,0) [0|63.5] "dB"  LR,ADCU
 SG_ RR_ElevationSNR_041 : 460|7@0+ (0.5,0) [0|63.5] "dB"  LR,ADCU
 SG_ RR_Range_036 : 7|12@0+ (0.0625,0) [0|255.9375] "m"  LR,ADCU
 SG_ RR_Range_037 : 87|12@0+ (0.0625,0) [0|255.9375] "m"  LR,ADCU
 SG_ RR_Range_038 : 167|12@0+ (0.0625,0) [0|255.9375] "m"  LR,ADCU
 SG_ RR_Range_039 : 247|12@0+ (0.0625,0) [0|255.9375] "m"  LR,ADCU
 SG_ RR_Range_040 : 327|12@0+ (0.0625,0) [0|255.9375] "m"  LR,ADCU
 SG_ RR_Range_041 : 407|12@0+ (0.0625,0) [0|255.9375] "m"  LR,ADCU
 SG_ RR_RCS_036 : 16|9@0+ (0.2,-51.1) [-51.1|51.1] "dBsm"  LR,ADCU
 SG_ RR_RCS_037 : 96|9@0+ (0.2,-51.1) [-51.1|51.1] "dBsm"  LR,ADCU
 SG_ RR_RCS_038 : 176|9@0+ (0.2,-51.1) [-51.1|51.1] "dBsm"  LR,ADCU
 SG_ RR_RCS_039 : 256|9@0+ (0.2,-51.1) [-51.1|51.1] "dBsm"  LR,ADCU
 SG_ RR_RCS_040 : 336|9@0+ (0.2,-51.1) [-51.1|51.1] "dBsm"  LR,ADCU
 SG_ RR_RCS_041 : 416|9@0+ (0.2,-51.1) [-51.1|51.1] "dBsm"  LR,ADCU
 SG_ RR_RDI_036_041_AliveCounter : 499|4@0+ (1,0) [0|15] ""  LR,ADCU
 SG_ RR_RDI_036_041_CheckSum : 511|8@0+ (1,0) [0|255] ""  LR,ADCU
 SG_ RR_Status_036 : 79|8@0+ (1,0) [0|255] ""  ADCU
 SG_ RR_Status_037 : 159|8@0+ (1,0) [0|255] ""  ADCU
 SG_ RR_Status_038 : 239|8@0+ (1,0) [0|255] ""  ADCU
 SG_ RR_Status_039 : 319|8@0+ (1,0) [0|255] ""  ADCU
 SG_ RR_Status_040 : 399|8@0+ (1,0) [0|255] ""  ADCU
 SG_ RR_Status_041 : 479|8@0+ (1,0) [0|255] ""  ADCU
 SG_ RR_Tbd_036 : 69|6@0+ (1,0) [0|63] ""  ADCU
 SG_ RR_Tbd_037 : 149|6@0+ (1,0) [0|63] ""  ADCU
 SG_ RR_Tbd_038 : 229|6@0+ (1,0) [0|63] ""  ADCU
 SG_ RR_Tbd_039 : 309|6@0+ (1,0) [0|63] ""  ADCU
 SG_ RR_Tbd_040 : 389|6@0+ (1,0) [0|63] ""  ADCU
 SG_ RR_Tbd_041 : 469|6@0+ (1,0) [0|63] ""  ADCU
 SG_ RR_Velocity_036 : 11|11@0+ (0.05,-60) [-60|42.35] "m/s"  LR,ADCU
 SG_ RR_Velocity_037 : 91|11@0+ (0.05,-60) [-60|42.35] "m/s"  LR,ADCU
 SG_ RR_Velocity_038 : 171|11@0+ (0.05,-60) [-60|42.35] "m/s"  LR,ADCU
 SG_ RR_Velocity_039 : 251|11@0+ (0.05,-60) [-60|42.35] "m/s"  LR,ADCU
 SG_ RR_Velocity_040 : 331|11@0+ (0.05,-60) [-60|42.35] "m/s"  LR,ADCU
 SG_ RR_Velocity_041 : 411|11@0+ (0.05,-60) [-60|42.35] "m/s"  LR,ADCU

BO_ 312 RR_RDI_042_047: 64 RR
 SG_ RR_AzimuthAng_042 : 39|11@0+ (0.1,-90) [-90|114.7] "deg"  LR,ADCU
 SG_ RR_AzimuthAng_043 : 119|11@0+ (0.1,-90) [-90|114.7] "deg"  LR,ADCU
 SG_ RR_AzimuthAng_044 : 199|11@0+ (0.1,-90) [-90|114.7] "deg"  LR,ADCU
 SG_ RR_AzimuthAng_045 : 279|11@0+ (0.1,-90) [-90|114.7] "deg"  LR,ADCU
 SG_ RR_AzimuthAng_046 : 359|11@0+ (0.1,-90) [-90|114.7] "deg"  LR,ADCU
 SG_ RR_AzimuthAng_047 : 439|11@0+ (0.1,-90) [-90|114.7] "deg"  LR,ADCU
 SG_ RR_AzimuthSNR_042 : 51|7@0+ (0.5,0) [0|63.5] "dB"  LR,ADCU
 SG_ RR_AzimuthSNR_043 : 131|7@0+ (0.5,0) [0|63.5] "dB"  LR,ADCU
 SG_ RR_AzimuthSNR_044 : 211|7@0+ (0.5,0) [0|63.5] "dB"  LR,ADCU
 SG_ RR_AzimuthSNR_045 : 291|7@0+ (0.5,0) [0|63.5] "dB"  LR,ADCU
 SG_ RR_AzimuthSNR_046 : 371|7@0+ (0.5,0) [0|63.5] "dB"  LR,ADCU
 SG_ RR_AzimuthSNR_047 : 451|7@0+ (0.5,0) [0|63.5] "dB"  LR,ADCU
 SG_ RR_ElevationAng_042 : 44|9@0+ (0.1,-25) [-25|26.1] "deg"  LR,ADCU
 SG_ RR_ElevationAng_043 : 124|9@0+ (0.1,-25) [-25|26.1] "deg"  LR,ADCU
 SG_ RR_ElevationAng_044 : 204|9@0+ (0.1,-25) [-25|26.1] "deg"  LR,ADCU
 SG_ RR_ElevationAng_045 : 284|9@0+ (0.1,-25) [-25|26.1] "deg"  LR,ADCU
 SG_ RR_ElevationAng_046 : 364|9@0+ (0.1,-25) [-25|26.1] "deg"  LR,ADCU
 SG_ RR_ElevationAng_047 : 444|9@0+ (0.1,-25) [-25|26.1] "deg"  LR,ADCU
 SG_ RR_ElevationSNR_042 : 60|7@0+ (0.5,0) [0|63.5] "dB"  LR,ADCU
 SG_ RR_ElevationSNR_043 : 140|7@0+ (0.5,0) [0|63.5] "dB"  LR,ADCU
 SG_ RR_ElevationSNR_044 : 220|7@0+ (0.5,0) [0|63.5] "dB"  LR,ADCU
 SG_ RR_ElevationSNR_045 : 300|7@0+ (0.5,0) [0|63.5] "dB"  LR,ADCU
 SG_ RR_ElevationSNR_046 : 380|7@0+ (0.5,0) [0|63.5] "dB"  LR,ADCU
 SG_ RR_ElevationSNR_047 : 460|7@0+ (0.5,0) [0|63.5] "dB"  LR,ADCU
 SG_ RR_Range_042 : 7|12@0+ (0.0625,0) [0|255.9375] "m"  LR,ADCU
 SG_ RR_Range_043 : 87|12@0+ (0.0625,0) [0|255.9375] "m"  LR,ADCU
 SG_ RR_Range_044 : 167|12@0+ (0.0625,0) [0|255.9375] "m"  LR,ADCU
 SG_ RR_Range_045 : 247|12@0+ (0.0625,0) [0|255.9375] "m"  LR,ADCU
 SG_ RR_Range_046 : 327|12@0+ (0.0625,0) [0|255.9375] "m"  LR,ADCU
 SG_ RR_Range_047 : 407|12@0+ (0.0625,0) [0|255.9375] "m"  LR,ADCU
 SG_ RR_RCS_042 : 16|9@0+ (0.2,-51.1) [-51.1|51.1] "dBsm"  LR,ADCU
 SG_ RR_RCS_043 : 96|9@0+ (0.2,-51.1) [-51.1|51.1] "dBsm"  LR,ADCU
 SG_ RR_RCS_044 : 176|9@0+ (0.2,-51.1) [-51.1|51.1] "dBsm"  LR,ADCU
 SG_ RR_RCS_045 : 256|9@0+ (0.2,-51.1) [-51.1|51.1] "dBsm"  LR,ADCU
 SG_ RR_RCS_046 : 336|9@0+ (0.2,-51.1) [-51.1|51.1] "dBsm"  LR,ADCU
 SG_ RR_RCS_047 : 416|9@0+ (0.2,-51.1) [-51.1|51.1] "dBsm"  LR,ADCU
 SG_ RR_RDI_042_047_AliveCounter : 499|4@0+ (1,0) [0|15] ""  LR,ADCU
 SG_ RR_RDI_042_047_CheckSum : 511|8@0+ (1,0) [0|255] ""  LR,ADCU
 SG_ RR_Status_042 : 79|8@0+ (1,0) [0|255] ""  ADCU
 SG_ RR_Status_043 : 159|8@0+ (1,0) [0|255] ""  ADCU
 SG_ RR_Status_044 : 239|8@0+ (1,0) [0|255] ""  ADCU
 SG_ RR_Status_045 : 319|8@0+ (1,0) [0|255] ""  ADCU
 SG_ RR_Status_046 : 399|8@0+ (1,0) [0|255] ""  ADCU
 SG_ RR_Status_047 : 479|8@0+ (1,0) [0|255] ""  ADCU
 SG_ RR_Tbd_042 : 69|6@0+ (1,0) [0|63] ""  ADCU
 SG_ RR_Tbd_043 : 149|6@0+ (1,0) [0|63] ""  ADCU
 SG_ RR_Tbd_044 : 229|6@0+ (1,0) [0|63] ""  ADCU
 SG_ RR_Tbd_045 : 309|6@0+ (1,0) [0|63] ""  ADCU
 SG_ RR_Tbd_046 : 389|6@0+ (1,0) [0|63] ""  ADCU
 SG_ RR_Tbd_047 : 469|6@0+ (1,0) [0|63] ""  ADCU
 SG_ RR_Velocity_042 : 11|11@0+ (0.05,-60) [-60|42.35] "m/s"  LR,ADCU
 SG_ RR_Velocity_043 : 91|11@0+ (0.05,-60) [-60|42.35] "m/s"  LR,ADCU
 SG_ RR_Velocity_044 : 171|11@0+ (0.05,-60) [-60|42.35] "m/s"  LR,ADCU
 SG_ RR_Velocity_045 : 251|11@0+ (0.05,-60) [-60|42.35] "m/s"  LR,ADCU
 SG_ RR_Velocity_046 : 331|11@0+ (0.05,-60) [-60|42.35] "m/s"  LR,ADCU
 SG_ RR_Velocity_047 : 411|11@0+ (0.05,-60) [-60|42.35] "m/s"  LR,ADCU

BO_ 313 RR_RDI_048_053: 64 RR
 SG_ RR_AzimuthAng_048 : 39|11@0+ (0.1,-90) [-90|114.7] "deg"  LR,ADCU
 SG_ RR_AzimuthAng_049 : 119|11@0+ (0.1,-90) [-90|114.7] "deg"  LR,ADCU
 SG_ RR_AzimuthAng_050 : 199|11@0+ (0.1,-90) [-90|114.7] "deg"  LR,ADCU
 SG_ RR_AzimuthAng_051 : 279|11@0+ (0.1,-90) [-90|114.7] "deg"  LR,ADCU
 SG_ RR_AzimuthAng_052 : 359|11@0+ (0.1,-90) [-90|114.7] "deg"  LR,ADCU
 SG_ RR_AzimuthAng_053 : 439|11@0+ (0.1,-90) [-90|114.7] "deg"  LR,ADCU
 SG_ RR_AzimuthSNR_048 : 51|7@0+ (0.5,0) [0|63.5] "dB"  LR,ADCU
 SG_ RR_AzimuthSNR_049 : 131|7@0+ (0.5,0) [0|63.5] "dB"  LR,ADCU
 SG_ RR_AzimuthSNR_050 : 211|7@0+ (0.5,0) [0|63.5] "dB"  LR,ADCU
 SG_ RR_AzimuthSNR_051 : 291|7@0+ (0.5,0) [0|63.5] "dB"  LR,ADCU
 SG_ RR_AzimuthSNR_052 : 371|7@0+ (0.5,0) [0|63.5] "dB"  LR,ADCU
 SG_ RR_AzimuthSNR_053 : 451|7@0+ (0.5,0) [0|63.5] "dB"  LR,ADCU
 SG_ RR_ElevationAng_048 : 44|9@0+ (0.1,-25) [-25|26.1] "deg"  LR,ADCU
 SG_ RR_ElevationAng_049 : 124|9@0+ (0.1,-25) [-25|26.1] "deg"  LR,ADCU
 SG_ RR_ElevationAng_050 : 204|9@0+ (0.1,-25) [-25|26.1] "deg"  LR,ADCU
 SG_ RR_ElevationAng_051 : 284|9@0+ (0.1,-25) [-25|26.1] "deg"  LR,ADCU
 SG_ RR_ElevationAng_052 : 364|9@0+ (0.1,-25) [-25|26.1] "deg"  LR,ADCU
 SG_ RR_ElevationAng_053 : 444|9@0+ (0.1,-25) [-25|26.1] "deg"  LR,ADCU
 SG_ RR_ElevationSNR_048 : 60|7@0+ (0.5,0) [0|63.5] "dB"  LR,ADCU
 SG_ RR_ElevationSNR_049 : 140|7@0+ (0.5,0) [0|63.5] "dB"  LR,ADCU
 SG_ RR_ElevationSNR_050 : 220|7@0+ (0.5,0) [0|63.5] "dB"  LR,ADCU
 SG_ RR_ElevationSNR_051 : 300|7@0+ (0.5,0) [0|63.5] "dB"  LR,ADCU
 SG_ RR_ElevationSNR_052 : 380|7@0+ (0.5,0) [0|63.5] "dB"  LR,ADCU
 SG_ RR_ElevationSNR_053 : 460|7@0+ (0.5,0) [0|63.5] "dB"  LR,ADCU
 SG_ RR_Range_048 : 7|12@0+ (0.0625,0) [0|255.9375] "m"  LR,ADCU
 SG_ RR_Range_049 : 87|12@0+ (0.0625,0) [0|255.9375] "m"  LR,ADCU
 SG_ RR_Range_050 : 167|12@0+ (0.0625,0) [0|255.9375] "m"  LR,ADCU
 SG_ RR_Range_051 : 247|12@0+ (0.0625,0) [0|255.9375] "m"  LR,ADCU
 SG_ RR_Range_052 : 327|12@0+ (0.0625,0) [0|255.9375] "m"  LR,ADCU
 SG_ RR_Range_053 : 407|12@0+ (0.0625,0) [0|255.9375] "m"  LR,ADCU
 SG_ RR_RCS_048 : 16|9@0+ (0.2,-51.1) [-51.1|51.1] "dBsm"  LR,ADCU
 SG_ RR_RCS_049 : 96|9@0+ (0.2,-51.1) [-51.1|51.1] "dBsm"  LR,ADCU
 SG_ RR_RCS_050 : 176|9@0+ (0.2,-51.1) [-51.1|51.1] "dBsm"  LR,ADCU
 SG_ RR_RCS_051 : 256|9@0+ (0.2,-51.1) [-51.1|51.1] "dBsm"  LR,ADCU
 SG_ RR_RCS_052 : 336|9@0+ (0.2,-51.1) [-51.1|51.1] "dBsm"  LR,ADCU
 SG_ RR_RCS_053 : 416|9@0+ (0.2,-51.1) [-51.1|51.1] "dBsm"  LR,ADCU
 SG_ RR_RDI_048_053_AliveCounter : 499|4@0+ (1,0) [0|15] ""  LR,ADCU
 SG_ RR_RDI_048_053_CheckSum : 511|8@0+ (1,0) [0|255] ""  LR,ADCU
 SG_ RR_Status_048 : 79|8@0+ (1,0) [0|255] ""  ADCU
 SG_ RR_Status_049 : 159|8@0+ (1,0) [0|255] ""  ADCU
 SG_ RR_Status_050 : 239|8@0+ (1,0) [0|255] ""  ADCU
 SG_ RR_Status_051 : 319|8@0+ (1,0) [0|255] ""  ADCU
 SG_ RR_Status_052 : 399|8@0+ (1,0) [0|255] ""  ADCU
 SG_ RR_Status_053 : 479|8@0+ (1,0) [0|255] ""  ADCU
 SG_ RR_Tbd_048 : 69|6@0+ (1,0) [0|63] ""  ADCU
 SG_ RR_Tbd_049 : 149|6@0+ (1,0) [0|63] ""  ADCU
 SG_ RR_Tbd_050 : 229|6@0+ (1,0) [0|63] ""  ADCU
 SG_ RR_Tbd_051 : 309|6@0+ (1,0) [0|63] ""  ADCU
 SG_ RR_Tbd_052 : 389|6@0+ (1,0) [0|63] ""  ADCU
 SG_ RR_Tbd_053 : 469|6@0+ (1,0) [0|63] ""  ADCU
 SG_ RR_Velocity_048 : 11|11@0+ (0.05,-60) [-60|42.35] "m/s"  LR,ADCU
 SG_ RR_Velocity_049 : 91|11@0+ (0.05,-60) [-60|42.35] "m/s"  LR,ADCU
 SG_ RR_Velocity_050 : 171|11@0+ (0.05,-60) [-60|42.35] "m/s"  LR,ADCU
 SG_ RR_Velocity_051 : 251|11@0+ (0.05,-60) [-60|42.35] "m/s"  LR,ADCU
 SG_ RR_Velocity_052 : 331|11@0+ (0.05,-60) [-60|42.35] "m/s"  LR,ADCU
 SG_ RR_Velocity_053 : 411|11@0+ (0.05,-60) [-60|42.35] "m/s"  LR,ADCU

BO_ 314 RR_RDI_054_059: 64 RR
 SG_ RR_AzimuthAng_054 : 39|11@0+ (0.1,-90) [-90|114.7] "deg"  LR,ADCU
 SG_ RR_AzimuthAng_055 : 119|11@0+ (0.1,-90) [-90|114.7] "deg"  LR,ADCU
 SG_ RR_AzimuthAng_056 : 199|11@0+ (0.1,-90) [-90|114.7] "deg"  LR,ADCU
 SG_ RR_AzimuthAng_057 : 279|11@0+ (0.1,-90) [-90|114.7] "deg"  LR,ADCU
 SG_ RR_AzimuthAng_058 : 359|11@0+ (0.1,-90) [-90|114.7] "deg"  LR,ADCU
 SG_ RR_AzimuthAng_059 : 439|11@0+ (0.1,-90) [-90|114.7] "deg"  LR,ADCU
 SG_ RR_AzimuthSNR_054 : 51|7@0+ (0.5,0) [0|63.5] "dB"  LR,ADCU
 SG_ RR_AzimuthSNR_055 : 131|7@0+ (0.5,0) [0|63.5] "dB"  LR,ADCU
 SG_ RR_AzimuthSNR_056 : 211|7@0+ (0.5,0) [0|63.5] "dB"  LR,ADCU
 SG_ RR_AzimuthSNR_057 : 291|7@0+ (0.5,0) [0|63.5] "dB"  LR,ADCU
 SG_ RR_AzimuthSNR_058 : 371|7@0+ (0.5,0) [0|63.5] "dB"  LR,ADCU
 SG_ RR_AzimuthSNR_059 : 451|7@0+ (0.5,0) [0|63.5] "dB"  LR,ADCU
 SG_ RR_ElevationAng_054 : 44|9@0+ (0.1,-25) [-25|26.1] "deg"  LR,ADCU
 SG_ RR_ElevationAng_055 : 124|9@0+ (0.1,-25) [-25|26.1] "deg"  LR,ADCU
 SG_ RR_ElevationAng_056 : 204|9@0+ (0.1,-25) [-25|26.1] "deg"  LR,ADCU
 SG_ RR_ElevationAng_057 : 284|9@0+ (0.1,-25) [-25|26.1] "deg"  LR,ADCU
 SG_ RR_ElevationAng_058 : 364|9@0+ (0.1,-25) [-25|26.1] "deg"  LR,ADCU
 SG_ RR_ElevationAng_059 : 444|9@0+ (0.1,-25) [-25|26.1] "deg"  LR,ADCU
 SG_ RR_ElevationSNR_054 : 60|7@0+ (0.5,0) [0|63.5] "dB"  LR,ADCU
 SG_ RR_ElevationSNR_055 : 140|7@0+ (0.5,0) [0|63.5] "dB"  LR,ADCU
 SG_ RR_ElevationSNR_056 : 220|7@0+ (0.5,0) [0|63.5] "dB"  LR,ADCU
 SG_ RR_ElevationSNR_057 : 300|7@0+ (0.5,0) [0|63.5] "dB"  LR,ADCU
 SG_ RR_ElevationSNR_058 : 380|7@0+ (0.5,0) [0|63.5] "dB"  LR,ADCU
 SG_ RR_ElevationSNR_059 : 460|7@0+ (0.5,0) [0|63.5] "dB"  LR,ADCU
 SG_ RR_Range_054 : 7|12@0+ (0.0625,0) [0|255.9375] "m"  LR,ADCU
 SG_ RR_Range_055 : 87|12@0+ (0.0625,0) [0|255.9375] "m"  LR,ADCU
 SG_ RR_Range_056 : 167|12@0+ (0.0625,0) [0|255.9375] "m"  LR,ADCU
 SG_ RR_Range_057 : 247|12@0+ (0.0625,0) [0|255.9375] "m"  LR,ADCU
 SG_ RR_Range_058 : 327|12@0+ (0.0625,0) [0|255.9375] "m"  LR,ADCU
 SG_ RR_Range_059 : 407|12@0+ (0.0625,0) [0|255.9375] "m"  LR,ADCU
 SG_ RR_RCS_054 : 16|9@0+ (0.2,-51.1) [-51.1|51.1] "dBsm"  LR,ADCU
 SG_ RR_RCS_055 : 96|9@0+ (0.2,-51.1) [-51.1|51.1] "dBsm"  LR,ADCU
 SG_ RR_RCS_056 : 176|9@0+ (0.2,-51.1) [-51.1|51.1] "dBsm"  LR,ADCU
 SG_ RR_RCS_057 : 256|9@0+ (0.2,-51.1) [-51.1|51.1] "dBsm"  LR,ADCU
 SG_ RR_RCS_058 : 336|9@0+ (0.2,-51.1) [-51.1|51.1] "dBsm"  LR,ADCU
 SG_ RR_RCS_059 : 416|9@0+ (0.2,-51.1) [-51.1|51.1] "dBsm"  LR,ADCU
 SG_ RR_RDI_054_059_AliveCounter : 499|4@0+ (1,0) [0|15] ""  LR,ADCU
 SG_ RR_RDI_054_059_CheckSum : 511|8@0+ (1,0) [0|255] ""  LR,ADCU
 SG_ RR_Status_054 : 79|8@0+ (1,0) [0|255] ""  ADCU
 SG_ RR_Status_055 : 159|8@0+ (1,0) [0|255] ""  ADCU
 SG_ RR_Status_056 : 239|8@0+ (1,0) [0|255] ""  ADCU
 SG_ RR_Status_057 : 319|8@0+ (1,0) [0|255] ""  ADCU
 SG_ RR_Status_058 : 399|8@0+ (1,0) [0|255] ""  ADCU
 SG_ RR_Status_059 : 479|8@0+ (1,0) [0|255] ""  ADCU
 SG_ RR_Tbd_054 : 69|6@0+ (1,0) [0|63] ""  ADCU
 SG_ RR_Tbd_055 : 149|6@0+ (1,0) [0|63] ""  ADCU
 SG_ RR_Tbd_056 : 229|6@0+ (1,0) [0|63] ""  ADCU
 SG_ RR_Tbd_057 : 309|6@0+ (1,0) [0|63] ""  ADCU
 SG_ RR_Tbd_058 : 389|6@0+ (1,0) [0|63] ""  ADCU
 SG_ RR_Tbd_059 : 469|6@0+ (1,0) [0|63] ""  ADCU
 SG_ RR_Velocity_054 : 11|11@0+ (0.05,-60) [-60|42.35] "m/s"  LR,ADCU
 SG_ RR_Velocity_055 : 91|11@0+ (0.05,-60) [-60|42.35] "m/s"  LR,ADCU
 SG_ RR_Velocity_056 : 171|11@0+ (0.05,-60) [-60|42.35] "m/s"  LR,ADCU
 SG_ RR_Velocity_057 : 251|11@0+ (0.05,-60) [-60|42.35] "m/s"  LR,ADCU
 SG_ RR_Velocity_058 : 331|11@0+ (0.05,-60) [-60|42.35] "m/s"  LR,ADCU
 SG_ RR_Velocity_059 : 411|11@0+ (0.05,-60) [-60|42.35] "m/s"  LR,ADCU

BO_ 315 RR_RDI_060_065: 64 RR
 SG_ RR_AzimuthAng_060 : 39|11@0+ (0.1,-90) [-90|114.7] "deg"  LR,ADCU
 SG_ RR_AzimuthAng_061 : 119|11@0+ (0.1,-90) [-90|114.7] "deg"  LR,ADCU
 SG_ RR_AzimuthAng_062 : 199|11@0+ (0.1,-90) [-90|114.7] "deg"  LR,ADCU
 SG_ RR_AzimuthAng_063 : 279|11@0+ (0.1,-90) [-90|114.7] "deg"  LR,ADCU
 SG_ RR_AzimuthAng_064 : 359|11@0+ (0.1,-90) [-90|114.7] "deg"  LR,ADCU
 SG_ RR_AzimuthAng_065 : 439|11@0+ (0.1,-90) [-90|114.7] "deg"  LR,ADCU
 SG_ RR_AzimuthSNR_060 : 51|7@0+ (0.5,0) [0|63.5] "dB"  LR,ADCU
 SG_ RR_AzimuthSNR_061 : 131|7@0+ (0.5,0) [0|63.5] "dB"  LR,ADCU
 SG_ RR_AzimuthSNR_062 : 211|7@0+ (0.5,0) [0|63.5] "dB"  LR,ADCU
 SG_ RR_AzimuthSNR_063 : 291|7@0+ (0.5,0) [0|63.5] "dB"  LR,ADCU
 SG_ RR_AzimuthSNR_064 : 371|7@0+ (0.5,0) [0|63.5] "dB"  LR,ADCU
 SG_ RR_AzimuthSNR_065 : 451|7@0+ (0.5,0) [0|63.5] "dB"  LR,ADCU
 SG_ RR_ElevationAng_060 : 44|9@0+ (0.1,-25) [-25|26.1] "deg"  LR,ADCU
 SG_ RR_ElevationAng_061 : 124|9@0+ (0.1,-25) [-25|26.1] "deg"  LR,ADCU
 SG_ RR_ElevationAng_062 : 204|9@0+ (0.1,-25) [-25|26.1] "deg"  LR,ADCU
 SG_ RR_ElevationAng_063 : 284|9@0+ (0.1,-25) [-25|26.1] "deg"  LR,ADCU
 SG_ RR_ElevationAng_064 : 364|9@0+ (0.1,-25) [-25|26.1] "deg"  LR,ADCU
 SG_ RR_ElevationAng_065 : 444|9@0+ (0.1,-25) [-25|26.1] "deg"  LR,ADCU
 SG_ RR_ElevationSNR_060 : 60|7@0+ (0.5,0) [0|63.5] "dB"  LR,ADCU
 SG_ RR_ElevationSNR_061 : 140|7@0+ (0.5,0) [0|63.5] "dB"  LR,ADCU
 SG_ RR_ElevationSNR_062 : 220|7@0+ (0.5,0) [0|63.5] "dB"  LR,ADCU
 SG_ RR_ElevationSNR_063 : 300|7@0+ (0.5,0) [0|63.5] "dB"  LR,ADCU
 SG_ RR_ElevationSNR_064 : 380|7@0+ (0.5,0) [0|63.5] "dB"  LR,ADCU
 SG_ RR_ElevationSNR_065 : 460|7@0+ (0.5,0) [0|63.5] "dB"  LR,ADCU
 SG_ RR_Range_060 : 7|12@0+ (0.0625,0) [0|255.9375] "m"  LR,ADCU
 SG_ RR_Range_061 : 87|12@0+ (0.0625,0) [0|255.9375] "m"  LR,ADCU
 SG_ RR_Range_062 : 167|12@0+ (0.0625,0) [0|255.9375] "m"  LR,ADCU
 SG_ RR_Range_063 : 247|12@0+ (0.0625,0) [0|255.9375] "m"  LR,ADCU
 SG_ RR_Range_064 : 327|12@0+ (0.0625,0) [0|255.9375] "m"  LR,ADCU
 SG_ RR_Range_065 : 407|12@0+ (0.0625,0) [0|255.9375] "m"  LR,ADCU
 SG_ RR_RCS_060 : 16|9@0+ (0.2,-51.1) [-51.1|51.1] "dBsm"  LR,ADCU
 SG_ RR_RCS_061 : 96|9@0+ (0.2,-51.1) [-51.1|51.1] "dBsm"  LR,ADCU
 SG_ RR_RCS_062 : 176|9@0+ (0.2,-51.1) [-51.1|51.1] "dBsm"  LR,ADCU
 SG_ RR_RCS_063 : 256|9@0+ (0.2,-51.1) [-51.1|51.1] "dBsm"  LR,ADCU
 SG_ RR_RCS_064 : 336|9@0+ (0.2,-51.1) [-51.1|51.1] "dBsm"  LR,ADCU
 SG_ RR_RCS_065 : 416|9@0+ (0.2,-51.1) [-51.1|51.1] "dBsm"  LR,ADCU
 SG_ RR_RDI_060_065_AliveCounter : 499|4@0+ (1,0) [0|15] ""  LR,ADCU
 SG_ RR_RDI_060_065_CheckSum : 511|8@0+ (1,0) [0|255] ""  LR,ADCU
 SG_ RR_Status_060 : 79|8@0+ (1,0) [0|255] ""  ADCU
 SG_ RR_Status_061 : 159|8@0+ (1,0) [0|255] ""  ADCU
 SG_ RR_Status_062 : 239|8@0+ (1,0) [0|255] ""  ADCU
 SG_ RR_Status_063 : 319|8@0+ (1,0) [0|255] ""  ADCU
 SG_ RR_Status_064 : 399|8@0+ (1,0) [0|255] ""  ADCU
 SG_ RR_Status_065 : 479|8@0+ (1,0) [0|255] ""  ADCU
 SG_ RR_Tbd_060 : 69|6@0+ (1,0) [0|63] ""  ADCU
 SG_ RR_Tbd_061 : 149|6@0+ (1,0) [0|63] ""  ADCU
 SG_ RR_Tbd_062 : 229|6@0+ (1,0) [0|63] ""  ADCU
 SG_ RR_Tbd_063 : 309|6@0+ (1,0) [0|63] ""  ADCU
 SG_ RR_Tbd_064 : 389|6@0+ (1,0) [0|63] ""  ADCU
 SG_ RR_Tbd_065 : 469|6@0+ (1,0) [0|63] ""  ADCU
 SG_ RR_Velocity_060 : 11|11@0+ (0.05,-60) [-60|42.35] "m/s"  LR,ADCU
 SG_ RR_Velocity_061 : 91|11@0+ (0.05,-60) [-60|42.35] "m/s"  LR,ADCU
 SG_ RR_Velocity_062 : 171|11@0+ (0.05,-60) [-60|42.35] "m/s"  LR,ADCU
 SG_ RR_Velocity_063 : 251|11@0+ (0.05,-60) [-60|42.35] "m/s"  LR,ADCU
 SG_ RR_Velocity_064 : 331|11@0+ (0.05,-60) [-60|42.35] "m/s"  LR,ADCU
 SG_ RR_Velocity_065 : 411|11@0+ (0.05,-60) [-60|42.35] "m/s"  LR,ADCU

BO_ 316 RR_RDI_066_071: 64 RR
 SG_ RR_AzimuthAng_066 : 39|11@0+ (0.1,-90) [-90|114.7] "deg"  LR,ADCU
 SG_ RR_AzimuthAng_067 : 119|11@0+ (0.1,-90) [-90|114.7] "deg"  LR,ADCU
 SG_ RR_AzimuthAng_068 : 199|11@0+ (0.1,-90) [-90|114.7] "deg"  LR,ADCU
 SG_ RR_AzimuthAng_069 : 279|11@0+ (0.1,-90) [-90|114.7] "deg"  LR,ADCU
 SG_ RR_AzimuthAng_070 : 359|11@0+ (0.1,-90) [-90|114.7] "deg"  LR,ADCU
 SG_ RR_AzimuthAng_071 : 439|11@0+ (0.1,-90) [-90|114.7] "deg"  LR,ADCU
 SG_ RR_AzimuthSNR_066 : 51|7@0+ (0.5,0) [0|63.5] "dB"  LR,ADCU
 SG_ RR_AzimuthSNR_067 : 131|7@0+ (0.5,0) [0|63.5] "dB"  LR,ADCU
 SG_ RR_AzimuthSNR_068 : 211|7@0+ (0.5,0) [0|63.5] "dB"  LR,ADCU
 SG_ RR_AzimuthSNR_069 : 291|7@0+ (0.5,0) [0|63.5] "dB"  LR,ADCU
 SG_ RR_AzimuthSNR_070 : 371|7@0+ (0.5,0) [0|63.5] "dB"  LR,ADCU
 SG_ RR_AzimuthSNR_071 : 451|7@0+ (0.5,0) [0|63.5] "dB"  LR,ADCU
 SG_ RR_ElevationAng_066 : 44|9@0+ (0.1,-25) [-25|26.1] "deg"  LR,ADCU
 SG_ RR_ElevationAng_067 : 124|9@0+ (0.1,-25) [-25|26.1] "deg"  LR,ADCU
 SG_ RR_ElevationAng_068 : 204|9@0+ (0.1,-25) [-25|26.1] "deg"  LR,ADCU
 SG_ RR_ElevationAng_069 : 284|9@0+ (0.1,-25) [-25|26.1] "deg"  LR,ADCU
 SG_ RR_ElevationAng_070 : 364|9@0+ (0.1,-25) [-25|26.1] "deg"  LR,ADCU
 SG_ RR_ElevationAng_071 : 444|9@0+ (0.1,-25) [-25|26.1] "deg"  LR,ADCU
 SG_ RR_ElevationSNR_066 : 60|7@0+ (0.5,0) [0|63.5] "dB"  LR,ADCU
 SG_ RR_ElevationSNR_067 : 140|7@0+ (0.5,0) [0|63.5] "dB"  LR,ADCU
 SG_ RR_ElevationSNR_068 : 220|7@0+ (0.5,0) [0|63.5] "dB"  LR,ADCU
 SG_ RR_ElevationSNR_069 : 300|7@0+ (0.5,0) [0|63.5] "dB"  LR,ADCU
 SG_ RR_ElevationSNR_070 : 380|7@0+ (0.5,0) [0|63.5] "dB"  LR,ADCU
 SG_ RR_ElevationSNR_071 : 460|7@0+ (0.5,0) [0|63.5] "dB"  LR,ADCU
 SG_ RR_Range_066 : 7|12@0+ (0.0625,0) [0|255.9375] "m"  LR,ADCU
 SG_ RR_Range_067 : 87|12@0+ (0.0625,0) [0|255.9375] "m"  LR,ADCU
 SG_ RR_Range_068 : 167|12@0+ (0.0625,0) [0|255.9375] "m"  LR,ADCU
 SG_ RR_Range_069 : 247|12@0+ (0.0625,0) [0|255.9375] "m"  LR,ADCU
 SG_ RR_Range_070 : 327|12@0+ (0.0625,0) [0|255.9375] "m"  LR,ADCU
 SG_ RR_Range_071 : 407|12@0+ (0.0625,0) [0|255.9375] "m"  LR,ADCU
 SG_ RR_RCS_066 : 16|9@0+ (0.2,-51.1) [-51.1|51.1] "dBsm"  LR,ADCU
 SG_ RR_RCS_067 : 96|9@0+ (0.2,-51.1) [-51.1|51.1] "dBsm"  LR,ADCU
 SG_ RR_RCS_068 : 176|9@0+ (0.2,-51.1) [-51.1|51.1] "dBsm"  LR,ADCU
 SG_ RR_RCS_069 : 256|9@0+ (0.2,-51.1) [-51.1|51.1] "dBsm"  LR,ADCU
 SG_ RR_RCS_070 : 336|9@0+ (0.2,-51.1) [-51.1|51.1] "dBsm"  LR,ADCU
 SG_ RR_RCS_071 : 416|9@0+ (0.2,-51.1) [-51.1|51.1] "dBsm"  LR,ADCU
 SG_ RR_RDI_066_071_AliveCounter : 499|4@0+ (1,0) [0|15] ""  LR,ADCU
 SG_ RR_RDI_066_071_CheckSum : 511|8@0+ (1,0) [0|255] ""  LR,ADCU
 SG_ RR_Status_066 : 79|8@0+ (1,0) [0|255] ""  ADCU
 SG_ RR_Status_067 : 159|8@0+ (1,0) [0|255] ""  ADCU
 SG_ RR_Status_068 : 239|8@0+ (1,0) [0|255] ""  ADCU
 SG_ RR_Status_069 : 319|8@0+ (1,0) [0|255] ""  ADCU
 SG_ RR_Status_070 : 399|8@0+ (1,0) [0|255] ""  ADCU
 SG_ RR_Status_071 : 479|8@0+ (1,0) [0|255] ""  ADCU
 SG_ RR_Tbd_066 : 69|6@0+ (1,0) [0|63] ""  ADCU
 SG_ RR_Tbd_067 : 149|6@0+ (1,0) [0|63] ""  ADCU
 SG_ RR_Tbd_068 : 229|6@0+ (1,0) [0|63] ""  ADCU
 SG_ RR_Tbd_069 : 309|6@0+ (1,0) [0|63] ""  ADCU
 SG_ RR_Tbd_070 : 389|6@0+ (1,0) [0|63] ""  ADCU
 SG_ RR_Tbd_071 : 469|6@0+ (1,0) [0|63] ""  ADCU
 SG_ RR_Velocity_066 : 11|11@0+ (0.05,-60) [-60|42.35] "m/s"  LR,ADCU
 SG_ RR_Velocity_067 : 91|11@0+ (0.05,-60) [-60|42.35] "m/s"  LR,ADCU
 SG_ RR_Velocity_068 : 171|11@0+ (0.05,-60) [-60|42.35] "m/s"  LR,ADCU
 SG_ RR_Velocity_069 : 251|11@0+ (0.05,-60) [-60|42.35] "m/s"  LR,ADCU
 SG_ RR_Velocity_070 : 331|11@0+ (0.05,-60) [-60|42.35] "m/s"  LR,ADCU
 SG_ RR_Velocity_071 : 411|11@0+ (0.05,-60) [-60|42.35] "m/s"  LR,ADCU

BO_ 317 RR_RDI_072_077: 64 RR
 SG_ RR_AzimuthAng_072 : 39|11@0+ (0.1,-90) [-90|114.7] "deg"  LR,ADCU
 SG_ RR_AzimuthAng_073 : 119|11@0+ (0.1,-90) [-90|114.7] "deg"  LR,ADCU
 SG_ RR_AzimuthAng_074 : 199|11@0+ (0.1,-90) [-90|114.7] "deg"  LR,ADCU
 SG_ RR_AzimuthAng_075 : 279|11@0+ (0.1,-90) [-90|114.7] "deg"  LR,ADCU
 SG_ RR_AzimuthAng_076 : 359|11@0+ (0.1,-90) [-90|114.7] "deg"  LR,ADCU
 SG_ RR_AzimuthAng_077 : 439|11@0+ (0.1,-90) [-90|114.7] "deg"  LR,ADCU
 SG_ RR_AzimuthSNR_072 : 51|7@0+ (0.5,0) [0|63.5] "dB"  LR,ADCU
 SG_ RR_AzimuthSNR_073 : 131|7@0+ (0.5,0) [0|63.5] "dB"  LR,ADCU
 SG_ RR_AzimuthSNR_074 : 211|7@0+ (0.5,0) [0|63.5] "dB"  LR,ADCU
 SG_ RR_AzimuthSNR_075 : 291|7@0+ (0.5,0) [0|63.5] "dB"  LR,ADCU
 SG_ RR_AzimuthSNR_076 : 371|7@0+ (0.5,0) [0|63.5] "dB"  LR,ADCU
 SG_ RR_AzimuthSNR_077 : 451|7@0+ (0.5,0) [0|63.5] "dB"  LR,ADCU
 SG_ RR_ElevationAng_072 : 44|9@0+ (0.1,-25) [-25|26.1] "deg"  LR,ADCU
 SG_ RR_ElevationAng_073 : 124|9@0+ (0.1,-25) [-25|26.1] "deg"  LR,ADCU
 SG_ RR_ElevationAng_074 : 204|9@0+ (0.1,-25) [-25|26.1] "deg"  LR,ADCU
 SG_ RR_ElevationAng_075 : 284|9@0+ (0.1,-25) [-25|26.1] "deg"  LR,ADCU
 SG_ RR_ElevationAng_076 : 364|9@0+ (0.1,-25) [-25|26.1] "deg"  LR,ADCU
 SG_ RR_ElevationAng_077 : 444|9@0+ (0.1,-25) [-25|26.1] "deg"  LR,ADCU
 SG_ RR_ElevationSNR_072 : 60|7@0+ (0.5,0) [0|63.5] "dB"  LR,ADCU
 SG_ RR_ElevationSNR_073 : 140|7@0+ (0.5,0) [0|63.5] "dB"  LR,ADCU
 SG_ RR_ElevationSNR_074 : 220|7@0+ (0.5,0) [0|63.5] "dB"  LR,ADCU
 SG_ RR_ElevationSNR_075 : 300|7@0+ (0.5,0) [0|63.5] "dB"  LR,ADCU
 SG_ RR_ElevationSNR_076 : 380|7@0+ (0.5,0) [0|63.5] "dB"  LR,ADCU
 SG_ RR_ElevationSNR_077 : 460|7@0+ (0.5,0) [0|63.5] "dB"  LR,ADCU
 SG_ RR_Range_072 : 7|12@0+ (0.0625,0) [0|255.9375] "m"  LR,ADCU
 SG_ RR_Range_073 : 87|12@0+ (0.0625,0) [0|255.9375] "m"  LR,ADCU
 SG_ RR_Range_074 : 167|12@0+ (0.0625,0) [0|255.9375] "m"  LR,ADCU
 SG_ RR_Range_075 : 247|12@0+ (0.0625,0) [0|255.9375] "m"  LR,ADCU
 SG_ RR_Range_076 : 327|12@0+ (0.0625,0) [0|255.9375] "m"  LR,ADCU
 SG_ RR_Range_077 : 407|12@0+ (0.0625,0) [0|255.9375] "m"  LR,ADCU
 SG_ RR_RCS_072 : 16|9@0+ (0.2,-51.1) [-51.1|51.1] "dBsm"  LR,ADCU
 SG_ RR_RCS_073 : 96|9@0+ (0.2,-51.1) [-51.1|51.1] "dBsm"  LR,ADCU
 SG_ RR_RCS_074 : 176|9@0+ (0.2,-51.1) [-51.1|51.1] "dBsm"  LR,ADCU
 SG_ RR_RCS_075 : 256|9@0+ (0.2,-51.1) [-51.1|51.1] "dBsm"  LR,ADCU
 SG_ RR_RCS_076 : 336|9@0+ (0.2,-51.1) [-51.1|51.1] "dBsm"  LR,ADCU
 SG_ RR_RCS_077 : 416|9@0+ (0.2,-51.1) [-51.1|51.1] "dBsm"  LR,ADCU
 SG_ RR_RDI_072_077_AliveCounter : 499|4@0+ (1,0) [0|15] ""  LR,ADCU
 SG_ RR_RDI_072_077_CheckSum : 511|8@0+ (1,0) [0|255] ""  LR,ADCU
 SG_ RR_Status_072 : 79|8@0+ (1,0) [0|255] ""  ADCU
 SG_ RR_Status_073 : 159|8@0+ (1,0) [0|255] ""  ADCU
 SG_ RR_Status_074 : 239|8@0+ (1,0) [0|255] ""  ADCU
 SG_ RR_Status_075 : 319|8@0+ (1,0) [0|255] ""  ADCU
 SG_ RR_Status_076 : 399|8@0+ (1,0) [0|255] ""  ADCU
 SG_ RR_Status_077 : 479|8@0+ (1,0) [0|255] ""  ADCU
 SG_ RR_Tbd_072 : 69|6@0+ (1,0) [0|63] ""  ADCU
 SG_ RR_Tbd_073 : 149|6@0+ (1,0) [0|63] ""  ADCU
 SG_ RR_Tbd_074 : 229|6@0+ (1,0) [0|63] ""  ADCU
 SG_ RR_Tbd_075 : 309|6@0+ (1,0) [0|63] ""  ADCU
 SG_ RR_Tbd_076 : 389|6@0+ (1,0) [0|63] ""  ADCU
 SG_ RR_Tbd_077 : 469|6@0+ (1,0) [0|63] ""  ADCU
 SG_ RR_Velocity_072 : 11|11@0+ (0.05,-60) [-60|42.35] "m/s"  LR,ADCU
 SG_ RR_Velocity_073 : 91|11@0+ (0.05,-60) [-60|42.35] "m/s"  LR,ADCU
 SG_ RR_Velocity_074 : 171|11@0+ (0.05,-60) [-60|42.35] "m/s"  LR,ADCU
 SG_ RR_Velocity_075 : 251|11@0+ (0.05,-60) [-60|42.35] "m/s"  LR,ADCU
 SG_ RR_Velocity_076 : 331|11@0+ (0.05,-60) [-60|42.35] "m/s"  LR,ADCU
 SG_ RR_Velocity_077 : 411|11@0+ (0.05,-60) [-60|42.35] "m/s"  LR,ADCU

BO_ 318 RR_RDI_078_083: 64 RR
 SG_ RR_AzimuthAng_078 : 39|11@0+ (0.1,-90) [-90|114.7] "deg"  LR,ADCU
 SG_ RR_AzimuthAng_079 : 119|11@0+ (0.1,-90) [-90|114.7] "deg"  LR,ADCU
 SG_ RR_AzimuthAng_080 : 199|11@0+ (0.1,-90) [-90|114.7] "deg"  LR,ADCU
 SG_ RR_AzimuthAng_081 : 279|11@0+ (0.1,-90) [-90|114.7] "deg"  LR,ADCU
 SG_ RR_AzimuthAng_082 : 359|11@0+ (0.1,-90) [-90|114.7] "deg"  LR,ADCU
 SG_ RR_AzimuthAng_083 : 439|11@0+ (0.1,-90) [-90|114.7] "deg"  LR,ADCU
 SG_ RR_AzimuthSNR_078 : 51|7@0+ (0.5,0) [0|63.5] "dB"  LR,ADCU
 SG_ RR_AzimuthSNR_079 : 131|7@0+ (0.5,0) [0|63.5] "dB"  LR,ADCU
 SG_ RR_AzimuthSNR_080 : 211|7@0+ (0.5,0) [0|63.5] "dB"  LR,ADCU
 SG_ RR_AzimuthSNR_081 : 291|7@0+ (0.5,0) [0|63.5] "dB"  LR,ADCU
 SG_ RR_AzimuthSNR_082 : 371|7@0+ (0.5,0) [0|63.5] "dB"  LR,ADCU
 SG_ RR_AzimuthSNR_083 : 451|7@0+ (0.5,0) [0|63.5] "dB"  LR,ADCU
 SG_ RR_ElevationAng_078 : 44|9@0+ (0.1,-25) [-25|26.1] "deg"  LR,ADCU
 SG_ RR_ElevationAng_079 : 124|9@0+ (0.1,-25) [-25|26.1] "deg"  LR,ADCU
 SG_ RR_ElevationAng_080 : 204|9@0+ (0.1,-25) [-25|26.1] "deg"  LR,ADCU
 SG_ RR_ElevationAng_081 : 284|9@0+ (0.1,-25) [-25|26.1] "deg"  LR,ADCU
 SG_ RR_ElevationAng_082 : 364|9@0+ (0.1,-25) [-25|26.1] "deg"  LR,ADCU
 SG_ RR_ElevationAng_083 : 444|9@0+ (0.1,-25) [-25|26.1] "deg"  LR,ADCU
 SG_ RR_ElevationSNR_078 : 60|7@0+ (0.5,0) [0|63.5] "dB"  LR,ADCU
 SG_ RR_ElevationSNR_079 : 140|7@0+ (0.5,0) [0|63.5] "dB"  LR,ADCU
 SG_ RR_ElevationSNR_080 : 220|7@0+ (0.5,0) [0|63.5] "dB"  LR,ADCU
 SG_ RR_ElevationSNR_081 : 300|7@0+ (0.5,0) [0|63.5] "dB"  LR,ADCU
 SG_ RR_ElevationSNR_082 : 380|7@0+ (0.5,0) [0|63.5] "dB"  LR,ADCU
 SG_ RR_ElevationSNR_083 : 460|7@0+ (0.5,0) [0|63.5] "dB"  LR,ADCU
 SG_ RR_Range_078 : 7|12@0+ (0.0625,0) [0|255.9375] "m"  LR,ADCU
 SG_ RR_Range_079 : 87|12@0+ (0.0625,0) [0|255.9375] "m"  LR,ADCU
 SG_ RR_Range_080 : 167|12@0+ (0.0625,0) [0|255.9375] "m"  LR,ADCU
 SG_ RR_Range_081 : 247|12@0+ (0.0625,0) [0|255.9375] "m"  LR,ADCU
 SG_ RR_Range_082 : 327|12@0+ (0.0625,0) [0|255.9375] "m"  LR,ADCU
 SG_ RR_Range_083 : 407|12@0+ (0.0625,0) [0|255.9375] "m"  LR,ADCU
 SG_ RR_RCS_078 : 16|9@0+ (0.2,-51.1) [-51.1|51.1] "dBsm"  LR,ADCU
 SG_ RR_RCS_079 : 96|9@0+ (0.2,-51.1) [-51.1|51.1] "dBsm"  LR,ADCU
 SG_ RR_RCS_080 : 176|9@0+ (0.2,-51.1) [-51.1|51.1] "dBsm"  LR,ADCU
 SG_ RR_RCS_081 : 256|9@0+ (0.2,-51.1) [-51.1|51.1] "dBsm"  LR,ADCU
 SG_ RR_RCS_082 : 336|9@0+ (0.2,-51.1) [-51.1|51.1] "dBsm"  LR,ADCU
 SG_ RR_RCS_083 : 416|9@0+ (0.2,-51.1) [-51.1|51.1] "dBsm"  LR,ADCU
 SG_ RR_RDI_078_083_AliveCounter : 499|4@0+ (1,0) [0|15] ""  LR,ADCU
 SG_ RR_RDI_078_083_CheckSum : 511|8@0+ (1,0) [0|255] ""  LR,ADCU
 SG_ RR_Status_078 : 79|8@0+ (1,0) [0|255] ""  ADCU
 SG_ RR_Status_079 : 159|8@0+ (1,0) [0|255] ""  ADCU
 SG_ RR_Status_080 : 239|8@0+ (1,0) [0|255] ""  ADCU
 SG_ RR_Status_081 : 319|8@0+ (1,0) [0|255] ""  ADCU
 SG_ RR_Status_082 : 399|8@0+ (1,0) [0|255] ""  ADCU
 SG_ RR_Status_083 : 479|8@0+ (1,0) [0|255] ""  ADCU
 SG_ RR_Tbd_078 : 69|6@0+ (1,0) [0|63] ""  ADCU
 SG_ RR_Tbd_079 : 149|6@0+ (1,0) [0|63] ""  ADCU
 SG_ RR_Tbd_080 : 229|6@0+ (1,0) [0|63] ""  ADCU
 SG_ RR_Tbd_081 : 309|6@0+ (1,0) [0|63] ""  ADCU
 SG_ RR_Tbd_082 : 389|6@0+ (1,0) [0|63] ""  ADCU
 SG_ RR_Tbd_083 : 469|6@0+ (1,0) [0|63] ""  ADCU
 SG_ RR_Velocity_078 : 11|11@0+ (0.05,-60) [-60|42.35] "m/s"  LR,ADCU
 SG_ RR_Velocity_079 : 91|11@0+ (0.05,-60) [-60|42.35] "m/s"  LR,ADCU
 SG_ RR_Velocity_080 : 171|11@0+ (0.05,-60) [-60|42.35] "m/s"  LR,ADCU
 SG_ RR_Velocity_081 : 251|11@0+ (0.05,-60) [-60|42.35] "m/s"  LR,ADCU
 SG_ RR_Velocity_082 : 331|11@0+ (0.05,-60) [-60|42.35] "m/s"  LR,ADCU
 SG_ RR_Velocity_083 : 411|11@0+ (0.05,-60) [-60|42.35] "m/s"  LR,ADCU

BO_ 319 RR_RDI_084_089: 64 RR
 SG_ RR_AzimuthAng_084 : 39|11@0+ (0.1,-90) [-90|114.7] "deg"  LR,ADCU
 SG_ RR_AzimuthAng_085 : 119|11@0+ (0.1,-90) [-90|114.7] "deg"  LR,ADCU
 SG_ RR_AzimuthAng_086 : 199|11@0+ (0.1,-90) [-90|114.7] "deg"  LR,ADCU
 SG_ RR_AzimuthAng_087 : 279|11@0+ (0.1,-90) [-90|114.7] "deg"  LR,ADCU
 SG_ RR_AzimuthAng_088 : 359|11@0+ (0.1,-90) [-90|114.7] "deg"  LR,ADCU
 SG_ RR_AzimuthAng_089 : 439|11@0+ (0.1,-90) [-90|114.7] "deg"  LR,ADCU
 SG_ RR_AzimuthSNR_084 : 51|7@0+ (0.5,0) [0|63.5] "dB"  LR,ADCU
 SG_ RR_AzimuthSNR_085 : 131|7@0+ (0.5,0) [0|63.5] "dB"  LR,ADCU
 SG_ RR_AzimuthSNR_086 : 211|7@0+ (0.5,0) [0|63.5] "dB"  LR,ADCU
 SG_ RR_AzimuthSNR_087 : 291|7@0+ (0.5,0) [0|63.5] "dB"  LR,ADCU
 SG_ RR_AzimuthSNR_088 : 371|7@0+ (0.5,0) [0|63.5] "dB"  LR,ADCU
 SG_ RR_AzimuthSNR_089 : 451|7@0+ (0.5,0) [0|63.5] "dB"  LR,ADCU
 SG_ RR_ElevationAng_084 : 44|9@0+ (0.1,-25) [-25|26.1] "deg"  LR,ADCU
 SG_ RR_ElevationAng_085 : 124|9@0+ (0.1,-25) [-25|26.1] "deg"  LR,ADCU
 SG_ RR_ElevationAng_086 : 204|9@0+ (0.1,-25) [-25|26.1] "deg"  LR,ADCU
 SG_ RR_ElevationAng_087 : 284|9@0+ (0.1,-25) [-25|26.1] "deg"  LR,ADCU
 SG_ RR_ElevationAng_088 : 364|9@0+ (0.1,-25) [-25|26.1] "deg"  LR,ADCU
 SG_ RR_ElevationAng_089 : 444|9@0+ (0.1,-25) [-25|26.1] "deg"  LR,ADCU
 SG_ RR_ElevationSNR_084 : 60|7@0+ (0.5,0) [0|63.5] "dB"  LR,ADCU
 SG_ RR_ElevationSNR_085 : 140|7@0+ (0.5,0) [0|63.5] "dB"  LR,ADCU
 SG_ RR_ElevationSNR_086 : 220|7@0+ (0.5,0) [0|63.5] "dB"  LR,ADCU
 SG_ RR_ElevationSNR_087 : 300|7@0+ (0.5,0) [0|63.5] "dB"  LR,ADCU
 SG_ RR_ElevationSNR_088 : 380|7@0+ (0.5,0) [0|63.5] "dB"  LR,ADCU
 SG_ RR_ElevationSNR_089 : 460|7@0+ (0.5,0) [0|63.5] "dB"  LR,ADCU
 SG_ RR_Range_084 : 7|12@0+ (0.0625,0) [0|255.9375] "m"  LR,ADCU
 SG_ RR_Range_085 : 87|12@0+ (0.0625,0) [0|255.9375] "m"  LR,ADCU
 SG_ RR_Range_086 : 167|12@0+ (0.0625,0) [0|255.9375] "m"  LR,ADCU
 SG_ RR_Range_087 : 247|12@0+ (0.0625,0) [0|255.9375] "m"  LR,ADCU
 SG_ RR_Range_088 : 327|12@0+ (0.0625,0) [0|255.9375] "m"  LR,ADCU
 SG_ RR_Range_089 : 407|12@0+ (0.0625,0) [0|255.9375] "m"  LR,ADCU
 SG_ RR_RCS_084 : 16|9@0+ (0.2,-51.1) [-51.1|51.1] "dBsm"  LR,ADCU
 SG_ RR_RCS_085 : 96|9@0+ (0.2,-51.1) [-51.1|51.1] "dBsm"  LR,ADCU
 SG_ RR_RCS_086 : 176|9@0+ (0.2,-51.1) [-51.1|51.1] "dBsm"  LR,ADCU
 SG_ RR_RCS_087 : 256|9@0+ (0.2,-51.1) [-51.1|51.1] "dBsm"  LR,ADCU
 SG_ RR_RCS_088 : 336|9@0+ (0.2,-51.1) [-51.1|51.1] "dBsm"  LR,ADCU
 SG_ RR_RCS_089 : 416|9@0+ (0.2,-51.1) [-51.1|51.1] "dBsm"  LR,ADCU
 SG_ RR_RDI_084_089_AliveCounter : 499|4@0+ (1,0) [0|15] ""  LR,ADCU
 SG_ RR_RDI_084_089_CheckSum : 511|8@0+ (1,0) [0|255] ""  LR,ADCU
 SG_ RR_Status_084 : 79|8@0+ (1,0) [0|255] ""  ADCU
 SG_ RR_Status_085 : 159|8@0+ (1,0) [0|255] ""  ADCU
 SG_ RR_Status_086 : 239|8@0+ (1,0) [0|255] ""  ADCU
 SG_ RR_Status_087 : 319|8@0+ (1,0) [0|255] ""  ADCU
 SG_ RR_Status_088 : 399|8@0+ (1,0) [0|255] ""  ADCU
 SG_ RR_Status_089 : 479|8@0+ (1,0) [0|255] ""  ADCU
 SG_ RR_Tbd_084 : 69|6@0+ (1,0) [0|63] ""  ADCU
 SG_ RR_Tbd_085 : 149|6@0+ (1,0) [0|63] ""  ADCU
 SG_ RR_Tbd_086 : 229|6@0+ (1,0) [0|63] ""  ADCU
 SG_ RR_Tbd_087 : 309|6@0+ (1,0) [0|63] ""  ADCU
 SG_ RR_Tbd_088 : 389|6@0+ (1,0) [0|63] ""  ADCU
 SG_ RR_Tbd_089 : 469|6@0+ (1,0) [0|63] ""  ADCU
 SG_ RR_Velocity_084 : 11|11@0+ (0.05,-60) [-60|42.35] "m/s"  LR,ADCU
 SG_ RR_Velocity_085 : 91|11@0+ (0.05,-60) [-60|42.35] "m/s"  LR,ADCU
 SG_ RR_Velocity_086 : 171|11@0+ (0.05,-60) [-60|42.35] "m/s"  LR,ADCU
 SG_ RR_Velocity_087 : 251|11@0+ (0.05,-60) [-60|42.35] "m/s"  LR,ADCU
 SG_ RR_Velocity_088 : 331|11@0+ (0.05,-60) [-60|42.35] "m/s"  LR,ADCU
 SG_ RR_Velocity_089 : 411|11@0+ (0.05,-60) [-60|42.35] "m/s"  LR,ADCU

BO_ 320 RR_RDI_090_095: 64 RR
 SG_ RR_AzimuthAng_090 : 39|11@0+ (0.1,-90) [-90|114.7] "deg"  LR,ADCU
 SG_ RR_AzimuthAng_091 : 119|11@0+ (0.1,-90) [-90|114.7] "deg"  LR,ADCU
 SG_ RR_AzimuthAng_092 : 199|11@0+ (0.1,-90) [-90|114.7] "deg"  LR,ADCU
 SG_ RR_AzimuthAng_093 : 279|11@0+ (0.1,-90) [-90|114.7] "deg"  LR,ADCU
 SG_ RR_AzimuthAng_094 : 359|11@0+ (0.1,-90) [-90|114.7] "deg"  LR,ADCU
 SG_ RR_AzimuthAng_095 : 439|11@0+ (0.1,-90) [-90|114.7] "deg"  LR,ADCU
 SG_ RR_AzimuthSNR_090 : 51|7@0+ (0.5,0) [0|63.5] "dB"  LR,ADCU
 SG_ RR_AzimuthSNR_091 : 131|7@0+ (0.5,0) [0|63.5] "dB"  LR,ADCU
 SG_ RR_AzimuthSNR_092 : 211|7@0+ (0.5,0) [0|63.5] "dB"  LR,ADCU
 SG_ RR_AzimuthSNR_093 : 291|7@0+ (0.5,0) [0|63.5] "dB"  LR,ADCU
 SG_ RR_AzimuthSNR_094 : 371|7@0+ (0.5,0) [0|63.5] "dB"  LR,ADCU
 SG_ RR_AzimuthSNR_095 : 451|7@0+ (0.5,0) [0|63.5] "dB"  LR,ADCU
 SG_ RR_ElevationAng_090 : 44|9@0+ (0.1,-25) [-25|26.1] "deg"  LR,ADCU
 SG_ RR_ElevationAng_091 : 124|9@0+ (0.1,-25) [-25|26.1] "deg"  LR,ADCU
 SG_ RR_ElevationAng_092 : 204|9@0+ (0.1,-25) [-25|26.1] "deg"  LR,ADCU
 SG_ RR_ElevationAng_093 : 284|9@0+ (0.1,-25) [-25|26.1] "deg"  LR,ADCU
 SG_ RR_ElevationAng_094 : 364|9@0+ (0.1,-25) [-25|26.1] "deg"  LR,ADCU
 SG_ RR_ElevationAng_095 : 444|9@0+ (0.1,-25) [-25|26.1] "deg"  LR,ADCU
 SG_ RR_ElevationSNR_090 : 60|7@0+ (0.5,0) [0|63.5] "dB"  LR,ADCU
 SG_ RR_ElevationSNR_091 : 140|7@0+ (0.5,0) [0|63.5] "dB"  LR,ADCU
 SG_ RR_ElevationSNR_092 : 220|7@0+ (0.5,0) [0|63.5] "dB"  LR,ADCU
 SG_ RR_ElevationSNR_093 : 300|7@0+ (0.5,0) [0|63.5] "dB"  LR,ADCU
 SG_ RR_ElevationSNR_094 : 380|7@0+ (0.5,0) [0|63.5] "dB"  LR,ADCU
 SG_ RR_ElevationSNR_095 : 460|7@0+ (0.5,0) [0|63.5] "dB"  LR,ADCU
 SG_ RR_Range_090 : 7|12@0+ (0.0625,0) [0|255.9375] "m"  LR,ADCU
 SG_ RR_Range_091 : 87|12@0+ (0.0625,0) [0|255.9375] "m"  LR,ADCU
 SG_ RR_Range_092 : 167|12@0+ (0.0625,0) [0|255.9375] "m"  LR,ADCU
 SG_ RR_Range_093 : 247|12@0+ (0.0625,0) [0|255.9375] "m"  LR,ADCU
 SG_ RR_Range_094 : 327|12@0+ (0.0625,0) [0|255.9375] "m"  LR,ADCU
 SG_ RR_Range_095 : 407|12@0+ (0.0625,0) [0|255.9375] "m"  LR,ADCU
 SG_ RR_RCS_090 : 16|9@0+ (0.2,-51.1) [-51.1|51.1] "dBsm"  LR,ADCU
 SG_ RR_RCS_091 : 96|9@0+ (0.2,-51.1) [-51.1|51.1] "dBsm"  LR,ADCU
 SG_ RR_RCS_092 : 176|9@0+ (0.2,-51.1) [-51.1|51.1] "dBsm"  LR,ADCU
 SG_ RR_RCS_093 : 256|9@0+ (0.2,-51.1) [-51.1|51.1] "dBsm"  LR,ADCU
 SG_ RR_RCS_094 : 336|9@0+ (0.2,-51.1) [-51.1|51.1] "dBsm"  LR,ADCU
 SG_ RR_RCS_095 : 416|9@0+ (0.2,-51.1) [-51.1|51.1] "dBsm"  LR,ADCU
 SG_ RR_RDI_090_095_AliveCounter : 499|4@0+ (1,0) [0|15] ""  LR,ADCU
 SG_ RR_RDI_090_095_CheckSum : 511|8@0+ (1,0) [0|255] ""  LR,ADCU
 SG_ RR_Status_090 : 79|8@0+ (1,0) [0|255] ""  ADCU
 SG_ RR_Status_091 : 159|8@0+ (1,0) [0|255] ""  ADCU
 SG_ RR_Status_092 : 239|8@0+ (1,0) [0|255] ""  ADCU
 SG_ RR_Status_093 : 319|8@0+ (1,0) [0|255] ""  ADCU
 SG_ RR_Status_094 : 399|8@0+ (1,0) [0|255] ""  ADCU
 SG_ RR_Status_095 : 479|8@0+ (1,0) [0|255] ""  ADCU
 SG_ RR_Tbd_090 : 69|6@0+ (1,0) [0|63] ""  ADCU
 SG_ RR_Tbd_091 : 149|6@0+ (1,0) [0|63] ""  ADCU
 SG_ RR_Tbd_092 : 229|6@0+ (1,0) [0|63] ""  ADCU
 SG_ RR_Tbd_093 : 309|6@0+ (1,0) [0|63] ""  ADCU
 SG_ RR_Tbd_094 : 389|6@0+ (1,0) [0|63] ""  ADCU
 SG_ RR_Tbd_095 : 469|6@0+ (1,0) [0|63] ""  ADCU
 SG_ RR_Velocity_090 : 11|11@0+ (0.05,-60) [-60|42.35] "m/s"  LR,ADCU
 SG_ RR_Velocity_091 : 91|11@0+ (0.05,-60) [-60|42.35] "m/s"  LR,ADCU
 SG_ RR_Velocity_092 : 171|11@0+ (0.05,-60) [-60|42.35] "m/s"  LR,ADCU
 SG_ RR_Velocity_093 : 251|11@0+ (0.05,-60) [-60|42.35] "m/s"  LR,ADCU
 SG_ RR_Velocity_094 : 331|11@0+ (0.05,-60) [-60|42.35] "m/s"  LR,ADCU
 SG_ RR_Velocity_095 : 411|11@0+ (0.05,-60) [-60|42.35] "m/s"  LR,ADCU

BO_ 321 RR_RDI_096_101: 64 RR
 SG_ RR_AzimuthAng_096 : 39|11@0+ (0.1,-90) [-90|114.7] "deg"  LR,ADCU
 SG_ RR_AzimuthAng_097 : 119|11@0+ (0.1,-90) [-90|114.7] "deg"  LR,ADCU
 SG_ RR_AzimuthAng_098 : 199|11@0+ (0.1,-90) [-90|114.7] "deg"  LR,ADCU
 SG_ RR_AzimuthAng_099 : 279|11@0+ (0.1,-90) [-90|114.7] "deg"  LR,ADCU
 SG_ RR_AzimuthAng_100 : 359|11@0+ (0.1,-90) [-90|114.7] "deg"  LR,ADCU
 SG_ RR_AzimuthAng_101 : 439|11@0+ (0.1,-90) [-90|114.7] "deg"  LR,ADCU
 SG_ RR_AzimuthSNR_096 : 51|7@0+ (0.5,0) [0|63.5] "dB"  LR,ADCU
 SG_ RR_AzimuthSNR_097 : 131|7@0+ (0.5,0) [0|63.5] "dB"  LR,ADCU
 SG_ RR_AzimuthSNR_098 : 211|7@0+ (0.5,0) [0|63.5] "dB"  LR,ADCU
 SG_ RR_AzimuthSNR_099 : 291|7@0+ (0.5,0) [0|63.5] "dB"  LR,ADCU
 SG_ RR_AzimuthSNR_100 : 371|7@0+ (0.5,0) [0|63.5] "dB"  LR,ADCU
 SG_ RR_AzimuthSNR_101 : 451|7@0+ (0.5,0) [0|63.5] "dB"  LR,ADCU
 SG_ RR_ElevationAng_096 : 44|9@0+ (0.1,-25) [-25|26.1] "deg"  LR,ADCU
 SG_ RR_ElevationAng_097 : 124|9@0+ (0.1,-25) [-25|26.1] "deg"  LR,ADCU
 SG_ RR_ElevationAng_098 : 204|9@0+ (0.1,-25) [-25|26.1] "deg"  LR,ADCU
 SG_ RR_ElevationAng_099 : 284|9@0+ (0.1,-25) [-25|26.1] "deg"  LR,ADCU
 SG_ RR_ElevationAng_100 : 364|9@0+ (0.1,-25) [-25|26.1] "deg"  LR,ADCU
 SG_ RR_ElevationAng_101 : 444|9@0+ (0.1,-25) [-25|26.1] "deg"  LR,ADCU
 SG_ RR_ElevationSNR_096 : 60|7@0+ (0.5,0) [0|63.5] "dB"  LR,ADCU
 SG_ RR_ElevationSNR_097 : 140|7@0+ (0.5,0) [0|63.5] "dB"  LR,ADCU
 SG_ RR_ElevationSNR_098 : 220|7@0+ (0.5,0) [0|63.5] "dB"  LR,ADCU
 SG_ RR_ElevationSNR_099 : 300|7@0+ (0.5,0) [0|63.5] "dB"  LR,ADCU
 SG_ RR_ElevationSNR_100 : 380|7@0+ (0.5,0) [0|63.5] "dB"  LR,ADCU
 SG_ RR_ElevationSNR_101 : 460|7@0+ (0.5,0) [0|63.5] "dB"  LR,ADCU
 SG_ RR_Range_096 : 7|12@0+ (0.0625,0) [0|255.9375] "m"  LR,ADCU
 SG_ RR_Range_097 : 87|12@0+ (0.0625,0) [0|255.9375] "m"  LR,ADCU
 SG_ RR_Range_098 : 167|12@0+ (0.0625,0) [0|255.9375] "m"  LR,ADCU
 SG_ RR_Range_099 : 247|12@0+ (0.0625,0) [0|255.9375] "m"  LR,ADCU
 SG_ RR_Range_100 : 327|12@0+ (0.0625,0) [0|255.9375] "m"  LR,ADCU
 SG_ RR_Range_101 : 407|12@0+ (0.0625,0) [0|255.9375] "m"  LR,ADCU
 SG_ RR_RCS_096 : 16|9@0+ (0.2,-51.1) [-51.1|51.1] "dBsm"  LR,ADCU
 SG_ RR_RCS_097 : 96|9@0+ (0.2,-51.1) [-51.1|51.1] "dBsm"  LR,ADCU
 SG_ RR_RCS_098 : 176|9@0+ (0.2,-51.1) [-51.1|51.1] "dBsm"  LR,ADCU
 SG_ RR_RCS_099 : 256|9@0+ (0.2,-51.1) [-51.1|51.1] "dBsm"  LR,ADCU
 SG_ RR_RCS_100 : 336|9@0+ (0.2,-51.1) [-51.1|51.1] "dBsm"  LR,ADCU
 SG_ RR_RCS_101 : 416|9@0+ (0.2,-51.1) [-51.1|51.1] "dBsm"  LR,ADCU
 SG_ RR_RDI_096_101_AliveCounter : 499|4@0+ (1,0) [0|15] ""  LR,ADCU
 SG_ RR_RDI_096_101_CheckSum : 511|8@0+ (1,0) [0|255] ""  LR,ADCU
 SG_ RR_Status_096 : 79|8@0+ (1,0) [0|255] ""  ADCU
 SG_ RR_Status_097 : 159|8@0+ (1,0) [0|255] ""  ADCU
 SG_ RR_Status_098 : 239|8@0+ (1,0) [0|255] ""  ADCU
 SG_ RR_Status_099 : 319|8@0+ (1,0) [0|255] ""  ADCU
 SG_ RR_Status_100 : 399|8@0+ (1,0) [0|255] ""  ADCU
 SG_ RR_Status_101 : 479|8@0+ (1,0) [0|255] ""  ADCU
 SG_ RR_Tbd_096 : 69|6@0+ (1,0) [0|63] ""  ADCU
 SG_ RR_Tbd_097 : 149|6@0+ (1,0) [0|63] ""  ADCU
 SG_ RR_Tbd_098 : 229|6@0+ (1,0) [0|63] ""  ADCU
 SG_ RR_Tbd_099 : 309|6@0+ (1,0) [0|63] ""  ADCU
 SG_ RR_Tbd_100 : 389|6@0+ (1,0) [0|63] ""  ADCU
 SG_ RR_Tbd_101 : 469|6@0+ (1,0) [0|63] ""  ADCU
 SG_ RR_Velocity_096 : 11|11@0+ (0.05,-60) [-60|42.35] "m/s"  LR,ADCU
 SG_ RR_Velocity_097 : 91|11@0+ (0.05,-60) [-60|42.35] "m/s"  LR,ADCU
 SG_ RR_Velocity_098 : 171|11@0+ (0.05,-60) [-60|42.35] "m/s"  LR,ADCU
 SG_ RR_Velocity_099 : 251|11@0+ (0.05,-60) [-60|42.35] "m/s"  LR,ADCU
 SG_ RR_Velocity_100 : 331|11@0+ (0.05,-60) [-60|42.35] "m/s"  LR,ADCU
 SG_ RR_Velocity_101 : 411|11@0+ (0.05,-60) [-60|42.35] "m/s"  LR,ADCU

BO_ 322 RR_RDI_102_107: 64 RR
 SG_ RR_AzimuthAng_102 : 39|11@0+ (0.1,-90) [-90|114.7] "deg"  LR,ADCU
 SG_ RR_AzimuthAng_103 : 119|11@0+ (0.1,-90) [-90|114.7] "deg"  LR,ADCU
 SG_ RR_AzimuthAng_104 : 199|11@0+ (0.1,-90) [-90|114.7] "deg"  LR,ADCU
 SG_ RR_AzimuthAng_105 : 279|11@0+ (0.1,-90) [-90|114.7] "deg"  LR,ADCU
 SG_ RR_AzimuthAng_106 : 359|11@0+ (0.1,-90) [-90|114.7] "deg"  LR,ADCU
 SG_ RR_AzimuthAng_107 : 439|11@0+ (0.1,-90) [-90|114.7] "deg"  LR,ADCU
 SG_ RR_AzimuthSNR_102 : 51|7@0+ (0.5,0) [0|63.5] "dB"  LR,ADCU
 SG_ RR_AzimuthSNR_103 : 131|7@0+ (0.5,0) [0|63.5] "dB"  LR,ADCU
 SG_ RR_AzimuthSNR_104 : 211|7@0+ (0.5,0) [0|63.5] "dB"  LR,ADCU
 SG_ RR_AzimuthSNR_105 : 291|7@0+ (0.5,0) [0|63.5] "dB"  LR,ADCU
 SG_ RR_AzimuthSNR_106 : 371|7@0+ (0.5,0) [0|63.5] "dB"  LR,ADCU
 SG_ RR_AzimuthSNR_107 : 451|7@0+ (0.5,0) [0|63.5] "dB"  LR,ADCU
 SG_ RR_ElevationAng_102 : 44|9@0+ (0.1,-25) [-25|26.1] "deg"  LR,ADCU
 SG_ RR_ElevationAng_103 : 124|9@0+ (0.1,-25) [-25|26.1] "deg"  LR,ADCU
 SG_ RR_ElevationAng_104 : 204|9@0+ (0.1,-25) [-25|26.1] "deg"  LR,ADCU
 SG_ RR_ElevationAng_105 : 284|9@0+ (0.1,-25) [-25|26.1] "deg"  LR,ADCU
 SG_ RR_ElevationAng_106 : 364|9@0+ (0.1,-25) [-25|26.1] "deg"  LR,ADCU
 SG_ RR_ElevationAng_107 : 444|9@0+ (0.1,-25) [-25|26.1] "deg"  LR,ADCU
 SG_ RR_ElevationSNR_102 : 60|7@0+ (0.5,0) [0|63.5] "dB"  LR,ADCU
 SG_ RR_ElevationSNR_103 : 140|7@0+ (0.5,0) [0|63.5] "dB"  LR,ADCU
 SG_ RR_ElevationSNR_104 : 220|7@0+ (0.5,0) [0|63.5] "dB"  LR,ADCU
 SG_ RR_ElevationSNR_105 : 300|7@0+ (0.5,0) [0|63.5] "dB"  LR,ADCU
 SG_ RR_ElevationSNR_106 : 380|7@0+ (0.5,0) [0|63.5] "dB"  LR,ADCU
 SG_ RR_ElevationSNR_107 : 460|7@0+ (0.5,0) [0|63.5] "dB"  LR,ADCU
 SG_ RR_Range_102 : 7|12@0+ (0.0625,0) [0|255.9375] "m"  LR,ADCU
 SG_ RR_Range_103 : 87|12@0+ (0.0625,0) [0|255.9375] "m"  LR,ADCU
 SG_ RR_Range_104 : 167|12@0+ (0.0625,0) [0|255.9375] "m"  LR,ADCU
 SG_ RR_Range_105 : 247|12@0+ (0.0625,0) [0|255.9375] "m"  LR,ADCU
 SG_ RR_Range_106 : 327|12@0+ (0.0625,0) [0|255.9375] "m"  LR,ADCU
 SG_ RR_Range_107 : 407|12@0+ (0.0625,0) [0|255.9375] "m"  LR,ADCU
 SG_ RR_RCS_102 : 16|9@0+ (0.2,-51.1) [-51.1|51.1] "dBsm"  LR,ADCU
 SG_ RR_RCS_103 : 96|9@0+ (0.2,-51.1) [-51.1|51.1] "dBsm"  LR,ADCU
 SG_ RR_RCS_104 : 176|9@0+ (0.2,-51.1) [-51.1|51.1] "dBsm"  LR,ADCU
 SG_ RR_RCS_105 : 256|9@0+ (0.2,-51.1) [-51.1|51.1] "dBsm"  LR,ADCU
 SG_ RR_RCS_106 : 336|9@0+ (0.2,-51.1) [-51.1|51.1] "dBsm"  LR,ADCU
 SG_ RR_RCS_107 : 416|9@0+ (0.2,-51.1) [-51.1|51.1] "dBsm"  LR,ADCU
 SG_ RR_RDI_102_107_AliveCounter : 499|4@0+ (1,0) [0|15] ""  LR,ADCU
 SG_ RR_RDI_102_107_CheckSum : 511|8@0+ (1,0) [0|255] ""  LR,ADCU
 SG_ RR_Status_102 : 79|8@0+ (1,0) [0|255] ""  ADCU
 SG_ RR_Status_103 : 159|8@0+ (1,0) [0|255] ""  ADCU
 SG_ RR_Status_104 : 239|8@0+ (1,0) [0|255] ""  ADCU
 SG_ RR_Status_105 : 319|8@0+ (1,0) [0|255] ""  ADCU
 SG_ RR_Status_106 : 399|8@0+ (1,0) [0|255] ""  ADCU
 SG_ RR_Status_107 : 479|8@0+ (1,0) [0|255] ""  ADCU
 SG_ RR_Tbd_102 : 69|6@0+ (1,0) [0|63] ""  ADCU
 SG_ RR_Tbd_103 : 149|6@0+ (1,0) [0|63] ""  ADCU
 SG_ RR_Tbd_104 : 229|6@0+ (1,0) [0|63] ""  ADCU
 SG_ RR_Tbd_105 : 309|6@0+ (1,0) [0|63] ""  ADCU
 SG_ RR_Tbd_106 : 389|6@0+ (1,0) [0|63] ""  ADCU
 SG_ RR_Tbd_107 : 469|6@0+ (1,0) [0|63] ""  ADCU
 SG_ RR_Velocity_102 : 11|11@0+ (0.05,-60) [-60|42.35] "m/s"  LR,ADCU
 SG_ RR_Velocity_103 : 91|11@0+ (0.05,-60) [-60|42.35] "m/s"  LR,ADCU
 SG_ RR_Velocity_104 : 171|11@0+ (0.05,-60) [-60|42.35] "m/s"  LR,ADCU
 SG_ RR_Velocity_105 : 251|11@0+ (0.05,-60) [-60|42.35] "m/s"  LR,ADCU
 SG_ RR_Velocity_106 : 331|11@0+ (0.05,-60) [-60|42.35] "m/s"  LR,ADCU
 SG_ RR_Velocity_107 : 411|11@0+ (0.05,-60) [-60|42.35] "m/s"  LR,ADCU

BO_ 323 RR_RDI_108_113: 64 RR
 SG_ RR_AzimuthAng_108 : 39|11@0+ (0.1,-90) [-90|114.7] "deg"  LR,ADCU
 SG_ RR_AzimuthAng_109 : 119|11@0+ (0.1,-90) [-90|114.7] "deg"  LR,ADCU
 SG_ RR_AzimuthAng_110 : 199|11@0+ (0.1,-90) [-90|114.7] "deg"  LR,ADCU
 SG_ RR_AzimuthAng_111 : 279|11@0+ (0.1,-90) [-90|114.7] "deg"  LR,ADCU
 SG_ RR_AzimuthAng_112 : 359|11@0+ (0.1,-90) [-90|114.7] "deg"  LR,ADCU
 SG_ RR_AzimuthAng_113 : 439|11@0+ (0.1,-90) [-90|114.7] "deg"  LR,ADCU
 SG_ RR_AzimuthSNR_108 : 51|7@0+ (0.5,0) [0|63.5] "dB"  LR,ADCU
 SG_ RR_AzimuthSNR_109 : 131|7@0+ (0.5,0) [0|63.5] "dB"  LR,ADCU
 SG_ RR_AzimuthSNR_110 : 211|7@0+ (0.5,0) [0|63.5] "dB"  LR,ADCU
 SG_ RR_AzimuthSNR_111 : 291|7@0+ (0.5,0) [0|63.5] "dB"  LR,ADCU
 SG_ RR_AzimuthSNR_112 : 371|7@0+ (0.5,0) [0|63.5] "dB"  LR,ADCU
 SG_ RR_AzimuthSNR_113 : 451|7@0+ (0.5,0) [0|63.5] "dB"  LR,ADCU
 SG_ RR_ElevationAng_108 : 44|9@0+ (0.1,-25) [-25|26.1] "deg"  LR,ADCU
 SG_ RR_ElevationAng_109 : 124|9@0+ (0.1,-25) [-25|26.1] "deg"  LR,ADCU
 SG_ RR_ElevationAng_110 : 204|9@0+ (0.1,-25) [-25|26.1] "deg"  LR,ADCU
 SG_ RR_ElevationAng_111 : 284|9@0+ (0.1,-25) [-25|26.1] "deg"  LR,ADCU
 SG_ RR_ElevationAng_112 : 364|9@0+ (0.1,-25) [-25|26.1] "deg"  LR,ADCU
 SG_ RR_ElevationAng_113 : 444|9@0+ (0.1,-25) [-25|26.1] "deg"  LR,ADCU
 SG_ RR_ElevationSNR_108 : 60|7@0+ (0.5,0) [0|63.5] "dB"  LR,ADCU
 SG_ RR_ElevationSNR_109 : 140|7@0+ (0.5,0) [0|63.5] "dB"  LR,ADCU
 SG_ RR_ElevationSNR_110 : 220|7@0+ (0.5,0) [0|63.5] "dB"  LR,ADCU
 SG_ RR_ElevationSNR_111 : 300|7@0+ (0.5,0) [0|63.5] "dB"  LR,ADCU
 SG_ RR_ElevationSNR_112 : 380|7@0+ (0.5,0) [0|63.5] "dB"  LR,ADCU
 SG_ RR_ElevationSNR_113 : 460|7@0+ (0.5,0) [0|63.5] "dB"  LR,ADCU
 SG_ RR_Range_108 : 7|12@0+ (0.0625,0) [0|255.9375] "m"  LR,ADCU
 SG_ RR_Range_109 : 87|12@0+ (0.0625,0) [0|255.9375] "m"  LR,ADCU
 SG_ RR_Range_110 : 167|12@0+ (0.0625,0) [0|255.9375] "m"  LR,ADCU
 SG_ RR_Range_111 : 247|12@0+ (0.0625,0) [0|255.9375] "m"  LR,ADCU
 SG_ RR_Range_112 : 327|12@0+ (0.0625,0) [0|255.9375] "m"  LR,ADCU
 SG_ RR_Range_113 : 407|12@0+ (0.0625,0) [0|255.9375] "m"  LR,ADCU
 SG_ RR_RCS_108 : 16|9@0+ (0.2,-51.1) [-51.1|51.1] "dBsm"  LR,ADCU
 SG_ RR_RCS_109 : 96|9@0+ (0.2,-51.1) [-51.1|51.1] "dBsm"  LR,ADCU
 SG_ RR_RCS_110 : 176|9@0+ (0.2,-51.1) [-51.1|51.1] "dBsm"  LR,ADCU
 SG_ RR_RCS_111 : 256|9@0+ (0.2,-51.1) [-51.1|51.1] "dBsm"  LR,ADCU
 SG_ RR_RCS_112 : 336|9@0+ (0.2,-51.1) [-51.1|51.1] "dBsm"  LR,ADCU
 SG_ RR_RCS_113 : 416|9@0+ (0.2,-51.1) [-51.1|51.1] "dBsm"  LR,ADCU
 SG_ RR_RDI_108_113_AliveCounter : 499|4@0+ (1,0) [0|15] ""  LR,ADCU
 SG_ RR_RDI_108_113_CheckSum : 511|8@0+ (1,0) [0|255] ""  LR,ADCU
 SG_ RR_Status_108 : 79|8@0+ (1,0) [0|255] ""  ADCU
 SG_ RR_Status_109 : 159|8@0+ (1,0) [0|255] ""  ADCU
 SG_ RR_Status_110 : 239|8@0+ (1,0) [0|255] ""  ADCU
 SG_ RR_Status_111 : 319|8@0+ (1,0) [0|255] ""  ADCU
 SG_ RR_Status_112 : 399|8@0+ (1,0) [0|255] ""  ADCU
 SG_ RR_Status_113 : 479|8@0+ (1,0) [0|255] ""  ADCU
 SG_ RR_Tbd_108 : 69|6@0+ (1,0) [0|63] ""  ADCU
 SG_ RR_Tbd_109 : 149|6@0+ (1,0) [0|63] ""  ADCU
 SG_ RR_Tbd_110 : 229|6@0+ (1,0) [0|63] ""  ADCU
 SG_ RR_Tbd_111 : 309|6@0+ (1,0) [0|63] ""  ADCU
 SG_ RR_Tbd_112 : 389|6@0+ (1,0) [0|63] ""  ADCU
 SG_ RR_Tbd_113 : 469|6@0+ (1,0) [0|63] ""  ADCU
 SG_ RR_Velocity_108 : 11|11@0+ (0.05,-60) [-60|42.35] "m/s"  LR,ADCU
 SG_ RR_Velocity_109 : 91|11@0+ (0.05,-60) [-60|42.35] "m/s"  LR,ADCU
 SG_ RR_Velocity_110 : 171|11@0+ (0.05,-60) [-60|42.35] "m/s"  LR,ADCU
 SG_ RR_Velocity_111 : 251|11@0+ (0.05,-60) [-60|42.35] "m/s"  LR,ADCU
 SG_ RR_Velocity_112 : 331|11@0+ (0.05,-60) [-60|42.35] "m/s"  LR,ADCU
 SG_ RR_Velocity_113 : 411|11@0+ (0.05,-60) [-60|42.35] "m/s"  LR,ADCU

BO_ 324 RR_RDI_114_119: 64 RR
 SG_ RR_AzimuthAng_114 : 39|11@0+ (0.1,-90) [-90|114.7] "deg"  LR,ADCU
 SG_ RR_AzimuthAng_115 : 119|11@0+ (0.1,-90) [-90|114.7] "deg"  LR,ADCU
 SG_ RR_AzimuthAng_116 : 199|11@0+ (0.1,-90) [-90|114.7] "deg"  LR,ADCU
 SG_ RR_AzimuthAng_117 : 279|11@0+ (0.1,-90) [-90|114.7] "deg"  LR,ADCU
 SG_ RR_AzimuthAng_118 : 359|11@0+ (0.1,-90) [-90|114.7] "deg"  LR,ADCU
 SG_ RR_AzimuthAng_119 : 439|11@0+ (0.1,-90) [-90|114.7] "deg"  LR,ADCU
 SG_ RR_AzimuthSNR_114 : 51|7@0+ (0.5,0) [0|63.5] "dB"  LR,ADCU
 SG_ RR_AzimuthSNR_115 : 131|7@0+ (0.5,0) [0|63.5] "dB"  LR,ADCU
 SG_ RR_AzimuthSNR_116 : 211|7@0+ (0.5,0) [0|63.5] "dB"  LR,ADCU
 SG_ RR_AzimuthSNR_117 : 291|7@0+ (0.5,0) [0|63.5] "dB"  LR,ADCU
 SG_ RR_AzimuthSNR_118 : 371|7@0+ (0.5,0) [0|63.5] "dB"  LR,ADCU
 SG_ RR_AzimuthSNR_119 : 451|7@0+ (0.5,0) [0|63.5] "dB"  LR,ADCU
 SG_ RR_ElevationAng_114 : 44|9@0+ (0.1,-25) [-25|26.1] "deg"  LR,ADCU
 SG_ RR_ElevationAng_115 : 124|9@0+ (0.1,-25) [-25|26.1] "deg"  LR,ADCU
 SG_ RR_ElevationAng_116 : 204|9@0+ (0.1,-25) [-25|26.1] "deg"  LR,ADCU
 SG_ RR_ElevationAng_117 : 284|9@0+ (0.1,-25) [-25|26.1] "deg"  LR,ADCU
 SG_ RR_ElevationAng_118 : 364|9@0+ (0.1,-25) [-25|26.1] "deg"  LR,ADCU
 SG_ RR_ElevationAng_119 : 444|9@0+ (0.1,-25) [-25|26.1] "deg"  LR,ADCU
 SG_ RR_ElevationSNR_114 : 60|7@0+ (0.5,0) [0|63.5] "dB"  LR,ADCU
 SG_ RR_ElevationSNR_115 : 140|7@0+ (0.5,0) [0|63.5] "dB"  LR,ADCU
 SG_ RR_ElevationSNR_116 : 220|7@0+ (0.5,0) [0|63.5] "dB"  LR,ADCU
 SG_ RR_ElevationSNR_117 : 300|7@0+ (0.5,0) [0|63.5] "dB"  LR,ADCU
 SG_ RR_ElevationSNR_118 : 380|7@0+ (0.5,0) [0|63.5] "dB"  LR,ADCU
 SG_ RR_ElevationSNR_119 : 460|7@0+ (0.5,0) [0|63.5] "dB"  LR,ADCU
 SG_ RR_Range_114 : 7|12@0+ (0.0625,0) [0|255.9375] "m"  LR,ADCU
 SG_ RR_Range_115 : 87|12@0+ (0.0625,0) [0|255.9375] "m"  LR,ADCU
 SG_ RR_Range_116 : 167|12@0+ (0.0625,0) [0|255.9375] "m"  LR,ADCU
 SG_ RR_Range_117 : 247|12@0+ (0.0625,0) [0|255.9375] "m"  LR,ADCU
 SG_ RR_Range_118 : 327|12@0+ (0.0625,0) [0|255.9375] "m"  LR,ADCU
 SG_ RR_Range_119 : 407|12@0+ (0.0625,0) [0|255.9375] "m"  LR,ADCU
 SG_ RR_RCS_114 : 16|9@0+ (0.2,-51.1) [-51.1|51.1] "dBsm"  LR,ADCU
 SG_ RR_RCS_115 : 96|9@0+ (0.2,-51.1) [-51.1|51.1] "dBsm"  LR,ADCU
 SG_ RR_RCS_116 : 176|9@0+ (0.2,-51.1) [-51.1|51.1] "dBsm"  LR,ADCU
 SG_ RR_RCS_117 : 256|9@0+ (0.2,-51.1) [-51.1|51.1] "dBsm"  LR,ADCU
 SG_ RR_RCS_118 : 336|9@0+ (0.2,-51.1) [-51.1|51.1] "dBsm"  LR,ADCU
 SG_ RR_RCS_119 : 416|9@0+ (0.2,-51.1) [-51.1|51.1] "dBsm"  LR,ADCU
 SG_ RR_RDI_114_119_AliveCounter : 499|4@0+ (1,0) [0|15] ""  LR,ADCU
 SG_ RR_RDI_114_119_CheckSum : 511|8@0+ (1,0) [0|255] ""  LR,ADCU
 SG_ RR_Status_114 : 79|8@0+ (1,0) [0|255] ""  ADCU
 SG_ RR_Status_115 : 159|8@0+ (1,0) [0|255] ""  ADCU
 SG_ RR_Status_116 : 239|8@0+ (1,0) [0|255] ""  ADCU
 SG_ RR_Status_117 : 319|8@0+ (1,0) [0|255] ""  ADCU
 SG_ RR_Status_118 : 399|8@0+ (1,0) [0|255] ""  ADCU
 SG_ RR_Status_119 : 479|8@0+ (1,0) [0|255] ""  ADCU
 SG_ RR_Tbd_114 : 69|6@0+ (1,0) [0|63] ""  ADCU
 SG_ RR_Tbd_115 : 149|6@0+ (1,0) [0|63] ""  ADCU
 SG_ RR_Tbd_116 : 229|6@0+ (1,0) [0|63] ""  ADCU
 SG_ RR_Tbd_117 : 309|6@0+ (1,0) [0|63] ""  ADCU
 SG_ RR_Tbd_118 : 389|6@0+ (1,0) [0|63] ""  ADCU
 SG_ RR_Tbd_119 : 469|6@0+ (1,0) [0|63] ""  ADCU
 SG_ RR_Velocity_114 : 11|11@0+ (0.05,-60) [-60|42.35] "m/s"  LR,ADCU
 SG_ RR_Velocity_115 : 91|11@0+ (0.05,-60) [-60|42.35] "m/s"  LR,ADCU
 SG_ RR_Velocity_116 : 171|11@0+ (0.05,-60) [-60|42.35] "m/s"  LR,ADCU
 SG_ RR_Velocity_117 : 251|11@0+ (0.05,-60) [-60|42.35] "m/s"  LR,ADCU
 SG_ RR_Velocity_118 : 331|11@0+ (0.05,-60) [-60|42.35] "m/s"  LR,ADCU
 SG_ RR_Velocity_119 : 411|11@0+ (0.05,-60) [-60|42.35] "m/s"  LR,ADCU

BO_ 325 RR_RDI_120_125: 64 RR
 SG_ RR_AzimuthAng_120 : 39|11@0+ (0.1,-90) [-90|114.7] "deg"  LR,ADCU
 SG_ RR_AzimuthAng_121 : 119|11@0+ (0.1,-90) [-90|114.7] "deg"  LR,ADCU
 SG_ RR_AzimuthAng_122 : 199|11@0+ (0.1,-90) [-90|114.7] "deg"  LR,ADCU
 SG_ RR_AzimuthAng_123 : 279|11@0+ (0.1,-90) [-90|114.7] "deg"  LR,ADCU
 SG_ RR_AzimuthAng_124 : 359|11@0+ (0.1,-90) [-90|114.7] "deg"  LR,ADCU
 SG_ RR_AzimuthAng_125 : 439|11@0+ (0.1,-90) [-90|114.7] "deg"  LR,ADCU
 SG_ RR_AzimuthSNR_120 : 51|7@0+ (0.5,0) [0|63.5] "dB"  LR,ADCU
 SG_ RR_AzimuthSNR_121 : 131|7@0+ (0.5,0) [0|63.5] "dB"  LR,ADCU
 SG_ RR_AzimuthSNR_122 : 211|7@0+ (0.5,0) [0|63.5] "dB"  LR,ADCU
 SG_ RR_AzimuthSNR_123 : 291|7@0+ (0.5,0) [0|63.5] "dB"  LR,ADCU
 SG_ RR_AzimuthSNR_124 : 371|7@0+ (0.5,0) [0|63.5] "dB"  LR,ADCU
 SG_ RR_AzimuthSNR_125 : 451|7@0+ (0.5,0) [0|63.5] "dB"  LR,ADCU
 SG_ RR_ElevationAng_120 : 44|9@0+ (0.1,-25) [-25|26.1] "deg"  LR,ADCU
 SG_ RR_ElevationAng_121 : 124|9@0+ (0.1,-25) [-25|26.1] "deg"  LR,ADCU
 SG_ RR_ElevationAng_122 : 204|9@0+ (0.1,-25) [-25|26.1] "deg"  LR,ADCU
 SG_ RR_ElevationAng_123 : 284|9@0+ (0.1,-25) [-25|26.1] "deg"  LR,ADCU
 SG_ RR_ElevationAng_124 : 364|9@0+ (0.1,-25) [-25|26.1] "deg"  LR,ADCU
 SG_ RR_ElevationAng_125 : 444|9@0+ (0.1,-25) [-25|26.1] "deg"  LR,ADCU
 SG_ RR_ElevationSNR_120 : 60|7@0+ (0.5,0) [0|63.5] "dB"  LR,ADCU
 SG_ RR_ElevationSNR_121 : 140|7@0+ (0.5,0) [0|63.5] "dB"  LR,ADCU
 SG_ RR_ElevationSNR_122 : 220|7@0+ (0.5,0) [0|63.5] "dB"  LR,ADCU
 SG_ RR_ElevationSNR_123 : 300|7@0+ (0.5,0) [0|63.5] "dB"  LR,ADCU
 SG_ RR_ElevationSNR_124 : 380|7@0+ (0.5,0) [0|63.5] "dB"  LR,ADCU
 SG_ RR_ElevationSNR_125 : 460|7@0+ (0.5,0) [0|63.5] "dB"  LR,ADCU
 SG_ RR_Range_120 : 7|12@0+ (0.0625,0) [0|255.9375] "m"  LR,ADCU
 SG_ RR_Range_121 : 87|12@0+ (0.0625,0) [0|255.9375] "m"  LR,ADCU
 SG_ RR_Range_122 : 167|12@0+ (0.0625,0) [0|255.9375] "m"  LR,ADCU
 SG_ RR_Range_123 : 247|12@0+ (0.0625,0) [0|255.9375] "m"  LR,ADCU
 SG_ RR_Range_124 : 327|12@0+ (0.0625,0) [0|255.9375] "m"  LR,ADCU
 SG_ RR_Range_125 : 407|12@0+ (0.0625,0) [0|255.9375] "m"  LR,ADCU
 SG_ RR_RCS_120 : 16|9@0+ (0.2,-51.1) [-51.1|51.1] "dBsm"  LR,ADCU
 SG_ RR_RCS_121 : 96|9@0+ (0.2,-51.1) [-51.1|51.1] "dBsm"  LR,ADCU
 SG_ RR_RCS_122 : 176|9@0+ (0.2,-51.1) [-51.1|51.1] "dBsm"  LR,ADCU
 SG_ RR_RCS_123 : 256|9@0+ (0.2,-51.1) [-51.1|51.1] "dBsm"  LR,ADCU
 SG_ RR_RCS_124 : 336|9@0+ (0.2,-51.1) [-51.1|51.1] "dBsm"  LR,ADCU
 SG_ RR_RCS_125 : 416|9@0+ (0.2,-51.1) [-51.1|51.1] "dBsm"  LR,ADCU
 SG_ RR_RDI_120_125_AliveCounter : 499|4@0+ (1,0) [0|15] ""  LR,ADCU
 SG_ RR_RDI_120_125_CheckSum : 511|8@0+ (1,0) [0|255] ""  LR,ADCU
 SG_ RR_Status_120 : 79|8@0+ (1,0) [0|255] ""  ADCU
 SG_ RR_Status_121 : 159|8@0+ (1,0) [0|255] ""  ADCU
 SG_ RR_Status_122 : 239|8@0+ (1,0) [0|255] ""  ADCU
 SG_ RR_Status_123 : 319|8@0+ (1,0) [0|255] ""  ADCU
 SG_ RR_Status_124 : 399|8@0+ (1,0) [0|255] ""  ADCU
 SG_ RR_Status_125 : 479|8@0+ (1,0) [0|255] ""  ADCU
 SG_ RR_Tbd_120 : 69|6@0+ (1,0) [0|63] ""  ADCU
 SG_ RR_Tbd_121 : 149|6@0+ (1,0) [0|63] ""  ADCU
 SG_ RR_Tbd_122 : 229|6@0+ (1,0) [0|63] ""  ADCU
 SG_ RR_Tbd_123 : 309|6@0+ (1,0) [0|63] ""  ADCU
 SG_ RR_Tbd_124 : 389|6@0+ (1,0) [0|63] ""  ADCU
 SG_ RR_Tbd_125 : 469|6@0+ (1,0) [0|63] ""  ADCU
 SG_ RR_Velocity_120 : 11|11@0+ (0.05,-60) [-60|42.35] "m/s"  LR,ADCU
 SG_ RR_Velocity_121 : 91|11@0+ (0.05,-60) [-60|42.35] "m/s"  LR,ADCU
 SG_ RR_Velocity_122 : 171|11@0+ (0.05,-60) [-60|42.35] "m/s"  LR,ADCU
 SG_ RR_Velocity_123 : 251|11@0+ (0.05,-60) [-60|42.35] "m/s"  LR,ADCU
 SG_ RR_Velocity_124 : 331|11@0+ (0.05,-60) [-60|42.35] "m/s"  LR,ADCU
 SG_ RR_Velocity_125 : 411|11@0+ (0.05,-60) [-60|42.35] "m/s"  LR,ADCU

BO_ 326 RR_RDI_126_131: 64 RR
 SG_ RR_AzimuthAng_126 : 39|11@0+ (0.1,-90) [-90|114.7] "deg"  LR,ADCU
 SG_ RR_AzimuthAng_127 : 119|11@0+ (0.1,-90) [-90|114.7] "deg"  LR,ADCU
 SG_ RR_AzimuthAng_128 : 199|11@0+ (0.1,-90) [-90|114.7] "deg"  LR,ADCU
 SG_ RR_AzimuthAng_129 : 279|11@0+ (0.1,-90) [-90|114.7] "deg"  LR,ADCU
 SG_ RR_AzimuthAng_130 : 359|11@0+ (0.1,-90) [-90|114.7] "deg"  LR,ADCU
 SG_ RR_AzimuthAng_131 : 439|11@0+ (0.1,-90) [-90|114.7] "deg"  LR,ADCU
 SG_ RR_AzimuthSNR_126 : 51|7@0+ (0.5,0) [0|63.5] "dB"  LR,ADCU
 SG_ RR_AzimuthSNR_127 : 131|7@0+ (0.5,0) [0|63.5] "dB"  LR,ADCU
 SG_ RR_AzimuthSNR_128 : 211|7@0+ (0.5,0) [0|63.5] "dB"  LR,ADCU
 SG_ RR_AzimuthSNR_129 : 291|7@0+ (0.5,0) [0|63.5] "dB"  LR,ADCU
 SG_ RR_AzimuthSNR_130 : 371|7@0+ (0.5,0) [0|63.5] "dB"  LR,ADCU
 SG_ RR_AzimuthSNR_131 : 451|7@0+ (0.5,0) [0|63.5] "dB"  LR,ADCU
 SG_ RR_ElevationAng_126 : 44|9@0+ (0.1,-25) [-25|26.1] "deg"  LR,ADCU
 SG_ RR_ElevationAng_127 : 124|9@0+ (0.1,-25) [-25|26.1] "deg"  LR,ADCU
 SG_ RR_ElevationAng_128 : 204|9@0+ (0.1,-25) [-25|26.1] "deg"  LR,ADCU
 SG_ RR_ElevationAng_129 : 284|9@0+ (0.1,-25) [-25|26.1] "deg"  LR,ADCU
 SG_ RR_ElevationAng_130 : 364|9@0+ (0.1,-25) [-25|26.1] "deg"  LR,ADCU
 SG_ RR_ElevationAng_131 : 444|9@0+ (0.1,-25) [-25|26.1] "deg"  LR,ADCU
 SG_ RR_ElevationSNR_126 : 60|7@0+ (0.5,0) [0|63.5] "dB"  LR,ADCU
 SG_ RR_ElevationSNR_127 : 140|7@0+ (0.5,0) [0|63.5] "dB"  LR,ADCU
 SG_ RR_ElevationSNR_128 : 220|7@0+ (0.5,0) [0|63.5] "dB"  LR,ADCU
 SG_ RR_ElevationSNR_129 : 300|7@0+ (0.5,0) [0|63.5] "dB"  LR,ADCU
 SG_ RR_ElevationSNR_130 : 380|7@0+ (0.5,0) [0|63.5] "dB"  LR,ADCU
 SG_ RR_ElevationSNR_131 : 460|7@0+ (0.5,0) [0|63.5] "dB"  LR,ADCU
 SG_ RR_Range_126 : 7|12@0+ (0.0625,0) [0|255.9375] "m"  LR,ADCU
 SG_ RR_Range_127 : 87|12@0+ (0.0625,0) [0|255.9375] "m"  LR,ADCU
 SG_ RR_Range_128 : 167|12@0+ (0.0625,0) [0|255.9375] "m"  LR,ADCU
 SG_ RR_Range_129 : 247|12@0+ (0.0625,0) [0|255.9375] "m"  LR,ADCU
 SG_ RR_Range_130 : 327|12@0+ (0.0625,0) [0|255.9375] "m"  LR,ADCU
 SG_ RR_Range_131 : 407|12@0+ (0.0625,0) [0|255.9375] "m"  LR,ADCU
 SG_ RR_RCS_126 : 16|9@0+ (0.2,-51.1) [-51.1|51.1] "dBsm"  LR,ADCU
 SG_ RR_RCS_127 : 96|9@0+ (0.2,-51.1) [-51.1|51.1] "dBsm"  LR,ADCU
 SG_ RR_RCS_128 : 176|9@0+ (0.2,-51.1) [-51.1|51.1] "dBsm"  LR,ADCU
 SG_ RR_RCS_129 : 256|9@0+ (0.2,-51.1) [-51.1|51.1] "dBsm"  LR,ADCU
 SG_ RR_RCS_130 : 336|9@0+ (0.2,-51.1) [-51.1|51.1] "dBsm"  LR,ADCU
 SG_ RR_RCS_131 : 416|9@0+ (0.2,-51.1) [-51.1|51.1] "dBsm"  LR,ADCU
 SG_ RR_RDI_126_131_AliveCounter : 499|4@0+ (1,0) [0|15] ""  LR,ADCU
 SG_ RR_RDI_126_131_CheckSum : 511|8@0+ (1,0) [0|255] ""  LR,ADCU
 SG_ RR_Status_126 : 79|8@0+ (1,0) [0|255] ""  ADCU
 SG_ RR_Status_127 : 159|8@0+ (1,0) [0|255] ""  ADCU
 SG_ RR_Status_128 : 239|8@0+ (1,0) [0|255] ""  ADCU
 SG_ RR_Status_129 : 319|8@0+ (1,0) [0|255] ""  ADCU
 SG_ RR_Status_130 : 399|8@0+ (1,0) [0|255] ""  ADCU
 SG_ RR_Status_131 : 479|8@0+ (1,0) [0|255] ""  ADCU
 SG_ RR_Tbd_126 : 69|6@0+ (1,0) [0|63] ""  ADCU
 SG_ RR_Tbd_127 : 149|6@0+ (1,0) [0|63] ""  ADCU
 SG_ RR_Tbd_128 : 229|6@0+ (1,0) [0|63] ""  ADCU
 SG_ RR_Tbd_129 : 309|6@0+ (1,0) [0|63] ""  ADCU
 SG_ RR_Tbd_130 : 389|6@0+ (1,0) [0|63] ""  ADCU
 SG_ RR_Tbd_131 : 469|6@0+ (1,0) [0|63] ""  ADCU
 SG_ RR_Velocity_126 : 11|11@0+ (0.05,-60) [-60|42.35] "m/s"  LR,ADCU
 SG_ RR_Velocity_127 : 91|11@0+ (0.05,-60) [-60|42.35] "m/s"  LR,ADCU
 SG_ RR_Velocity_128 : 171|11@0+ (0.05,-60) [-60|42.35] "m/s"  LR,ADCU
 SG_ RR_Velocity_129 : 251|11@0+ (0.05,-60) [-60|42.35] "m/s"  LR,ADCU
 SG_ RR_Velocity_130 : 331|11@0+ (0.05,-60) [-60|42.35] "m/s"  LR,ADCU
 SG_ RR_Velocity_131 : 411|11@0+ (0.05,-60) [-60|42.35] "m/s"  LR,ADCU

BO_ 327 RR_RDI_132_137: 64 RR
 SG_ RR_AzimuthAng_132 : 39|11@0+ (0.1,-90) [-90|114.7] "deg"  LR,ADCU
 SG_ RR_AzimuthAng_133 : 119|11@0+ (0.1,-90) [-90|114.7] "deg"  LR,ADCU
 SG_ RR_AzimuthAng_134 : 199|11@0+ (0.1,-90) [-90|114.7] "deg"  LR,ADCU
 SG_ RR_AzimuthAng_135 : 279|11@0+ (0.1,-90) [-90|114.7] "deg"  LR,ADCU
 SG_ RR_AzimuthAng_136 : 359|11@0+ (0.1,-90) [-90|114.7] "deg"  LR,ADCU
 SG_ RR_AzimuthAng_137 : 439|11@0+ (0.1,-90) [-90|114.7] "deg"  LR,ADCU
 SG_ RR_AzimuthSNR_132 : 51|7@0+ (0.5,0) [0|63.5] "dB"  LR,ADCU
 SG_ RR_AzimuthSNR_133 : 131|7@0+ (0.5,0) [0|63.5] "dB"  LR,ADCU
 SG_ RR_AzimuthSNR_134 : 211|7@0+ (0.5,0) [0|63.5] "dB"  LR,ADCU
 SG_ RR_AzimuthSNR_135 : 291|7@0+ (0.5,0) [0|63.5] "dB"  LR,ADCU
 SG_ RR_AzimuthSNR_136 : 371|7@0+ (0.5,0) [0|63.5] "dB"  LR,ADCU
 SG_ RR_AzimuthSNR_137 : 451|7@0+ (0.5,0) [0|63.5] "dB"  LR,ADCU
 SG_ RR_ElevationAng_132 : 44|9@0+ (0.1,-25) [-25|26.1] "deg"  LR,ADCU
 SG_ RR_ElevationAng_133 : 124|9@0+ (0.1,-25) [-25|26.1] "deg"  LR,ADCU
 SG_ RR_ElevationAng_134 : 204|9@0+ (0.1,-25) [-25|26.1] "deg"  LR,ADCU
 SG_ RR_ElevationAng_135 : 284|9@0+ (0.1,-25) [-25|26.1] "deg"  LR,ADCU
 SG_ RR_ElevationAng_136 : 364|9@0+ (0.1,-25) [-25|26.1] "deg"  LR,ADCU
 SG_ RR_ElevationAng_137 : 444|9@0+ (0.1,-25) [-25|26.1] "deg"  LR,ADCU
 SG_ RR_ElevationSNR_132 : 60|7@0+ (0.5,0) [0|63.5] "dB"  LR,ADCU
 SG_ RR_ElevationSNR_133 : 140|7@0+ (0.5,0) [0|63.5] "dB"  LR,ADCU
 SG_ RR_ElevationSNR_134 : 220|7@0+ (0.5,0) [0|63.5] "dB"  LR,ADCU
 SG_ RR_ElevationSNR_135 : 300|7@0+ (0.5,0) [0|63.5] "dB"  LR,ADCU
 SG_ RR_ElevationSNR_136 : 380|7@0+ (0.5,0) [0|63.5] "dB"  LR,ADCU
 SG_ RR_ElevationSNR_137 : 460|7@0+ (0.5,0) [0|63.5] "dB"  LR,ADCU
 SG_ RR_Range_132 : 7|12@0+ (0.0625,0) [0|255.9375] "m"  LR,ADCU
 SG_ RR_Range_133 : 87|12@0+ (0.0625,0) [0|255.9375] "m"  LR,ADCU
 SG_ RR_Range_134 : 167|12@0+ (0.0625,0) [0|255.9375] "m"  LR,ADCU
 SG_ RR_Range_135 : 247|12@0+ (0.0625,0) [0|255.9375] "m"  LR,ADCU
 SG_ RR_Range_136 : 327|12@0+ (0.0625,0) [0|255.9375] "m"  LR,ADCU
 SG_ RR_Range_137 : 407|12@0+ (0.0625,0) [0|255.9375] "m"  LR,ADCU
 SG_ RR_RCS_132 : 16|9@0+ (0.2,-51.1) [-51.1|51.1] "dBsm"  LR,ADCU
 SG_ RR_RCS_133 : 96|9@0+ (0.2,-51.1) [-51.1|51.1] "dBsm"  LR,ADCU
 SG_ RR_RCS_134 : 176|9@0+ (0.2,-51.1) [-51.1|51.1] "dBsm"  LR,ADCU
 SG_ RR_RCS_135 : 256|9@0+ (0.2,-51.1) [-51.1|51.1] "dBsm"  LR,ADCU
 SG_ RR_RCS_136 : 336|9@0+ (0.2,-51.1) [-51.1|51.1] "dBsm"  LR,ADCU
 SG_ RR_RCS_137 : 416|9@0+ (0.2,-51.1) [-51.1|51.1] "dBsm"  LR,ADCU
 SG_ RR_RDI_132_137_AliveCounter : 499|4@0+ (1,0) [0|15] ""  LR,ADCU
 SG_ RR_RDI_132_137_CheckSum : 511|8@0+ (1,0) [0|255] ""  LR,ADCU
 SG_ RR_Status_132 : 79|8@0+ (1,0) [0|255] ""  ADCU
 SG_ RR_Status_133 : 159|8@0+ (1,0) [0|255] ""  ADCU
 SG_ RR_Status_134 : 239|8@0+ (1,0) [0|255] ""  ADCU
 SG_ RR_Status_135 : 319|8@0+ (1,0) [0|255] ""  ADCU
 SG_ RR_Status_136 : 399|8@0+ (1,0) [0|255] ""  ADCU
 SG_ RR_Status_137 : 479|8@0+ (1,0) [0|255] ""  ADCU
 SG_ RR_Tbd_132 : 69|6@0+ (1,0) [0|63] ""  ADCU
 SG_ RR_Tbd_133 : 149|6@0+ (1,0) [0|63] ""  ADCU
 SG_ RR_Tbd_134 : 229|6@0+ (1,0) [0|63] ""  ADCU
 SG_ RR_Tbd_135 : 309|6@0+ (1,0) [0|63] ""  ADCU
 SG_ RR_Tbd_136 : 389|6@0+ (1,0) [0|63] ""  ADCU
 SG_ RR_Tbd_137 : 469|6@0+ (1,0) [0|63] ""  ADCU
 SG_ RR_Velocity_132 : 11|11@0+ (0.05,-60) [-60|42.35] "m/s"  LR,ADCU
 SG_ RR_Velocity_133 : 91|11@0+ (0.05,-60) [-60|42.35] "m/s"  LR,ADCU
 SG_ RR_Velocity_134 : 171|11@0+ (0.05,-60) [-60|42.35] "m/s"  LR,ADCU
 SG_ RR_Velocity_135 : 251|11@0+ (0.05,-60) [-60|42.35] "m/s"  LR,ADCU
 SG_ RR_Velocity_136 : 331|11@0+ (0.05,-60) [-60|42.35] "m/s"  LR,ADCU
 SG_ RR_Velocity_137 : 411|11@0+ (0.05,-60) [-60|42.35] "m/s"  LR,ADCU

CM_ SG_ 304 RR_CRC16_Checksum_Header "CRC16 of Message Header";
CM_ SG_ 304 RR_CycleCounter "Internal coutner that increments if RDI task executes once";
CM_ SG_ 304 RR_DPMode "Driving or parking mode";
CM_ SG_ 304 RR_DynamicCalibPitchDeg "DynamicCalibPitchDeg";
CM_ SG_ 304 RR_DynamicCalibProgress "DynamicCalibProgress";
CM_ SG_ 304 RR_DynamicCalibState "DynamicCalibState";
CM_ SG_ 304 RR_DynamicCalibYawDeg "DynamicCalibYawDeg";
CM_ SG_ 304 RR_EgoAcceleration "Ego acceleration filtered by Radar Algorithm";
CM_ SG_ 304 RR_EgoCurvature "Ego curvature filtered by Radar Algorithm";
CM_ SG_ 304 RR_EgoGear "Ego gear filtered by Radar Algorithm";
CM_ SG_ 304 RR_EgoVelocity "EgoVelocity";
CM_ SG_ 304 RR_EgoVelocityStd "Ego velocity standard deviation filtered by Radar Algorithm";
CM_ SG_ 304 RR_EgoYawRate "Ego yaw rate filtered by Radar Algorithm";
CM_ SG_ 304 RR_Latency "Time difference between RF task and RDI task (signal processing time)";
CM_ SG_ 304 RR_MaxDetectionRange "Maximal detection range";
CM_ SG_ 304 RR_MaxVelMultiple "AmbigFreeDopplerRange";
CM_ SG_ 304 RR_Measure_Begin_Timestamp_NSec "Timestamp of RF task begin (nannosecond)";
CM_ SG_ 304 RR_Measure_Begin_Timestamp_Sec "Timestamp of RF task begin (second)";
CM_ SG_ 304 RR_Measure_End_Timestamp_NSec "Timestamp of RF task done (nannosecond)";
CM_ SG_ 304 RR_Measure_End_Timestamp_Sec "Timestamp of RF task done (second)";
CM_ SG_ 304 RR_MsgCounter_Header "Counter of Message Header";
CM_ SG_ 304 RR_NumOfRDI "Number of points";
CM_ SG_ 304 RR_RadarInfo_InstallDirection "Radar installation direction";
CM_ SG_ 304 RR_RadarInfo_InstallPitchDeg "Radar Installation Pitch Angle (Degrees)";
CM_ SG_ 304 RR_RadarInfo_InstallX "Radar Installation X-Axis Offset (m)";
CM_ SG_ 304 RR_RadarInfo_InstallY "Radar Installation Y-Axis Offset (m)";
CM_ SG_ 304 RR_RadarInfo_InstallYawDeg "Radar Installation Yaw Angle (Degrees)";
CM_ SG_ 304 RR_RadarInfo_InstallZ "Radar Installation Z-Axis Offset (m)";
CM_ SG_ 304 RR_RadarInfo_LastCalibPitchDeg "RadarInfo_LastCalibPitchDeg";
CM_ SG_ 304 RR_RadarInfo_LastCalibValid "RadarInfo_LastCalibValid";
CM_ SG_ 304 RR_RadarInfo_LastCalibYawDeg "RadarInfo_LastCalibYawDeg";
CM_ SG_ 304 RR_RadarInfo_RadarIndex "Radar Index";
CM_ SG_ 304 RR_RadarInfo_RadarType "RadarInfo_RadarType";
CM_ SG_ 304 RR_RangeResolution "Range resolution";
CM_ SG_ 304 RR_SelfCalibPitchDeg "SelfCalibPitchDeg";
CM_ SG_ 304 RR_SelfCalibProgress "SelfCalibProgress";
CM_ SG_ 304 RR_SelfCalibState "StaticCalibState";
CM_ SG_ 304 RR_SelfCalibYawDeg "SelfCalibYawDeg";
CM_ SG_ 304 RR_StaticCalibPitchDeg "StaticCalibPitchDeg";
CM_ SG_ 304 RR_StaticCalibProgress "StaticCalibProgress";
CM_ SG_ 304 RR_StaticCalibState "StaticCalibState";
CM_ SG_ 304 RR_StaticCalibYawDeg "StaticCalibYawDeg";
CM_ SG_ 304 RR_SubFrameID "Internal counter that increments if RF task executes once";
CM_ SG_ 304 RR_TimeConsuming "Internal coutner that increments if RDI task executes once";
CM_ SG_ 305 RR_AzimuthAng_000 "Azimuth angle of point_000";
CM_ SG_ 305 RR_AzimuthAng_001 "Azimuth angle of point_001";
CM_ SG_ 305 RR_AzimuthAng_002 "Azimuth angle of point_002";
CM_ SG_ 305 RR_AzimuthAng_003 "Azimuth angle of point_003";
CM_ SG_ 305 RR_AzimuthAng_004 "Azimuth angle of point_004";
CM_ SG_ 305 RR_AzimuthAng_005 "Azimuth angle of point_005";
CM_ SG_ 305 RR_AzimuthSNR_000 "Azimuth SNR of point_000";
CM_ SG_ 305 RR_AzimuthSNR_001 "Azimuth SNR of point_001";
CM_ SG_ 305 RR_AzimuthSNR_002 "Azimuth SNR of point_002";
CM_ SG_ 305 RR_AzimuthSNR_003 "Azimuth SNR of point_003";
CM_ SG_ 305 RR_AzimuthSNR_004 "Azimuth SNR of point_004";
CM_ SG_ 305 RR_AzimuthSNR_005 "Azimuth SNR of point_005";
CM_ SG_ 305 RR_ElevationAng_000 "Elevation angle of point_000";
CM_ SG_ 305 RR_ElevationAng_001 "Elevation angle of point_001";
CM_ SG_ 305 RR_ElevationAng_002 "Elevation angle of point_002";
CM_ SG_ 305 RR_ElevationAng_003 "Elevation angle of point_003";
CM_ SG_ 305 RR_ElevationAng_004 "Elevation angle of point_004";
CM_ SG_ 305 RR_ElevationAng_005 "Elevation angle of point_005";
CM_ SG_ 305 RR_ElevationSNR_000 "Elevation SNR of point_000";
CM_ SG_ 305 RR_ElevationSNR_001 "Elevation SNR of point_001";
CM_ SG_ 305 RR_ElevationSNR_002 "Elevation SNR of point_002";
CM_ SG_ 305 RR_ElevationSNR_003 "Elevation SNR of point_003";
CM_ SG_ 305 RR_ElevationSNR_004 "Elevation SNR of point_004";
CM_ SG_ 305 RR_ElevationSNR_005 "Elevation SNR of point_005";
CM_ SG_ 305 RR_Range_000 "Range of point_000";
CM_ SG_ 305 RR_Range_001 "Range of point_001";
CM_ SG_ 305 RR_Range_002 "Range of point_002";
CM_ SG_ 305 RR_Range_003 "Range of point_003";
CM_ SG_ 305 RR_Range_004 "Range of point_004";
CM_ SG_ 305 RR_Range_005 "Range of point_005";
CM_ SG_ 305 RR_RCS_000 "RCS of point_000";
CM_ SG_ 305 RR_RCS_001 "RCS of point_001";
CM_ SG_ 305 RR_RCS_002 "RCS of point_002";
CM_ SG_ 305 RR_RCS_003 "RCS of point_003";
CM_ SG_ 305 RR_RCS_004 "RCS of point_004";
CM_ SG_ 305 RR_RCS_005 "RCS of point_005";
CM_ SG_ 305 RR_Status_000 "Status of point_000";
CM_ SG_ 305 RR_Status_001 "Status of point_001";
CM_ SG_ 305 RR_Status_002 "Status of point_002";
CM_ SG_ 305 RR_Status_003 "Status of point_003";
CM_ SG_ 305 RR_Status_004 "Status of point_004";
CM_ SG_ 305 RR_Status_005 "Status of point_005";
CM_ SG_ 305 RR_Tbd_000 "To be defined";
CM_ SG_ 305 RR_Tbd_001 "To be defined";
CM_ SG_ 305 RR_Tbd_002 "To be defined";
CM_ SG_ 305 RR_Tbd_003 "To be defined";
CM_ SG_ 305 RR_Tbd_004 "To be defined";
CM_ SG_ 305 RR_Tbd_005 "To be defined";
CM_ SG_ 305 RR_Velocity_000 "Relative radial velocity of point_000";
CM_ SG_ 305 RR_Velocity_001 "Relative radial velocity of point_001";
CM_ SG_ 305 RR_Velocity_002 "Relative radial velocity of point_002";
CM_ SG_ 305 RR_Velocity_003 "Relative radial velocity of point_003";
CM_ SG_ 305 RR_Velocity_004 "Relative radial velocity of point_004";
CM_ SG_ 305 RR_Velocity_005 "Relative radial velocity of point_005";
CM_ SG_ 306 RR_AzimuthAng_006 "Azimuth angle of point_006";
CM_ SG_ 306 RR_AzimuthAng_007 "Azimuth angle of point_007";
CM_ SG_ 306 RR_AzimuthAng_008 "Azimuth angle of point_008";
CM_ SG_ 306 RR_AzimuthAng_009 "Azimuth angle of point_009";
CM_ SG_ 306 RR_AzimuthAng_010 "Azimuth angle of point_010";
CM_ SG_ 306 RR_AzimuthAng_011 "Azimuth angle of point_011";
CM_ SG_ 306 RR_AzimuthSNR_006 "Azimuth SNR of point_006";
CM_ SG_ 306 RR_AzimuthSNR_007 "Azimuth SNR of point_007";
CM_ SG_ 306 RR_AzimuthSNR_008 "Azimuth SNR of point_008";
CM_ SG_ 306 RR_AzimuthSNR_009 "Azimuth SNR of point_009";
CM_ SG_ 306 RR_AzimuthSNR_010 "Azimuth SNR of point_010";
CM_ SG_ 306 RR_AzimuthSNR_011 "Azimuth SNR of point_011";
CM_ SG_ 306 RR_ElevationAng_006 "Elevation angle of point_006";
CM_ SG_ 306 RR_ElevationAng_007 "Elevation angle of point_007";
CM_ SG_ 306 RR_ElevationAng_008 "Elevation angle of point_008";
CM_ SG_ 306 RR_ElevationAng_009 "Elevation angle of point_009";
CM_ SG_ 306 RR_ElevationAng_010 "Elevation angle of point_010";
CM_ SG_ 306 RR_ElevationAng_011 "Elevation angle of point_011";
CM_ SG_ 306 RR_ElevationSNR_006 "Elevation SNR of point_006";
CM_ SG_ 306 RR_ElevationSNR_007 "Elevation SNR of point_007";
CM_ SG_ 306 RR_ElevationSNR_008 "Elevation SNR of point_008";
CM_ SG_ 306 RR_ElevationSNR_009 "Elevation SNR of point_009";
CM_ SG_ 306 RR_ElevationSNR_010 "Elevation SNR of point_010";
CM_ SG_ 306 RR_ElevationSNR_011 "Elevation SNR of point_011";
CM_ SG_ 306 RR_Range_006 "Range of point_006";
CM_ SG_ 306 RR_Range_007 "Range of point_007";
CM_ SG_ 306 RR_Range_008 "Range of point_008";
CM_ SG_ 306 RR_Range_009 "Range of point_009";
CM_ SG_ 306 RR_Range_010 "Range of point_010";
CM_ SG_ 306 RR_Range_011 "Range of point_011";
CM_ SG_ 306 RR_RCS_006 "RCS of point_006";
CM_ SG_ 306 RR_RCS_007 "RCS of point_007";
CM_ SG_ 306 RR_RCS_008 "RCS of point_008";
CM_ SG_ 306 RR_RCS_009 "RCS of point_009";
CM_ SG_ 306 RR_RCS_010 "RCS of point_010";
CM_ SG_ 306 RR_RCS_011 "RCS of point_011";
CM_ SG_ 306 RR_Status_006 "Status of point_006";
CM_ SG_ 306 RR_Status_007 "Status of point_007";
CM_ SG_ 306 RR_Status_008 "Status of point_008";
CM_ SG_ 306 RR_Status_009 "Status of point_009";
CM_ SG_ 306 RR_Status_010 "Status of point_010";
CM_ SG_ 306 RR_Status_011 "Status of point_011";
CM_ SG_ 306 RR_Tbd_006 "To be defined";
CM_ SG_ 306 RR_Tbd_007 "To be defined";
CM_ SG_ 306 RR_Tbd_008 "To be defined";
CM_ SG_ 306 RR_Tbd_009 "To be defined";
CM_ SG_ 306 RR_Tbd_010 "To be defined";
CM_ SG_ 306 RR_Tbd_011 "To be defined";
CM_ SG_ 306 RR_Velocity_006 "Relative radial velocity of point_006";
CM_ SG_ 306 RR_Velocity_007 "Relative radial velocity of point_007";
CM_ SG_ 306 RR_Velocity_008 "Relative radial velocity of point_008";
CM_ SG_ 306 RR_Velocity_009 "Relative radial velocity of point_009";
CM_ SG_ 306 RR_Velocity_010 "Relative radial velocity of point_010";
CM_ SG_ 306 RR_Velocity_011 "Relative radial velocity of point_011";
CM_ SG_ 307 RR_AzimuthAng_012 "Azimuth angle of point_012";
CM_ SG_ 307 RR_AzimuthAng_013 "Azimuth angle of point_013";
CM_ SG_ 307 RR_AzimuthAng_014 "Azimuth angle of point_014";
CM_ SG_ 307 RR_AzimuthAng_015 "Azimuth angle of point_015";
CM_ SG_ 307 RR_AzimuthAng_016 "Azimuth angle of point_016";
CM_ SG_ 307 RR_AzimuthAng_017 "Azimuth angle of point_017";
CM_ SG_ 307 RR_AzimuthSNR_012 "Azimuth SNR of point_012";
CM_ SG_ 307 RR_AzimuthSNR_013 "Azimuth SNR of point_013";
CM_ SG_ 307 RR_AzimuthSNR_014 "Azimuth SNR of point_014";
CM_ SG_ 307 RR_AzimuthSNR_015 "Azimuth SNR of point_015";
CM_ SG_ 307 RR_AzimuthSNR_016 "Azimuth SNR of point_016";
CM_ SG_ 307 RR_AzimuthSNR_017 "Azimuth SNR of point_017";
CM_ SG_ 307 RR_ElevationAng_012 "Elevation angle of point_012";
CM_ SG_ 307 RR_ElevationAng_013 "Elevation angle of point_013";
CM_ SG_ 307 RR_ElevationAng_014 "Elevation angle of point_014";
CM_ SG_ 307 RR_ElevationAng_015 "Elevation angle of point_015";
CM_ SG_ 307 RR_ElevationAng_016 "Elevation angle of point_016";
CM_ SG_ 307 RR_ElevationAng_017 "Elevation angle of point_017";
CM_ SG_ 307 RR_ElevationSNR_012 "Elevation SNR of point_012";
CM_ SG_ 307 RR_ElevationSNR_013 "Elevation SNR of point_013";
CM_ SG_ 307 RR_ElevationSNR_014 "Elevation SNR of point_014";
CM_ SG_ 307 RR_ElevationSNR_015 "Elevation SNR of point_015";
CM_ SG_ 307 RR_ElevationSNR_016 "Elevation SNR of point_016";
CM_ SG_ 307 RR_ElevationSNR_017 "Elevation SNR of point_017";
CM_ SG_ 307 RR_Range_012 "Range of point_012";
CM_ SG_ 307 RR_Range_013 "Range of point_013";
CM_ SG_ 307 RR_Range_014 "Range of point_014";
CM_ SG_ 307 RR_Range_015 "Range of point_015";
CM_ SG_ 307 RR_Range_016 "Range of point_016";
CM_ SG_ 307 RR_Range_017 "Range of point_017";
CM_ SG_ 307 RR_RCS_012 "RCS of point_012";
CM_ SG_ 307 RR_RCS_013 "RCS of point_013";
CM_ SG_ 307 RR_RCS_014 "RCS of point_014";
CM_ SG_ 307 RR_RCS_015 "RCS of point_015";
CM_ SG_ 307 RR_RCS_016 "RCS of point_016";
CM_ SG_ 307 RR_RCS_017 "RCS of point_017";
CM_ SG_ 307 RR_Status_012 "Status of point_012";
CM_ SG_ 307 RR_Status_013 "Status of point_013";
CM_ SG_ 307 RR_Status_014 "Status of point_014";
CM_ SG_ 307 RR_Status_015 "Status of point_015";
CM_ SG_ 307 RR_Status_016 "Status of point_016";
CM_ SG_ 307 RR_Status_017 "Status of point_017";
CM_ SG_ 307 RR_Tbd_012 "To be defined";
CM_ SG_ 307 RR_Tbd_013 "To be defined";
CM_ SG_ 307 RR_Tbd_014 "To be defined";
CM_ SG_ 307 RR_Tbd_015 "To be defined";
CM_ SG_ 307 RR_Tbd_016 "To be defined";
CM_ SG_ 307 RR_Tbd_017 "To be defined";
CM_ SG_ 307 RR_Velocity_012 "Relative radial velocity of point_012";
CM_ SG_ 307 RR_Velocity_013 "Relative radial velocity of point_013";
CM_ SG_ 307 RR_Velocity_014 "Relative radial velocity of point_014";
CM_ SG_ 307 RR_Velocity_015 "Relative radial velocity of point_015";
CM_ SG_ 307 RR_Velocity_016 "Relative radial velocity of point_016";
CM_ SG_ 307 RR_Velocity_017 "Relative radial velocity of point_017";
CM_ SG_ 308 RR_AzimuthAng_018 "Azimuth angle of point_018";
CM_ SG_ 308 RR_AzimuthAng_019 "Azimuth angle of point_019";
CM_ SG_ 308 RR_AzimuthAng_020 "Azimuth angle of point_020";
CM_ SG_ 308 RR_AzimuthAng_021 "Azimuth angle of point_021";
CM_ SG_ 308 RR_AzimuthAng_022 "Azimuth angle of point_022";
CM_ SG_ 308 RR_AzimuthAng_023 "Azimuth angle of point_023";
CM_ SG_ 308 RR_AzimuthSNR_018 "Azimuth SNR of point_018";
CM_ SG_ 308 RR_AzimuthSNR_019 "Azimuth SNR of point_019";
CM_ SG_ 308 RR_AzimuthSNR_020 "Azimuth SNR of point_020";
CM_ SG_ 308 RR_AzimuthSNR_021 "Azimuth SNR of point_021";
CM_ SG_ 308 RR_AzimuthSNR_022 "Azimuth SNR of point_022";
CM_ SG_ 308 RR_AzimuthSNR_023 "Azimuth SNR of point_023";
CM_ SG_ 308 RR_ElevationAng_018 "Elevation angle of point_018";
CM_ SG_ 308 RR_ElevationAng_019 "Elevation angle of point_019";
CM_ SG_ 308 RR_ElevationAng_020 "Elevation angle of point_020";
CM_ SG_ 308 RR_ElevationAng_021 "Elevation angle of point_021";
CM_ SG_ 308 RR_ElevationAng_022 "Elevation angle of point_022";
CM_ SG_ 308 RR_ElevationAng_023 "Elevation angle of point_023";
CM_ SG_ 308 RR_ElevationSNR_018 "Elevation SNR of point_018";
CM_ SG_ 308 RR_ElevationSNR_019 "Elevation SNR of point_019";
CM_ SG_ 308 RR_ElevationSNR_020 "Elevation SNR of point_020";
CM_ SG_ 308 RR_ElevationSNR_021 "Elevation SNR of point_021";
CM_ SG_ 308 RR_ElevationSNR_022 "Elevation SNR of point_022";
CM_ SG_ 308 RR_ElevationSNR_023 "Elevation SNR of point_023";
CM_ SG_ 308 RR_Range_018 "Range of point_018";
CM_ SG_ 308 RR_Range_019 "Range of point_019";
CM_ SG_ 308 RR_Range_020 "Range of point_020";
CM_ SG_ 308 RR_Range_021 "Range of point_021";
CM_ SG_ 308 RR_Range_022 "Range of point_022";
CM_ SG_ 308 RR_Range_023 "Range of point_023";
CM_ SG_ 308 RR_RCS_018 "RCS of point_018";
CM_ SG_ 308 RR_RCS_019 "RCS of point_019";
CM_ SG_ 308 RR_RCS_020 "RCS of point_020";
CM_ SG_ 308 RR_RCS_021 "RCS of point_021";
CM_ SG_ 308 RR_RCS_022 "RCS of point_022";
CM_ SG_ 308 RR_RCS_023 "RCS of point_023";
CM_ SG_ 308 RR_Status_018 "Status of point_018";
CM_ SG_ 308 RR_Status_019 "Status of point_019";
CM_ SG_ 308 RR_Status_020 "Status of point_020";
CM_ SG_ 308 RR_Status_021 "Status of point_021";
CM_ SG_ 308 RR_Status_022 "Status of point_022";
CM_ SG_ 308 RR_Status_023 "Status of point_023";
CM_ SG_ 308 RR_Tbd_018 "To be defined";
CM_ SG_ 308 RR_Tbd_019 "To be defined";
CM_ SG_ 308 RR_Tbd_020 "To be defined";
CM_ SG_ 308 RR_Tbd_021 "To be defined";
CM_ SG_ 308 RR_Tbd_022 "To be defined";
CM_ SG_ 308 RR_Tbd_023 "To be defined";
CM_ SG_ 308 RR_Velocity_018 "Relative radial velocity of point_018";
CM_ SG_ 308 RR_Velocity_019 "Relative radial velocity of point_019";
CM_ SG_ 308 RR_Velocity_020 "Relative radial velocity of point_020";
CM_ SG_ 308 RR_Velocity_021 "Relative radial velocity of point_021";
CM_ SG_ 308 RR_Velocity_022 "Relative radial velocity of point_022";
CM_ SG_ 308 RR_Velocity_023 "Relative radial velocity of point_023";
CM_ SG_ 309 RR_AzimuthAng_024 "Azimuth angle of point_024";
CM_ SG_ 309 RR_AzimuthAng_025 "Azimuth angle of point_025";
CM_ SG_ 309 RR_AzimuthAng_026 "Azimuth angle of point_026";
CM_ SG_ 309 RR_AzimuthAng_027 "Azimuth angle of point_027";
CM_ SG_ 309 RR_AzimuthAng_028 "Azimuth angle of point_028";
CM_ SG_ 309 RR_AzimuthAng_029 "Azimuth angle of point_029";
CM_ SG_ 309 RR_AzimuthSNR_024 "Azimuth SNR of point_024";
CM_ SG_ 309 RR_AzimuthSNR_025 "Azimuth SNR of point_025";
CM_ SG_ 309 RR_AzimuthSNR_026 "Azimuth SNR of point_026";
CM_ SG_ 309 RR_AzimuthSNR_027 "Azimuth SNR of point_027";
CM_ SG_ 309 RR_AzimuthSNR_028 "Azimuth SNR of point_028";
CM_ SG_ 309 RR_AzimuthSNR_029 "Azimuth SNR of point_029";
CM_ SG_ 309 RR_ElevationAng_024 "Elevation angle of point_024";
CM_ SG_ 309 RR_ElevationAng_025 "Elevation angle of point_025";
CM_ SG_ 309 RR_ElevationAng_026 "Elevation angle of point_026";
CM_ SG_ 309 RR_ElevationAng_027 "Elevation angle of point_027";
CM_ SG_ 309 RR_ElevationAng_028 "Elevation angle of point_028";
CM_ SG_ 309 RR_ElevationAng_029 "Elevation angle of point_029";
CM_ SG_ 309 RR_ElevationSNR_024 "Elevation SNR of point_024";
CM_ SG_ 309 RR_ElevationSNR_025 "Elevation SNR of point_025";
CM_ SG_ 309 RR_ElevationSNR_026 "Elevation SNR of point_026";
CM_ SG_ 309 RR_ElevationSNR_027 "Elevation SNR of point_027";
CM_ SG_ 309 RR_ElevationSNR_028 "Elevation SNR of point_028";
CM_ SG_ 309 RR_ElevationSNR_029 "Elevation SNR of point_029";
CM_ SG_ 309 RR_Range_024 "Range of point_024";
CM_ SG_ 309 RR_Range_025 "Range of point_025";
CM_ SG_ 309 RR_Range_026 "Range of point_026";
CM_ SG_ 309 RR_Range_027 "Range of point_027";
CM_ SG_ 309 RR_Range_028 "Range of point_028";
CM_ SG_ 309 RR_Range_029 "Range of point_029";
CM_ SG_ 309 RR_RCS_024 "RCS of point_024";
CM_ SG_ 309 RR_RCS_025 "RCS of point_025";
CM_ SG_ 309 RR_RCS_026 "RCS of point_026";
CM_ SG_ 309 RR_RCS_027 "RCS of point_027";
CM_ SG_ 309 RR_RCS_028 "RCS of point_028";
CM_ SG_ 309 RR_RCS_029 "RCS of point_029";
CM_ SG_ 309 RR_Status_024 "Status of point_024";
CM_ SG_ 309 RR_Status_025 "Status of point_025";
CM_ SG_ 309 RR_Status_026 "Status of point_026";
CM_ SG_ 309 RR_Status_027 "Status of point_027";
CM_ SG_ 309 RR_Status_028 "Status of point_028";
CM_ SG_ 309 RR_Status_029 "Status of point_029";
CM_ SG_ 309 RR_Tbd_024 "To be defined";
CM_ SG_ 309 RR_Tbd_025 "To be defined";
CM_ SG_ 309 RR_Tbd_026 "To be defined";
CM_ SG_ 309 RR_Tbd_027 "To be defined";
CM_ SG_ 309 RR_Tbd_028 "To be defined";
CM_ SG_ 309 RR_Tbd_029 "To be defined";
CM_ SG_ 309 RR_Velocity_024 "Relative radial velocity of point_024";
CM_ SG_ 309 RR_Velocity_025 "Relative radial velocity of point_025";
CM_ SG_ 309 RR_Velocity_026 "Relative radial velocity of point_026";
CM_ SG_ 309 RR_Velocity_027 "Relative radial velocity of point_027";
CM_ SG_ 309 RR_Velocity_028 "Relative radial velocity of point_028";
CM_ SG_ 309 RR_Velocity_029 "Relative radial velocity of point_029";
CM_ SG_ 310 RR_AzimuthAng_030 "Azimuth angle of point_030";
CM_ SG_ 310 RR_AzimuthAng_031 "Azimuth angle of point_031";
CM_ SG_ 310 RR_AzimuthAng_032 "Azimuth angle of point_032";
CM_ SG_ 310 RR_AzimuthAng_033 "Azimuth angle of point_033";
CM_ SG_ 310 RR_AzimuthAng_034 "Azimuth angle of point_034";
CM_ SG_ 310 RR_AzimuthAng_035 "Azimuth angle of point_035";
CM_ SG_ 310 RR_AzimuthSNR_030 "Azimuth SNR of point_030";
CM_ SG_ 310 RR_AzimuthSNR_031 "Azimuth SNR of point_031";
CM_ SG_ 310 RR_AzimuthSNR_032 "Azimuth SNR of point_032";
CM_ SG_ 310 RR_AzimuthSNR_033 "Azimuth SNR of point_033";
CM_ SG_ 310 RR_AzimuthSNR_034 "Azimuth SNR of point_034";
CM_ SG_ 310 RR_AzimuthSNR_035 "Azimuth SNR of point_035";
CM_ SG_ 310 RR_ElevationAng_030 "Elevation angle of point_030";
CM_ SG_ 310 RR_ElevationAng_031 "Elevation angle of point_031";
CM_ SG_ 310 RR_ElevationAng_032 "Elevation angle of point_032";
CM_ SG_ 310 RR_ElevationAng_033 "Elevation angle of point_033";
CM_ SG_ 310 RR_ElevationAng_034 "Elevation angle of point_034";
CM_ SG_ 310 RR_ElevationAng_035 "Elevation angle of point_035";
CM_ SG_ 310 RR_ElevationSNR_030 "Elevation SNR of point_030";
CM_ SG_ 310 RR_ElevationSNR_031 "Elevation SNR of point_031";
CM_ SG_ 310 RR_ElevationSNR_032 "Elevation SNR of point_032";
CM_ SG_ 310 RR_ElevationSNR_033 "Elevation SNR of point_033";
CM_ SG_ 310 RR_ElevationSNR_034 "Elevation SNR of point_034";
CM_ SG_ 310 RR_ElevationSNR_035 "Elevation SNR of point_035";
CM_ SG_ 310 RR_Range_030 "Range of point_030";
CM_ SG_ 310 RR_Range_031 "Range of point_031";
CM_ SG_ 310 RR_Range_032 "Range of point_032";
CM_ SG_ 310 RR_Range_033 "Range of point_033";
CM_ SG_ 310 RR_Range_034 "Range of point_034";
CM_ SG_ 310 RR_Range_035 "Range of point_035";
CM_ SG_ 310 RR_RCS_030 "RCS of point_030";
CM_ SG_ 310 RR_RCS_031 "RCS of point_031";
CM_ SG_ 310 RR_RCS_032 "RCS of point_032";
CM_ SG_ 310 RR_RCS_033 "RCS of point_033";
CM_ SG_ 310 RR_RCS_034 "RCS of point_034";
CM_ SG_ 310 RR_RCS_035 "RCS of point_035";
CM_ SG_ 310 RR_Status_030 "Status of point_030";
CM_ SG_ 310 RR_Status_031 "Status of point_031";
CM_ SG_ 310 RR_Status_032 "Status of point_032";
CM_ SG_ 310 RR_Status_033 "Status of point_033";
CM_ SG_ 310 RR_Status_034 "Status of point_034";
CM_ SG_ 310 RR_Status_035 "Status of point_035";
CM_ SG_ 310 RR_Tbd_030 "To be defined";
CM_ SG_ 310 RR_Tbd_031 "To be defined";
CM_ SG_ 310 RR_Tbd_032 "To be defined";
CM_ SG_ 310 RR_Tbd_033 "To be defined";
CM_ SG_ 310 RR_Tbd_034 "To be defined";
CM_ SG_ 310 RR_Tbd_035 "To be defined";
CM_ SG_ 310 RR_Velocity_030 "Relative radial velocity of point_030";
CM_ SG_ 310 RR_Velocity_031 "Relative radial velocity of point_031";
CM_ SG_ 310 RR_Velocity_032 "Relative radial velocity of point_032";
CM_ SG_ 310 RR_Velocity_033 "Relative radial velocity of point_033";
CM_ SG_ 310 RR_Velocity_034 "Relative radial velocity of point_034";
CM_ SG_ 310 RR_Velocity_035 "Relative radial velocity of point_035";
CM_ SG_ 311 RR_AzimuthAng_036 "Azimuth angle of point_036";
CM_ SG_ 311 RR_AzimuthAng_037 "Azimuth angle of point_037";
CM_ SG_ 311 RR_AzimuthAng_038 "Azimuth angle of point_038";
CM_ SG_ 311 RR_AzimuthAng_039 "Azimuth angle of point_039";
CM_ SG_ 311 RR_AzimuthAng_040 "Azimuth angle of point_040";
CM_ SG_ 311 RR_AzimuthAng_041 "Azimuth angle of point_041";
CM_ SG_ 311 RR_AzimuthSNR_036 "Azimuth SNR of point_036";
CM_ SG_ 311 RR_AzimuthSNR_037 "Azimuth SNR of point_037";
CM_ SG_ 311 RR_AzimuthSNR_038 "Azimuth SNR of point_038";
CM_ SG_ 311 RR_AzimuthSNR_039 "Azimuth SNR of point_039";
CM_ SG_ 311 RR_AzimuthSNR_040 "Azimuth SNR of point_040";
CM_ SG_ 311 RR_AzimuthSNR_041 "Azimuth SNR of point_041";
CM_ SG_ 311 RR_ElevationAng_036 "Elevation angle of point_036";
CM_ SG_ 311 RR_ElevationAng_037 "Elevation angle of point_037";
CM_ SG_ 311 RR_ElevationAng_038 "Elevation angle of point_038";
CM_ SG_ 311 RR_ElevationAng_039 "Elevation angle of point_039";
CM_ SG_ 311 RR_ElevationAng_040 "Elevation angle of point_040";
CM_ SG_ 311 RR_ElevationAng_041 "Elevation angle of point_041";
CM_ SG_ 311 RR_ElevationSNR_036 "Elevation SNR of point_036";
CM_ SG_ 311 RR_ElevationSNR_037 "Elevation SNR of point_037";
CM_ SG_ 311 RR_ElevationSNR_038 "Elevation SNR of point_038";
CM_ SG_ 311 RR_ElevationSNR_039 "Elevation SNR of point_039";
CM_ SG_ 311 RR_ElevationSNR_040 "Elevation SNR of point_040";
CM_ SG_ 311 RR_ElevationSNR_041 "Elevation SNR of point_041";
CM_ SG_ 311 RR_Range_036 "Range of point_036";
CM_ SG_ 311 RR_Range_037 "Range of point_037";
CM_ SG_ 311 RR_Range_038 "Range of point_038";
CM_ SG_ 311 RR_Range_039 "Range of point_039";
CM_ SG_ 311 RR_Range_040 "Range of point_040";
CM_ SG_ 311 RR_Range_041 "Range of point_041";
CM_ SG_ 311 RR_RCS_036 "RCS of point_036";
CM_ SG_ 311 RR_RCS_037 "RCS of point_037";
CM_ SG_ 311 RR_RCS_038 "RCS of point_038";
CM_ SG_ 311 RR_RCS_039 "RCS of point_039";
CM_ SG_ 311 RR_RCS_040 "RCS of point_040";
CM_ SG_ 311 RR_RCS_041 "RCS of point_041";
CM_ SG_ 311 RR_Status_036 "Status of point_036";
CM_ SG_ 311 RR_Status_037 "Status of point_037";
CM_ SG_ 311 RR_Status_038 "Status of point_038";
CM_ SG_ 311 RR_Status_039 "Status of point_039";
CM_ SG_ 311 RR_Status_040 "Status of point_040";
CM_ SG_ 311 RR_Status_041 "Status of point_041";
CM_ SG_ 311 RR_Tbd_036 "To be defined";
CM_ SG_ 311 RR_Tbd_037 "To be defined";
CM_ SG_ 311 RR_Tbd_038 "To be defined";
CM_ SG_ 311 RR_Tbd_039 "To be defined";
CM_ SG_ 311 RR_Tbd_040 "To be defined";
CM_ SG_ 311 RR_Tbd_041 "To be defined";
CM_ SG_ 311 RR_Velocity_036 "Relative radial velocity of point_036";
CM_ SG_ 311 RR_Velocity_037 "Relative radial velocity of point_037";
CM_ SG_ 311 RR_Velocity_038 "Relative radial velocity of point_038";
CM_ SG_ 311 RR_Velocity_039 "Relative radial velocity of point_039";
CM_ SG_ 311 RR_Velocity_040 "Relative radial velocity of point_040";
CM_ SG_ 311 RR_Velocity_041 "Relative radial velocity of point_041";
CM_ SG_ 312 RR_AzimuthAng_042 "Azimuth angle of point_042";
CM_ SG_ 312 RR_AzimuthAng_043 "Azimuth angle of point_043";
CM_ SG_ 312 RR_AzimuthAng_044 "Azimuth angle of point_044";
CM_ SG_ 312 RR_AzimuthAng_045 "Azimuth angle of point_045";
CM_ SG_ 312 RR_AzimuthAng_046 "Azimuth angle of point_046";
CM_ SG_ 312 RR_AzimuthAng_047 "Azimuth angle of point_047";
CM_ SG_ 312 RR_AzimuthSNR_042 "Azimuth SNR of point_042";
CM_ SG_ 312 RR_AzimuthSNR_043 "Azimuth SNR of point_043";
CM_ SG_ 312 RR_AzimuthSNR_044 "Azimuth SNR of point_044";
CM_ SG_ 312 RR_AzimuthSNR_045 "Azimuth SNR of point_045";
CM_ SG_ 312 RR_AzimuthSNR_046 "Azimuth SNR of point_046";
CM_ SG_ 312 RR_AzimuthSNR_047 "Azimuth SNR of point_047";
CM_ SG_ 312 RR_ElevationAng_042 "Elevation angle of point_042";
CM_ SG_ 312 RR_ElevationAng_043 "Elevation angle of point_043";
CM_ SG_ 312 RR_ElevationAng_044 "Elevation angle of point_044";
CM_ SG_ 312 RR_ElevationAng_045 "Elevation angle of point_045";
CM_ SG_ 312 RR_ElevationAng_046 "Elevation angle of point_046";
CM_ SG_ 312 RR_ElevationAng_047 "Elevation angle of point_047";
CM_ SG_ 312 RR_ElevationSNR_042 "Elevation SNR of point_042";
CM_ SG_ 312 RR_ElevationSNR_043 "Elevation SNR of point_043";
CM_ SG_ 312 RR_ElevationSNR_044 "Elevation SNR of point_044";
CM_ SG_ 312 RR_ElevationSNR_045 "Elevation SNR of point_045";
CM_ SG_ 312 RR_ElevationSNR_046 "Elevation SNR of point_046";
CM_ SG_ 312 RR_ElevationSNR_047 "Elevation SNR of point_047";
CM_ SG_ 312 RR_Range_042 "Range of point_042";
CM_ SG_ 312 RR_Range_043 "Range of point_043";
CM_ SG_ 312 RR_Range_044 "Range of point_044";
CM_ SG_ 312 RR_Range_045 "Range of point_045";
CM_ SG_ 312 RR_Range_046 "Range of point_046";
CM_ SG_ 312 RR_Range_047 "Range of point_047";
CM_ SG_ 312 RR_RCS_042 "RCS of point_042";
CM_ SG_ 312 RR_RCS_043 "RCS of point_043";
CM_ SG_ 312 RR_RCS_044 "RCS of point_044";
CM_ SG_ 312 RR_RCS_045 "RCS of point_045";
CM_ SG_ 312 RR_RCS_046 "RCS of point_046";
CM_ SG_ 312 RR_RCS_047 "RCS of point_047";
CM_ SG_ 312 RR_Status_042 "Status of point_042";
CM_ SG_ 312 RR_Status_043 "Status of point_043";
CM_ SG_ 312 RR_Status_044 "Status of point_044";
CM_ SG_ 312 RR_Status_045 "Status of point_045";
CM_ SG_ 312 RR_Status_046 "Status of point_046";
CM_ SG_ 312 RR_Status_047 "Status of point_047";
CM_ SG_ 312 RR_Tbd_042 "To be defined";
CM_ SG_ 312 RR_Tbd_043 "To be defined";
CM_ SG_ 312 RR_Tbd_044 "To be defined";
CM_ SG_ 312 RR_Tbd_045 "To be defined";
CM_ SG_ 312 RR_Tbd_046 "To be defined";
CM_ SG_ 312 RR_Tbd_047 "To be defined";
CM_ SG_ 312 RR_Velocity_042 "Relative radial velocity of point_042";
CM_ SG_ 312 RR_Velocity_043 "Relative radial velocity of point_043";
CM_ SG_ 312 RR_Velocity_044 "Relative radial velocity of point_044";
CM_ SG_ 312 RR_Velocity_045 "Relative radial velocity of point_045";
CM_ SG_ 312 RR_Velocity_046 "Relative radial velocity of point_046";
CM_ SG_ 312 RR_Velocity_047 "Relative radial velocity of point_047";
CM_ SG_ 313 RR_AzimuthAng_048 "Azimuth angle of point_048";
CM_ SG_ 313 RR_AzimuthAng_049 "Azimuth angle of point_049";
CM_ SG_ 313 RR_AzimuthAng_050 "Azimuth angle of point_050";
CM_ SG_ 313 RR_AzimuthAng_051 "Azimuth angle of point_051";
CM_ SG_ 313 RR_AzimuthAng_052 "Azimuth angle of point_052";
CM_ SG_ 313 RR_AzimuthAng_053 "Azimuth angle of point_053";
CM_ SG_ 313 RR_AzimuthSNR_048 "Azimuth SNR of point_048";
CM_ SG_ 313 RR_AzimuthSNR_049 "Azimuth SNR of point_049";
CM_ SG_ 313 RR_AzimuthSNR_050 "Azimuth SNR of point_050";
CM_ SG_ 313 RR_AzimuthSNR_051 "Azimuth SNR of point_051";
CM_ SG_ 313 RR_AzimuthSNR_052 "Azimuth SNR of point_052";
CM_ SG_ 313 RR_AzimuthSNR_053 "Azimuth SNR of point_053";
CM_ SG_ 313 RR_ElevationAng_048 "Elevation angle of point_048";
CM_ SG_ 313 RR_ElevationAng_049 "Elevation angle of point_049";
CM_ SG_ 313 RR_ElevationAng_050 "Elevation angle of point_050";
CM_ SG_ 313 RR_ElevationAng_051 "Elevation angle of point_051";
CM_ SG_ 313 RR_ElevationAng_052 "Elevation angle of point_052";
CM_ SG_ 313 RR_ElevationAng_053 "Elevation angle of point_053";
CM_ SG_ 313 RR_ElevationSNR_048 "Elevation SNR of point_048";
CM_ SG_ 313 RR_ElevationSNR_049 "Elevation SNR of point_049";
CM_ SG_ 313 RR_ElevationSNR_050 "Elevation SNR of point_050";
CM_ SG_ 313 RR_ElevationSNR_051 "Elevation SNR of point_051";
CM_ SG_ 313 RR_ElevationSNR_052 "Elevation SNR of point_052";
CM_ SG_ 313 RR_ElevationSNR_053 "Elevation SNR of point_053";
CM_ SG_ 313 RR_Range_048 "Range of point_048";
CM_ SG_ 313 RR_Range_049 "Range of point_049";
CM_ SG_ 313 RR_Range_050 "Range of point_050";
CM_ SG_ 313 RR_Range_051 "Range of point_051";
CM_ SG_ 313 RR_Range_052 "Range of point_052";
CM_ SG_ 313 RR_Range_053 "Range of point_053";
CM_ SG_ 313 RR_RCS_048 "RCS of point_048";
CM_ SG_ 313 RR_RCS_049 "RCS of point_049";
CM_ SG_ 313 RR_RCS_050 "RCS of point_050";
CM_ SG_ 313 RR_RCS_051 "RCS of point_051";
CM_ SG_ 313 RR_RCS_052 "RCS of point_052";
CM_ SG_ 313 RR_RCS_053 "RCS of point_053";
CM_ SG_ 313 RR_Status_048 "Status of point_048";
CM_ SG_ 313 RR_Status_049 "Status of point_049";
CM_ SG_ 313 RR_Status_050 "Status of point_050";
CM_ SG_ 313 RR_Status_051 "Status of point_051";
CM_ SG_ 313 RR_Status_052 "Status of point_052";
CM_ SG_ 313 RR_Status_053 "Status of point_053";
CM_ SG_ 313 RR_Tbd_048 "To be defined";
CM_ SG_ 313 RR_Tbd_049 "To be defined";
CM_ SG_ 313 RR_Tbd_050 "To be defined";
CM_ SG_ 313 RR_Tbd_051 "To be defined";
CM_ SG_ 313 RR_Tbd_052 "To be defined";
CM_ SG_ 313 RR_Tbd_053 "To be defined";
CM_ SG_ 313 RR_Velocity_048 "Relative radial velocity of point_048";
CM_ SG_ 313 RR_Velocity_049 "Relative radial velocity of point_049";
CM_ SG_ 313 RR_Velocity_050 "Relative radial velocity of point_050";
CM_ SG_ 313 RR_Velocity_051 "Relative radial velocity of point_051";
CM_ SG_ 313 RR_Velocity_052 "Relative radial velocity of point_052";
CM_ SG_ 313 RR_Velocity_053 "Relative radial velocity of point_053";
CM_ SG_ 314 RR_AzimuthAng_054 "Azimuth angle of point_054";
CM_ SG_ 314 RR_AzimuthAng_055 "Azimuth angle of point_055";
CM_ SG_ 314 RR_AzimuthAng_056 "Azimuth angle of point_056";
CM_ SG_ 314 RR_AzimuthAng_057 "Azimuth angle of point_057";
CM_ SG_ 314 RR_AzimuthAng_058 "Azimuth angle of point_058";
CM_ SG_ 314 RR_AzimuthAng_059 "Azimuth angle of point_059";
CM_ SG_ 314 RR_AzimuthSNR_054 "Azimuth SNR of point_054";
CM_ SG_ 314 RR_AzimuthSNR_055 "Azimuth SNR of point_055";
CM_ SG_ 314 RR_AzimuthSNR_056 "Azimuth SNR of point_056";
CM_ SG_ 314 RR_AzimuthSNR_057 "Azimuth SNR of point_057";
CM_ SG_ 314 RR_AzimuthSNR_058 "Azimuth SNR of point_058";
CM_ SG_ 314 RR_AzimuthSNR_059 "Azimuth SNR of point_059";
CM_ SG_ 314 RR_ElevationAng_054 "Elevation angle of point_054";
CM_ SG_ 314 RR_ElevationAng_055 "Elevation angle of point_055";
CM_ SG_ 314 RR_ElevationAng_056 "Elevation angle of point_056";
CM_ SG_ 314 RR_ElevationAng_057 "Elevation angle of point_057";
CM_ SG_ 314 RR_ElevationAng_058 "Elevation angle of point_058";
CM_ SG_ 314 RR_ElevationAng_059 "Elevation angle of point_059";
CM_ SG_ 314 RR_ElevationSNR_054 "Elevation SNR of point_054";
CM_ SG_ 314 RR_ElevationSNR_055 "Elevation SNR of point_055";
CM_ SG_ 314 RR_ElevationSNR_056 "Elevation SNR of point_056";
CM_ SG_ 314 RR_ElevationSNR_057 "Elevation SNR of point_057";
CM_ SG_ 314 RR_ElevationSNR_058 "Elevation SNR of point_058";
CM_ SG_ 314 RR_ElevationSNR_059 "Elevation SNR of point_059";
CM_ SG_ 314 RR_Range_054 "Range of point_054";
CM_ SG_ 314 RR_Range_055 "Range of point_055";
CM_ SG_ 314 RR_Range_056 "Range of point_056";
CM_ SG_ 314 RR_Range_057 "Range of point_057";
CM_ SG_ 314 RR_Range_058 "Range of point_058";
CM_ SG_ 314 RR_Range_059 "Range of point_059";
CM_ SG_ 314 RR_RCS_054 "RCS of point_054";
CM_ SG_ 314 RR_RCS_055 "RCS of point_055";
CM_ SG_ 314 RR_RCS_056 "RCS of point_056";
CM_ SG_ 314 RR_RCS_057 "RCS of point_057";
CM_ SG_ 314 RR_RCS_058 "RCS of point_058";
CM_ SG_ 314 RR_RCS_059 "RCS of point_059";
CM_ SG_ 314 RR_Status_054 "Status of point_054";
CM_ SG_ 314 RR_Status_055 "Status of point_055";
CM_ SG_ 314 RR_Status_056 "Status of point_056";
CM_ SG_ 314 RR_Status_057 "Status of point_057";
CM_ SG_ 314 RR_Status_058 "Status of point_058";
CM_ SG_ 314 RR_Status_059 "Status of point_059";
CM_ SG_ 314 RR_Tbd_054 "To be defined";
CM_ SG_ 314 RR_Tbd_055 "To be defined";
CM_ SG_ 314 RR_Tbd_056 "To be defined";
CM_ SG_ 314 RR_Tbd_057 "To be defined";
CM_ SG_ 314 RR_Tbd_058 "To be defined";
CM_ SG_ 314 RR_Tbd_059 "To be defined";
CM_ SG_ 314 RR_Velocity_054 "Relative radial velocity of point_054";
CM_ SG_ 314 RR_Velocity_055 "Relative radial velocity of point_055";
CM_ SG_ 314 RR_Velocity_056 "Relative radial velocity of point_056";
CM_ SG_ 314 RR_Velocity_057 "Relative radial velocity of point_057";
CM_ SG_ 314 RR_Velocity_058 "Relative radial velocity of point_058";
CM_ SG_ 314 RR_Velocity_059 "Relative radial velocity of point_059";
CM_ SG_ 315 RR_AzimuthAng_060 "Azimuth angle of point_060";
CM_ SG_ 315 RR_AzimuthAng_061 "Azimuth angle of point_061";
CM_ SG_ 315 RR_AzimuthAng_062 "Azimuth angle of point_062";
CM_ SG_ 315 RR_AzimuthAng_063 "Azimuth angle of point_063";
CM_ SG_ 315 RR_AzimuthAng_064 "Azimuth angle of point_064";
CM_ SG_ 315 RR_AzimuthAng_065 "Azimuth angle of point_065";
CM_ SG_ 315 RR_AzimuthSNR_060 "Azimuth SNR of point_060";
CM_ SG_ 315 RR_AzimuthSNR_061 "Azimuth SNR of point_061";
CM_ SG_ 315 RR_AzimuthSNR_062 "Azimuth SNR of point_062";
CM_ SG_ 315 RR_AzimuthSNR_063 "Azimuth SNR of point_063";
CM_ SG_ 315 RR_AzimuthSNR_064 "Azimuth SNR of point_064";
CM_ SG_ 315 RR_AzimuthSNR_065 "Azimuth SNR of point_065";
CM_ SG_ 315 RR_ElevationAng_060 "Elevation angle of point_060";
CM_ SG_ 315 RR_ElevationAng_061 "Elevation angle of point_061";
CM_ SG_ 315 RR_ElevationAng_062 "Elevation angle of point_062";
CM_ SG_ 315 RR_ElevationAng_063 "Elevation angle of point_063";
CM_ SG_ 315 RR_ElevationAng_064 "Elevation angle of point_064";
CM_ SG_ 315 RR_ElevationAng_065 "Elevation angle of point_065";
CM_ SG_ 315 RR_ElevationSNR_060 "Elevation SNR of point_060";
CM_ SG_ 315 RR_ElevationSNR_061 "Elevation SNR of point_061";
CM_ SG_ 315 RR_ElevationSNR_062 "Elevation SNR of point_062";
CM_ SG_ 315 RR_ElevationSNR_063 "Elevation SNR of point_063";
CM_ SG_ 315 RR_ElevationSNR_064 "Elevation SNR of point_064";
CM_ SG_ 315 RR_ElevationSNR_065 "Elevation SNR of point_065";
CM_ SG_ 315 RR_Range_060 "Range of point_060";
CM_ SG_ 315 RR_Range_061 "Range of point_061";
CM_ SG_ 315 RR_Range_062 "Range of point_062";
CM_ SG_ 315 RR_Range_063 "Range of point_063";
CM_ SG_ 315 RR_Range_064 "Range of point_064";
CM_ SG_ 315 RR_Range_065 "Range of point_065";
CM_ SG_ 315 RR_RCS_060 "RCS of point_060";
CM_ SG_ 315 RR_RCS_061 "RCS of point_061";
CM_ SG_ 315 RR_RCS_062 "RCS of point_062";
CM_ SG_ 315 RR_RCS_063 "RCS of point_063";
CM_ SG_ 315 RR_RCS_064 "RCS of point_064";
CM_ SG_ 315 RR_RCS_065 "RCS of point_065";
CM_ SG_ 315 RR_Status_060 "Status of point_060";
CM_ SG_ 315 RR_Status_061 "Status of point_061";
CM_ SG_ 315 RR_Status_062 "Status of point_062";
CM_ SG_ 315 RR_Status_063 "Status of point_063";
CM_ SG_ 315 RR_Status_064 "Status of point_064";
CM_ SG_ 315 RR_Status_065 "Status of point_065";
CM_ SG_ 315 RR_Tbd_060 "To be defined";
CM_ SG_ 315 RR_Tbd_061 "To be defined";
CM_ SG_ 315 RR_Tbd_062 "To be defined";
CM_ SG_ 315 RR_Tbd_063 "To be defined";
CM_ SG_ 315 RR_Tbd_064 "To be defined";
CM_ SG_ 315 RR_Tbd_065 "To be defined";
CM_ SG_ 315 RR_Velocity_060 "Relative radial velocity of point_060";
CM_ SG_ 315 RR_Velocity_061 "Relative radial velocity of point_061";
CM_ SG_ 315 RR_Velocity_062 "Relative radial velocity of point_062";
CM_ SG_ 315 RR_Velocity_063 "Relative radial velocity of point_063";
CM_ SG_ 315 RR_Velocity_064 "Relative radial velocity of point_064";
CM_ SG_ 315 RR_Velocity_065 "Relative radial velocity of point_065";
CM_ SG_ 316 RR_AzimuthAng_066 "Azimuth angle of point_066";
CM_ SG_ 316 RR_AzimuthAng_067 "Azimuth angle of point_067";
CM_ SG_ 316 RR_AzimuthAng_068 "Azimuth angle of point_068";
CM_ SG_ 316 RR_AzimuthAng_069 "Azimuth angle of point_069";
CM_ SG_ 316 RR_AzimuthAng_070 "Azimuth angle of point_070";
CM_ SG_ 316 RR_AzimuthAng_071 "Azimuth angle of point_071";
CM_ SG_ 316 RR_AzimuthSNR_066 "Azimuth SNR of point_066";
CM_ SG_ 316 RR_AzimuthSNR_067 "Azimuth SNR of point_067";
CM_ SG_ 316 RR_AzimuthSNR_068 "Azimuth SNR of point_068";
CM_ SG_ 316 RR_AzimuthSNR_069 "Azimuth SNR of point_069";
CM_ SG_ 316 RR_AzimuthSNR_070 "Azimuth SNR of point_070";
CM_ SG_ 316 RR_AzimuthSNR_071 "Azimuth SNR of point_071";
CM_ SG_ 316 RR_ElevationAng_066 "Elevation angle of point_066";
CM_ SG_ 316 RR_ElevationAng_067 "Elevation angle of point_067";
CM_ SG_ 316 RR_ElevationAng_068 "Elevation angle of point_068";
CM_ SG_ 316 RR_ElevationAng_069 "Elevation angle of point_069";
CM_ SG_ 316 RR_ElevationAng_070 "Elevation angle of point_070";
CM_ SG_ 316 RR_ElevationAng_071 "Elevation angle of point_071";
CM_ SG_ 316 RR_ElevationSNR_066 "Elevation SNR of point_066";
CM_ SG_ 316 RR_ElevationSNR_067 "Elevation SNR of point_067";
CM_ SG_ 316 RR_ElevationSNR_068 "Elevation SNR of point_068";
CM_ SG_ 316 RR_ElevationSNR_069 "Elevation SNR of point_069";
CM_ SG_ 316 RR_ElevationSNR_070 "Elevation SNR of point_070";
CM_ SG_ 316 RR_ElevationSNR_071 "Elevation SNR of point_071";
CM_ SG_ 316 RR_Range_066 "Range of point_066";
CM_ SG_ 316 RR_Range_067 "Range of point_067";
CM_ SG_ 316 RR_Range_068 "Range of point_068";
CM_ SG_ 316 RR_Range_069 "Range of point_069";
CM_ SG_ 316 RR_Range_070 "Range of point_070";
CM_ SG_ 316 RR_Range_071 "Range of point_071";
CM_ SG_ 316 RR_RCS_066 "RCS of point_066";
CM_ SG_ 316 RR_RCS_067 "RCS of point_067";
CM_ SG_ 316 RR_RCS_068 "RCS of point_068";
CM_ SG_ 316 RR_RCS_069 "RCS of point_069";
CM_ SG_ 316 RR_RCS_070 "RCS of point_070";
CM_ SG_ 316 RR_RCS_071 "RCS of point_071";
CM_ SG_ 316 RR_Status_066 "Status of point_066";
CM_ SG_ 316 RR_Status_067 "Status of point_067";
CM_ SG_ 316 RR_Status_068 "Status of point_068";
CM_ SG_ 316 RR_Status_069 "Status of point_069";
CM_ SG_ 316 RR_Status_070 "Status of point_070";
CM_ SG_ 316 RR_Status_071 "Status of point_071";
CM_ SG_ 316 RR_Tbd_066 "To be defined";
CM_ SG_ 316 RR_Tbd_067 "To be defined";
CM_ SG_ 316 RR_Tbd_068 "To be defined";
CM_ SG_ 316 RR_Tbd_069 "To be defined";
CM_ SG_ 316 RR_Tbd_070 "To be defined";
CM_ SG_ 316 RR_Tbd_071 "To be defined";
CM_ SG_ 316 RR_Velocity_066 "Relative radial velocity of point_066";
CM_ SG_ 316 RR_Velocity_067 "Relative radial velocity of point_067";
CM_ SG_ 316 RR_Velocity_068 "Relative radial velocity of point_068";
CM_ SG_ 316 RR_Velocity_069 "Relative radial velocity of point_069";
CM_ SG_ 316 RR_Velocity_070 "Relative radial velocity of point_070";
CM_ SG_ 316 RR_Velocity_071 "Relative radial velocity of point_071";
CM_ SG_ 317 RR_AzimuthAng_072 "Azimuth angle of point_072";
CM_ SG_ 317 RR_AzimuthAng_073 "Azimuth angle of point_073";
CM_ SG_ 317 RR_AzimuthAng_074 "Azimuth angle of point_074";
CM_ SG_ 317 RR_AzimuthAng_075 "Azimuth angle of point_075";
CM_ SG_ 317 RR_AzimuthAng_076 "Azimuth angle of point_076";
CM_ SG_ 317 RR_AzimuthAng_077 "Azimuth angle of point_077";
CM_ SG_ 317 RR_AzimuthSNR_072 "Azimuth SNR of point_072";
CM_ SG_ 317 RR_AzimuthSNR_073 "Azimuth SNR of point_073";
CM_ SG_ 317 RR_AzimuthSNR_074 "Azimuth SNR of point_074";
CM_ SG_ 317 RR_AzimuthSNR_075 "Azimuth SNR of point_075";
CM_ SG_ 317 RR_AzimuthSNR_076 "Azimuth SNR of point_076";
CM_ SG_ 317 RR_AzimuthSNR_077 "Azimuth SNR of point_077";
CM_ SG_ 317 RR_ElevationAng_072 "Elevation angle of point_072";
CM_ SG_ 317 RR_ElevationAng_073 "Elevation angle of point_073";
CM_ SG_ 317 RR_ElevationAng_074 "Elevation angle of point_074";
CM_ SG_ 317 RR_ElevationAng_075 "Elevation angle of point_075";
CM_ SG_ 317 RR_ElevationAng_076 "Elevation angle of point_076";
CM_ SG_ 317 RR_ElevationAng_077 "Elevation angle of point_077";
CM_ SG_ 317 RR_ElevationSNR_072 "Elevation SNR of point_072";
CM_ SG_ 317 RR_ElevationSNR_073 "Elevation SNR of point_073";
CM_ SG_ 317 RR_ElevationSNR_074 "Elevation SNR of point_074";
CM_ SG_ 317 RR_ElevationSNR_075 "Elevation SNR of point_075";
CM_ SG_ 317 RR_ElevationSNR_076 "Elevation SNR of point_076";
CM_ SG_ 317 RR_ElevationSNR_077 "Elevation SNR of point_077";
CM_ SG_ 317 RR_Range_072 "Range of point_072";
CM_ SG_ 317 RR_Range_073 "Range of point_073";
CM_ SG_ 317 RR_Range_074 "Range of point_074";
CM_ SG_ 317 RR_Range_075 "Range of point_075";
CM_ SG_ 317 RR_Range_076 "Range of point_076";
CM_ SG_ 317 RR_Range_077 "Range of point_077";
CM_ SG_ 317 RR_RCS_072 "RCS of point_072";
CM_ SG_ 317 RR_RCS_073 "RCS of point_073";
CM_ SG_ 317 RR_RCS_074 "RCS of point_074";
CM_ SG_ 317 RR_RCS_075 "RCS of point_075";
CM_ SG_ 317 RR_RCS_076 "RCS of point_076";
CM_ SG_ 317 RR_RCS_077 "RCS of point_077";
CM_ SG_ 317 RR_Status_072 "Status of point_072";
CM_ SG_ 317 RR_Status_073 "Status of point_073";
CM_ SG_ 317 RR_Status_074 "Status of point_074";
CM_ SG_ 317 RR_Status_075 "Status of point_075";
CM_ SG_ 317 RR_Status_076 "Status of point_076";
CM_ SG_ 317 RR_Status_077 "Status of point_077";
CM_ SG_ 317 RR_Tbd_072 "To be defined";
CM_ SG_ 317 RR_Tbd_073 "To be defined";
CM_ SG_ 317 RR_Tbd_074 "To be defined";
CM_ SG_ 317 RR_Tbd_075 "To be defined";
CM_ SG_ 317 RR_Tbd_076 "To be defined";
CM_ SG_ 317 RR_Tbd_077 "To be defined";
CM_ SG_ 317 RR_Velocity_072 "Relative radial velocity of point_072";
CM_ SG_ 317 RR_Velocity_073 "Relative radial velocity of point_073";
CM_ SG_ 317 RR_Velocity_074 "Relative radial velocity of point_074";
CM_ SG_ 317 RR_Velocity_075 "Relative radial velocity of point_075";
CM_ SG_ 317 RR_Velocity_076 "Relative radial velocity of point_076";
CM_ SG_ 317 RR_Velocity_077 "Relative radial velocity of point_077";
CM_ SG_ 318 RR_AzimuthAng_078 "Azimuth angle of point_078";
CM_ SG_ 318 RR_AzimuthAng_079 "Azimuth angle of point_079";
CM_ SG_ 318 RR_AzimuthAng_080 "Azimuth angle of point_080";
CM_ SG_ 318 RR_AzimuthAng_081 "Azimuth angle of point_081";
CM_ SG_ 318 RR_AzimuthAng_082 "Azimuth angle of point_082";
CM_ SG_ 318 RR_AzimuthAng_083 "Azimuth angle of point_083";
CM_ SG_ 318 RR_AzimuthSNR_078 "Azimuth SNR of point_078";
CM_ SG_ 318 RR_AzimuthSNR_079 "Azimuth SNR of point_079";
CM_ SG_ 318 RR_AzimuthSNR_080 "Azimuth SNR of point_080";
CM_ SG_ 318 RR_AzimuthSNR_081 "Azimuth SNR of point_081";
CM_ SG_ 318 RR_AzimuthSNR_082 "Azimuth SNR of point_082";
CM_ SG_ 318 RR_AzimuthSNR_083 "Azimuth SNR of point_083";
CM_ SG_ 318 RR_ElevationAng_078 "Elevation angle of point_078";
CM_ SG_ 318 RR_ElevationAng_079 "Elevation angle of point_079";
CM_ SG_ 318 RR_ElevationAng_080 "Elevation angle of point_080";
CM_ SG_ 318 RR_ElevationAng_081 "Elevation angle of point_081";
CM_ SG_ 318 RR_ElevationAng_082 "Elevation angle of point_082";
CM_ SG_ 318 RR_ElevationAng_083 "Elevation angle of point_083";
CM_ SG_ 318 RR_ElevationSNR_078 "Elevation SNR of point_078";
CM_ SG_ 318 RR_ElevationSNR_079 "Elevation SNR of point_079";
CM_ SG_ 318 RR_ElevationSNR_080 "Elevation SNR of point_080";
CM_ SG_ 318 RR_ElevationSNR_081 "Elevation SNR of point_081";
CM_ SG_ 318 RR_ElevationSNR_082 "Elevation SNR of point_082";
CM_ SG_ 318 RR_ElevationSNR_083 "Elevation SNR of point_083";
CM_ SG_ 318 RR_Range_078 "Range of point_078";
CM_ SG_ 318 RR_Range_079 "Range of point_079";
CM_ SG_ 318 RR_Range_080 "Range of point_080";
CM_ SG_ 318 RR_Range_081 "Range of point_081";
CM_ SG_ 318 RR_Range_082 "Range of point_082";
CM_ SG_ 318 RR_Range_083 "Range of point_083";
CM_ SG_ 318 RR_RCS_078 "RCS of point_078";
CM_ SG_ 318 RR_RCS_079 "RCS of point_079";
CM_ SG_ 318 RR_RCS_080 "RCS of point_080";
CM_ SG_ 318 RR_RCS_081 "RCS of point_081";
CM_ SG_ 318 RR_RCS_082 "RCS of point_082";
CM_ SG_ 318 RR_RCS_083 "RCS of point_083";
CM_ SG_ 318 RR_Status_078 "Status of point_078";
CM_ SG_ 318 RR_Status_079 "Status of point_079";
CM_ SG_ 318 RR_Status_080 "Status of point_080";
CM_ SG_ 318 RR_Status_081 "Status of point_081";
CM_ SG_ 318 RR_Status_082 "Status of point_082";
CM_ SG_ 318 RR_Status_083 "Status of point_083";
CM_ SG_ 318 RR_Tbd_078 "To be defined";
CM_ SG_ 318 RR_Tbd_079 "To be defined";
CM_ SG_ 318 RR_Tbd_080 "To be defined";
CM_ SG_ 318 RR_Tbd_081 "To be defined";
CM_ SG_ 318 RR_Tbd_082 "To be defined";
CM_ SG_ 318 RR_Tbd_083 "To be defined";
CM_ SG_ 318 RR_Velocity_078 "Relative radial velocity of point_078";
CM_ SG_ 318 RR_Velocity_079 "Relative radial velocity of point_079";
CM_ SG_ 318 RR_Velocity_080 "Relative radial velocity of point_080";
CM_ SG_ 318 RR_Velocity_081 "Relative radial velocity of point_081";
CM_ SG_ 318 RR_Velocity_082 "Relative radial velocity of point_082";
CM_ SG_ 318 RR_Velocity_083 "Relative radial velocity of point_083";
CM_ SG_ 319 RR_AzimuthAng_084 "Azimuth angle of point_084";
CM_ SG_ 319 RR_AzimuthAng_085 "Azimuth angle of point_085";
CM_ SG_ 319 RR_AzimuthAng_086 "Azimuth angle of point_086";
CM_ SG_ 319 RR_AzimuthAng_087 "Azimuth angle of point_087";
CM_ SG_ 319 RR_AzimuthAng_088 "Azimuth angle of point_088";
CM_ SG_ 319 RR_AzimuthAng_089 "Azimuth angle of point_089";
CM_ SG_ 319 RR_AzimuthSNR_084 "Azimuth SNR of point_084";
CM_ SG_ 319 RR_AzimuthSNR_085 "Azimuth SNR of point_085";
CM_ SG_ 319 RR_AzimuthSNR_086 "Azimuth SNR of point_086";
CM_ SG_ 319 RR_AzimuthSNR_087 "Azimuth SNR of point_087";
CM_ SG_ 319 RR_AzimuthSNR_088 "Azimuth SNR of point_088";
CM_ SG_ 319 RR_AzimuthSNR_089 "Azimuth SNR of point_089";
CM_ SG_ 319 RR_ElevationAng_084 "Elevation angle of point_084";
CM_ SG_ 319 RR_ElevationAng_085 "Elevation angle of point_085";
CM_ SG_ 319 RR_ElevationAng_086 "Elevation angle of point_086";
CM_ SG_ 319 RR_ElevationAng_087 "Elevation angle of point_087";
CM_ SG_ 319 RR_ElevationAng_088 "Elevation angle of point_088";
CM_ SG_ 319 RR_ElevationAng_089 "Elevation angle of point_089";
CM_ SG_ 319 RR_ElevationSNR_084 "Elevation SNR of point_084";
CM_ SG_ 319 RR_ElevationSNR_085 "Elevation SNR of point_085";
CM_ SG_ 319 RR_ElevationSNR_086 "Elevation SNR of point_086";
CM_ SG_ 319 RR_ElevationSNR_087 "Elevation SNR of point_087";
CM_ SG_ 319 RR_ElevationSNR_088 "Elevation SNR of point_088";
CM_ SG_ 319 RR_ElevationSNR_089 "Elevation SNR of point_089";
CM_ SG_ 319 RR_Range_084 "Range of point_084";
CM_ SG_ 319 RR_Range_085 "Range of point_085";
CM_ SG_ 319 RR_Range_086 "Range of point_086";
CM_ SG_ 319 RR_Range_087 "Range of point_087";
CM_ SG_ 319 RR_Range_088 "Range of point_088";
CM_ SG_ 319 RR_Range_089 "Range of point_089";
CM_ SG_ 319 RR_RCS_084 "RCS of point_084";
CM_ SG_ 319 RR_RCS_085 "RCS of point_085";
CM_ SG_ 319 RR_RCS_086 "RCS of point_086";
CM_ SG_ 319 RR_RCS_087 "RCS of point_087";
CM_ SG_ 319 RR_RCS_088 "RCS of point_088";
CM_ SG_ 319 RR_RCS_089 "RCS of point_089";
CM_ SG_ 319 RR_Status_084 "Status of point_084";
CM_ SG_ 319 RR_Status_085 "Status of point_085";
CM_ SG_ 319 RR_Status_086 "Status of point_086";
CM_ SG_ 319 RR_Status_087 "Status of point_087";
CM_ SG_ 319 RR_Status_088 "Status of point_088";
CM_ SG_ 319 RR_Status_089 "Status of point_089";
CM_ SG_ 319 RR_Tbd_084 "To be defined";
CM_ SG_ 319 RR_Tbd_085 "To be defined";
CM_ SG_ 319 RR_Tbd_086 "To be defined";
CM_ SG_ 319 RR_Tbd_087 "To be defined";
CM_ SG_ 319 RR_Tbd_088 "To be defined";
CM_ SG_ 319 RR_Tbd_089 "To be defined";
CM_ SG_ 319 RR_Velocity_084 "Relative radial velocity of point_084";
CM_ SG_ 319 RR_Velocity_085 "Relative radial velocity of point_085";
CM_ SG_ 319 RR_Velocity_086 "Relative radial velocity of point_086";
CM_ SG_ 319 RR_Velocity_087 "Relative radial velocity of point_087";
CM_ SG_ 319 RR_Velocity_088 "Relative radial velocity of point_088";
CM_ SG_ 319 RR_Velocity_089 "Relative radial velocity of point_089";
CM_ SG_ 320 RR_AzimuthAng_090 "Azimuth angle of point_090";
CM_ SG_ 320 RR_AzimuthAng_091 "Azimuth angle of point_091";
CM_ SG_ 320 RR_AzimuthAng_092 "Azimuth angle of point_092";
CM_ SG_ 320 RR_AzimuthAng_093 "Azimuth angle of point_093";
CM_ SG_ 320 RR_AzimuthAng_094 "Azimuth angle of point_094";
CM_ SG_ 320 RR_AzimuthAng_095 "Azimuth angle of point_095";
CM_ SG_ 320 RR_AzimuthSNR_090 "Azimuth SNR of point_090";
CM_ SG_ 320 RR_AzimuthSNR_091 "Azimuth SNR of point_091";
CM_ SG_ 320 RR_AzimuthSNR_092 "Azimuth SNR of point_092";
CM_ SG_ 320 RR_AzimuthSNR_093 "Azimuth SNR of point_093";
CM_ SG_ 320 RR_AzimuthSNR_094 "Azimuth SNR of point_094";
CM_ SG_ 320 RR_AzimuthSNR_095 "Azimuth SNR of point_095";
CM_ SG_ 320 RR_ElevationAng_090 "Elevation angle of point_090";
CM_ SG_ 320 RR_ElevationAng_091 "Elevation angle of point_091";
CM_ SG_ 320 RR_ElevationAng_092 "Elevation angle of point_092";
CM_ SG_ 320 RR_ElevationAng_093 "Elevation angle of point_093";
CM_ SG_ 320 RR_ElevationAng_094 "Elevation angle of point_094";
CM_ SG_ 320 RR_ElevationAng_095 "Elevation angle of point_095";
CM_ SG_ 320 RR_ElevationSNR_090 "Elevation SNR of point_090";
CM_ SG_ 320 RR_ElevationSNR_091 "Elevation SNR of point_091";
CM_ SG_ 320 RR_ElevationSNR_092 "Elevation SNR of point_092";
CM_ SG_ 320 RR_ElevationSNR_093 "Elevation SNR of point_093";
CM_ SG_ 320 RR_ElevationSNR_094 "Elevation SNR of point_094";
CM_ SG_ 320 RR_ElevationSNR_095 "Elevation SNR of point_095";
CM_ SG_ 320 RR_Range_090 "Range of point_090";
CM_ SG_ 320 RR_Range_091 "Range of point_091";
CM_ SG_ 320 RR_Range_092 "Range of point_092";
CM_ SG_ 320 RR_Range_093 "Range of point_093";
CM_ SG_ 320 RR_Range_094 "Range of point_094";
CM_ SG_ 320 RR_Range_095 "Range of point_095";
CM_ SG_ 320 RR_RCS_090 "RCS of point_090";
CM_ SG_ 320 RR_RCS_091 "RCS of point_091";
CM_ SG_ 320 RR_RCS_092 "RCS of point_092";
CM_ SG_ 320 RR_RCS_093 "RCS of point_093";
CM_ SG_ 320 RR_RCS_094 "RCS of point_094";
CM_ SG_ 320 RR_RCS_095 "RCS of point_095";
CM_ SG_ 320 RR_Status_090 "Status of point_090";
CM_ SG_ 320 RR_Status_091 "Status of point_091";
CM_ SG_ 320 RR_Status_092 "Status of point_092";
CM_ SG_ 320 RR_Status_093 "Status of point_093";
CM_ SG_ 320 RR_Status_094 "Status of point_094";
CM_ SG_ 320 RR_Status_095 "Status of point_095";
CM_ SG_ 320 RR_Tbd_090 "To be defined";
CM_ SG_ 320 RR_Tbd_091 "To be defined";
CM_ SG_ 320 RR_Tbd_092 "To be defined";
CM_ SG_ 320 RR_Tbd_093 "To be defined";
CM_ SG_ 320 RR_Tbd_094 "To be defined";
CM_ SG_ 320 RR_Tbd_095 "To be defined";
CM_ SG_ 320 RR_Velocity_090 "Relative radial velocity of point_090";
CM_ SG_ 320 RR_Velocity_091 "Relative radial velocity of point_091";
CM_ SG_ 320 RR_Velocity_092 "Relative radial velocity of point_092";
CM_ SG_ 320 RR_Velocity_093 "Relative radial velocity of point_093";
CM_ SG_ 320 RR_Velocity_094 "Relative radial velocity of point_094";
CM_ SG_ 320 RR_Velocity_095 "Relative radial velocity of point_095";
CM_ SG_ 321 RR_AzimuthAng_096 "Azimuth angle of point_096";
CM_ SG_ 321 RR_AzimuthAng_097 "Azimuth angle of point_097";
CM_ SG_ 321 RR_AzimuthAng_098 "Azimuth angle of point_098";
CM_ SG_ 321 RR_AzimuthAng_099 "Azimuth angle of point_099";
CM_ SG_ 321 RR_AzimuthAng_100 "Azimuth angle of point_100";
CM_ SG_ 321 RR_AzimuthAng_101 "Azimuth angle of point_101";
CM_ SG_ 321 RR_AzimuthSNR_096 "Azimuth SNR of point_096";
CM_ SG_ 321 RR_AzimuthSNR_097 "Azimuth SNR of point_097";
CM_ SG_ 321 RR_AzimuthSNR_098 "Azimuth SNR of point_098";
CM_ SG_ 321 RR_AzimuthSNR_099 "Azimuth SNR of point_099";
CM_ SG_ 321 RR_AzimuthSNR_100 "Azimuth SNR of point_100";
CM_ SG_ 321 RR_AzimuthSNR_101 "Azimuth SNR of point_101";
CM_ SG_ 321 RR_ElevationAng_096 "Elevation angle of point_096";
CM_ SG_ 321 RR_ElevationAng_097 "Elevation angle of point_097";
CM_ SG_ 321 RR_ElevationAng_098 "Elevation angle of point_098";
CM_ SG_ 321 RR_ElevationAng_099 "Elevation angle of point_099";
CM_ SG_ 321 RR_ElevationAng_100 "Elevation angle of point_100";
CM_ SG_ 321 RR_ElevationAng_101 "Elevation angle of point_101";
CM_ SG_ 321 RR_ElevationSNR_096 "Elevation SNR of point_096";
CM_ SG_ 321 RR_ElevationSNR_097 "Elevation SNR of point_097";
CM_ SG_ 321 RR_ElevationSNR_098 "Elevation SNR of point_098";
CM_ SG_ 321 RR_ElevationSNR_099 "Elevation SNR of point_099";
CM_ SG_ 321 RR_ElevationSNR_100 "Elevation SNR of point_100";
CM_ SG_ 321 RR_ElevationSNR_101 "Elevation SNR of point_101";
CM_ SG_ 321 RR_Range_096 "Range of point_096";
CM_ SG_ 321 RR_Range_097 "Range of point_097";
CM_ SG_ 321 RR_Range_098 "Range of point_098";
CM_ SG_ 321 RR_Range_099 "Range of point_099";
CM_ SG_ 321 RR_Range_100 "Range of point_100";
CM_ SG_ 321 RR_Range_101 "Range of point_101";
CM_ SG_ 321 RR_RCS_096 "RCS of point_096";
CM_ SG_ 321 RR_RCS_097 "RCS of point_097";
CM_ SG_ 321 RR_RCS_098 "RCS of point_098";
CM_ SG_ 321 RR_RCS_099 "RCS of point_099";
CM_ SG_ 321 RR_RCS_100 "RCS of point_100";
CM_ SG_ 321 RR_RCS_101 "RCS of point_101";
CM_ SG_ 321 RR_Status_096 "Status of point_096";
CM_ SG_ 321 RR_Status_097 "Status of point_097";
CM_ SG_ 321 RR_Status_098 "Status of point_098";
CM_ SG_ 321 RR_Status_099 "Status of point_099";
CM_ SG_ 321 RR_Status_100 "Status of point_100";
CM_ SG_ 321 RR_Status_101 "Status of point_101";
CM_ SG_ 321 RR_Tbd_096 "To be defined";
CM_ SG_ 321 RR_Tbd_097 "To be defined";
CM_ SG_ 321 RR_Tbd_098 "To be defined";
CM_ SG_ 321 RR_Tbd_099 "To be defined";
CM_ SG_ 321 RR_Tbd_100 "To be defined";
CM_ SG_ 321 RR_Tbd_101 "To be defined";
CM_ SG_ 321 RR_Velocity_096 "Relative radial velocity of point_096";
CM_ SG_ 321 RR_Velocity_097 "Relative radial velocity of point_097";
CM_ SG_ 321 RR_Velocity_098 "Relative radial velocity of point_098";
CM_ SG_ 321 RR_Velocity_099 "Relative radial velocity of point_099";
CM_ SG_ 321 RR_Velocity_100 "Relative radial velocity of point_100";
CM_ SG_ 321 RR_Velocity_101 "Relative radial velocity of point_101";
CM_ SG_ 322 RR_AzimuthAng_102 "Azimuth angle of point_102";
CM_ SG_ 322 RR_AzimuthAng_103 "Azimuth angle of point_103";
CM_ SG_ 322 RR_AzimuthAng_104 "Azimuth angle of point_104";
CM_ SG_ 322 RR_AzimuthAng_105 "Azimuth angle of point_105";
CM_ SG_ 322 RR_AzimuthAng_106 "Azimuth angle of point_106";
CM_ SG_ 322 RR_AzimuthAng_107 "Azimuth angle of point_107";
CM_ SG_ 322 RR_AzimuthSNR_102 "Azimuth SNR of point_102";
CM_ SG_ 322 RR_AzimuthSNR_103 "Azimuth SNR of point_103";
CM_ SG_ 322 RR_AzimuthSNR_104 "Azimuth SNR of point_104";
CM_ SG_ 322 RR_AzimuthSNR_105 "Azimuth SNR of point_105";
CM_ SG_ 322 RR_AzimuthSNR_106 "Azimuth SNR of point_106";
CM_ SG_ 322 RR_AzimuthSNR_107 "Azimuth SNR of point_107";
CM_ SG_ 322 RR_ElevationAng_102 "Elevation angle of point_102";
CM_ SG_ 322 RR_ElevationAng_103 "Elevation angle of point_103";
CM_ SG_ 322 RR_ElevationAng_104 "Elevation angle of point_104";
CM_ SG_ 322 RR_ElevationAng_105 "Elevation angle of point_105";
CM_ SG_ 322 RR_ElevationAng_106 "Elevation angle of point_106";
CM_ SG_ 322 RR_ElevationAng_107 "Elevation angle of point_107";
CM_ SG_ 322 RR_ElevationSNR_102 "Elevation SNR of point_102";
CM_ SG_ 322 RR_ElevationSNR_103 "Elevation SNR of point_103";
CM_ SG_ 322 RR_ElevationSNR_104 "Elevation SNR of point_104";
CM_ SG_ 322 RR_ElevationSNR_105 "Elevation SNR of point_105";
CM_ SG_ 322 RR_ElevationSNR_106 "Elevation SNR of point_106";
CM_ SG_ 322 RR_ElevationSNR_107 "Elevation SNR of point_107";
CM_ SG_ 322 RR_Range_102 "Range of point_102";
CM_ SG_ 322 RR_Range_103 "Range of point_103";
CM_ SG_ 322 RR_Range_104 "Range of point_104";
CM_ SG_ 322 RR_Range_105 "Range of point_105";
CM_ SG_ 322 RR_Range_106 "Range of point_106";
CM_ SG_ 322 RR_Range_107 "Range of point_107";
CM_ SG_ 322 RR_RCS_102 "RCS of point_102";
CM_ SG_ 322 RR_RCS_103 "RCS of point_103";
CM_ SG_ 322 RR_RCS_104 "RCS of point_104";
CM_ SG_ 322 RR_RCS_105 "RCS of point_105";
CM_ SG_ 322 RR_RCS_106 "RCS of point_106";
CM_ SG_ 322 RR_RCS_107 "RCS of point_107";
CM_ SG_ 322 RR_Status_102 "Status of point_102";
CM_ SG_ 322 RR_Status_103 "Status of point_103";
CM_ SG_ 322 RR_Status_104 "Status of point_104";
CM_ SG_ 322 RR_Status_105 "Status of point_105";
CM_ SG_ 322 RR_Status_106 "Status of point_106";
CM_ SG_ 322 RR_Status_107 "Status of point_107";
CM_ SG_ 322 RR_Tbd_102 "To be defined";
CM_ SG_ 322 RR_Tbd_103 "To be defined";
CM_ SG_ 322 RR_Tbd_104 "To be defined";
CM_ SG_ 322 RR_Tbd_105 "To be defined";
CM_ SG_ 322 RR_Tbd_106 "To be defined";
CM_ SG_ 322 RR_Tbd_107 "To be defined";
CM_ SG_ 322 RR_Velocity_102 "Relative radial velocity of point_102";
CM_ SG_ 322 RR_Velocity_103 "Relative radial velocity of point_103";
CM_ SG_ 322 RR_Velocity_104 "Relative radial velocity of point_104";
CM_ SG_ 322 RR_Velocity_105 "Relative radial velocity of point_105";
CM_ SG_ 322 RR_Velocity_106 "Relative radial velocity of point_106";
CM_ SG_ 322 RR_Velocity_107 "Relative radial velocity of point_107";
CM_ SG_ 323 RR_AzimuthAng_108 "Azimuth angle of point_108";
CM_ SG_ 323 RR_AzimuthAng_109 "Azimuth angle of point_109";
CM_ SG_ 323 RR_AzimuthAng_110 "Azimuth angle of point_110";
CM_ SG_ 323 RR_AzimuthAng_111 "Azimuth angle of point_111";
CM_ SG_ 323 RR_AzimuthAng_112 "Azimuth angle of point_112";
CM_ SG_ 323 RR_AzimuthAng_113 "Azimuth angle of point_113";
CM_ SG_ 323 RR_AzimuthSNR_108 "Azimuth SNR of point_108";
CM_ SG_ 323 RR_AzimuthSNR_109 "Azimuth SNR of point_109";
CM_ SG_ 323 RR_AzimuthSNR_110 "Azimuth SNR of point_110";
CM_ SG_ 323 RR_AzimuthSNR_111 "Azimuth SNR of point_111";
CM_ SG_ 323 RR_AzimuthSNR_112 "Azimuth SNR of point_112";
CM_ SG_ 323 RR_AzimuthSNR_113 "Azimuth SNR of point_113";
CM_ SG_ 323 RR_ElevationAng_108 "Elevation angle of point_108";
CM_ SG_ 323 RR_ElevationAng_109 "Elevation angle of point_109";
CM_ SG_ 323 RR_ElevationAng_110 "Elevation angle of point_110";
CM_ SG_ 323 RR_ElevationAng_111 "Elevation angle of point_111";
CM_ SG_ 323 RR_ElevationAng_112 "Elevation angle of point_112";
CM_ SG_ 323 RR_ElevationAng_113 "Elevation angle of point_113";
CM_ SG_ 323 RR_ElevationSNR_108 "Elevation SNR of point_108";
CM_ SG_ 323 RR_ElevationSNR_109 "Elevation SNR of point_109";
CM_ SG_ 323 RR_ElevationSNR_110 "Elevation SNR of point_110";
CM_ SG_ 323 RR_ElevationSNR_111 "Elevation SNR of point_111";
CM_ SG_ 323 RR_ElevationSNR_112 "Elevation SNR of point_112";
CM_ SG_ 323 RR_ElevationSNR_113 "Elevation SNR of point_113";
CM_ SG_ 323 RR_Range_108 "Range of point_108";
CM_ SG_ 323 RR_Range_109 "Range of point_109";
CM_ SG_ 323 RR_Range_110 "Range of point_110";
CM_ SG_ 323 RR_Range_111 "Range of point_111";
CM_ SG_ 323 RR_Range_112 "Range of point_112";
CM_ SG_ 323 RR_Range_113 "Range of point_113";
CM_ SG_ 323 RR_RCS_108 "RCS of point_108";
CM_ SG_ 323 RR_RCS_109 "RCS of point_109";
CM_ SG_ 323 RR_RCS_110 "RCS of point_110";
CM_ SG_ 323 RR_RCS_111 "RCS of point_111";
CM_ SG_ 323 RR_RCS_112 "RCS of point_112";
CM_ SG_ 323 RR_RCS_113 "RCS of point_113";
CM_ SG_ 323 RR_Status_108 "Status of point_108";
CM_ SG_ 323 RR_Status_109 "Status of point_109";
CM_ SG_ 323 RR_Status_110 "Status of point_110";
CM_ SG_ 323 RR_Status_111 "Status of point_111";
CM_ SG_ 323 RR_Status_112 "Status of point_112";
CM_ SG_ 323 RR_Status_113 "Status of point_113";
CM_ SG_ 323 RR_Tbd_108 "To be defined";
CM_ SG_ 323 RR_Tbd_109 "To be defined";
CM_ SG_ 323 RR_Tbd_110 "To be defined";
CM_ SG_ 323 RR_Tbd_111 "To be defined";
CM_ SG_ 323 RR_Tbd_112 "To be defined";
CM_ SG_ 323 RR_Tbd_113 "To be defined";
CM_ SG_ 323 RR_Velocity_108 "Relative radial velocity of point_108";
CM_ SG_ 323 RR_Velocity_109 "Relative radial velocity of point_109";
CM_ SG_ 323 RR_Velocity_110 "Relative radial velocity of point_110";
CM_ SG_ 323 RR_Velocity_111 "Relative radial velocity of point_111";
CM_ SG_ 323 RR_Velocity_112 "Relative radial velocity of point_112";
CM_ SG_ 323 RR_Velocity_113 "Relative radial velocity of point_113";
CM_ SG_ 324 RR_AzimuthAng_114 "Azimuth angle of point_114";
CM_ SG_ 324 RR_AzimuthAng_115 "Azimuth angle of point_115";
CM_ SG_ 324 RR_AzimuthAng_116 "Azimuth angle of point_116";
CM_ SG_ 324 RR_AzimuthAng_117 "Azimuth angle of point_117";
CM_ SG_ 324 RR_AzimuthAng_118 "Azimuth angle of point_118";
CM_ SG_ 324 RR_AzimuthAng_119 "Azimuth angle of point_119";
CM_ SG_ 324 RR_AzimuthSNR_114 "Azimuth SNR of point_114";
CM_ SG_ 324 RR_AzimuthSNR_115 "Azimuth SNR of point_115";
CM_ SG_ 324 RR_AzimuthSNR_116 "Azimuth SNR of point_116";
CM_ SG_ 324 RR_AzimuthSNR_117 "Azimuth SNR of point_117";
CM_ SG_ 324 RR_AzimuthSNR_118 "Azimuth SNR of point_118";
CM_ SG_ 324 RR_AzimuthSNR_119 "Azimuth SNR of point_119";
CM_ SG_ 324 RR_ElevationAng_114 "Elevation angle of point_114";
CM_ SG_ 324 RR_ElevationAng_115 "Elevation angle of point_115";
CM_ SG_ 324 RR_ElevationAng_116 "Elevation angle of point_116";
CM_ SG_ 324 RR_ElevationAng_117 "Elevation angle of point_117";
CM_ SG_ 324 RR_ElevationAng_118 "Elevation angle of point_118";
CM_ SG_ 324 RR_ElevationAng_119 "Elevation angle of point_119";
CM_ SG_ 324 RR_ElevationSNR_114 "Elevation SNR of point_114";
CM_ SG_ 324 RR_ElevationSNR_115 "Elevation SNR of point_115";
CM_ SG_ 324 RR_ElevationSNR_116 "Elevation SNR of point_116";
CM_ SG_ 324 RR_ElevationSNR_117 "Elevation SNR of point_117";
CM_ SG_ 324 RR_ElevationSNR_118 "Elevation SNR of point_118";
CM_ SG_ 324 RR_ElevationSNR_119 "Elevation SNR of point_119";
CM_ SG_ 324 RR_Range_114 "Range of point_114";
CM_ SG_ 324 RR_Range_115 "Range of point_115";
CM_ SG_ 324 RR_Range_116 "Range of point_116";
CM_ SG_ 324 RR_Range_117 "Range of point_117";
CM_ SG_ 324 RR_Range_118 "Range of point_118";
CM_ SG_ 324 RR_Range_119 "Range of point_119";
CM_ SG_ 324 RR_RCS_114 "RCS of point_114";
CM_ SG_ 324 RR_RCS_115 "RCS of point_115";
CM_ SG_ 324 RR_RCS_116 "RCS of point_116";
CM_ SG_ 324 RR_RCS_117 "RCS of point_117";
CM_ SG_ 324 RR_RCS_118 "RCS of point_118";
CM_ SG_ 324 RR_RCS_119 "RCS of point_119";
CM_ SG_ 324 RR_Status_114 "Status of point_114";
CM_ SG_ 324 RR_Status_115 "Status of point_115";
CM_ SG_ 324 RR_Status_116 "Status of point_116";
CM_ SG_ 324 RR_Status_117 "Status of point_117";
CM_ SG_ 324 RR_Status_118 "Status of point_118";
CM_ SG_ 324 RR_Status_119 "Status of point_119";
CM_ SG_ 324 RR_Tbd_114 "To be defined";
CM_ SG_ 324 RR_Tbd_115 "To be defined";
CM_ SG_ 324 RR_Tbd_116 "To be defined";
CM_ SG_ 324 RR_Tbd_117 "To be defined";
CM_ SG_ 324 RR_Tbd_118 "To be defined";
CM_ SG_ 324 RR_Tbd_119 "To be defined";
CM_ SG_ 324 RR_Velocity_114 "Relative radial velocity of point_114";
CM_ SG_ 324 RR_Velocity_115 "Relative radial velocity of point_115";
CM_ SG_ 324 RR_Velocity_116 "Relative radial velocity of point_116";
CM_ SG_ 324 RR_Velocity_117 "Relative radial velocity of point_117";
CM_ SG_ 324 RR_Velocity_118 "Relative radial velocity of point_118";
CM_ SG_ 324 RR_Velocity_119 "Relative radial velocity of point_119";
CM_ SG_ 325 RR_AzimuthAng_120 "Azimuth angle of point_120";
CM_ SG_ 325 RR_AzimuthAng_121 "Azimuth angle of point_121";
CM_ SG_ 325 RR_AzimuthAng_122 "Azimuth angle of point_122";
CM_ SG_ 325 RR_AzimuthAng_123 "Azimuth angle of point_123";
CM_ SG_ 325 RR_AzimuthAng_124 "Azimuth angle of point_124";
CM_ SG_ 325 RR_AzimuthAng_125 "Azimuth angle of point_125";
CM_ SG_ 325 RR_AzimuthSNR_120 "Azimuth SNR of point_120";
CM_ SG_ 325 RR_AzimuthSNR_121 "Azimuth SNR of point_121";
CM_ SG_ 325 RR_AzimuthSNR_122 "Azimuth SNR of point_122";
CM_ SG_ 325 RR_AzimuthSNR_123 "Azimuth SNR of point_123";
CM_ SG_ 325 RR_AzimuthSNR_124 "Azimuth SNR of point_124";
CM_ SG_ 325 RR_AzimuthSNR_125 "Azimuth SNR of point_125";
CM_ SG_ 325 RR_ElevationAng_120 "Elevation angle of point_120";
CM_ SG_ 325 RR_ElevationAng_121 "Elevation angle of point_121";
CM_ SG_ 325 RR_ElevationAng_122 "Elevation angle of point_122";
CM_ SG_ 325 RR_ElevationAng_123 "Elevation angle of point_123";
CM_ SG_ 325 RR_ElevationAng_124 "Elevation angle of point_124";
CM_ SG_ 325 RR_ElevationAng_125 "Elevation angle of point_125";
CM_ SG_ 325 RR_ElevationSNR_120 "Elevation SNR of point_120";
CM_ SG_ 325 RR_ElevationSNR_121 "Elevation SNR of point_121";
CM_ SG_ 325 RR_ElevationSNR_122 "Elevation SNR of point_122";
CM_ SG_ 325 RR_ElevationSNR_123 "Elevation SNR of point_123";
CM_ SG_ 325 RR_ElevationSNR_124 "Elevation SNR of point_124";
CM_ SG_ 325 RR_ElevationSNR_125 "Elevation SNR of point_125";
CM_ SG_ 325 RR_Range_120 "Range of point_120";
CM_ SG_ 325 RR_Range_121 "Range of point_121";
CM_ SG_ 325 RR_Range_122 "Range of point_122";
CM_ SG_ 325 RR_Range_123 "Range of point_123";
CM_ SG_ 325 RR_Range_124 "Range of point_124";
CM_ SG_ 325 RR_Range_125 "Range of point_125";
CM_ SG_ 325 RR_RCS_120 "RCS of point_120";
CM_ SG_ 325 RR_RCS_121 "RCS of point_121";
CM_ SG_ 325 RR_RCS_122 "RCS of point_122";
CM_ SG_ 325 RR_RCS_123 "RCS of point_123";
CM_ SG_ 325 RR_RCS_124 "RCS of point_124";
CM_ SG_ 325 RR_RCS_125 "RCS of point_125";
CM_ SG_ 325 RR_Status_120 "Status of point_120";
CM_ SG_ 325 RR_Status_121 "Status of point_121";
CM_ SG_ 325 RR_Status_122 "Status of point_122";
CM_ SG_ 325 RR_Status_123 "Status of point_123";
CM_ SG_ 325 RR_Status_124 "Status of point_124";
CM_ SG_ 325 RR_Status_125 "Status of point_125";
CM_ SG_ 325 RR_Tbd_120 "To be defined";
CM_ SG_ 325 RR_Tbd_121 "To be defined";
CM_ SG_ 325 RR_Tbd_122 "To be defined";
CM_ SG_ 325 RR_Tbd_123 "To be defined";
CM_ SG_ 325 RR_Tbd_124 "To be defined";
CM_ SG_ 325 RR_Tbd_125 "To be defined";
CM_ SG_ 325 RR_Velocity_120 "Relative radial velocity of point_120";
CM_ SG_ 325 RR_Velocity_121 "Relative radial velocity of point_121";
CM_ SG_ 325 RR_Velocity_122 "Relative radial velocity of point_122";
CM_ SG_ 325 RR_Velocity_123 "Relative radial velocity of point_123";
CM_ SG_ 325 RR_Velocity_124 "Relative radial velocity of point_124";
CM_ SG_ 325 RR_Velocity_125 "Relative radial velocity of point_125";
CM_ SG_ 326 RR_AzimuthAng_126 "Azimuth angle of point_126";
CM_ SG_ 326 RR_AzimuthAng_127 "Azimuth angle of point_127";
CM_ SG_ 326 RR_AzimuthAng_128 "Azimuth angle of point_128";
CM_ SG_ 326 RR_AzimuthAng_129 "Azimuth angle of point_129";
CM_ SG_ 326 RR_AzimuthAng_130 "Azimuth angle of point_130";
CM_ SG_ 326 RR_AzimuthAng_131 "Azimuth angle of point_131";
CM_ SG_ 326 RR_AzimuthSNR_126 "Azimuth SNR of point_126";
CM_ SG_ 326 RR_AzimuthSNR_127 "Azimuth SNR of point_127";
CM_ SG_ 326 RR_AzimuthSNR_128 "Azimuth SNR of point_128";
CM_ SG_ 326 RR_AzimuthSNR_129 "Azimuth SNR of point_129";
CM_ SG_ 326 RR_AzimuthSNR_130 "Azimuth SNR of point_130";
CM_ SG_ 326 RR_AzimuthSNR_131 "Azimuth SNR of point_131";
CM_ SG_ 326 RR_ElevationAng_126 "Elevation angle of point_126";
CM_ SG_ 326 RR_ElevationAng_127 "Elevation angle of point_127";
CM_ SG_ 326 RR_ElevationAng_128 "Elevation angle of point_128";
CM_ SG_ 326 RR_ElevationAng_129 "Elevation angle of point_129";
CM_ SG_ 326 RR_ElevationAng_130 "Elevation angle of point_130";
CM_ SG_ 326 RR_ElevationAng_131 "Elevation angle of point_131";
CM_ SG_ 326 RR_ElevationSNR_126 "Elevation SNR of point_126";
CM_ SG_ 326 RR_ElevationSNR_127 "Elevation SNR of point_127";
CM_ SG_ 326 RR_ElevationSNR_128 "Elevation SNR of point_128";
CM_ SG_ 326 RR_ElevationSNR_129 "Elevation SNR of point_129";
CM_ SG_ 326 RR_ElevationSNR_130 "Elevation SNR of point_130";
CM_ SG_ 326 RR_ElevationSNR_131 "Elevation SNR of point_131";
CM_ SG_ 326 RR_Range_126 "Range of point_126";
CM_ SG_ 326 RR_Range_127 "Range of point_127";
CM_ SG_ 326 RR_Range_128 "Range of point_128";
CM_ SG_ 326 RR_Range_129 "Range of point_129";
CM_ SG_ 326 RR_Range_130 "Range of point_130";
CM_ SG_ 326 RR_Range_131 "Range of point_131";
CM_ SG_ 326 RR_RCS_126 "RCS of point_126";
CM_ SG_ 326 RR_RCS_127 "RCS of point_127";
CM_ SG_ 326 RR_RCS_128 "RCS of point_128";
CM_ SG_ 326 RR_RCS_129 "RCS of point_129";
CM_ SG_ 326 RR_RCS_130 "RCS of point_130";
CM_ SG_ 326 RR_RCS_131 "RCS of point_131";
CM_ SG_ 326 RR_Status_126 "Status of point_126";
CM_ SG_ 326 RR_Status_127 "Status of point_127";
CM_ SG_ 326 RR_Status_128 "Status of point_128";
CM_ SG_ 326 RR_Status_129 "Status of point_129";
CM_ SG_ 326 RR_Status_130 "Status of point_130";
CM_ SG_ 326 RR_Status_131 "Status of point_131";
CM_ SG_ 326 RR_Tbd_126 "To be defined";
CM_ SG_ 326 RR_Tbd_127 "To be defined";
CM_ SG_ 326 RR_Tbd_128 "To be defined";
CM_ SG_ 326 RR_Tbd_129 "To be defined";
CM_ SG_ 326 RR_Tbd_130 "To be defined";
CM_ SG_ 326 RR_Tbd_131 "To be defined";
CM_ SG_ 326 RR_Velocity_126 "Relative radial velocity of point_126";
CM_ SG_ 326 RR_Velocity_127 "Relative radial velocity of point_127";
CM_ SG_ 326 RR_Velocity_128 "Relative radial velocity of point_128";
CM_ SG_ 326 RR_Velocity_129 "Relative radial velocity of point_129";
CM_ SG_ 326 RR_Velocity_130 "Relative radial velocity of point_130";
CM_ SG_ 326 RR_Velocity_131 "Relative radial velocity of point_131";
CM_ SG_ 327 RR_AzimuthAng_132 "Azimuth angle of point_132";
CM_ SG_ 327 RR_AzimuthAng_133 "Azimuth angle of point_133";
CM_ SG_ 327 RR_AzimuthAng_134 "Azimuth angle of point_134";
CM_ SG_ 327 RR_AzimuthAng_135 "Azimuth angle of point_135";
CM_ SG_ 327 RR_AzimuthAng_136 "Azimuth angle of point_136";
CM_ SG_ 327 RR_AzimuthAng_137 "Azimuth angle of point_137";
CM_ SG_ 327 RR_AzimuthSNR_132 "Azimuth SNR of point_132";
CM_ SG_ 327 RR_AzimuthSNR_133 "Azimuth SNR of point_133";
CM_ SG_ 327 RR_AzimuthSNR_134 "Azimuth SNR of point_134";
CM_ SG_ 327 RR_AzimuthSNR_135 "Azimuth SNR of point_135";
CM_ SG_ 327 RR_AzimuthSNR_136 "Azimuth SNR of point_136";
CM_ SG_ 327 RR_AzimuthSNR_137 "Azimuth SNR of point_137";
CM_ SG_ 327 RR_ElevationAng_132 "Elevation angle of point_132";
CM_ SG_ 327 RR_ElevationAng_133 "Elevation angle of point_133";
CM_ SG_ 327 RR_ElevationAng_134 "Elevation angle of point_134";
CM_ SG_ 327 RR_ElevationAng_135 "Elevation angle of point_135";
CM_ SG_ 327 RR_ElevationAng_136 "Elevation angle of point_136";
CM_ SG_ 327 RR_ElevationAng_137 "Elevation angle of point_137";
CM_ SG_ 327 RR_ElevationSNR_132 "Elevation SNR of point_132";
CM_ SG_ 327 RR_ElevationSNR_133 "Elevation SNR of point_133";
CM_ SG_ 327 RR_ElevationSNR_134 "Elevation SNR of point_134";
CM_ SG_ 327 RR_ElevationSNR_135 "Elevation SNR of point_135";
CM_ SG_ 327 RR_ElevationSNR_136 "Elevation SNR of point_136";
CM_ SG_ 327 RR_ElevationSNR_137 "Elevation SNR of point_137";
CM_ SG_ 327 RR_Range_132 "Range of point_132";
CM_ SG_ 327 RR_Range_133 "Range of point_133";
CM_ SG_ 327 RR_Range_134 "Range of point_134";
CM_ SG_ 327 RR_Range_135 "Range of point_135";
CM_ SG_ 327 RR_Range_136 "Range of point_136";
CM_ SG_ 327 RR_Range_137 "Range of point_137";
CM_ SG_ 327 RR_RCS_132 "RCS of point_132";
CM_ SG_ 327 RR_RCS_133 "RCS of point_133";
CM_ SG_ 327 RR_RCS_134 "RCS of point_134";
CM_ SG_ 327 RR_RCS_135 "RCS of point_135";
CM_ SG_ 327 RR_RCS_136 "RCS of point_136";
CM_ SG_ 327 RR_RCS_137 "RCS of point_137";
CM_ SG_ 327 RR_Status_132 "Status of point_132";
CM_ SG_ 327 RR_Status_133 "Status of point_133";
CM_ SG_ 327 RR_Status_134 "Status of point_134";
CM_ SG_ 327 RR_Status_135 "Status of point_135";
CM_ SG_ 327 RR_Status_136 "Status of point_136";
CM_ SG_ 327 RR_Status_137 "Status of point_137";
CM_ SG_ 327 RR_Tbd_132 "To be defined";
CM_ SG_ 327 RR_Tbd_133 "To be defined";
CM_ SG_ 327 RR_Tbd_134 "To be defined";
CM_ SG_ 327 RR_Tbd_135 "To be defined";
CM_ SG_ 327 RR_Tbd_136 "To be defined";
CM_ SG_ 327 RR_Tbd_137 "To be defined";
CM_ SG_ 327 RR_Velocity_132 "Relative radial velocity of point_132";
CM_ SG_ 327 RR_Velocity_133 "Relative radial velocity of point_133";
CM_ SG_ 327 RR_Velocity_134 "Relative radial velocity of point_134";
CM_ SG_ 327 RR_Velocity_135 "Relative radial velocity of point_135";
CM_ SG_ 327 RR_Velocity_136 "Relative radial velocity of point_136";
CM_ SG_ 327 RR_Velocity_137 "Relative radial velocity of point_137";
BA_DEF_ BO_  "GenMsgCycleTime" INT 0 0;
BA_DEF_ BO_  "GenMsgSendType" ENUM  "Cyclic","NotUsed","Event","NotUsed","NotUsed","NotUsed","NotUsed","IfActive","NoMsgSendType","NotUsed";
BA_DEF_ BO_  "VFrameFormat" ENUM  "StandardCAN","ExtendedCAN","reserved","reserved","reserved","reserved","reserved","reserved","reserved","reserved","reserved","reserved","reserved","reserved","StandardCAN_FD","ExtendedCAN_FD";
BA_DEF_ BO_  "GenSigSendType" ENUM  "Cyclic","OnWrite","OnWriteWithRepetition","OnChange","OnChangeWithRepetition";
BA_DEF_ SG_  "GenSigStartValue" INT 0 0;
BA_DEF_ BO_  "CANFD_BRS" ENUM  "0","1";
BA_DEF_DEF_  "GenMsgCycleTime" 0;
BA_DEF_DEF_  "GenMsgSendType" "Cyclic";
BA_DEF_DEF_  "VFrameFormat" "ExtendedCAN_FD";
BA_DEF_DEF_  "GenSigSendType" "Cyclic";
BA_DEF_DEF_  "GenSigStartValue" 0;
BA_DEF_DEF_  "CANFD_BRS" "1";
BA_ "GenMsgSendType" BO_ 295 2;
BA_ "VFrameFormat" BO_ 295 14;
BA_ "GenMsgSendType" BO_ 296 2;
BA_ "VFrameFormat" BO_ 296 14;
BA_ "GenMsgSendType" BO_ 304 2;
BA_ "VFrameFormat" BO_ 304 14;
BA_ "GenMsgSendType" BO_ 305 2;
BA_ "VFrameFormat" BO_ 305 14;
BA_ "GenMsgSendType" BO_ 306 2;
BA_ "VFrameFormat" BO_ 306 14;
BA_ "GenMsgSendType" BO_ 307 2;
BA_ "VFrameFormat" BO_ 307 14;
BA_ "GenMsgSendType" BO_ 308 2;
BA_ "VFrameFormat" BO_ 308 14;
BA_ "GenMsgSendType" BO_ 309 2;
BA_ "VFrameFormat" BO_ 309 14;
BA_ "GenMsgSendType" BO_ 310 2;
BA_ "VFrameFormat" BO_ 310 14;
BA_ "GenMsgSendType" BO_ 311 2;
BA_ "VFrameFormat" BO_ 311 14;
BA_ "GenMsgSendType" BO_ 312 2;
BA_ "VFrameFormat" BO_ 312 14;
BA_ "GenMsgSendType" BO_ 313 2;
BA_ "VFrameFormat" BO_ 313 14;
BA_ "GenMsgSendType" BO_ 314 2;
BA_ "VFrameFormat" BO_ 314 14;
BA_ "GenMsgSendType" BO_ 315 2;
BA_ "VFrameFormat" BO_ 315 14;
BA_ "GenMsgSendType" BO_ 316 2;
BA_ "VFrameFormat" BO_ 316 14;
BA_ "GenMsgSendType" BO_ 317 2;
BA_ "VFrameFormat" BO_ 317 14;
BA_ "GenMsgSendType" BO_ 318 2;
BA_ "VFrameFormat" BO_ 318 14;
BA_ "GenMsgSendType" BO_ 319 2;
BA_ "VFrameFormat" BO_ 319 14;
BA_ "GenMsgSendType" BO_ 320 2;
BA_ "VFrameFormat" BO_ 320 14;
BA_ "GenMsgSendType" BO_ 321 2;
BA_ "VFrameFormat" BO_ 321 14;
BA_ "GenMsgSendType" BO_ 322 2;
BA_ "VFrameFormat" BO_ 322 14;
BA_ "GenMsgSendType" BO_ 323 2;
BA_ "VFrameFormat" BO_ 323 14;
BA_ "GenMsgSendType" BO_ 324 2;
BA_ "VFrameFormat" BO_ 324 14;
BA_ "GenMsgSendType" BO_ 325 2;
BA_ "VFrameFormat" BO_ 325 14;
BA_ "GenMsgSendType" BO_ 326 2;
BA_ "VFrameFormat" BO_ 326 14;
BA_ "GenMsgSendType" BO_ 327 2;
BA_ "VFrameFormat" BO_ 327 14;
BA_ "GenSigStartValue" SG_ 304 RR_DynamicCalibPitchDeg 250;
BA_ "GenSigStartValue" SG_ 304 RR_DynamicCalibYawDeg 1800;
BA_ "GenSigStartValue" SG_ 304 RR_RadarInfo_InstallPitchDeg 50;
BA_ "GenSigStartValue" SG_ 304 RR_RadarInfo_InstallX 50;
BA_ "GenSigStartValue" SG_ 304 RR_RadarInfo_InstallY 50;
BA_ "GenSigStartValue" SG_ 304 RR_RadarInfo_InstallYawDeg 1800;
BA_ "GenSigStartValue" SG_ 304 RR_RadarInfo_LastCalibPitchDeg 50;
BA_ "GenSigStartValue" SG_ 304 RR_RadarInfo_LastCalibYawDeg 1800;
BA_ "GenSigStartValue" SG_ 304 RR_SelfCalibPitchDeg 250;
BA_ "GenSigStartValue" SG_ 304 RR_SelfCalibYawDeg 1800;
BA_ "GenSigStartValue" SG_ 304 RR_StaticCalibPitchDeg 250;
BA_ "GenSigStartValue" SG_ 304 RR_StaticCalibYawDeg 1800;
BA_ "GenSigStartValue" SG_ 305 RR_AzimuthAng_000 900;
BA_ "GenSigStartValue" SG_ 305 RR_AzimuthAng_001 900;
BA_ "GenSigStartValue" SG_ 305 RR_AzimuthAng_002 900;
BA_ "GenSigStartValue" SG_ 305 RR_AzimuthAng_003 900;
BA_ "GenSigStartValue" SG_ 305 RR_AzimuthAng_004 900;
BA_ "GenSigStartValue" SG_ 305 RR_AzimuthAng_005 900;
BA_ "GenSigStartValue" SG_ 305 RR_ElevationAng_000 250;
BA_ "GenSigStartValue" SG_ 305 RR_ElevationAng_001 250;
BA_ "GenSigStartValue" SG_ 305 RR_ElevationAng_002 250;
BA_ "GenSigStartValue" SG_ 305 RR_ElevationAng_003 250;
BA_ "GenSigStartValue" SG_ 305 RR_ElevationAng_004 250;
BA_ "GenSigStartValue" SG_ 305 RR_ElevationAng_005 250;
BA_ "GenSigStartValue" SG_ 306 RR_AzimuthAng_006 900;
BA_ "GenSigStartValue" SG_ 306 RR_AzimuthAng_007 900;
BA_ "GenSigStartValue" SG_ 306 RR_AzimuthAng_008 900;
BA_ "GenSigStartValue" SG_ 306 RR_AzimuthAng_009 900;
BA_ "GenSigStartValue" SG_ 306 RR_AzimuthAng_010 900;
BA_ "GenSigStartValue" SG_ 306 RR_AzimuthAng_011 900;
BA_ "GenSigStartValue" SG_ 306 RR_ElevationAng_006 250;
BA_ "GenSigStartValue" SG_ 306 RR_ElevationAng_007 250;
BA_ "GenSigStartValue" SG_ 306 RR_ElevationAng_008 250;
BA_ "GenSigStartValue" SG_ 306 RR_ElevationAng_009 250;
BA_ "GenSigStartValue" SG_ 306 RR_ElevationAng_010 250;
BA_ "GenSigStartValue" SG_ 306 RR_ElevationAng_011 250;
VAL_ 304 RR_EgoGear 0 "INVALI" 1 "VALI" ;
