VERSION "created by canmatrix"

NS_ :

BS_:

BU_: RR LR ADCU

BO_ 267 LR_RDI_060_065: 64 LR
 SG_ LR_AzimuthAng_060 : 39|11@0+ (0.1,-90) [-90|114.7] "deg"  RR,ADCU
 SG_ LR_AzimuthAng_061 : 119|11@0+ (0.1,-90) [-90|114.7] "deg"  RR,ADCU
 SG_ LR_AzimuthAng_062 : 199|11@0+ (0.1,-90) [-90|114.7] "deg"  RR,ADCU
 SG_ LR_AzimuthAng_063 : 279|11@0+ (0.1,-90) [-90|114.7] "deg"  RR,ADCU
 SG_ LR_AzimuthAng_064 : 359|11@0+ (0.1,-90) [-90|114.7] "deg"  RR,ADCU
 SG_ LR_AzimuthAng_065 : 439|11@0+ (0.1,-90) [-90|114.7] "deg"  RR,ADCU
 SG_ LR_AzimuthSNR_060 : 51|7@0+ (0.5,0) [0|63.5] "dB"  RR,ADCU
 SG_ LR_AzimuthSNR_061 : 131|7@0+ (0.5,0) [0|63.5] "dB"  RR,ADCU
 SG_ LR_AzimuthSNR_062 : 211|7@0+ (0.5,0) [0|63.5] "dB"  RR,ADCU
 SG_ LR_AzimuthSNR_063 : 291|7@0+ (0.5,0) [0|63.5] "dB"  RR,ADCU
 SG_ LR_AzimuthSNR_064 : 371|7@0+ (0.5,0) [0|63.5] "dB"  RR,ADCU
 SG_ LR_AzimuthSNR_065 : 451|7@0+ (0.5,0) [0|63.5] "dB"  RR,ADCU
 SG_ LR_ElevationAng_060 : 44|9@0+ (0.1,-25) [-25|26.1] "deg"  RR,ADCU
 SG_ LR_ElevationAng_061 : 124|9@0+ (0.1,-25) [-25|26.1] "deg"  RR,ADCU
 SG_ LR_ElevationAng_062 : 204|9@0+ (0.1,-25) [-25|26.1] "deg"  RR,ADCU
 SG_ LR_ElevationAng_063 : 284|9@0+ (0.1,-25) [-25|26.1] "deg"  RR,ADCU
 SG_ LR_ElevationAng_064 : 364|9@0+ (0.1,-25) [-25|26.1] "deg"  RR,ADCU
 SG_ LR_ElevationAng_065 : 444|9@0+ (0.1,-25) [-25|26.1] "deg"  RR,ADCU
 SG_ LR_ElevationSNR_060 : 60|7@0+ (0.5,0) [0|63.5] "dB"  RR,ADCU
 SG_ LR_ElevationSNR_061 : 140|7@0+ (0.5,0) [0|63.5] "dB"  RR,ADCU
 SG_ LR_ElevationSNR_062 : 220|7@0+ (0.5,0) [0|63.5] "dB"  RR,ADCU
 SG_ LR_ElevationSNR_063 : 300|7@0+ (0.5,0) [0|63.5] "dB"  RR,ADCU
 SG_ LR_ElevationSNR_064 : 380|7@0+ (0.5,0) [0|63.5] "dB"  RR,ADCU
 SG_ LR_ElevationSNR_065 : 460|7@0+ (0.5,0) [0|63.5] "dB"  RR,ADCU
 SG_ LR_Range_060 : 7|12@0+ (0.0625,0) [0|255.9375] "m"  RR,ADCU
 SG_ LR_Range_061 : 87|12@0+ (0.0625,0) [0|255.9375] "m"  RR,ADCU
 SG_ LR_Range_062 : 167|12@0+ (0.0625,0) [0|255.9375] "m"  RR,ADCU
 SG_ LR_Range_063 : 247|12@0+ (0.0625,0) [0|255.9375] "m"  RR,ADCU
 SG_ LR_Range_064 : 327|12@0+ (0.0625,0) [0|255.9375] "m"  RR,ADCU
 SG_ LR_Range_065 : 407|12@0+ (0.0625,0) [0|255.9375] "m"  RR,ADCU
 SG_ LR_RCS_060 : 16|9@0+ (0.2,-51.1) [-51.1|51.1] "dBsm"  RR,ADCU
 SG_ LR_RCS_061 : 96|9@0+ (0.2,-51.1) [-51.1|51.1] "dBsm"  RR,ADCU
 SG_ LR_RCS_062 : 176|9@0+ (0.2,-51.1) [-51.1|51.1] "dBsm"  RR,ADCU
 SG_ LR_RCS_063 : 256|9@0+ (0.2,-51.1) [-51.1|51.1] "dBsm"  RR,ADCU
 SG_ LR_RCS_064 : 336|9@0+ (0.2,-51.1) [-51.1|51.1] "dBsm"  RR,ADCU
 SG_ LR_RCS_065 : 416|9@0+ (0.2,-51.1) [-51.1|51.1] "dBsm"  RR,ADCU
 SG_ LR_RDI_060_065_AliveCounter : 499|4@0+ (1,0) [0|15] ""  RR,ADCU
 SG_ LR_RDI_060_065_CheckSum : 511|8@0+ (1,0) [0|255] ""  RR,ADCU
 SG_ LR_Status_060 : 79|8@0+ (1,0) [0|255] ""  RR,ADCU
 SG_ LR_Status_061 : 159|8@0+ (1,0) [0|255] ""  RR,ADCU
 SG_ LR_Status_062 : 239|8@0+ (1,0) [0|255] ""  RR,ADCU
 SG_ LR_Status_063 : 319|8@0+ (1,0) [0|255] ""  RR,ADCU
 SG_ LR_Status_064 : 399|8@0+ (1,0) [0|255] ""  RR,ADCU
 SG_ LR_Status_065 : 479|8@0+ (1,0) [0|255] ""  RR,ADCU
 SG_ LR_Tbd_060 : 69|6@0+ (1,0) [0|63] ""  RR,ADCU
 SG_ LR_Tbd_061 : 149|6@0+ (1,0) [0|63] ""  RR,ADCU
 SG_ LR_Tbd_062 : 229|6@0+ (1,0) [0|63] ""  RR,ADCU
 SG_ LR_Tbd_063 : 309|6@0+ (1,0) [0|63] ""  RR,ADCU
 SG_ LR_Tbd_064 : 389|6@0+ (1,0) [0|63] ""  RR,ADCU
 SG_ LR_Tbd_065 : 469|6@0+ (1,0) [0|63] ""  RR,ADCU
 SG_ LR_Velocity_060 : 11|11@0+ (0.05,-60) [-60|42.35] "m/s"  RR,ADCU
 SG_ LR_Velocity_061 : 91|11@0+ (0.05,-60) [-60|42.35] "m/s"  RR,ADCU
 SG_ LR_Velocity_062 : 171|11@0+ (0.05,-60) [-60|42.35] "m/s"  RR,ADCU
 SG_ LR_Velocity_063 : 251|11@0+ (0.05,-60) [-60|42.35] "m/s"  RR,ADCU
 SG_ LR_Velocity_064 : 331|11@0+ (0.05,-60) [-60|42.35] "m/s"  RR,ADCU
 SG_ LR_Velocity_065 : 411|11@0+ (0.05,-60) [-60|42.35] "m/s"  RR,ADCU

BO_ 268 LR_RDI_066_071: 64 LR
 SG_ LR_AzimuthAng_066 : 39|11@0+ (0.1,-90) [-90|114.7] "deg"  RR,ADCU
 SG_ LR_AzimuthAng_067 : 119|11@0+ (0.1,-90) [-90|114.7] "deg"  RR,ADCU
 SG_ LR_AzimuthAng_068 : 199|11@0+ (0.1,-90) [-90|114.7] "deg"  RR,ADCU
 SG_ LR_AzimuthAng_069 : 279|11@0+ (0.1,-90) [-90|114.7] "deg"  RR,ADCU
 SG_ LR_AzimuthAng_070 : 359|11@0+ (0.1,-90) [-90|114.7] "deg"  RR,ADCU
 SG_ LR_AzimuthAng_071 : 439|11@0+ (0.1,-90) [-90|114.7] "deg"  RR,ADCU
 SG_ LR_AzimuthSNR_066 : 51|7@0+ (0.5,0) [0|63.5] "dB"  RR,ADCU
 SG_ LR_AzimuthSNR_067 : 131|7@0+ (0.5,0) [0|63.5] "dB"  RR,ADCU
 SG_ LR_AzimuthSNR_068 : 211|7@0+ (0.5,0) [0|63.5] "dB"  RR,ADCU
 SG_ LR_AzimuthSNR_069 : 291|7@0+ (0.5,0) [0|63.5] "dB"  RR,ADCU
 SG_ LR_AzimuthSNR_070 : 371|7@0+ (0.5,0) [0|63.5] "dB"  RR,ADCU
 SG_ LR_AzimuthSNR_071 : 451|7@0+ (0.5,0) [0|63.5] "dB"  RR,ADCU
 SG_ LR_ElevationAng_066 : 44|9@0+ (0.1,-25) [-25|26.1] "deg"  RR,ADCU
 SG_ LR_ElevationAng_067 : 124|9@0+ (0.1,-25) [-25|26.1] "deg"  RR,ADCU
 SG_ LR_ElevationAng_068 : 204|9@0+ (0.1,-25) [-25|26.1] "deg"  RR,ADCU
 SG_ LR_ElevationAng_069 : 284|9@0+ (0.1,-25) [-25|26.1] "deg"  RR,ADCU
 SG_ LR_ElevationAng_070 : 364|9@0+ (0.1,-25) [-25|26.1] "deg"  RR,ADCU
 SG_ LR_ElevationAng_071 : 444|9@0+ (0.1,-25) [-25|26.1] "deg"  RR,ADCU
 SG_ LR_ElevationSNR_066 : 60|7@0+ (0.5,0) [0|63.5] "dB"  RR,ADCU
 SG_ LR_ElevationSNR_067 : 140|7@0+ (0.5,0) [0|63.5] "dB"  RR,ADCU
 SG_ LR_ElevationSNR_068 : 220|7@0+ (0.5,0) [0|63.5] "dB"  RR,ADCU
 SG_ LR_ElevationSNR_069 : 300|7@0+ (0.5,0) [0|63.5] "dB"  RR,ADCU
 SG_ LR_ElevationSNR_070 : 380|7@0+ (0.5,0) [0|63.5] "dB"  RR,ADCU
 SG_ LR_ElevationSNR_071 : 460|7@0+ (0.5,0) [0|63.5] "dB"  RR,ADCU
 SG_ LR_Range_066 : 7|12@0+ (0.0625,0) [0|255.9375] "m"  RR,ADCU
 SG_ LR_Range_067 : 87|12@0+ (0.0625,0) [0|255.9375] "m"  RR,ADCU
 SG_ LR_Range_068 : 167|12@0+ (0.0625,0) [0|255.9375] "m"  RR,ADCU
 SG_ LR_Range_069 : 247|12@0+ (0.0625,0) [0|255.9375] "m"  RR,ADCU
 SG_ LR_Range_070 : 327|12@0+ (0.0625,0) [0|255.9375] "m"  RR,ADCU
 SG_ LR_Range_071 : 407|12@0+ (0.0625,0) [0|255.9375] "m"  RR,ADCU
 SG_ LR_RCS_066 : 16|9@0+ (0.2,-51.1) [-51.1|51.1] "dBsm"  RR,ADCU
 SG_ LR_RCS_067 : 96|9@0+ (0.2,-51.1) [-51.1|51.1] "dBsm"  RR,ADCU
 SG_ LR_RCS_068 : 176|9@0+ (0.2,-51.1) [-51.1|51.1] "dBsm"  RR,ADCU
 SG_ LR_RCS_069 : 256|9@0+ (0.2,-51.1) [-51.1|51.1] "dBsm"  RR,ADCU
 SG_ LR_RCS_070 : 336|9@0+ (0.2,-51.1) [-51.1|51.1] "dBsm"  RR,ADCU
 SG_ LR_RCS_071 : 416|9@0+ (0.2,-51.1) [-51.1|51.1] "dBsm"  RR,ADCU
 SG_ LR_RDI_066_071_AliveCounter : 499|4@0+ (1,0) [0|15] ""  RR,ADCU
 SG_ LR_RDI_066_071_CheckSum : 511|8@0+ (1,0) [0|255] ""  RR,ADCU
 SG_ LR_Status_066 : 79|8@0+ (1,0) [0|255] ""  RR,ADCU
 SG_ LR_Status_067 : 159|8@0+ (1,0) [0|255] ""  RR,ADCU
 SG_ LR_Status_068 : 239|8@0+ (1,0) [0|255] ""  RR,ADCU
 SG_ LR_Status_069 : 319|8@0+ (1,0) [0|255] ""  RR,ADCU
 SG_ LR_Status_070 : 399|8@0+ (1,0) [0|255] ""  RR,ADCU
 SG_ LR_Status_071 : 479|8@0+ (1,0) [0|255] ""  RR,ADCU
 SG_ LR_Tbd_066 : 69|6@0+ (1,0) [0|63] ""  RR,ADCU
 SG_ LR_Tbd_067 : 149|6@0+ (1,0) [0|63] ""  RR,ADCU
 SG_ LR_Tbd_068 : 229|6@0+ (1,0) [0|63] ""  RR,ADCU
 SG_ LR_Tbd_069 : 309|6@0+ (1,0) [0|63] ""  RR,ADCU
 SG_ LR_Tbd_070 : 389|6@0+ (1,0) [0|63] ""  RR,ADCU
 SG_ LR_Tbd_071 : 469|6@0+ (1,0) [0|63] ""  RR,ADCU
 SG_ LR_Velocity_066 : 11|11@0+ (0.05,-60) [-60|42.35] "m/s"  RR,ADCU
 SG_ LR_Velocity_067 : 91|11@0+ (0.05,-60) [-60|42.35] "m/s"  RR,ADCU
 SG_ LR_Velocity_068 : 171|11@0+ (0.05,-60) [-60|42.35] "m/s"  RR,ADCU
 SG_ LR_Velocity_069 : 251|11@0+ (0.05,-60) [-60|42.35] "m/s"  RR,ADCU
 SG_ LR_Velocity_070 : 331|11@0+ (0.05,-60) [-60|42.35] "m/s"  RR,ADCU
 SG_ LR_Velocity_071 : 411|11@0+ (0.05,-60) [-60|42.35] "m/s"  RR,ADCU

BO_ 269 LR_RDI_072_077: 64 LR
 SG_ LR_AzimuthAng_072 : 39|11@0+ (0.1,-90) [-90|114.7] "deg"  RR,ADCU
 SG_ LR_AzimuthAng_073 : 119|11@0+ (0.1,-90) [-90|114.7] "deg"  RR,ADCU
 SG_ LR_AzimuthAng_074 : 199|11@0+ (0.1,-90) [-90|114.7] "deg"  RR,ADCU
 SG_ LR_AzimuthAng_075 : 279|11@0+ (0.1,-90) [-90|114.7] "deg"  RR,ADCU
 SG_ LR_AzimuthAng_076 : 359|11@0+ (0.1,-90) [-90|114.7] "deg"  RR,ADCU
 SG_ LR_AzimuthAng_077 : 439|11@0+ (0.1,-90) [-90|114.7] "deg"  RR,ADCU
 SG_ LR_AzimuthSNR_072 : 51|7@0+ (0.5,0) [0|63.5] "dB"  RR,ADCU
 SG_ LR_AzimuthSNR_073 : 131|7@0+ (0.5,0) [0|63.5] "dB"  RR,ADCU
 SG_ LR_AzimuthSNR_074 : 211|7@0+ (0.5,0) [0|63.5] "dB"  RR,ADCU
 SG_ LR_AzimuthSNR_075 : 291|7@0+ (0.5,0) [0|63.5] "dB"  RR,ADCU
 SG_ LR_AzimuthSNR_076 : 371|7@0+ (0.5,0) [0|63.5] "dB"  RR,ADCU
 SG_ LR_AzimuthSNR_077 : 451|7@0+ (0.5,0) [0|63.5] "dB"  RR,ADCU
 SG_ LR_ElevationAng_072 : 44|9@0+ (0.1,-25) [-25|26.1] "deg"  RR,ADCU
 SG_ LR_ElevationAng_073 : 124|9@0+ (0.1,-25) [-25|26.1] "deg"  RR,ADCU
 SG_ LR_ElevationAng_074 : 204|9@0+ (0.1,-25) [-25|26.1] "deg"  RR,ADCU
 SG_ LR_ElevationAng_075 : 284|9@0+ (0.1,-25) [-25|26.1] "deg"  RR,ADCU
 SG_ LR_ElevationAng_076 : 364|9@0+ (0.1,-25) [-25|26.1] "deg"  RR,ADCU
 SG_ LR_ElevationAng_077 : 444|9@0+ (0.1,-25) [-25|26.1] "deg"  RR,ADCU
 SG_ LR_ElevationSNR_072 : 60|7@0+ (0.5,0) [0|63.5] "dB"  RR,ADCU
 SG_ LR_ElevationSNR_073 : 140|7@0+ (0.5,0) [0|63.5] "dB"  RR,ADCU
 SG_ LR_ElevationSNR_074 : 220|7@0+ (0.5,0) [0|63.5] "dB"  RR,ADCU
 SG_ LR_ElevationSNR_075 : 300|7@0+ (0.5,0) [0|63.5] "dB"  RR,ADCU
 SG_ LR_ElevationSNR_076 : 380|7@0+ (0.5,0) [0|63.5] "dB"  RR,ADCU
 SG_ LR_ElevationSNR_077 : 460|7@0+ (0.5,0) [0|63.5] "dB"  RR,ADCU
 SG_ LR_Range_072 : 7|12@0+ (0.0625,0) [0|255.9375] "m"  RR,ADCU
 SG_ LR_Range_073 : 87|12@0+ (0.0625,0) [0|255.9375] "m"  RR,ADCU
 SG_ LR_Range_074 : 167|12@0+ (0.0625,0) [0|255.9375] "m"  RR,ADCU
 SG_ LR_Range_075 : 247|12@0+ (0.0625,0) [0|255.9375] "m"  RR,ADCU
 SG_ LR_Range_076 : 327|12@0+ (0.0625,0) [0|255.9375] "m"  RR,ADCU
 SG_ LR_Range_077 : 407|12@0+ (0.0625,0) [0|255.9375] "m"  RR,ADCU
 SG_ LR_RCS_072 : 16|9@0+ (0.2,-51.1) [-51.1|51.1] "dBsm"  RR,ADCU
 SG_ LR_RCS_073 : 96|9@0+ (0.2,-51.1) [-51.1|51.1] "dBsm"  RR,ADCU
 SG_ LR_RCS_074 : 176|9@0+ (0.2,-51.1) [-51.1|51.1] "dBsm"  RR,ADCU
 SG_ LR_RCS_075 : 256|9@0+ (0.2,-51.1) [-51.1|51.1] "dBsm"  RR,ADCU
 SG_ LR_RCS_076 : 336|9@0+ (0.2,-51.1) [-51.1|51.1] "dBsm"  RR,ADCU
 SG_ LR_RCS_077 : 416|9@0+ (0.2,-51.1) [-51.1|51.1] "dBsm"  RR,ADCU
 SG_ LR_RDI_072_077_AliveCounter : 499|4@0+ (1,0) [0|15] ""  RR,ADCU
 SG_ LR_RDI_072_077_CheckSum : 511|8@0+ (1,0) [0|255] ""  RR,ADCU
 SG_ LR_Status_072 : 79|8@0+ (1,0) [0|255] ""  RR,ADCU
 SG_ LR_Status_073 : 159|8@0+ (1,0) [0|255] ""  RR,ADCU
 SG_ LR_Status_074 : 239|8@0+ (1,0) [0|255] ""  RR,ADCU
 SG_ LR_Status_075 : 319|8@0+ (1,0) [0|255] ""  RR,ADCU
 SG_ LR_Status_076 : 399|8@0+ (1,0) [0|255] ""  RR,ADCU
 SG_ LR_Status_077 : 479|8@0+ (1,0) [0|255] ""  RR,ADCU
 SG_ LR_Tbd_072 : 69|6@0+ (1,0) [0|63] ""  RR,ADCU
 SG_ LR_Tbd_073 : 149|6@0+ (1,0) [0|63] ""  RR,ADCU
 SG_ LR_Tbd_074 : 229|6@0+ (1,0) [0|63] ""  RR,ADCU
 SG_ LR_Tbd_075 : 309|6@0+ (1,0) [0|63] ""  RR,ADCU
 SG_ LR_Tbd_076 : 389|6@0+ (1,0) [0|63] ""  RR,ADCU
 SG_ LR_Tbd_077 : 469|6@0+ (1,0) [0|63] ""  RR,ADCU
 SG_ LR_Velocity_072 : 11|11@0+ (0.05,-60) [-60|42.35] "m/s"  RR,ADCU
 SG_ LR_Velocity_073 : 91|11@0+ (0.05,-60) [-60|42.35] "m/s"  RR,ADCU
 SG_ LR_Velocity_074 : 171|11@0+ (0.05,-60) [-60|42.35] "m/s"  RR,ADCU
 SG_ LR_Velocity_075 : 251|11@0+ (0.05,-60) [-60|42.35] "m/s"  RR,ADCU
 SG_ LR_Velocity_076 : 331|11@0+ (0.05,-60) [-60|42.35] "m/s"  RR,ADCU
 SG_ LR_Velocity_077 : 411|11@0+ (0.05,-60) [-60|42.35] "m/s"  RR,ADCU

BO_ 270 LR_RDI_078_083: 64 LR
 SG_ LR_AzimuthAng_078 : 39|11@0+ (0.1,-90) [-90|114.7] "deg"  RR,ADCU
 SG_ LR_AzimuthAng_079 : 119|11@0+ (0.1,-90) [-90|114.7] "deg"  RR,ADCU
 SG_ LR_AzimuthAng_080 : 199|11@0+ (0.1,-90) [-90|114.7] "deg"  RR,ADCU
 SG_ LR_AzimuthAng_081 : 279|11@0+ (0.1,-90) [-90|114.7] "deg"  RR,ADCU
 SG_ LR_AzimuthAng_082 : 359|11@0+ (0.1,-90) [-90|114.7] "deg"  RR,ADCU
 SG_ LR_AzimuthAng_083 : 439|11@0+ (0.1,-90) [-90|114.7] "deg"  RR,ADCU
 SG_ LR_AzimuthSNR_078 : 51|7@0+ (0.5,0) [0|63.5] "dB"  RR,ADCU
 SG_ LR_AzimuthSNR_079 : 131|7@0+ (0.5,0) [0|63.5] "dB"  RR,ADCU
 SG_ LR_AzimuthSNR_080 : 211|7@0+ (0.5,0) [0|63.5] "dB"  RR,ADCU
 SG_ LR_AzimuthSNR_081 : 291|7@0+ (0.5,0) [0|63.5] "dB"  RR,ADCU
 SG_ LR_AzimuthSNR_082 : 371|7@0+ (0.5,0) [0|63.5] "dB"  RR,ADCU
 SG_ LR_AzimuthSNR_083 : 451|7@0+ (0.5,0) [0|63.5] "dB"  RR,ADCU
 SG_ LR_ElevationAng_078 : 44|9@0+ (0.1,-25) [-25|26.1] "deg"  RR,ADCU
 SG_ LR_ElevationAng_079 : 124|9@0+ (0.1,-25) [-25|26.1] "deg"  RR,ADCU
 SG_ LR_ElevationAng_080 : 204|9@0+ (0.1,-25) [-25|26.1] "deg"  RR,ADCU
 SG_ LR_ElevationAng_081 : 284|9@0+ (0.1,-25) [-25|26.1] "deg"  RR,ADCU
 SG_ LR_ElevationAng_082 : 364|9@0+ (0.1,-25) [-25|26.1] "deg"  RR,ADCU
 SG_ LR_ElevationAng_083 : 444|9@0+ (0.1,-25) [-25|26.1] "deg"  RR,ADCU
 SG_ LR_ElevationSNR_078 : 60|7@0+ (0.5,0) [0|63.5] "dB"  RR,ADCU
 SG_ LR_ElevationSNR_079 : 140|7@0+ (0.5,0) [0|63.5] "dB"  RR,ADCU
 SG_ LR_ElevationSNR_080 : 220|7@0+ (0.5,0) [0|63.5] "dB"  RR,ADCU
 SG_ LR_ElevationSNR_081 : 300|7@0+ (0.5,0) [0|63.5] "dB"  RR,ADCU
 SG_ LR_ElevationSNR_082 : 380|7@0+ (0.5,0) [0|63.5] "dB"  RR,ADCU
 SG_ LR_ElevationSNR_083 : 460|7@0+ (0.5,0) [0|63.5] "dB"  RR,ADCU
 SG_ LR_Range_078 : 7|12@0+ (0.0625,0) [0|255.9375] "m"  RR,ADCU
 SG_ LR_Range_079 : 87|12@0+ (0.0625,0) [0|255.9375] "m"  RR,ADCU
 SG_ LR_Range_080 : 167|12@0+ (0.0625,0) [0|255.9375] "m"  RR,ADCU
 SG_ LR_Range_081 : 247|12@0+ (0.0625,0) [0|255.9375] "m"  RR,ADCU
 SG_ LR_Range_082 : 327|12@0+ (0.0625,0) [0|255.9375] "m"  RR,ADCU
 SG_ LR_Range_083 : 407|12@0+ (0.0625,0) [0|255.9375] "m"  RR,ADCU
 SG_ LR_RCS_078 : 16|9@0+ (0.2,-51.1) [-51.1|51.1] "dBsm"  RR,ADCU
 SG_ LR_RCS_079 : 96|9@0+ (0.2,-51.1) [-51.1|51.1] "dBsm"  RR,ADCU
 SG_ LR_RCS_080 : 176|9@0+ (0.2,-51.1) [-51.1|51.1] "dBsm"  RR,ADCU
 SG_ LR_RCS_081 : 256|9@0+ (0.2,-51.1) [-51.1|51.1] "dBsm"  RR,ADCU
 SG_ LR_RCS_082 : 336|9@0+ (0.2,-51.1) [-51.1|51.1] "dBsm"  RR,ADCU
 SG_ LR_RCS_083 : 416|9@0+ (0.2,-51.1) [-51.1|51.1] "dBsm"  RR,ADCU
 SG_ LR_RDI_078_083_AliveCounter : 499|4@0+ (1,0) [0|15] ""  RR,ADCU
 SG_ LR_RDI_078_083_CheckSum : 511|8@0+ (1,0) [0|255] ""  RR,ADCU
 SG_ LR_Status_078 : 79|8@0+ (1,0) [0|255] ""  RR,ADCU
 SG_ LR_Status_079 : 159|8@0+ (1,0) [0|255] ""  RR,ADCU
 SG_ LR_Status_080 : 239|8@0+ (1,0) [0|255] ""  RR,ADCU
 SG_ LR_Status_081 : 319|8@0+ (1,0) [0|255] ""  RR,ADCU
 SG_ LR_Status_082 : 399|8@0+ (1,0) [0|255] ""  RR,ADCU
 SG_ LR_Status_083 : 479|8@0+ (1,0) [0|255] ""  RR,ADCU
 SG_ LR_Tbd_078 : 69|6@0+ (1,0) [0|63] ""  RR,ADCU
 SG_ LR_Tbd_079 : 149|6@0+ (1,0) [0|63] ""  RR,ADCU
 SG_ LR_Tbd_080 : 229|6@0+ (1,0) [0|63] ""  RR,ADCU
 SG_ LR_Tbd_081 : 309|6@0+ (1,0) [0|63] ""  RR,ADCU
 SG_ LR_Tbd_082 : 389|6@0+ (1,0) [0|63] ""  RR,ADCU
 SG_ LR_Tbd_083 : 469|6@0+ (1,0) [0|63] ""  RR,ADCU
 SG_ LR_Velocity_078 : 11|11@0+ (0.05,-60) [-60|42.35] "m/s"  RR,ADCU
 SG_ LR_Velocity_079 : 91|11@0+ (0.05,-60) [-60|42.35] "m/s"  RR,ADCU
 SG_ LR_Velocity_080 : 171|11@0+ (0.05,-60) [-60|42.35] "m/s"  RR,ADCU
 SG_ LR_Velocity_081 : 251|11@0+ (0.05,-60) [-60|42.35] "m/s"  RR,ADCU
 SG_ LR_Velocity_082 : 331|11@0+ (0.05,-60) [-60|42.35] "m/s"  RR,ADCU
 SG_ LR_Velocity_083 : 411|11@0+ (0.05,-60) [-60|42.35] "m/s"  RR,ADCU

BO_ 271 LR_RDI_084_089: 64 LR
 SG_ LR_AzimuthAng_084 : 39|11@0+ (0.1,-90) [-90|114.7] "deg"  RR,ADCU
 SG_ LR_AzimuthAng_085 : 119|11@0+ (0.1,-90) [-90|114.7] "deg"  RR,ADCU
 SG_ LR_AzimuthAng_086 : 199|11@0+ (0.1,-90) [-90|114.7] "deg"  RR,ADCU
 SG_ LR_AzimuthAng_087 : 279|11@0+ (0.1,-90) [-90|114.7] "deg"  RR,ADCU
 SG_ LR_AzimuthAng_088 : 359|11@0+ (0.1,-90) [-90|114.7] "deg"  RR,ADCU
 SG_ LR_AzimuthAng_089 : 439|11@0+ (0.1,-90) [-90|114.7] "deg"  RR,ADCU
 SG_ LR_AzimuthSNR_084 : 51|7@0+ (0.5,0) [0|63.5] "dB"  RR,ADCU
 SG_ LR_AzimuthSNR_085 : 131|7@0+ (0.5,0) [0|63.5] "dB"  RR,ADCU
 SG_ LR_AzimuthSNR_086 : 211|7@0+ (0.5,0) [0|63.5] "dB"  RR,ADCU
 SG_ LR_AzimuthSNR_087 : 291|7@0+ (0.5,0) [0|63.5] "dB"  RR,ADCU
 SG_ LR_AzimuthSNR_088 : 371|7@0+ (0.5,0) [0|63.5] "dB"  RR,ADCU
 SG_ LR_AzimuthSNR_089 : 451|7@0+ (0.5,0) [0|63.5] "dB"  RR,ADCU
 SG_ LR_ElevationAng_084 : 44|9@0+ (0.1,-25) [-25|26.1] "deg"  RR,ADCU
 SG_ LR_ElevationAng_085 : 124|9@0+ (0.1,-25) [-25|26.1] "deg"  RR,ADCU
 SG_ LR_ElevationAng_086 : 204|9@0+ (0.1,-25) [-25|26.1] "deg"  RR,ADCU
 SG_ LR_ElevationAng_087 : 284|9@0+ (0.1,-25) [-25|26.1] "deg"  RR,ADCU
 SG_ LR_ElevationAng_088 : 364|9@0+ (0.1,-25) [-25|26.1] "deg"  RR,ADCU
 SG_ LR_ElevationAng_089 : 444|9@0+ (0.1,-25) [-25|26.1] "deg"  RR,ADCU
 SG_ LR_ElevationSNR_084 : 60|7@0+ (0.5,0) [0|63.5] "dB"  RR,ADCU
 SG_ LR_ElevationSNR_085 : 140|7@0+ (0.5,0) [0|63.5] "dB"  RR,ADCU
 SG_ LR_ElevationSNR_086 : 220|7@0+ (0.5,0) [0|63.5] "dB"  RR,ADCU
 SG_ LR_ElevationSNR_087 : 300|7@0+ (0.5,0) [0|63.5] "dB"  RR,ADCU
 SG_ LR_ElevationSNR_088 : 380|7@0+ (0.5,0) [0|63.5] "dB"  RR,ADCU
 SG_ LR_ElevationSNR_089 : 460|7@0+ (0.5,0) [0|63.5] "dB"  RR,ADCU
 SG_ LR_Range_084 : 7|12@0+ (0.0625,0) [0|255.9375] "m"  RR,ADCU
 SG_ LR_Range_085 : 87|12@0+ (0.0625,0) [0|255.9375] "m"  RR,ADCU
 SG_ LR_Range_086 : 167|12@0+ (0.0625,0) [0|255.9375] "m"  RR,ADCU
 SG_ LR_Range_087 : 247|12@0+ (0.0625,0) [0|255.9375] "m"  RR,ADCU
 SG_ LR_Range_088 : 327|12@0+ (0.0625,0) [0|255.9375] "m"  RR,ADCU
 SG_ LR_Range_089 : 407|12@0+ (0.0625,0) [0|255.9375] "m"  RR,ADCU
 SG_ LR_RCS_084 : 16|9@0+ (0.2,-51.1) [-51.1|51.1] "dBsm"  RR,ADCU
 SG_ LR_RCS_085 : 96|9@0+ (0.2,-51.1) [-51.1|51.1] "dBsm"  RR,ADCU
 SG_ LR_RCS_086 : 176|9@0+ (0.2,-51.1) [-51.1|51.1] "dBsm"  RR,ADCU
 SG_ LR_RCS_087 : 256|9@0+ (0.2,-51.1) [-51.1|51.1] "dBsm"  RR,ADCU
 SG_ LR_RCS_088 : 336|9@0+ (0.2,-51.1) [-51.1|51.1] "dBsm"  RR,ADCU
 SG_ LR_RCS_089 : 416|9@0+ (0.2,-51.1) [-51.1|51.1] "dBsm"  RR,ADCU
 SG_ LR_RDI_084_089_AliveCounter : 499|4@0+ (1,0) [0|15] ""  RR,ADCU
 SG_ LR_RDI_084_089_CheckSum : 511|8@0+ (1,0) [0|255] ""  RR,ADCU
 SG_ LR_Status_084 : 79|8@0+ (1,0) [0|255] ""  RR,ADCU
 SG_ LR_Status_085 : 159|8@0+ (1,0) [0|255] ""  RR,ADCU
 SG_ LR_Status_086 : 239|8@0+ (1,0) [0|255] ""  RR,ADCU
 SG_ LR_Status_087 : 319|8@0+ (1,0) [0|255] ""  RR,ADCU
 SG_ LR_Status_088 : 399|8@0+ (1,0) [0|255] ""  RR,ADCU
 SG_ LR_Status_089 : 479|8@0+ (1,0) [0|255] ""  RR,ADCU
 SG_ LR_Tbd_084 : 69|6@0+ (1,0) [0|63] ""  RR,ADCU
 SG_ LR_Tbd_085 : 149|6@0+ (1,0) [0|63] ""  RR,ADCU
 SG_ LR_Tbd_086 : 229|6@0+ (1,0) [0|63] ""  RR,ADCU
 SG_ LR_Tbd_087 : 309|6@0+ (1,0) [0|63] ""  RR,ADCU
 SG_ LR_Tbd_088 : 389|6@0+ (1,0) [0|63] ""  RR,ADCU
 SG_ LR_Tbd_089 : 469|6@0+ (1,0) [0|63] ""  RR,ADCU
 SG_ LR_Velocity_084 : 11|11@0+ (0.05,-60) [-60|42.35] "m/s"  RR,ADCU
 SG_ LR_Velocity_085 : 91|11@0+ (0.05,-60) [-60|42.35] "m/s"  RR,ADCU
 SG_ LR_Velocity_086 : 171|11@0+ (0.05,-60) [-60|42.35] "m/s"  RR,ADCU
 SG_ LR_Velocity_087 : 251|11@0+ (0.05,-60) [-60|42.35] "m/s"  RR,ADCU
 SG_ LR_Velocity_088 : 331|11@0+ (0.05,-60) [-60|42.35] "m/s"  RR,ADCU
 SG_ LR_Velocity_089 : 411|11@0+ (0.05,-60) [-60|42.35] "m/s"  RR,ADCU

BO_ 272 LR_RDI_090_095: 64 LR
 SG_ LR_AzimuthAng_090 : 39|11@0+ (0.1,-90) [-90|114.7] "deg"  RR,ADCU
 SG_ LR_AzimuthAng_091 : 119|11@0+ (0.1,-90) [-90|114.7] "deg"  RR,ADCU
 SG_ LR_AzimuthAng_092 : 199|11@0+ (0.1,-90) [-90|114.7] "deg"  RR,ADCU
 SG_ LR_AzimuthAng_093 : 279|11@0+ (0.1,-90) [-90|114.7] "deg"  RR,ADCU
 SG_ LR_AzimuthAng_094 : 359|11@0+ (0.1,-90) [-90|114.7] "deg"  RR,ADCU
 SG_ LR_AzimuthAng_095 : 439|11@0+ (0.1,-90) [-90|114.7] "deg"  RR,ADCU
 SG_ LR_AzimuthSNR_090 : 51|7@0+ (0.5,0) [0|63.5] "dB"  RR,ADCU
 SG_ LR_AzimuthSNR_091 : 131|7@0+ (0.5,0) [0|63.5] "dB"  RR,ADCU
 SG_ LR_AzimuthSNR_092 : 211|7@0+ (0.5,0) [0|63.5] "dB"  RR,ADCU
 SG_ LR_AzimuthSNR_093 : 291|7@0+ (0.5,0) [0|63.5] "dB"  RR,ADCU
 SG_ LR_AzimuthSNR_094 : 371|7@0+ (0.5,0) [0|63.5] "dB"  RR,ADCU
 SG_ LR_AzimuthSNR_095 : 451|7@0+ (0.5,0) [0|63.5] "dB"  RR,ADCU
 SG_ LR_ElevationAng_090 : 44|9@0+ (0.1,-25) [-25|26.1] "deg"  RR,ADCU
 SG_ LR_ElevationAng_091 : 124|9@0+ (0.1,-25) [-25|26.1] "deg"  RR,ADCU
 SG_ LR_ElevationAng_092 : 204|9@0+ (0.1,-25) [-25|26.1] "deg"  RR,ADCU
 SG_ LR_ElevationAng_093 : 284|9@0+ (0.1,-25) [-25|26.1] "deg"  RR,ADCU
 SG_ LR_ElevationAng_094 : 364|9@0+ (0.1,-25) [-25|26.1] "deg"  RR,ADCU
 SG_ LR_ElevationAng_095 : 444|9@0+ (0.1,-25) [-25|26.1] "deg"  RR,ADCU
 SG_ LR_ElevationSNR_090 : 60|7@0+ (0.5,0) [0|63.5] "dB"  RR,ADCU
 SG_ LR_ElevationSNR_091 : 140|7@0+ (0.5,0) [0|63.5] "dB"  RR,ADCU
 SG_ LR_ElevationSNR_092 : 220|7@0+ (0.5,0) [0|63.5] "dB"  RR,ADCU
 SG_ LR_ElevationSNR_093 : 300|7@0+ (0.5,0) [0|63.5] "dB"  RR,ADCU
 SG_ LR_ElevationSNR_094 : 380|7@0+ (0.5,0) [0|63.5] "dB"  RR,ADCU
 SG_ LR_ElevationSNR_095 : 460|7@0+ (0.5,0) [0|63.5] "dB"  RR,ADCU
 SG_ LR_Range_090 : 7|12@0+ (0.0625,0) [0|255.9375] "m"  RR,ADCU
 SG_ LR_Range_091 : 87|12@0+ (0.0625,0) [0|255.9375] "m"  RR,ADCU
 SG_ LR_Range_092 : 167|12@0+ (0.0625,0) [0|255.9375] "m"  RR,ADCU
 SG_ LR_Range_093 : 247|12@0+ (0.0625,0) [0|255.9375] "m"  RR,ADCU
 SG_ LR_Range_094 : 327|12@0+ (0.0625,0) [0|255.9375] "m"  RR,ADCU
 SG_ LR_Range_095 : 407|12@0+ (0.0625,0) [0|255.9375] "m"  RR,ADCU
 SG_ LR_RCS_090 : 16|9@0+ (0.2,-51.1) [-51.1|51.1] "dBsm"  RR,ADCU
 SG_ LR_RCS_091 : 96|9@0+ (0.2,-51.1) [-51.1|51.1] "dBsm"  RR,ADCU
 SG_ LR_RCS_092 : 176|9@0+ (0.2,-51.1) [-51.1|51.1] "dBsm"  RR,ADCU
 SG_ LR_RCS_093 : 256|9@0+ (0.2,-51.1) [-51.1|51.1] "dBsm"  RR,ADCU
 SG_ LR_RCS_094 : 336|9@0+ (0.2,-51.1) [-51.1|51.1] "dBsm"  RR,ADCU
 SG_ LR_RCS_095 : 416|9@0+ (0.2,-51.1) [-51.1|51.1] "dBsm"  RR,ADCU
 SG_ LR_RDI_090_095_AliveCounter : 499|4@0+ (1,0) [0|15] ""  RR,ADCU
 SG_ LR_RDI_090_095_CheckSum : 511|8@0+ (1,0) [0|255] ""  RR,ADCU
 SG_ LR_Status_090 : 79|8@0+ (1,0) [0|255] ""  RR,ADCU
 SG_ LR_Status_091 : 159|8@0+ (1,0) [0|255] ""  RR,ADCU
 SG_ LR_Status_092 : 239|8@0+ (1,0) [0|255] ""  RR,ADCU
 SG_ LR_Status_093 : 319|8@0+ (1,0) [0|255] ""  RR,ADCU
 SG_ LR_Status_094 : 399|8@0+ (1,0) [0|255] ""  RR,ADCU
 SG_ LR_Status_095 : 479|8@0+ (1,0) [0|255] ""  RR,ADCU
 SG_ LR_Tbd_090 : 69|6@0+ (1,0) [0|63] ""  RR,ADCU
 SG_ LR_Tbd_091 : 149|6@0+ (1,0) [0|63] ""  RR,ADCU
 SG_ LR_Tbd_092 : 229|6@0+ (1,0) [0|63] ""  RR,ADCU
 SG_ LR_Tbd_093 : 309|6@0+ (1,0) [0|63] ""  RR,ADCU
 SG_ LR_Tbd_094 : 389|6@0+ (1,0) [0|63] ""  RR,ADCU
 SG_ LR_Tbd_095 : 469|6@0+ (1,0) [0|63] ""  RR,ADCU
 SG_ LR_Velocity_090 : 11|11@0+ (0.05,-60) [-60|42.35] "m/s"  RR,ADCU
 SG_ LR_Velocity_091 : 91|11@0+ (0.05,-60) [-60|42.35] "m/s"  RR,ADCU
 SG_ LR_Velocity_092 : 171|11@0+ (0.05,-60) [-60|42.35] "m/s"  RR,ADCU
 SG_ LR_Velocity_093 : 251|11@0+ (0.05,-60) [-60|42.35] "m/s"  RR,ADCU
 SG_ LR_Velocity_094 : 331|11@0+ (0.05,-60) [-60|42.35] "m/s"  RR,ADCU
 SG_ LR_Velocity_095 : 411|11@0+ (0.05,-60) [-60|42.35] "m/s"  RR,ADCU

BO_ 273 LR_RDI_096_101: 64 LR
 SG_ LR_AzimuthAng_096 : 39|11@0+ (0.1,-90) [-90|114.7] "deg"  RR,ADCU
 SG_ LR_AzimuthAng_097 : 119|11@0+ (0.1,-90) [-90|114.7] "deg"  RR,ADCU
 SG_ LR_AzimuthAng_098 : 199|11@0+ (0.1,-90) [-90|114.7] "deg"  RR,ADCU
 SG_ LR_AzimuthAng_099 : 279|11@0+ (0.1,-90) [-90|114.7] "deg"  RR,ADCU
 SG_ LR_AzimuthAng_100 : 359|11@0+ (0.1,-90) [-90|114.7] "deg"  RR,ADCU
 SG_ LR_AzimuthAng_101 : 439|11@0+ (0.1,-90) [-90|114.7] "deg"  RR,ADCU
 SG_ LR_AzimuthSNR_096 : 51|7@0+ (0.5,0) [0|63.5] "dB"  RR,ADCU
 SG_ LR_AzimuthSNR_097 : 131|7@0+ (0.5,0) [0|63.5] "dB"  RR,ADCU
 SG_ LR_AzimuthSNR_098 : 211|7@0+ (0.5,0) [0|63.5] "dB"  RR,ADCU
 SG_ LR_AzimuthSNR_099 : 291|7@0+ (0.5,0) [0|63.5] "dB"  RR,ADCU
 SG_ LR_AzimuthSNR_100 : 371|7@0+ (0.5,0) [0|63.5] "dB"  RR,ADCU
 SG_ LR_AzimuthSNR_101 : 451|7@0+ (0.5,0) [0|63.5] "dB"  RR,ADCU
 SG_ LR_ElevationAng_096 : 44|9@0+ (0.1,-25) [-25|26.1] "deg"  RR,ADCU
 SG_ LR_ElevationAng_097 : 124|9@0+ (0.1,-25) [-25|26.1] "deg"  RR,ADCU
 SG_ LR_ElevationAng_098 : 204|9@0+ (0.1,-25) [-25|26.1] "deg"  RR,ADCU
 SG_ LR_ElevationAng_099 : 284|9@0+ (0.1,-25) [-25|26.1] "deg"  RR,ADCU
 SG_ LR_ElevationAng_100 : 364|9@0+ (0.1,-25) [-25|26.1] "deg"  RR,ADCU
 SG_ LR_ElevationAng_101 : 444|9@0+ (0.1,-25) [-25|26.1] "deg"  RR,ADCU
 SG_ LR_ElevationSNR_096 : 60|7@0+ (0.5,0) [0|63.5] "dB"  RR,ADCU
 SG_ LR_ElevationSNR_097 : 140|7@0+ (0.5,0) [0|63.5] "dB"  RR,ADCU
 SG_ LR_ElevationSNR_098 : 220|7@0+ (0.5,0) [0|63.5] "dB"  RR,ADCU
 SG_ LR_ElevationSNR_099 : 300|7@0+ (0.5,0) [0|63.5] "dB"  RR,ADCU
 SG_ LR_ElevationSNR_100 : 380|7@0+ (0.5,0) [0|63.5] "dB"  RR,ADCU
 SG_ LR_ElevationSNR_101 : 460|7@0+ (0.5,0) [0|63.5] "dB"  RR,ADCU
 SG_ LR_Range_096 : 7|12@0+ (0.0625,0) [0|255.9375] "m"  RR,ADCU
 SG_ LR_Range_097 : 87|12@0+ (0.0625,0) [0|255.9375] "m"  RR,ADCU
 SG_ LR_Range_098 : 167|12@0+ (0.0625,0) [0|255.9375] "m"  RR,ADCU
 SG_ LR_Range_099 : 247|12@0+ (0.0625,0) [0|255.9375] "m"  RR,ADCU
 SG_ LR_Range_100 : 327|12@0+ (0.0625,0) [0|255.9375] "m"  RR,ADCU
 SG_ LR_Range_101 : 407|12@0+ (0.0625,0) [0|255.9375] "m"  RR,ADCU
 SG_ LR_RCS_096 : 16|9@0+ (0.2,-51.1) [-51.1|51.1] "dBsm"  RR,ADCU
 SG_ LR_RCS_097 : 96|9@0+ (0.2,-51.1) [-51.1|51.1] "dBsm"  RR,ADCU
 SG_ LR_RCS_098 : 176|9@0+ (0.2,-51.1) [-51.1|51.1] "dBsm"  RR,ADCU
 SG_ LR_RCS_099 : 256|9@0+ (0.2,-51.1) [-51.1|51.1] "dBsm"  RR,ADCU
 SG_ LR_RCS_100 : 336|9@0+ (0.2,-51.1) [-51.1|51.1] "dBsm"  RR,ADCU
 SG_ LR_RCS_101 : 416|9@0+ (0.2,-51.1) [-51.1|51.1] "dBsm"  RR,ADCU
 SG_ LR_RDI_096_101_AliveCounter : 499|4@0+ (1,0) [0|15] ""  RR,ADCU
 SG_ LR_RDI_096_101_CheckSum : 511|8@0+ (1,0) [0|255] ""  RR,ADCU
 SG_ LR_Status_096 : 79|8@0+ (1,0) [0|255] ""  RR,ADCU
 SG_ LR_Status_097 : 159|8@0+ (1,0) [0|255] ""  RR,ADCU
 SG_ LR_Status_098 : 239|8@0+ (1,0) [0|255] ""  RR,ADCU
 SG_ LR_Status_099 : 319|8@0+ (1,0) [0|255] ""  RR,ADCU
 SG_ LR_Status_100 : 399|8@0+ (1,0) [0|255] ""  RR,ADCU
 SG_ LR_Status_101 : 479|8@0+ (1,0) [0|255] ""  RR,ADCU
 SG_ LR_Tbd_096 : 69|6@0+ (1,0) [0|63] ""  RR,ADCU
 SG_ LR_Tbd_097 : 149|6@0+ (1,0) [0|63] ""  RR,ADCU
 SG_ LR_Tbd_098 : 229|6@0+ (1,0) [0|63] ""  RR,ADCU
 SG_ LR_Tbd_099 : 309|6@0+ (1,0) [0|63] ""  RR,ADCU
 SG_ LR_Tbd_100 : 389|6@0+ (1,0) [0|63] ""  RR,ADCU
 SG_ LR_Tbd_101 : 469|6@0+ (1,0) [0|63] ""  RR,ADCU
 SG_ LR_Velocity_096 : 11|11@0+ (0.05,-60) [-60|42.35] "m/s"  RR,ADCU
 SG_ LR_Velocity_097 : 91|11@0+ (0.05,-60) [-60|42.35] "m/s"  RR,ADCU
 SG_ LR_Velocity_098 : 171|11@0+ (0.05,-60) [-60|42.35] "m/s"  RR,ADCU
 SG_ LR_Velocity_099 : 251|11@0+ (0.05,-60) [-60|42.35] "m/s"  RR,ADCU
 SG_ LR_Velocity_100 : 331|11@0+ (0.05,-60) [-60|42.35] "m/s"  RR,ADCU
 SG_ LR_Velocity_101 : 411|11@0+ (0.05,-60) [-60|42.35] "m/s"  RR,ADCU

BO_ 274 LR_RDI_102_107: 64 LR
 SG_ LR_AzimuthAng_102 : 39|11@0+ (0.1,-90) [-90|114.7] "deg"  RR,ADCU
 SG_ LR_AzimuthAng_103 : 119|11@0+ (0.1,-90) [-90|114.7] "deg"  RR,ADCU
 SG_ LR_AzimuthAng_104 : 199|11@0+ (0.1,-90) [-90|114.7] "deg"  RR,ADCU
 SG_ LR_AzimuthAng_105 : 279|11@0+ (0.1,-90) [-90|114.7] "deg"  RR,ADCU
 SG_ LR_AzimuthAng_106 : 359|11@0+ (0.1,-90) [-90|114.7] "deg"  RR,ADCU
 SG_ LR_AzimuthAng_107 : 439|11@0+ (0.1,-90) [-90|114.7] "deg"  RR,ADCU
 SG_ LR_AzimuthSNR_102 : 51|7@0+ (0.5,0) [0|63.5] "dB"  RR,ADCU
 SG_ LR_AzimuthSNR_103 : 131|7@0+ (0.5,0) [0|63.5] "dB"  RR,ADCU
 SG_ LR_AzimuthSNR_104 : 211|7@0+ (0.5,0) [0|63.5] "dB"  RR,ADCU
 SG_ LR_AzimuthSNR_105 : 291|7@0+ (0.5,0) [0|63.5] "dB"  RR,ADCU
 SG_ LR_AzimuthSNR_106 : 371|7@0+ (0.5,0) [0|63.5] "dB"  RR,ADCU
 SG_ LR_AzimuthSNR_107 : 451|7@0+ (0.5,0) [0|63.5] "dB"  RR,ADCU
 SG_ LR_ElevationAng_102 : 44|9@0+ (0.1,-25) [-25|26.1] "deg"  RR,ADCU
 SG_ LR_ElevationAng_103 : 124|9@0+ (0.1,-25) [-25|26.1] "deg"  RR,ADCU
 SG_ LR_ElevationAng_104 : 204|9@0+ (0.1,-25) [-25|26.1] "deg"  RR,ADCU
 SG_ LR_ElevationAng_105 : 284|9@0+ (0.1,-25) [-25|26.1] "deg"  RR,ADCU
 SG_ LR_ElevationAng_106 : 364|9@0+ (0.1,-25) [-25|26.1] "deg"  RR,ADCU
 SG_ LR_ElevationAng_107 : 444|9@0+ (0.1,-25) [-25|26.1] "deg"  RR,ADCU
 SG_ LR_ElevationSNR_102 : 60|7@0+ (0.5,0) [0|63.5] "dB"  RR,ADCU
 SG_ LR_ElevationSNR_103 : 140|7@0+ (0.5,0) [0|63.5] "dB"  RR,ADCU
 SG_ LR_ElevationSNR_104 : 220|7@0+ (0.5,0) [0|63.5] "dB"  RR,ADCU
 SG_ LR_ElevationSNR_105 : 300|7@0+ (0.5,0) [0|63.5] "dB"  RR,ADCU
 SG_ LR_ElevationSNR_106 : 380|7@0+ (0.5,0) [0|63.5] "dB"  RR,ADCU
 SG_ LR_ElevationSNR_107 : 460|7@0+ (0.5,0) [0|63.5] "dB"  RR,ADCU
 SG_ LR_Range_102 : 7|12@0+ (0.0625,0) [0|255.9375] "m"  RR,ADCU
 SG_ LR_Range_103 : 87|12@0+ (0.0625,0) [0|255.9375] "m"  RR,ADCU
 SG_ LR_Range_104 : 167|12@0+ (0.0625,0) [0|255.9375] "m"  RR,ADCU
 SG_ LR_Range_105 : 247|12@0+ (0.0625,0) [0|255.9375] "m"  RR,ADCU
 SG_ LR_Range_106 : 327|12@0+ (0.0625,0) [0|255.9375] "m"  RR,ADCU
 SG_ LR_Range_107 : 407|12@0+ (0.0625,0) [0|255.9375] "m"  RR,ADCU
 SG_ LR_RCS_102 : 16|9@0+ (0.2,-51.1) [-51.1|51.1] "dBsm"  RR,ADCU
 SG_ LR_RCS_103 : 96|9@0+ (0.2,-51.1) [-51.1|51.1] "dBsm"  RR,ADCU
 SG_ LR_RCS_104 : 176|9@0+ (0.2,-51.1) [-51.1|51.1] "dBsm"  RR,ADCU
 SG_ LR_RCS_105 : 256|9@0+ (0.2,-51.1) [-51.1|51.1] "dBsm"  RR,ADCU
 SG_ LR_RCS_106 : 336|9@0+ (0.2,-51.1) [-51.1|51.1] "dBsm"  RR,ADCU
 SG_ LR_RCS_107 : 416|9@0+ (0.2,-51.1) [-51.1|51.1] "dBsm"  RR,ADCU
 SG_ LR_RDI_102_107_AliveCounter : 499|4@0+ (1,0) [0|15] ""  RR,ADCU
 SG_ LR_RDI_102_107_CheckSum : 511|8@0+ (1,0) [0|255] ""  RR,ADCU
 SG_ LR_Status_102 : 79|8@0+ (1,0) [0|255] ""  RR,ADCU
 SG_ LR_Status_103 : 159|8@0+ (1,0) [0|255] ""  RR,ADCU
 SG_ LR_Status_104 : 239|8@0+ (1,0) [0|255] ""  RR,ADCU
 SG_ LR_Status_105 : 319|8@0+ (1,0) [0|255] ""  RR,ADCU
 SG_ LR_Status_106 : 399|8@0+ (1,0) [0|255] ""  RR,ADCU
 SG_ LR_Status_107 : 479|8@0+ (1,0) [0|255] ""  RR,ADCU
 SG_ LR_Tbd_102 : 69|6@0+ (1,0) [0|63] ""  RR,ADCU
 SG_ LR_Tbd_103 : 149|6@0+ (1,0) [0|63] ""  RR,ADCU
 SG_ LR_Tbd_104 : 229|6@0+ (1,0) [0|63] ""  RR,ADCU
 SG_ LR_Tbd_105 : 309|6@0+ (1,0) [0|63] ""  RR,ADCU
 SG_ LR_Tbd_106 : 389|6@0+ (1,0) [0|63] ""  RR,ADCU
 SG_ LR_Tbd_107 : 469|6@0+ (1,0) [0|63] ""  RR,ADCU
 SG_ LR_Velocity_102 : 11|11@0+ (0.05,-60) [-60|42.35] "m/s"  RR,ADCU
 SG_ LR_Velocity_103 : 91|11@0+ (0.05,-60) [-60|42.35] "m/s"  RR,ADCU
 SG_ LR_Velocity_104 : 171|11@0+ (0.05,-60) [-60|42.35] "m/s"  RR,ADCU
 SG_ LR_Velocity_105 : 251|11@0+ (0.05,-60) [-60|42.35] "m/s"  RR,ADCU
 SG_ LR_Velocity_106 : 331|11@0+ (0.05,-60) [-60|42.35] "m/s"  RR,ADCU
 SG_ LR_Velocity_107 : 411|11@0+ (0.05,-60) [-60|42.35] "m/s"  RR,ADCU

BO_ 275 LR_RDI_108_113: 64 LR
 SG_ LR_AzimuthAng_108 : 39|11@0+ (0.1,-90) [-90|114.7] "deg"  RR,ADCU
 SG_ LR_AzimuthAng_109 : 119|11@0+ (0.1,-90) [-90|114.7] "deg"  RR,ADCU
 SG_ LR_AzimuthAng_110 : 199|11@0+ (0.1,-90) [-90|114.7] "deg"  RR,ADCU
 SG_ LR_AzimuthAng_111 : 279|11@0+ (0.1,-90) [-90|114.7] "deg"  RR,ADCU
 SG_ LR_AzimuthAng_112 : 359|11@0+ (0.1,-90) [-90|114.7] "deg"  RR,ADCU
 SG_ LR_AzimuthAng_113 : 439|11@0+ (0.1,-90) [-90|114.7] "deg"  RR,ADCU
 SG_ LR_AzimuthSNR_108 : 51|7@0+ (0.5,0) [0|63.5] "dB"  RR,ADCU
 SG_ LR_AzimuthSNR_109 : 131|7@0+ (0.5,0) [0|63.5] "dB"  RR,ADCU
 SG_ LR_AzimuthSNR_110 : 211|7@0+ (0.5,0) [0|63.5] "dB"  RR,ADCU
 SG_ LR_AzimuthSNR_111 : 291|7@0+ (0.5,0) [0|63.5] "dB"  RR,ADCU
 SG_ LR_AzimuthSNR_112 : 371|7@0+ (0.5,0) [0|63.5] "dB"  RR,ADCU
 SG_ LR_AzimuthSNR_113 : 451|7@0+ (0.5,0) [0|63.5] "dB"  RR,ADCU
 SG_ LR_ElevationAng_108 : 44|9@0+ (0.1,-25) [-25|26.1] "deg"  RR,ADCU
 SG_ LR_ElevationAng_109 : 124|9@0+ (0.1,-25) [-25|26.1] "deg"  RR,ADCU
 SG_ LR_ElevationAng_110 : 204|9@0+ (0.1,-25) [-25|26.1] "deg"  RR,ADCU
 SG_ LR_ElevationAng_111 : 284|9@0+ (0.1,-25) [-25|26.1] "deg"  RR,ADCU
 SG_ LR_ElevationAng_112 : 364|9@0+ (0.1,-25) [-25|26.1] "deg"  RR,ADCU
 SG_ LR_ElevationAng_113 : 444|9@0+ (0.1,-25) [-25|26.1] "deg"  RR,ADCU
 SG_ LR_ElevationSNR_108 : 60|7@0+ (0.5,0) [0|63.5] "dB"  RR,ADCU
 SG_ LR_ElevationSNR_109 : 140|7@0+ (0.5,0) [0|63.5] "dB"  RR,ADCU
 SG_ LR_ElevationSNR_110 : 220|7@0+ (0.5,0) [0|63.5] "dB"  RR,ADCU
 SG_ LR_ElevationSNR_111 : 300|7@0+ (0.5,0) [0|63.5] "dB"  RR,ADCU
 SG_ LR_ElevationSNR_112 : 380|7@0+ (0.5,0) [0|63.5] "dB"  RR,ADCU
 SG_ LR_ElevationSNR_113 : 460|7@0+ (0.5,0) [0|63.5] "dB"  RR,ADCU
 SG_ LR_Range_108 : 7|12@0+ (0.0625,0) [0|255.9375] "m"  RR,ADCU
 SG_ LR_Range_109 : 87|12@0+ (0.0625,0) [0|255.9375] "m"  RR,ADCU
 SG_ LR_Range_110 : 167|12@0+ (0.0625,0) [0|255.9375] "m"  RR,ADCU
 SG_ LR_Range_111 : 247|12@0+ (0.0625,0) [0|255.9375] "m"  RR,ADCU
 SG_ LR_Range_112 : 327|12@0+ (0.0625,0) [0|255.9375] "m"  RR,ADCU
 SG_ LR_Range_113 : 407|12@0+ (0.0625,0) [0|255.9375] "m"  RR,ADCU
 SG_ LR_RCS_108 : 16|9@0+ (0.2,-51.1) [-51.1|51.1] "dBsm"  RR,ADCU
 SG_ LR_RCS_109 : 96|9@0+ (0.2,-51.1) [-51.1|51.1] "dBsm"  RR,ADCU
 SG_ LR_RCS_110 : 176|9@0+ (0.2,-51.1) [-51.1|51.1] "dBsm"  RR,ADCU
 SG_ LR_RCS_111 : 256|9@0+ (0.2,-51.1) [-51.1|51.1] "dBsm"  RR,ADCU
 SG_ LR_RCS_112 : 336|9@0+ (0.2,-51.1) [-51.1|51.1] "dBsm"  RR,ADCU
 SG_ LR_RCS_113 : 416|9@0+ (0.2,-51.1) [-51.1|51.1] "dBsm"  RR,ADCU
 SG_ LR_RDI_108_113_AliveCounter : 499|4@0+ (1,0) [0|15] ""  RR,ADCU
 SG_ LR_RDI_108_113_CheckSum : 511|8@0+ (1,0) [0|255] ""  RR,ADCU
 SG_ LR_Status_108 : 79|8@0+ (1,0) [0|255] ""  RR,ADCU
 SG_ LR_Status_109 : 159|8@0+ (1,0) [0|255] ""  RR,ADCU
 SG_ LR_Status_110 : 239|8@0+ (1,0) [0|255] ""  RR,ADCU
 SG_ LR_Status_111 : 319|8@0+ (1,0) [0|255] ""  RR,ADCU
 SG_ LR_Status_112 : 399|8@0+ (1,0) [0|255] ""  RR,ADCU
 SG_ LR_Status_113 : 479|8@0+ (1,0) [0|255] ""  RR,ADCU
 SG_ LR_Tbd_108 : 69|6@0+ (1,0) [0|63] ""  RR,ADCU
 SG_ LR_Tbd_109 : 149|6@0+ (1,0) [0|63] ""  RR,ADCU
 SG_ LR_Tbd_110 : 229|6@0+ (1,0) [0|63] ""  RR,ADCU
 SG_ LR_Tbd_111 : 309|6@0+ (1,0) [0|63] ""  RR,ADCU
 SG_ LR_Tbd_112 : 389|6@0+ (1,0) [0|63] ""  RR,ADCU
 SG_ LR_Tbd_113 : 469|6@0+ (1,0) [0|63] ""  RR,ADCU
 SG_ LR_Velocity_108 : 11|11@0+ (0.05,-60) [-60|42.35] "m/s"  RR,ADCU
 SG_ LR_Velocity_109 : 91|11@0+ (0.05,-60) [-60|42.35] "m/s"  RR,ADCU
 SG_ LR_Velocity_110 : 171|11@0+ (0.05,-60) [-60|42.35] "m/s"  RR,ADCU
 SG_ LR_Velocity_111 : 251|11@0+ (0.05,-60) [-60|42.35] "m/s"  RR,ADCU
 SG_ LR_Velocity_112 : 331|11@0+ (0.05,-60) [-60|42.35] "m/s"  RR,ADCU
 SG_ LR_Velocity_113 : 411|11@0+ (0.05,-60) [-60|42.35] "m/s"  RR,ADCU

BO_ 276 LR_RDI_114_119: 64 LR
 SG_ LR_AzimuthAng_114 : 39|11@0+ (0.1,-90) [-90|114.7] "deg"  RR,ADCU
 SG_ LR_AzimuthAng_115 : 119|11@0+ (0.1,-90) [-90|114.7] "deg"  RR,ADCU
 SG_ LR_AzimuthAng_116 : 199|11@0+ (0.1,-90) [-90|114.7] "deg"  RR,ADCU
 SG_ LR_AzimuthAng_117 : 279|11@0+ (0.1,-90) [-90|114.7] "deg"  RR,ADCU
 SG_ LR_AzimuthAng_118 : 359|11@0+ (0.1,-90) [-90|114.7] "deg"  RR,ADCU
 SG_ LR_AzimuthAng_119 : 439|11@0+ (0.1,-90) [-90|114.7] "deg"  RR,ADCU
 SG_ LR_AzimuthSNR_114 : 51|7@0+ (0.5,0) [0|63.5] "dB"  RR,ADCU
 SG_ LR_AzimuthSNR_115 : 131|7@0+ (0.5,0) [0|63.5] "dB"  RR,ADCU
 SG_ LR_AzimuthSNR_116 : 211|7@0+ (0.5,0) [0|63.5] "dB"  RR,ADCU
 SG_ LR_AzimuthSNR_117 : 291|7@0+ (0.5,0) [0|63.5] "dB"  RR,ADCU
 SG_ LR_AzimuthSNR_118 : 371|7@0+ (0.5,0) [0|63.5] "dB"  RR,ADCU
 SG_ LR_AzimuthSNR_119 : 451|7@0+ (0.5,0) [0|63.5] "dB"  RR,ADCU
 SG_ LR_ElevationAng_114 : 44|9@0+ (0.1,-25) [-25|26.1] "deg"  RR,ADCU
 SG_ LR_ElevationAng_115 : 124|9@0+ (0.1,-25) [-25|26.1] "deg"  RR,ADCU
 SG_ LR_ElevationAng_116 : 204|9@0+ (0.1,-25) [-25|26.1] "deg"  RR,ADCU
 SG_ LR_ElevationAng_117 : 284|9@0+ (0.1,-25) [-25|26.1] "deg"  RR,ADCU
 SG_ LR_ElevationAng_118 : 364|9@0+ (0.1,-25) [-25|26.1] "deg"  RR,ADCU
 SG_ LR_ElevationAng_119 : 444|9@0+ (0.1,-25) [-25|26.1] "deg"  RR,ADCU
 SG_ LR_ElevationSNR_114 : 60|7@0+ (0.5,0) [0|63.5] "dB"  RR,ADCU
 SG_ LR_ElevationSNR_115 : 140|7@0+ (0.5,0) [0|63.5] "dB"  RR,ADCU
 SG_ LR_ElevationSNR_116 : 220|7@0+ (0.5,0) [0|63.5] "dB"  RR,ADCU
 SG_ LR_ElevationSNR_117 : 300|7@0+ (0.5,0) [0|63.5] "dB"  RR,ADCU
 SG_ LR_ElevationSNR_118 : 380|7@0+ (0.5,0) [0|63.5] "dB"  RR,ADCU
 SG_ LR_ElevationSNR_119 : 460|7@0+ (0.5,0) [0|63.5] "dB"  RR,ADCU
 SG_ LR_Range_114 : 7|12@0+ (0.0625,0) [0|255.9375] "m"  RR,ADCU
 SG_ LR_Range_115 : 87|12@0+ (0.0625,0) [0|255.9375] "m"  RR,ADCU
 SG_ LR_Range_116 : 167|12@0+ (0.0625,0) [0|255.9375] "m"  RR,ADCU
 SG_ LR_Range_117 : 247|12@0+ (0.0625,0) [0|255.9375] "m"  RR,ADCU
 SG_ LR_Range_118 : 327|12@0+ (0.0625,0) [0|255.9375] "m"  RR,ADCU
 SG_ LR_Range_119 : 407|12@0+ (0.0625,0) [0|255.9375] "m"  RR,ADCU
 SG_ LR_RCS_114 : 16|9@0+ (0.2,-51.1) [-51.1|51.1] "dBsm"  RR,ADCU
 SG_ LR_RCS_115 : 96|9@0+ (0.2,-51.1) [-51.1|51.1] "dBsm"  RR,ADCU
 SG_ LR_RCS_116 : 176|9@0+ (0.2,-51.1) [-51.1|51.1] "dBsm"  RR,ADCU
 SG_ LR_RCS_117 : 256|9@0+ (0.2,-51.1) [-51.1|51.1] "dBsm"  RR,ADCU
 SG_ LR_RCS_118 : 336|9@0+ (0.2,-51.1) [-51.1|51.1] "dBsm"  RR,ADCU
 SG_ LR_RCS_119 : 416|9@0+ (0.2,-51.1) [-51.1|51.1] "dBsm"  RR,ADCU
 SG_ LR_RDI_114_119_AliveCounter : 499|4@0+ (1,0) [0|15] ""  RR,ADCU
 SG_ LR_RDI_114_119_CheckSum : 511|8@0+ (1,0) [0|255] ""  RR,ADCU
 SG_ LR_Status_114 : 79|8@0+ (1,0) [0|255] ""  RR,ADCU
 SG_ LR_Status_115 : 159|8@0+ (1,0) [0|255] ""  RR,ADCU
 SG_ LR_Status_116 : 239|8@0+ (1,0) [0|255] ""  RR,ADCU
 SG_ LR_Status_117 : 319|8@0+ (1,0) [0|255] ""  RR,ADCU
 SG_ LR_Status_118 : 399|8@0+ (1,0) [0|255] ""  RR,ADCU
 SG_ LR_Status_119 : 479|8@0+ (1,0) [0|255] ""  RR,ADCU
 SG_ LR_Tbd_114 : 69|6@0+ (1,0) [0|63] ""  RR,ADCU
 SG_ LR_Tbd_115 : 149|6@0+ (1,0) [0|63] ""  RR,ADCU
 SG_ LR_Tbd_116 : 229|6@0+ (1,0) [0|63] ""  RR,ADCU
 SG_ LR_Tbd_117 : 309|6@0+ (1,0) [0|63] ""  RR,ADCU
 SG_ LR_Tbd_118 : 389|6@0+ (1,0) [0|63] ""  RR,ADCU
 SG_ LR_Tbd_119 : 469|6@0+ (1,0) [0|63] ""  RR,ADCU
 SG_ LR_Velocity_114 : 11|11@0+ (0.05,-60) [-60|42.35] "m/s"  RR,ADCU
 SG_ LR_Velocity_115 : 91|11@0+ (0.05,-60) [-60|42.35] "m/s"  RR,ADCU
 SG_ LR_Velocity_116 : 171|11@0+ (0.05,-60) [-60|42.35] "m/s"  RR,ADCU
 SG_ LR_Velocity_117 : 251|11@0+ (0.05,-60) [-60|42.35] "m/s"  RR,ADCU
 SG_ LR_Velocity_118 : 331|11@0+ (0.05,-60) [-60|42.35] "m/s"  RR,ADCU
 SG_ LR_Velocity_119 : 411|11@0+ (0.05,-60) [-60|42.35] "m/s"  RR,ADCU

BO_ 277 LR_RDI_120_125: 64 LR
 SG_ LR_AzimuthAng_120 : 39|11@0+ (0.1,-90) [-90|114.7] "deg"  RR,ADCU
 SG_ LR_AzimuthAng_121 : 119|11@0+ (0.1,-90) [-90|114.7] "deg"  RR,ADCU
 SG_ LR_AzimuthAng_122 : 199|11@0+ (0.1,-90) [-90|114.7] "deg"  RR,ADCU
 SG_ LR_AzimuthAng_123 : 279|11@0+ (0.1,-90) [-90|114.7] "deg"  RR,ADCU
 SG_ LR_AzimuthAng_124 : 359|11@0+ (0.1,-90) [-90|114.7] "deg"  RR,ADCU
 SG_ LR_AzimuthAng_125 : 439|11@0+ (0.1,-90) [-90|114.7] "deg"  RR,ADCU
 SG_ LR_AzimuthSNR_120 : 51|7@0+ (0.5,0) [0|63.5] "dB"  RR,ADCU
 SG_ LR_AzimuthSNR_121 : 131|7@0+ (0.5,0) [0|63.5] "dB"  RR,ADCU
 SG_ LR_AzimuthSNR_122 : 211|7@0+ (0.5,0) [0|63.5] "dB"  RR,ADCU
 SG_ LR_AzimuthSNR_123 : 291|7@0+ (0.5,0) [0|63.5] "dB"  RR,ADCU
 SG_ LR_AzimuthSNR_124 : 371|7@0+ (0.5,0) [0|63.5] "dB"  RR,ADCU
 SG_ LR_AzimuthSNR_125 : 451|7@0+ (0.5,0) [0|63.5] "dB"  RR,ADCU
 SG_ LR_ElevationAng_120 : 44|9@0+ (0.1,-25) [-25|26.1] "deg"  RR,ADCU
 SG_ LR_ElevationAng_121 : 124|9@0+ (0.1,-25) [-25|26.1] "deg"  RR,ADCU
 SG_ LR_ElevationAng_122 : 204|9@0+ (0.1,-25) [-25|26.1] "deg"  RR,ADCU
 SG_ LR_ElevationAng_123 : 284|9@0+ (0.1,-25) [-25|26.1] "deg"  RR,ADCU
 SG_ LR_ElevationAng_124 : 364|9@0+ (0.1,-25) [-25|26.1] "deg"  RR,ADCU
 SG_ LR_ElevationAng_125 : 444|9@0+ (0.1,-25) [-25|26.1] "deg"  RR,ADCU
 SG_ LR_ElevationSNR_120 : 60|7@0+ (0.5,0) [0|63.5] "dB"  RR,ADCU
 SG_ LR_ElevationSNR_121 : 140|7@0+ (0.5,0) [0|63.5] "dB"  RR,ADCU
 SG_ LR_ElevationSNR_122 : 220|7@0+ (0.5,0) [0|63.5] "dB"  RR,ADCU
 SG_ LR_ElevationSNR_123 : 300|7@0+ (0.5,0) [0|63.5] "dB"  RR,ADCU
 SG_ LR_ElevationSNR_124 : 380|7@0+ (0.5,0) [0|63.5] "dB"  RR,ADCU
 SG_ LR_ElevationSNR_125 : 460|7@0+ (0.5,0) [0|63.5] "dB"  RR,ADCU
 SG_ LR_Range_120 : 7|12@0+ (0.0625,0) [0|255.9375] "m"  RR,ADCU
 SG_ LR_Range_121 : 87|12@0+ (0.0625,0) [0|255.9375] "m"  RR,ADCU
 SG_ LR_Range_122 : 167|12@0+ (0.0625,0) [0|255.9375] "m"  RR,ADCU
 SG_ LR_Range_123 : 247|12@0+ (0.0625,0) [0|255.9375] "m"  RR,ADCU
 SG_ LR_Range_124 : 327|12@0+ (0.0625,0) [0|255.9375] "m"  RR,ADCU
 SG_ LR_Range_125 : 407|12@0+ (0.0625,0) [0|255.9375] "m"  RR,ADCU
 SG_ LR_RCS_120 : 16|9@0+ (0.2,-51.1) [-51.1|51.1] "dBsm"  RR,ADCU
 SG_ LR_RCS_121 : 96|9@0+ (0.2,-51.1) [-51.1|51.1] "dBsm"  RR,ADCU
 SG_ LR_RCS_122 : 176|9@0+ (0.2,-51.1) [-51.1|51.1] "dBsm"  RR,ADCU
 SG_ LR_RCS_123 : 256|9@0+ (0.2,-51.1) [-51.1|51.1] "dBsm"  RR,ADCU
 SG_ LR_RCS_124 : 336|9@0+ (0.2,-51.1) [-51.1|51.1] "dBsm"  RR,ADCU
 SG_ LR_RCS_125 : 416|9@0+ (0.2,-51.1) [-51.1|51.1] "dBsm"  RR,ADCU
 SG_ LR_RDI_120_125_AliveCounter : 499|4@0+ (1,0) [0|15] ""  RR,ADCU
 SG_ LR_RDI_120_125_CheckSum : 511|8@0+ (1,0) [0|255] ""  RR,ADCU
 SG_ LR_Status_120 : 79|8@0+ (1,0) [0|255] ""  RR,ADCU
 SG_ LR_Status_121 : 159|8@0+ (1,0) [0|255] ""  RR,ADCU
 SG_ LR_Status_122 : 239|8@0+ (1,0) [0|255] ""  RR,ADCU
 SG_ LR_Status_123 : 319|8@0+ (1,0) [0|255] ""  RR,ADCU
 SG_ LR_Status_124 : 399|8@0+ (1,0) [0|255] ""  RR,ADCU
 SG_ LR_Status_125 : 479|8@0+ (1,0) [0|255] ""  RR,ADCU
 SG_ LR_Tbd_120 : 69|6@0+ (1,0) [0|63] ""  RR,ADCU
 SG_ LR_Tbd_121 : 149|6@0+ (1,0) [0|63] ""  RR,ADCU
 SG_ LR_Tbd_122 : 229|6@0+ (1,0) [0|63] ""  RR,ADCU
 SG_ LR_Tbd_123 : 309|6@0+ (1,0) [0|63] ""  RR,ADCU
 SG_ LR_Tbd_124 : 389|6@0+ (1,0) [0|63] ""  RR,ADCU
 SG_ LR_Tbd_125 : 469|6@0+ (1,0) [0|63] ""  RR,ADCU
 SG_ LR_Velocity_120 : 11|11@0+ (0.05,-60) [-60|42.35] "m/s"  RR,ADCU
 SG_ LR_Velocity_121 : 91|11@0+ (0.05,-60) [-60|42.35] "m/s"  RR,ADCU
 SG_ LR_Velocity_122 : 171|11@0+ (0.05,-60) [-60|42.35] "m/s"  RR,ADCU
 SG_ LR_Velocity_123 : 251|11@0+ (0.05,-60) [-60|42.35] "m/s"  RR,ADCU
 SG_ LR_Velocity_124 : 331|11@0+ (0.05,-60) [-60|42.35] "m/s"  RR,ADCU
 SG_ LR_Velocity_125 : 411|11@0+ (0.05,-60) [-60|42.35] "m/s"  RR,ADCU

BO_ 278 LR_RDI_126_131: 64 LR
 SG_ LR_AzimuthAng_126 : 39|11@0+ (0.1,-90) [-90|114.7] "deg"  RR,ADCU
 SG_ LR_AzimuthAng_127 : 119|11@0+ (0.1,-90) [-90|114.7] "deg"  RR,ADCU
 SG_ LR_AzimuthAng_128 : 199|11@0+ (0.1,-90) [-90|114.7] "deg"  RR,ADCU
 SG_ LR_AzimuthAng_129 : 279|11@0+ (0.1,-90) [-90|114.7] "deg"  RR,ADCU
 SG_ LR_AzimuthAng_130 : 359|11@0+ (0.1,-90) [-90|114.7] "deg"  RR,ADCU
 SG_ LR_AzimuthAng_131 : 439|11@0+ (0.1,-90) [-90|114.7] "deg"  RR,ADCU
 SG_ LR_AzimuthSNR_126 : 51|7@0+ (0.5,0) [0|63.5] "dB"  RR,ADCU
 SG_ LR_AzimuthSNR_127 : 131|7@0+ (0.5,0) [0|63.5] "dB"  RR,ADCU
 SG_ LR_AzimuthSNR_128 : 211|7@0+ (0.5,0) [0|63.5] "dB"  RR,ADCU
 SG_ LR_AzimuthSNR_129 : 291|7@0+ (0.5,0) [0|63.5] "dB"  RR,ADCU
 SG_ LR_AzimuthSNR_130 : 371|7@0+ (0.5,0) [0|63.5] "dB"  RR,ADCU
 SG_ LR_AzimuthSNR_131 : 451|7@0+ (0.5,0) [0|63.5] "dB"  RR,ADCU
 SG_ LR_ElevationAng_126 : 44|9@0+ (0.1,-25) [-25|26.1] "deg"  RR,ADCU
 SG_ LR_ElevationAng_127 : 124|9@0+ (0.1,-25) [-25|26.1] "deg"  RR,ADCU
 SG_ LR_ElevationAng_128 : 204|9@0+ (0.1,-25) [-25|26.1] "deg"  RR,ADCU
 SG_ LR_ElevationAng_129 : 284|9@0+ (0.1,-25) [-25|26.1] "deg"  RR,ADCU
 SG_ LR_ElevationAng_130 : 364|9@0+ (0.1,-25) [-25|26.1] "deg"  RR,ADCU
 SG_ LR_ElevationAng_131 : 444|9@0+ (0.1,-25) [-25|26.1] "deg"  RR,ADCU
 SG_ LR_ElevationSNR_126 : 60|7@0+ (0.5,0) [0|63.5] "dB"  RR,ADCU
 SG_ LR_ElevationSNR_127 : 140|7@0+ (0.5,0) [0|63.5] "dB"  RR,ADCU
 SG_ LR_ElevationSNR_128 : 220|7@0+ (0.5,0) [0|63.5] "dB"  RR,ADCU
 SG_ LR_ElevationSNR_129 : 300|7@0+ (0.5,0) [0|63.5] "dB"  RR,ADCU
 SG_ LR_ElevationSNR_130 : 380|7@0+ (0.5,0) [0|63.5] "dB"  RR,ADCU
 SG_ LR_ElevationSNR_131 : 460|7@0+ (0.5,0) [0|63.5] "dB"  RR,ADCU
 SG_ LR_Range_126 : 7|12@0+ (0.0625,0) [0|255.9375] "m"  RR,ADCU
 SG_ LR_Range_127 : 87|12@0+ (0.0625,0) [0|255.9375] "m"  RR,ADCU
 SG_ LR_Range_128 : 167|12@0+ (0.0625,0) [0|255.9375] "m"  RR,ADCU
 SG_ LR_Range_129 : 247|12@0+ (0.0625,0) [0|255.9375] "m"  RR,ADCU
 SG_ LR_Range_130 : 327|12@0+ (0.0625,0) [0|255.9375] "m"  RR,ADCU
 SG_ LR_Range_131 : 407|12@0+ (0.0625,0) [0|255.9375] "m"  RR,ADCU
 SG_ LR_RCS_126 : 16|9@0+ (0.2,-51.1) [-51.1|51.1] "dBsm"  RR,ADCU
 SG_ LR_RCS_127 : 96|9@0+ (0.2,-51.1) [-51.1|51.1] "dBsm"  RR,ADCU
 SG_ LR_RCS_128 : 176|9@0+ (0.2,-51.1) [-51.1|51.1] "dBsm"  RR,ADCU
 SG_ LR_RCS_129 : 256|9@0+ (0.2,-51.1) [-51.1|51.1] "dBsm"  RR,ADCU
 SG_ LR_RCS_130 : 336|9@0+ (0.2,-51.1) [-51.1|51.1] "dBsm"  RR,ADCU
 SG_ LR_RCS_131 : 416|9@0+ (0.2,-51.1) [-51.1|51.1] "dBsm"  RR,ADCU
 SG_ LR_RDI_126_131_AliveCounter : 499|4@0+ (1,0) [0|15] ""  RR,ADCU
 SG_ LR_RDI_126_131_CheckSum : 511|8@0+ (1,0) [0|255] ""  RR,ADCU
 SG_ LR_Status_126 : 79|8@0+ (1,0) [0|255] ""  RR,ADCU
 SG_ LR_Status_127 : 159|8@0+ (1,0) [0|255] ""  RR,ADCU
 SG_ LR_Status_128 : 239|8@0+ (1,0) [0|255] ""  RR,ADCU
 SG_ LR_Status_129 : 319|8@0+ (1,0) [0|255] ""  RR,ADCU
 SG_ LR_Status_130 : 399|8@0+ (1,0) [0|255] ""  RR,ADCU
 SG_ LR_Status_131 : 479|8@0+ (1,0) [0|255] ""  RR,ADCU
 SG_ LR_Tbd_126 : 69|6@0+ (1,0) [0|63] ""  RR,ADCU
 SG_ LR_Tbd_127 : 149|6@0+ (1,0) [0|63] ""  RR,ADCU
 SG_ LR_Tbd_128 : 229|6@0+ (1,0) [0|63] ""  RR,ADCU
 SG_ LR_Tbd_129 : 309|6@0+ (1,0) [0|63] ""  RR,ADCU
 SG_ LR_Tbd_130 : 389|6@0+ (1,0) [0|63] ""  RR,ADCU
 SG_ LR_Tbd_131 : 469|6@0+ (1,0) [0|63] ""  RR,ADCU
 SG_ LR_Velocity_126 : 11|11@0+ (0.05,-60) [-60|42.35] "m/s"  RR,ADCU
 SG_ LR_Velocity_127 : 91|11@0+ (0.05,-60) [-60|42.35] "m/s"  RR,ADCU
 SG_ LR_Velocity_128 : 171|11@0+ (0.05,-60) [-60|42.35] "m/s"  RR,ADCU
 SG_ LR_Velocity_129 : 251|11@0+ (0.05,-60) [-60|42.35] "m/s"  RR,ADCU
 SG_ LR_Velocity_130 : 331|11@0+ (0.05,-60) [-60|42.35] "m/s"  RR,ADCU
 SG_ LR_Velocity_131 : 411|11@0+ (0.05,-60) [-60|42.35] "m/s"  RR,ADCU

BO_ 279 LR_RDI_132_137: 64 LR
 SG_ LR_AzimuthAng_132 : 39|11@0+ (0.1,-90) [-90|114.7] "deg"  RR,ADCU
 SG_ LR_AzimuthAng_133 : 119|11@0+ (0.1,-90) [-90|114.7] "deg"  RR,ADCU
 SG_ LR_AzimuthAng_134 : 199|11@0+ (0.1,-90) [-90|114.7] "deg"  RR,ADCU
 SG_ LR_AzimuthAng_135 : 279|11@0+ (0.1,-90) [-90|114.7] "deg"  RR,ADCU
 SG_ LR_AzimuthAng_136 : 359|11@0+ (0.1,-90) [-90|114.7] "deg"  RR,ADCU
 SG_ LR_AzimuthAng_137 : 439|11@0+ (0.1,-90) [-90|114.7] "deg"  RR,ADCU
 SG_ LR_AzimuthSNR_132 : 51|7@0+ (0.5,0) [0|63.5] "dB"  RR,ADCU
 SG_ LR_AzimuthSNR_133 : 131|7@0+ (0.5,0) [0|63.5] "dB"  RR,ADCU
 SG_ LR_AzimuthSNR_134 : 211|7@0+ (0.5,0) [0|63.5] "dB"  RR,ADCU
 SG_ LR_AzimuthSNR_135 : 291|7@0+ (0.5,0) [0|63.5] "dB"  RR,ADCU
 SG_ LR_AzimuthSNR_136 : 371|7@0+ (0.5,0) [0|63.5] "dB"  RR,ADCU
 SG_ LR_AzimuthSNR_137 : 451|7@0+ (0.5,0) [0|63.5] "dB"  RR,ADCU
 SG_ LR_ElevationAng_132 : 44|9@0+ (0.1,-25) [-25|26.1] "deg"  RR,ADCU
 SG_ LR_ElevationAng_133 : 124|9@0+ (0.1,-25) [-25|26.1] "deg"  RR,ADCU
 SG_ LR_ElevationAng_134 : 204|9@0+ (0.1,-25) [-25|26.1] "deg"  RR,ADCU
 SG_ LR_ElevationAng_135 : 284|9@0+ (0.1,-25) [-25|26.1] "deg"  RR,ADCU
 SG_ LR_ElevationAng_136 : 364|9@0+ (0.1,-25) [-25|26.1] "deg"  RR,ADCU
 SG_ LR_ElevationAng_137 : 444|9@0+ (0.1,-25) [-25|26.1] "deg"  RR,ADCU
 SG_ LR_ElevationSNR_132 : 60|7@0+ (0.5,0) [0|63.5] "dB"  RR,ADCU
 SG_ LR_ElevationSNR_133 : 140|7@0+ (0.5,0) [0|63.5] "dB"  RR,ADCU
 SG_ LR_ElevationSNR_134 : 220|7@0+ (0.5,0) [0|63.5] "dB"  RR,ADCU
 SG_ LR_ElevationSNR_135 : 300|7@0+ (0.5,0) [0|63.5] "dB"  RR,ADCU
 SG_ LR_ElevationSNR_136 : 380|7@0+ (0.5,0) [0|63.5] "dB"  RR,ADCU
 SG_ LR_ElevationSNR_137 : 460|7@0+ (0.5,0) [0|63.5] "dB"  RR,ADCU
 SG_ LR_Range_132 : 7|12@0+ (0.0625,0) [0|255.9375] "m"  RR,ADCU
 SG_ LR_Range_133 : 87|12@0+ (0.0625,0) [0|255.9375] "m"  RR,ADCU
 SG_ LR_Range_134 : 167|12@0+ (0.0625,0) [0|255.9375] "m"  RR,ADCU
 SG_ LR_Range_135 : 247|12@0+ (0.0625,0) [0|255.9375] "m"  RR,ADCU
 SG_ LR_Range_136 : 327|12@0+ (0.0625,0) [0|255.9375] "m"  RR,ADCU
 SG_ LR_Range_137 : 407|12@0+ (0.0625,0) [0|255.9375] "m"  RR,ADCU
 SG_ LR_RCS_132 : 16|9@0+ (0.2,-51.1) [-51.1|51.1] "dBsm"  RR,ADCU
 SG_ LR_RCS_133 : 96|9@0+ (0.2,-51.1) [-51.1|51.1] "dBsm"  RR,ADCU
 SG_ LR_RCS_134 : 176|9@0+ (0.2,-51.1) [-51.1|51.1] "dBsm"  RR,ADCU
 SG_ LR_RCS_135 : 256|9@0+ (0.2,-51.1) [-51.1|51.1] "dBsm"  RR,ADCU
 SG_ LR_RCS_136 : 336|9@0+ (0.2,-51.1) [-51.1|51.1] "dBsm"  RR,ADCU
 SG_ LR_RCS_137 : 416|9@0+ (0.2,-51.1) [-51.1|51.1] "dBsm"  RR,ADCU
 SG_ LR_RDI_132_137_AliveCounter : 499|4@0+ (1,0) [0|15] ""  RR,ADCU
 SG_ LR_RDI_132_137_CheckSum : 511|8@0+ (1,0) [0|255] ""  RR,ADCU
 SG_ LR_Status_132 : 79|8@0+ (1,0) [0|255] ""  RR,ADCU
 SG_ LR_Status_133 : 159|8@0+ (1,0) [0|255] ""  RR,ADCU
 SG_ LR_Status_134 : 239|8@0+ (1,0) [0|255] ""  RR,ADCU
 SG_ LR_Status_135 : 319|8@0+ (1,0) [0|255] ""  RR,ADCU
 SG_ LR_Status_136 : 399|8@0+ (1,0) [0|255] ""  RR,ADCU
 SG_ LR_Status_137 : 479|8@0+ (1,0) [0|255] ""  RR,ADCU
 SG_ LR_Tbd_132 : 69|6@0+ (1,0) [0|63] ""  RR,ADCU
 SG_ LR_Tbd_133 : 149|6@0+ (1,0) [0|63] ""  RR,ADCU
 SG_ LR_Tbd_134 : 229|6@0+ (1,0) [0|63] ""  RR,ADCU
 SG_ LR_Tbd_135 : 309|6@0+ (1,0) [0|63] ""  RR,ADCU
 SG_ LR_Tbd_136 : 389|6@0+ (1,0) [0|63] ""  RR,ADCU
 SG_ LR_Tbd_137 : 469|6@0+ (1,0) [0|63] ""  RR,ADCU
 SG_ LR_Velocity_132 : 11|11@0+ (0.05,-60) [-60|42.35] "m/s"  RR,ADCU
 SG_ LR_Velocity_133 : 91|11@0+ (0.05,-60) [-60|42.35] "m/s"  RR,ADCU
 SG_ LR_Velocity_134 : 171|11@0+ (0.05,-60) [-60|42.35] "m/s"  RR,ADCU
 SG_ LR_Velocity_135 : 251|11@0+ (0.05,-60) [-60|42.35] "m/s"  RR,ADCU
 SG_ LR_Velocity_136 : 331|11@0+ (0.05,-60) [-60|42.35] "m/s"  RR,ADCU
 SG_ LR_Velocity_137 : 411|11@0+ (0.05,-60) [-60|42.35] "m/s"  RR,ADCU

BO_ 280 LR_RDI_138_143: 64 LR
 SG_ LR_AzimuthAng_138 : 39|11@0+ (0.1,-90) [-90|114.7] "deg"  RR,ADCU
 SG_ LR_AzimuthAng_139 : 119|11@0+ (0.1,-90) [-90|114.7] "deg"  RR,ADCU
 SG_ LR_AzimuthAng_140 : 199|11@0+ (0.1,-90) [-90|114.7] "deg"  RR,ADCU
 SG_ LR_AzimuthAng_141 : 279|11@0+ (0.1,-90) [-90|114.7] "deg"  RR,ADCU
 SG_ LR_AzimuthAng_142 : 359|11@0+ (0.1,-90) [-90|114.7] "deg"  RR,ADCU
 SG_ LR_AzimuthAng_143 : 439|11@0+ (0.1,-90) [-90|114.7] "deg"  RR,ADCU
 SG_ LR_AzimuthSNR_138 : 51|7@0+ (0.5,0) [0|63.5] "dB"  RR,ADCU
 SG_ LR_AzimuthSNR_139 : 131|7@0+ (0.5,0) [0|63.5] "dB"  RR,ADCU
 SG_ LR_AzimuthSNR_140 : 211|7@0+ (0.5,0) [0|63.5] "dB"  RR,ADCU
 SG_ LR_AzimuthSNR_141 : 291|7@0+ (0.5,0) [0|63.5] "dB"  RR,ADCU
 SG_ LR_AzimuthSNR_142 : 371|7@0+ (0.5,0) [0|63.5] "dB"  RR,ADCU
 SG_ LR_AzimuthSNR_143 : 451|7@0+ (0.5,0) [0|63.5] "dB"  RR,ADCU
 SG_ LR_ElevationAng_138 : 44|9@0+ (0.1,-25) [-25|26.1] "deg"  RR,ADCU
 SG_ LR_ElevationAng_139 : 124|9@0+ (0.1,-25) [-25|26.1] "deg"  RR,ADCU
 SG_ LR_ElevationAng_140 : 204|9@0+ (0.1,-25) [-25|26.1] "deg"  RR,ADCU
 SG_ LR_ElevationAng_141 : 284|9@0+ (0.1,-25) [-25|26.1] "deg"  RR,ADCU
 SG_ LR_ElevationAng_142 : 364|9@0+ (0.1,-25) [-25|26.1] "deg"  RR,ADCU
 SG_ LR_ElevationAng_143 : 444|9@0+ (0.1,-25) [-25|26.1] "deg"  RR,ADCU
 SG_ LR_ElevationSNR_138 : 60|7@0+ (0.5,0) [0|63.5] "dB"  RR,ADCU
 SG_ LR_ElevationSNR_139 : 140|7@0+ (0.5,0) [0|63.5] "dB"  RR,ADCU
 SG_ LR_ElevationSNR_140 : 220|7@0+ (0.5,0) [0|63.5] "dB"  RR,ADCU
 SG_ LR_ElevationSNR_141 : 300|7@0+ (0.5,0) [0|63.5] "dB"  RR,ADCU
 SG_ LR_ElevationSNR_142 : 380|7@0+ (0.5,0) [0|63.5] "dB"  RR,ADCU
 SG_ LR_ElevationSNR_143 : 460|7@0+ (0.5,0) [0|63.5] "dB"  RR,ADCU
 SG_ LR_Range_138 : 7|12@0+ (0.0625,0) [0|255.9375] "m"  RR,ADCU
 SG_ LR_Range_139 : 87|12@0+ (0.0625,0) [0|255.9375] "m"  RR,ADCU
 SG_ LR_Range_140 : 167|12@0+ (0.0625,0) [0|255.9375] "m"  RR,ADCU
 SG_ LR_Range_141 : 247|12@0+ (0.0625,0) [0|255.9375] "m"  RR,ADCU
 SG_ LR_Range_142 : 327|12@0+ (0.0625,0) [0|255.9375] "m"  RR,ADCU
 SG_ LR_Range_143 : 407|12@0+ (0.0625,0) [0|255.9375] "m"  RR,ADCU
 SG_ LR_RCS_138 : 16|9@0+ (0.2,-51.1) [-51.1|51.1] "dBsm"  RR,ADCU
 SG_ LR_RCS_139 : 96|9@0+ (0.2,-51.1) [-51.1|51.1] "dBsm"  RR,ADCU
 SG_ LR_RCS_140 : 176|9@0+ (0.2,-51.1) [-51.1|51.1] "dBsm"  RR,ADCU
 SG_ LR_RCS_141 : 256|9@0+ (0.2,-51.1) [-51.1|51.1] "dBsm"  RR,ADCU
 SG_ LR_RCS_142 : 336|9@0+ (0.2,-51.1) [-51.1|51.1] "dBsm"  RR,ADCU
 SG_ LR_RCS_143 : 416|9@0+ (0.2,-51.1) [-51.1|51.1] "dBsm"  RR,ADCU
 SG_ LR_RDI_138_143_AliveCounter : 499|4@0+ (1,0) [0|15] ""  RR,ADCU
 SG_ LR_RDI_138_143_CheckSum : 511|8@0+ (1,0) [0|255] ""  RR,ADCU
 SG_ LR_Status_138 : 79|8@0+ (1,0) [0|255] ""  RR,ADCU
 SG_ LR_Status_139 : 159|8@0+ (1,0) [0|255] ""  RR,ADCU
 SG_ LR_Status_140 : 239|8@0+ (1,0) [0|255] ""  RR,ADCU
 SG_ LR_Status_141 : 319|8@0+ (1,0) [0|255] ""  RR,ADCU
 SG_ LR_Status_142 : 399|8@0+ (1,0) [0|255] ""  RR,ADCU
 SG_ LR_Status_143 : 479|8@0+ (1,0) [0|255] ""  RR,ADCU
 SG_ LR_Tbd_138 : 69|6@0+ (1,0) [0|63] ""  RR,ADCU
 SG_ LR_Tbd_139 : 149|6@0+ (1,0) [0|63] ""  RR,ADCU
 SG_ LR_Tbd_140 : 229|6@0+ (1,0) [0|63] ""  RR,ADCU
 SG_ LR_Tbd_141 : 309|6@0+ (1,0) [0|63] ""  RR,ADCU
 SG_ LR_Tbd_142 : 389|6@0+ (1,0) [0|63] ""  RR,ADCU
 SG_ LR_Tbd_143 : 469|6@0+ (1,0) [0|63] ""  RR,ADCU
 SG_ LR_Velocity_138 : 11|11@0+ (0.05,-60) [-60|42.35] "m/s"  RR,ADCU
 SG_ LR_Velocity_139 : 91|11@0+ (0.05,-60) [-60|42.35] "m/s"  RR,ADCU
 SG_ LR_Velocity_140 : 171|11@0+ (0.05,-60) [-60|42.35] "m/s"  RR,ADCU
 SG_ LR_Velocity_141 : 251|11@0+ (0.05,-60) [-60|42.35] "m/s"  RR,ADCU
 SG_ LR_Velocity_142 : 331|11@0+ (0.05,-60) [-60|42.35] "m/s"  RR,ADCU
 SG_ LR_Velocity_143 : 411|11@0+ (0.05,-60) [-60|42.35] "m/s"  RR,ADCU

BO_ 281 LR_RDI_144_149: 64 LR
 SG_ LR_AzimuthAng_144 : 39|11@0+ (0.1,-90) [-90|114.7] "deg"  RR,ADCU
 SG_ LR_AzimuthAng_145 : 119|11@0+ (0.1,-90) [-90|114.7] "deg"  RR,ADCU
 SG_ LR_AzimuthAng_146 : 199|11@0+ (0.1,-90) [-90|114.7] "deg"  RR,ADCU
 SG_ LR_AzimuthAng_147 : 279|11@0+ (0.1,-90) [-90|114.7] "deg"  RR,ADCU
 SG_ LR_AzimuthAng_148 : 359|11@0+ (0.1,-90) [-90|114.7] "deg"  RR,ADCU
 SG_ LR_AzimuthAng_149 : 439|11@0+ (0.1,-90) [-90|114.7] "deg"  RR,ADCU
 SG_ LR_AzimuthSNR_144 : 51|7@0+ (0.5,0) [0|63.5] "dB"  RR,ADCU
 SG_ LR_AzimuthSNR_145 : 131|7@0+ (0.5,0) [0|63.5] "dB"  RR,ADCU
 SG_ LR_AzimuthSNR_146 : 211|7@0+ (0.5,0) [0|63.5] "dB"  RR,ADCU
 SG_ LR_AzimuthSNR_147 : 291|7@0+ (0.5,0) [0|63.5] "dB"  RR,ADCU
 SG_ LR_AzimuthSNR_148 : 371|7@0+ (0.5,0) [0|63.5] "dB"  RR,ADCU
 SG_ LR_AzimuthSNR_149 : 451|7@0+ (0.5,0) [0|63.5] "dB"  RR,ADCU
 SG_ LR_ElevationAng_144 : 44|9@0+ (0.1,-25) [-25|26.1] "deg"  RR,ADCU
 SG_ LR_ElevationAng_145 : 124|9@0+ (0.1,-25) [-25|26.1] "deg"  RR,ADCU
 SG_ LR_ElevationAng_146 : 204|9@0+ (0.1,-25) [-25|26.1] "deg"  RR,ADCU
 SG_ LR_ElevationAng_147 : 284|9@0+ (0.1,-25) [-25|26.1] "deg"  RR,ADCU
 SG_ LR_ElevationAng_148 : 364|9@0+ (0.1,-25) [-25|26.1] "deg"  RR,ADCU
 SG_ LR_ElevationAng_149 : 444|9@0+ (0.1,-25) [-25|26.1] "deg"  RR,ADCU
 SG_ LR_ElevationSNR_144 : 60|7@0+ (0.5,0) [0|63.5] "dB"  RR,ADCU
 SG_ LR_ElevationSNR_145 : 140|7@0+ (0.5,0) [0|63.5] "dB"  RR,ADCU
 SG_ LR_ElevationSNR_146 : 220|7@0+ (0.5,0) [0|63.5] "dB"  RR,ADCU
 SG_ LR_ElevationSNR_147 : 300|7@0+ (0.5,0) [0|63.5] "dB"  RR,ADCU
 SG_ LR_ElevationSNR_148 : 380|7@0+ (0.5,0) [0|63.5] "dB"  RR,ADCU
 SG_ LR_ElevationSNR_149 : 460|7@0+ (0.5,0) [0|63.5] "dB"  RR,ADCU
 SG_ LR_Range_144 : 7|12@0+ (0.0625,0) [0|255.9375] "m"  RR,ADCU
 SG_ LR_Range_145 : 87|12@0+ (0.0625,0) [0|255.9375] "m"  RR,ADCU
 SG_ LR_Range_146 : 167|12@0+ (0.0625,0) [0|255.9375] "m"  RR,ADCU
 SG_ LR_Range_147 : 247|12@0+ (0.0625,0) [0|255.9375] "m"  RR,ADCU
 SG_ LR_Range_148 : 327|12@0+ (0.0625,0) [0|255.9375] "m"  RR,ADCU
 SG_ LR_Range_149 : 407|12@0+ (0.0625,0) [0|255.9375] "m"  RR,ADCU
 SG_ LR_RCS_144 : 16|9@0+ (0.2,-51.1) [-51.1|51.1] "dBsm"  RR,ADCU
 SG_ LR_RCS_145 : 96|9@0+ (0.2,-51.1) [-51.1|51.1] "dBsm"  RR,ADCU
 SG_ LR_RCS_146 : 176|9@0+ (0.2,-51.1) [-51.1|51.1] "dBsm"  RR,ADCU
 SG_ LR_RCS_147 : 256|9@0+ (0.2,-51.1) [-51.1|51.1] "dBsm"  RR,ADCU
 SG_ LR_RCS_148 : 336|9@0+ (0.2,-51.1) [-51.1|51.1] "dBsm"  RR,ADCU
 SG_ LR_RCS_149 : 416|9@0+ (0.2,-51.1) [-51.1|51.1] "dBsm"  RR,ADCU
 SG_ LR_RDI_144_149_AliveCounter : 499|4@0+ (1,0) [0|15] ""  RR,ADCU
 SG_ LR_RDI_144_149_CheckSum : 511|8@0+ (1,0) [0|255] ""  RR,ADCU
 SG_ LR_Status_144 : 79|8@0+ (1,0) [0|255] ""  RR,ADCU
 SG_ LR_Status_145 : 159|8@0+ (1,0) [0|255] ""  RR,ADCU
 SG_ LR_Status_146 : 239|8@0+ (1,0) [0|255] ""  RR,ADCU
 SG_ LR_Status_147 : 319|8@0+ (1,0) [0|255] ""  RR,ADCU
 SG_ LR_Status_148 : 399|8@0+ (1,0) [0|255] ""  RR,ADCU
 SG_ LR_Status_149 : 479|8@0+ (1,0) [0|255] ""  RR,ADCU
 SG_ LR_Tbd_144 : 69|6@0+ (1,0) [0|63] ""  RR,ADCU
 SG_ LR_Tbd_145 : 149|6@0+ (1,0) [0|63] ""  RR,ADCU
 SG_ LR_Tbd_146 : 229|6@0+ (1,0) [0|63] ""  RR,ADCU
 SG_ LR_Tbd_147 : 309|6@0+ (1,0) [0|63] ""  RR,ADCU
 SG_ LR_Tbd_148 : 389|6@0+ (1,0) [0|63] ""  RR,ADCU
 SG_ LR_Tbd_149 : 469|6@0+ (1,0) [0|63] ""  RR,ADCU
 SG_ LR_Velocity_144 : 11|11@0+ (0.05,-60) [-60|42.35] "m/s"  RR,ADCU
 SG_ LR_Velocity_145 : 91|11@0+ (0.05,-60) [-60|42.35] "m/s"  RR,ADCU
 SG_ LR_Velocity_146 : 171|11@0+ (0.05,-60) [-60|42.35] "m/s"  RR,ADCU
 SG_ LR_Velocity_147 : 251|11@0+ (0.05,-60) [-60|42.35] "m/s"  RR,ADCU
 SG_ LR_Velocity_148 : 331|11@0+ (0.05,-60) [-60|42.35] "m/s"  RR,ADCU
 SG_ LR_Velocity_149 : 411|11@0+ (0.05,-60) [-60|42.35] "m/s"  RR,ADCU

BO_ 282 LR_RDI_150_155: 64 LR
 SG_ LR_AzimuthAng_150 : 39|11@0+ (0.1,-90) [-90|114.7] "deg"  RR,ADCU
 SG_ LR_AzimuthAng_151 : 119|11@0+ (0.1,-90) [-90|114.7] "deg"  RR,ADCU
 SG_ LR_AzimuthAng_152 : 199|11@0+ (0.1,-90) [-90|114.7] "deg"  RR,ADCU
 SG_ LR_AzimuthAng_153 : 279|11@0+ (0.1,-90) [-90|114.7] "deg"  RR,ADCU
 SG_ LR_AzimuthAng_154 : 359|11@0+ (0.1,-90) [-90|114.7] "deg"  RR,ADCU
 SG_ LR_AzimuthAng_155 : 439|11@0+ (0.1,-90) [-90|114.7] "deg"  RR,ADCU
 SG_ LR_AzimuthSNR_150 : 51|7@0+ (0.5,0) [0|63.5] "dB"  RR,ADCU
 SG_ LR_AzimuthSNR_151 : 131|7@0+ (0.5,0) [0|63.5] "dB"  RR,ADCU
 SG_ LR_AzimuthSNR_152 : 211|7@0+ (0.5,0) [0|63.5] "dB"  RR,ADCU
 SG_ LR_AzimuthSNR_153 : 291|7@0+ (0.5,0) [0|63.5] "dB"  RR,ADCU
 SG_ LR_AzimuthSNR_154 : 371|7@0+ (0.5,0) [0|63.5] "dB"  RR,ADCU
 SG_ LR_AzimuthSNR_155 : 451|7@0+ (0.5,0) [0|63.5] "dB"  RR,ADCU
 SG_ LR_ElevationAng_150 : 44|9@0+ (0.1,-25) [-25|26.1] "deg"  RR,ADCU
 SG_ LR_ElevationAng_151 : 124|9@0+ (0.1,-25) [-25|26.1] "deg"  RR,ADCU
 SG_ LR_ElevationAng_152 : 204|9@0+ (0.1,-25) [-25|26.1] "deg"  RR,ADCU
 SG_ LR_ElevationAng_153 : 284|9@0+ (0.1,-25) [-25|26.1] "deg"  RR,ADCU
 SG_ LR_ElevationAng_154 : 364|9@0+ (0.1,-25) [-25|26.1] "deg"  RR,ADCU
 SG_ LR_ElevationAng_155 : 444|9@0+ (0.1,-25) [-25|26.1] "deg"  RR,ADCU
 SG_ LR_ElevationSNR_150 : 60|7@0+ (0.5,0) [0|63.5] "dB"  RR,ADCU
 SG_ LR_ElevationSNR_151 : 140|7@0+ (0.5,0) [0|63.5] "dB"  RR,ADCU
 SG_ LR_ElevationSNR_152 : 220|7@0+ (0.5,0) [0|63.5] "dB"  RR,ADCU
 SG_ LR_ElevationSNR_153 : 300|7@0+ (0.5,0) [0|63.5] "dB"  RR,ADCU
 SG_ LR_ElevationSNR_154 : 380|7@0+ (0.5,0) [0|63.5] "dB"  RR,ADCU
 SG_ LR_ElevationSNR_155 : 460|7@0+ (0.5,0) [0|63.5] "dB"  RR,ADCU
 SG_ LR_Range_150 : 7|12@0+ (0.0625,0) [0|255.9375] "m"  RR,ADCU
 SG_ LR_Range_151 : 87|12@0+ (0.0625,0) [0|255.9375] "m"  RR,ADCU
 SG_ LR_Range_152 : 167|12@0+ (0.0625,0) [0|255.9375] "m"  RR,ADCU
 SG_ LR_Range_153 : 247|12@0+ (0.0625,0) [0|255.9375] "m"  RR,ADCU
 SG_ LR_Range_154 : 327|12@0+ (0.0625,0) [0|255.9375] "m"  RR,ADCU
 SG_ LR_Range_155 : 407|12@0+ (0.0625,0) [0|255.9375] "m"  RR,ADCU
 SG_ LR_RCS_150 : 16|9@0+ (0.2,-51.1) [-51.1|51.1] "dBsm"  RR,ADCU
 SG_ LR_RCS_151 : 96|9@0+ (0.2,-51.1) [-51.1|51.1] "dBsm"  RR,ADCU
 SG_ LR_RCS_152 : 176|9@0+ (0.2,-51.1) [-51.1|51.1] "dBsm"  RR,ADCU
 SG_ LR_RCS_153 : 256|9@0+ (0.2,-51.1) [-51.1|51.1] "dBsm"  RR,ADCU
 SG_ LR_RCS_154 : 336|9@0+ (0.2,-51.1) [-51.1|51.1] "dBsm"  RR,ADCU
 SG_ LR_RCS_155 : 416|9@0+ (0.2,-51.1) [-51.1|51.1] "dBsm"  RR,ADCU
 SG_ LR_RDI_150_155_AliveCounter : 499|4@0+ (1,0) [0|15] ""  RR,ADCU
 SG_ LR_RDI_150_155_CheckSum : 511|8@0+ (1,0) [0|255] ""  RR,ADCU
 SG_ LR_Status_150 : 79|8@0+ (1,0) [0|255] ""  RR,ADCU
 SG_ LR_Status_151 : 159|8@0+ (1,0) [0|255] ""  RR,ADCU
 SG_ LR_Status_152 : 239|8@0+ (1,0) [0|255] ""  RR,ADCU
 SG_ LR_Status_153 : 319|8@0+ (1,0) [0|255] ""  RR,ADCU
 SG_ LR_Status_154 : 399|8@0+ (1,0) [0|255] ""  RR,ADCU
 SG_ LR_Status_155 : 479|8@0+ (1,0) [0|255] ""  RR,ADCU
 SG_ LR_Tbd_150 : 69|6@0+ (1,0) [0|63] ""  RR,ADCU
 SG_ LR_Tbd_151 : 149|6@0+ (1,0) [0|63] ""  RR,ADCU
 SG_ LR_Tbd_152 : 229|6@0+ (1,0) [0|63] ""  RR,ADCU
 SG_ LR_Tbd_153 : 309|6@0+ (1,0) [0|63] ""  RR,ADCU
 SG_ LR_Tbd_154 : 389|6@0+ (1,0) [0|63] ""  RR,ADCU
 SG_ LR_Tbd_155 : 469|6@0+ (1,0) [0|63] ""  RR,ADCU
 SG_ LR_Velocity_150 : 11|11@0+ (0.05,-60) [-60|42.35] "m/s"  RR,ADCU
 SG_ LR_Velocity_151 : 91|11@0+ (0.05,-60) [-60|42.35] "m/s"  RR,ADCU
 SG_ LR_Velocity_152 : 171|11@0+ (0.05,-60) [-60|42.35] "m/s"  RR,ADCU
 SG_ LR_Velocity_153 : 251|11@0+ (0.05,-60) [-60|42.35] "m/s"  RR,ADCU
 SG_ LR_Velocity_154 : 331|11@0+ (0.05,-60) [-60|42.35] "m/s"  RR,ADCU
 SG_ LR_Velocity_155 : 411|11@0+ (0.05,-60) [-60|42.35] "m/s"  RR,ADCU

BO_ 283 LR_RDI_156_161: 64 LR
 SG_ LR_AzimuthAng_156 : 39|11@0+ (0.1,-90) [-90|114.7] "deg"  RR,ADCU
 SG_ LR_AzimuthAng_157 : 119|11@0+ (0.1,-90) [-90|114.7] "deg"  RR,ADCU
 SG_ LR_AzimuthAng_158 : 199|11@0+ (0.1,-90) [-90|114.7] "deg"  RR,ADCU
 SG_ LR_AzimuthAng_159 : 279|11@0+ (0.1,-90) [-90|114.7] "deg"  RR,ADCU
 SG_ LR_AzimuthAng_160 : 359|11@0+ (0.1,-90) [-90|114.7] "deg"  RR,ADCU
 SG_ LR_AzimuthAng_161 : 439|11@0+ (0.1,-90) [-90|114.7] "deg"  RR,ADCU
 SG_ LR_AzimuthSNR_156 : 51|7@0+ (0.5,0) [0|63.5] "dB"  RR,ADCU
 SG_ LR_AzimuthSNR_157 : 131|7@0+ (0.5,0) [0|63.5] "dB"  RR,ADCU
 SG_ LR_AzimuthSNR_158 : 211|7@0+ (0.5,0) [0|63.5] "dB"  RR,ADCU
 SG_ LR_AzimuthSNR_159 : 291|7@0+ (0.5,0) [0|63.5] "dB"  RR,ADCU
 SG_ LR_AzimuthSNR_160 : 371|7@0+ (0.5,0) [0|63.5] "dB"  RR,ADCU
 SG_ LR_AzimuthSNR_161 : 451|7@0+ (0.5,0) [0|63.5] "dB"  RR,ADCU
 SG_ LR_ElevationAng_156 : 44|9@0+ (0.1,-25) [-25|26.1] "deg"  RR,ADCU
 SG_ LR_ElevationAng_157 : 124|9@0+ (0.1,-25) [-25|26.1] "deg"  RR,ADCU
 SG_ LR_ElevationAng_158 : 204|9@0+ (0.1,-25) [-25|26.1] "deg"  RR,ADCU
 SG_ LR_ElevationAng_159 : 284|9@0+ (0.1,-25) [-25|26.1] "deg"  RR,ADCU
 SG_ LR_ElevationAng_160 : 364|9@0+ (0.1,-25) [-25|26.1] "deg"  RR,ADCU
 SG_ LR_ElevationAng_161 : 444|9@0+ (0.1,-25) [-25|26.1] "deg"  RR,ADCU
 SG_ LR_ElevationSNR_156 : 60|7@0+ (0.5,0) [0|63.5] "dB"  RR,ADCU
 SG_ LR_ElevationSNR_157 : 140|7@0+ (0.5,0) [0|63.5] "dB"  RR,ADCU
 SG_ LR_ElevationSNR_158 : 220|7@0+ (0.5,0) [0|63.5] "dB"  RR,ADCU
 SG_ LR_ElevationSNR_159 : 300|7@0+ (0.5,0) [0|63.5] "dB"  RR,ADCU
 SG_ LR_ElevationSNR_160 : 380|7@0+ (0.5,0) [0|63.5] "dB"  RR,ADCU
 SG_ LR_ElevationSNR_161 : 460|7@0+ (0.5,0) [0|63.5] "dB"  RR,ADCU
 SG_ LR_Range_156 : 7|12@0+ (0.0625,0) [0|255.9375] "m"  RR,ADCU
 SG_ LR_Range_157 : 87|12@0+ (0.0625,0) [0|255.9375] "m"  RR,ADCU
 SG_ LR_Range_158 : 167|12@0+ (0.0625,0) [0|255.9375] "m"  RR,ADCU
 SG_ LR_Range_159 : 247|12@0+ (0.0625,0) [0|255.9375] "m"  RR,ADCU
 SG_ LR_Range_160 : 327|12@0+ (0.0625,0) [0|255.9375] "m"  RR,ADCU
 SG_ LR_Range_161 : 407|12@0+ (0.0625,0) [0|255.9375] "m"  RR,ADCU
 SG_ LR_RCS_156 : 16|9@0+ (0.2,-51.1) [-51.1|51.1] "dBsm"  RR,ADCU
 SG_ LR_RCS_157 : 96|9@0+ (0.2,-51.1) [-51.1|51.1] "dBsm"  RR,ADCU
 SG_ LR_RCS_158 : 176|9@0+ (0.2,-51.1) [-51.1|51.1] "dBsm"  RR,ADCU
 SG_ LR_RCS_159 : 256|9@0+ (0.2,-51.1) [-51.1|51.1] "dBsm"  RR,ADCU
 SG_ LR_RCS_160 : 336|9@0+ (0.2,-51.1) [-51.1|51.1] "dBsm"  RR,ADCU
 SG_ LR_RCS_161 : 416|9@0+ (0.2,-51.1) [-51.1|51.1] "dBsm"  RR,ADCU
 SG_ LR_RDI_156_161_AliveCounter : 499|4@0+ (1,0) [0|15] ""  RR,ADCU
 SG_ LR_RDI_156_161_CheckSum : 511|8@0+ (1,0) [0|255] ""  RR,ADCU
 SG_ LR_Status_156 : 79|8@0+ (1,0) [0|255] ""  RR,ADCU
 SG_ LR_Status_157 : 159|8@0+ (1,0) [0|255] ""  RR,ADCU
 SG_ LR_Status_158 : 239|8@0+ (1,0) [0|255] ""  RR,ADCU
 SG_ LR_Status_159 : 319|8@0+ (1,0) [0|255] ""  RR,ADCU
 SG_ LR_Status_160 : 399|8@0+ (1,0) [0|255] ""  RR,ADCU
 SG_ LR_Status_161 : 479|8@0+ (1,0) [0|255] ""  RR,ADCU
 SG_ LR_Tbd_156 : 69|6@0+ (1,0) [0|63] ""  RR,ADCU
 SG_ LR_Tbd_157 : 149|6@0+ (1,0) [0|63] ""  RR,ADCU
 SG_ LR_Tbd_158 : 229|6@0+ (1,0) [0|63] ""  RR,ADCU
 SG_ LR_Tbd_159 : 309|6@0+ (1,0) [0|63] ""  RR,ADCU
 SG_ LR_Tbd_160 : 389|6@0+ (1,0) [0|63] ""  RR,ADCU
 SG_ LR_Tbd_161 : 469|6@0+ (1,0) [0|63] ""  RR,ADCU
 SG_ LR_Velocity_156 : 11|11@0+ (0.05,-60) [-60|42.35] "m/s"  RR,ADCU
 SG_ LR_Velocity_157 : 91|11@0+ (0.05,-60) [-60|42.35] "m/s"  RR,ADCU
 SG_ LR_Velocity_158 : 171|11@0+ (0.05,-60) [-60|42.35] "m/s"  RR,ADCU
 SG_ LR_Velocity_159 : 251|11@0+ (0.05,-60) [-60|42.35] "m/s"  RR,ADCU
 SG_ LR_Velocity_160 : 331|11@0+ (0.05,-60) [-60|42.35] "m/s"  RR,ADCU
 SG_ LR_Velocity_161 : 411|11@0+ (0.05,-60) [-60|42.35] "m/s"  RR,ADCU

BO_ 284 LR_RDI_162_167: 64 LR
 SG_ LR_AzimuthAng_162 : 39|11@0+ (0.1,-90) [-90|114.7] "deg"  RR,ADCU
 SG_ LR_AzimuthAng_163 : 119|11@0+ (0.1,-90) [-90|114.7] "deg"  RR,ADCU
 SG_ LR_AzimuthAng_164 : 199|11@0+ (0.1,-90) [-90|114.7] "deg"  RR,ADCU
 SG_ LR_AzimuthAng_165 : 279|11@0+ (0.1,-90) [-90|114.7] "deg"  RR,ADCU
 SG_ LR_AzimuthAng_166 : 359|11@0+ (0.1,-90) [-90|114.7] "deg"  RR,ADCU
 SG_ LR_AzimuthAng_167 : 439|11@0+ (0.1,-90) [-90|114.7] "deg"  RR,ADCU
 SG_ LR_AzimuthSNR_162 : 51|7@0+ (0.5,0) [0|63.5] "dB"  RR,ADCU
 SG_ LR_AzimuthSNR_163 : 131|7@0+ (0.5,0) [0|63.5] "dB"  RR,ADCU
 SG_ LR_AzimuthSNR_164 : 211|7@0+ (0.5,0) [0|63.5] "dB"  RR,ADCU
 SG_ LR_AzimuthSNR_165 : 291|7@0+ (0.5,0) [0|63.5] "dB"  RR,ADCU
 SG_ LR_AzimuthSNR_166 : 371|7@0+ (0.5,0) [0|63.5] "dB"  RR,ADCU
 SG_ LR_AzimuthSNR_167 : 451|7@0+ (0.5,0) [0|63.5] "dB"  RR,ADCU
 SG_ LR_ElevationAng_162 : 44|9@0+ (0.1,-25) [-25|26.1] "deg"  RR,ADCU
 SG_ LR_ElevationAng_163 : 124|9@0+ (0.1,-25) [-25|26.1] "deg"  RR,ADCU
 SG_ LR_ElevationAng_164 : 204|9@0+ (0.1,-25) [-25|26.1] "deg"  RR,ADCU
 SG_ LR_ElevationAng_165 : 284|9@0+ (0.1,-25) [-25|26.1] "deg"  RR,ADCU
 SG_ LR_ElevationAng_166 : 364|9@0+ (0.1,-25) [-25|26.1] "deg"  RR,ADCU
 SG_ LR_ElevationAng_167 : 444|9@0+ (0.1,-25) [-25|26.1] "deg"  RR,ADCU
 SG_ LR_ElevationSNR_162 : 60|7@0+ (0.5,0) [0|63.5] "dB"  RR,ADCU
 SG_ LR_ElevationSNR_163 : 140|7@0+ (0.5,0) [0|63.5] "dB"  RR,ADCU
 SG_ LR_ElevationSNR_164 : 220|7@0+ (0.5,0) [0|63.5] "dB"  RR,ADCU
 SG_ LR_ElevationSNR_165 : 300|7@0+ (0.5,0) [0|63.5] "dB"  RR,ADCU
 SG_ LR_ElevationSNR_166 : 380|7@0+ (0.5,0) [0|63.5] "dB"  RR,ADCU
 SG_ LR_ElevationSNR_167 : 460|7@0+ (0.5,0) [0|63.5] "dB"  RR,ADCU
 SG_ LR_Range_162 : 7|12@0+ (0.0625,0) [0|255.9375] "m"  RR,ADCU
 SG_ LR_Range_163 : 87|12@0+ (0.0625,0) [0|255.9375] "m"  RR,ADCU
 SG_ LR_Range_164 : 167|12@0+ (0.0625,0) [0|255.9375] "m"  RR,ADCU
 SG_ LR_Range_165 : 247|12@0+ (0.0625,0) [0|255.9375] "m"  RR,ADCU
 SG_ LR_Range_166 : 327|12@0+ (0.0625,0) [0|255.9375] "m"  RR,ADCU
 SG_ LR_Range_167 : 407|12@0+ (0.0625,0) [0|255.9375] "m"  RR,ADCU
 SG_ LR_RCS_162 : 16|9@0+ (0.2,-51.1) [-51.1|51.1] "dBsm"  RR,ADCU
 SG_ LR_RCS_163 : 96|9@0+ (0.2,-51.1) [-51.1|51.1] "dBsm"  RR,ADCU
 SG_ LR_RCS_164 : 176|9@0+ (0.2,-51.1) [-51.1|51.1] "dBsm"  RR,ADCU
 SG_ LR_RCS_165 : 256|9@0+ (0.2,-51.1) [-51.1|51.1] "dBsm"  RR,ADCU
 SG_ LR_RCS_166 : 336|9@0+ (0.2,-51.1) [-51.1|51.1] "dBsm"  RR,ADCU
 SG_ LR_RCS_167 : 416|9@0+ (0.2,-51.1) [-51.1|51.1] "dBsm"  RR,ADCU
 SG_ LR_RDI_162_167_AliveCounter : 499|4@0+ (1,0) [0|15] ""  RR,ADCU
 SG_ LR_RDI_162_167_CheckSum : 511|8@0+ (1,0) [0|255] ""  RR,ADCU
 SG_ LR_Status_162 : 79|8@0+ (1,0) [0|255] ""  RR,ADCU
 SG_ LR_Status_163 : 159|8@0+ (1,0) [0|255] ""  RR,ADCU
 SG_ LR_Status_164 : 239|8@0+ (1,0) [0|255] ""  RR,ADCU
 SG_ LR_Status_165 : 319|8@0+ (1,0) [0|255] ""  RR,ADCU
 SG_ LR_Status_166 : 399|8@0+ (1,0) [0|255] ""  RR,ADCU
 SG_ LR_Status_167 : 479|8@0+ (1,0) [0|255] ""  RR,ADCU
 SG_ LR_Tbd_162 : 69|6@0+ (1,0) [0|63] ""  RR,ADCU
 SG_ LR_Tbd_163 : 149|6@0+ (1,0) [0|63] ""  RR,ADCU
 SG_ LR_Tbd_164 : 229|6@0+ (1,0) [0|63] ""  RR,ADCU
 SG_ LR_Tbd_165 : 309|6@0+ (1,0) [0|63] ""  RR,ADCU
 SG_ LR_Tbd_166 : 389|6@0+ (1,0) [0|63] ""  RR,ADCU
 SG_ LR_Tbd_167 : 469|6@0+ (1,0) [0|63] ""  RR,ADCU
 SG_ LR_Velocity_162 : 11|11@0+ (0.05,-60) [-60|42.35] "m/s"  RR,ADCU
 SG_ LR_Velocity_163 : 91|11@0+ (0.05,-60) [-60|42.35] "m/s"  RR,ADCU
 SG_ LR_Velocity_164 : 171|11@0+ (0.05,-60) [-60|42.35] "m/s"  RR,ADCU
 SG_ LR_Velocity_165 : 251|11@0+ (0.05,-60) [-60|42.35] "m/s"  RR,ADCU
 SG_ LR_Velocity_166 : 331|11@0+ (0.05,-60) [-60|42.35] "m/s"  RR,ADCU
 SG_ LR_Velocity_167 : 411|11@0+ (0.05,-60) [-60|42.35] "m/s"  RR,ADCU

BO_ 285 LR_RDI_168_173: 64 LR
 SG_ LR_AzimuthAng_168 : 39|11@0+ (0.1,-90) [-90|114.7] "deg"  RR,ADCU
 SG_ LR_AzimuthAng_169 : 119|11@0+ (0.1,-90) [-90|114.7] "deg"  RR,ADCU
 SG_ LR_AzimuthAng_170 : 199|11@0+ (0.1,-90) [-90|114.7] "deg"  RR,ADCU
 SG_ LR_AzimuthAng_171 : 279|11@0+ (0.1,-90) [-90|114.7] "deg"  RR,ADCU
 SG_ LR_AzimuthAng_172 : 359|11@0+ (0.1,-90) [-90|114.7] "deg"  RR,ADCU
 SG_ LR_AzimuthAng_173 : 439|11@0+ (0.1,-90) [-90|114.7] "deg"  RR,ADCU
 SG_ LR_AzimuthSNR_168 : 51|7@0+ (0.5,0) [0|63.5] "dB"  RR,ADCU
 SG_ LR_AzimuthSNR_169 : 131|7@0+ (0.5,0) [0|63.5] "dB"  RR,ADCU
 SG_ LR_AzimuthSNR_170 : 211|7@0+ (0.5,0) [0|63.5] "dB"  RR,ADCU
 SG_ LR_AzimuthSNR_171 : 291|7@0+ (0.5,0) [0|63.5] "dB"  RR,ADCU
 SG_ LR_AzimuthSNR_172 : 371|7@0+ (0.5,0) [0|63.5] "dB"  RR,ADCU
 SG_ LR_AzimuthSNR_173 : 451|7@0+ (0.5,0) [0|63.5] "dB"  RR,ADCU
 SG_ LR_ElevationAng_168 : 44|9@0+ (0.1,-25) [-25|26.1] "deg"  RR,ADCU
 SG_ LR_ElevationAng_169 : 124|9@0+ (0.1,-25) [-25|26.1] "deg"  RR,ADCU
 SG_ LR_ElevationAng_170 : 204|9@0+ (0.1,-25) [-25|26.1] "deg"  RR,ADCU
 SG_ LR_ElevationAng_171 : 284|9@0+ (0.1,-25) [-25|26.1] "deg"  RR,ADCU
 SG_ LR_ElevationAng_172 : 364|9@0+ (0.1,-25) [-25|26.1] "deg"  RR,ADCU
 SG_ LR_ElevationAng_173 : 444|9@0+ (0.1,-25) [-25|26.1] "deg"  RR,ADCU
 SG_ LR_ElevationSNR_168 : 60|7@0+ (0.5,0) [0|63.5] "dB"  RR,ADCU
 SG_ LR_ElevationSNR_169 : 140|7@0+ (0.5,0) [0|63.5] "dB"  RR,ADCU
 SG_ LR_ElevationSNR_170 : 220|7@0+ (0.5,0) [0|63.5] "dB"  RR,ADCU
 SG_ LR_ElevationSNR_171 : 300|7@0+ (0.5,0) [0|63.5] "dB"  RR,ADCU
 SG_ LR_ElevationSNR_172 : 380|7@0+ (0.5,0) [0|63.5] "dB"  RR,ADCU
 SG_ LR_ElevationSNR_173 : 460|7@0+ (0.5,0) [0|63.5] "dB"  RR,ADCU
 SG_ LR_Range_168 : 7|12@0+ (0.0625,0) [0|255.9375] "m"  RR,ADCU
 SG_ LR_Range_169 : 87|12@0+ (0.0625,0) [0|255.9375] "m"  RR,ADCU
 SG_ LR_Range_170 : 167|12@0+ (0.0625,0) [0|255.9375] "m"  RR,ADCU
 SG_ LR_Range_171 : 247|12@0+ (0.0625,0) [0|255.9375] "m"  RR,ADCU
 SG_ LR_Range_172 : 327|12@0+ (0.0625,0) [0|255.9375] "m"  RR,ADCU
 SG_ LR_Range_173 : 407|12@0+ (0.0625,0) [0|255.9375] "m"  RR,ADCU
 SG_ LR_RCS_168 : 16|9@0+ (0.2,-51.1) [-51.1|51.1] "dBsm"  RR,ADCU
 SG_ LR_RCS_169 : 96|9@0+ (0.2,-51.1) [-51.1|51.1] "dBsm"  RR,ADCU
 SG_ LR_RCS_170 : 176|9@0+ (0.2,-51.1) [-51.1|51.1] "dBsm"  RR,ADCU
 SG_ LR_RCS_171 : 256|9@0+ (0.2,-51.1) [-51.1|51.1] "dBsm"  RR,ADCU
 SG_ LR_RCS_172 : 336|9@0+ (0.2,-51.1) [-51.1|51.1] "dBsm"  RR,ADCU
 SG_ LR_RCS_173 : 416|9@0+ (0.2,-51.1) [-51.1|51.1] "dBsm"  RR,ADCU
 SG_ LR_RDI_168_173_AliveCounter : 499|4@0+ (1,0) [0|15] ""  RR,ADCU
 SG_ LR_RDI_168_173_CheckSum : 511|8@0+ (1,0) [0|255] ""  RR,ADCU
 SG_ LR_Status_168 : 79|8@0+ (1,0) [0|255] ""  RR,ADCU
 SG_ LR_Status_169 : 159|8@0+ (1,0) [0|255] ""  RR,ADCU
 SG_ LR_Status_170 : 239|8@0+ (1,0) [0|255] ""  RR,ADCU
 SG_ LR_Status_171 : 319|8@0+ (1,0) [0|255] ""  RR,ADCU
 SG_ LR_Status_172 : 399|8@0+ (1,0) [0|255] ""  RR,ADCU
 SG_ LR_Status_173 : 479|8@0+ (1,0) [0|255] ""  RR,ADCU
 SG_ LR_Tbd_168 : 69|6@0+ (1,0) [0|63] ""  RR,ADCU
 SG_ LR_Tbd_169 : 149|6@0+ (1,0) [0|63] ""  RR,ADCU
 SG_ LR_Tbd_170 : 229|6@0+ (1,0) [0|63] ""  RR,ADCU
 SG_ LR_Tbd_171 : 309|6@0+ (1,0) [0|63] ""  RR,ADCU
 SG_ LR_Tbd_172 : 389|6@0+ (1,0) [0|63] ""  RR,ADCU
 SG_ LR_Tbd_173 : 469|6@0+ (1,0) [0|63] ""  RR,ADCU
 SG_ LR_Velocity_168 : 11|11@0+ (0.05,-60) [-60|42.35] "m/s"  RR,ADCU
 SG_ LR_Velocity_169 : 91|11@0+ (0.05,-60) [-60|42.35] "m/s"  RR,ADCU
 SG_ LR_Velocity_170 : 171|11@0+ (0.05,-60) [-60|42.35] "m/s"  RR,ADCU
 SG_ LR_Velocity_171 : 251|11@0+ (0.05,-60) [-60|42.35] "m/s"  RR,ADCU
 SG_ LR_Velocity_172 : 331|11@0+ (0.05,-60) [-60|42.35] "m/s"  RR,ADCU
 SG_ LR_Velocity_173 : 411|11@0+ (0.05,-60) [-60|42.35] "m/s"  RR,ADCU

BO_ 286 LR_RDI_174_179: 64 LR
 SG_ LR_AzimuthAng_174 : 39|11@0+ (0.1,-90) [-90|114.7] "deg"  RR,ADCU
 SG_ LR_AzimuthAng_175 : 119|11@0+ (0.1,-90) [-90|114.7] "deg"  RR,ADCU
 SG_ LR_AzimuthAng_176 : 199|11@0+ (0.1,-90) [-90|114.7] "deg"  RR,ADCU
 SG_ LR_AzimuthAng_177 : 279|11@0+ (0.1,-90) [-90|114.7] "deg"  RR,ADCU
 SG_ LR_AzimuthAng_178 : 359|11@0+ (0.1,-90) [-90|114.7] "deg"  RR,ADCU
 SG_ LR_AzimuthAng_179 : 439|11@0+ (0.1,-90) [-90|114.7] "deg"  RR,ADCU
 SG_ LR_AzimuthSNR_174 : 51|7@0+ (0.5,0) [0|63.5] "dB"  RR,ADCU
 SG_ LR_AzimuthSNR_175 : 131|7@0+ (0.5,0) [0|63.5] "dB"  RR,ADCU
 SG_ LR_AzimuthSNR_176 : 211|7@0+ (0.5,0) [0|63.5] "dB"  RR,ADCU
 SG_ LR_AzimuthSNR_177 : 291|7@0+ (0.5,0) [0|63.5] "dB"  RR,ADCU
 SG_ LR_AzimuthSNR_178 : 371|7@0+ (0.5,0) [0|63.5] "dB"  RR,ADCU
 SG_ LR_AzimuthSNR_179 : 451|7@0+ (0.5,0) [0|63.5] "dB"  RR,ADCU
 SG_ LR_ElevationAng_174 : 44|9@0+ (0.1,-25) [-25|26.1] "deg"  RR,ADCU
 SG_ LR_ElevationAng_175 : 124|9@0+ (0.1,-25) [-25|26.1] "deg"  RR,ADCU
 SG_ LR_ElevationAng_176 : 204|9@0+ (0.1,-25) [-25|26.1] "deg"  RR,ADCU
 SG_ LR_ElevationAng_177 : 284|9@0+ (0.1,-25) [-25|26.1] "deg"  RR,ADCU
 SG_ LR_ElevationAng_178 : 364|9@0+ (0.1,-25) [-25|26.1] "deg"  RR,ADCU
 SG_ LR_ElevationAng_179 : 444|9@0+ (0.1,-25) [-25|26.1] "deg"  RR,ADCU
 SG_ LR_ElevationSNR_174 : 60|7@0+ (0.5,0) [0|63.5] "dB"  RR,ADCU
 SG_ LR_ElevationSNR_175 : 140|7@0+ (0.5,0) [0|63.5] "dB"  RR,ADCU
 SG_ LR_ElevationSNR_176 : 220|7@0+ (0.5,0) [0|63.5] "dB"  RR,ADCU
 SG_ LR_ElevationSNR_177 : 300|7@0+ (0.5,0) [0|63.5] "dB"  RR,ADCU
 SG_ LR_ElevationSNR_178 : 380|7@0+ (0.5,0) [0|63.5] "dB"  RR,ADCU
 SG_ LR_ElevationSNR_179 : 460|7@0+ (0.5,0) [0|63.5] "dB"  RR,ADCU
 SG_ LR_Range_174 : 7|12@0+ (0.0625,0) [0|255.9375] "m"  RR,ADCU
 SG_ LR_Range_175 : 87|12@0+ (0.0625,0) [0|255.9375] "m"  RR,ADCU
 SG_ LR_Range_176 : 167|12@0+ (0.0625,0) [0|255.9375] "m"  RR,ADCU
 SG_ LR_Range_177 : 247|12@0+ (0.0625,0) [0|255.9375] "m"  RR,ADCU
 SG_ LR_Range_178 : 327|12@0+ (0.0625,0) [0|255.9375] "m"  RR,ADCU
 SG_ LR_Range_179 : 407|12@0+ (0.0625,0) [0|255.9375] "m"  RR,ADCU
 SG_ LR_RCS_174 : 16|9@0+ (0.2,-51.1) [-51.1|51.1] "dBsm"  RR,ADCU
 SG_ LR_RCS_175 : 96|9@0+ (0.2,-51.1) [-51.1|51.1] "dBsm"  RR,ADCU
 SG_ LR_RCS_176 : 176|9@0+ (0.2,-51.1) [-51.1|51.1] "dBsm"  RR,ADCU
 SG_ LR_RCS_177 : 256|9@0+ (0.2,-51.1) [-51.1|51.1] "dBsm"  RR,ADCU
 SG_ LR_RCS_178 : 336|9@0+ (0.2,-51.1) [-51.1|51.1] "dBsm"  RR,ADCU
 SG_ LR_RCS_179 : 416|9@0+ (0.2,-51.1) [-51.1|51.1] "dBsm"  RR,ADCU
 SG_ LR_RDI_174_179_AliveCounter : 499|4@0+ (1,0) [0|15] ""  RR,ADCU
 SG_ LR_RDI_174_179_CheckSum : 511|8@0+ (1,0) [0|255] ""  RR,ADCU
 SG_ LR_Status_174 : 79|8@0+ (1,0) [0|255] ""  RR,ADCU
 SG_ LR_Status_175 : 159|8@0+ (1,0) [0|255] ""  RR,ADCU
 SG_ LR_Status_176 : 239|8@0+ (1,0) [0|255] ""  RR,ADCU
 SG_ LR_Status_177 : 319|8@0+ (1,0) [0|255] ""  RR,ADCU
 SG_ LR_Status_178 : 399|8@0+ (1,0) [0|255] ""  RR,ADCU
 SG_ LR_Status_179 : 479|8@0+ (1,0) [0|255] ""  RR,ADCU
 SG_ LR_Tbd_174 : 69|6@0+ (1,0) [0|63] ""  RR,ADCU
 SG_ LR_Tbd_175 : 149|6@0+ (1,0) [0|63] ""  RR,ADCU
 SG_ LR_Tbd_176 : 229|6@0+ (1,0) [0|63] ""  RR,ADCU
 SG_ LR_Tbd_177 : 309|6@0+ (1,0) [0|63] ""  RR,ADCU
 SG_ LR_Tbd_178 : 389|6@0+ (1,0) [0|63] ""  RR,ADCU
 SG_ LR_Tbd_179 : 469|6@0+ (1,0) [0|63] ""  RR,ADCU
 SG_ LR_Velocity_174 : 11|11@0+ (0.05,-60) [-60|42.35] "m/s"  RR,ADCU
 SG_ LR_Velocity_175 : 91|11@0+ (0.05,-60) [-60|42.35] "m/s"  RR,ADCU
 SG_ LR_Velocity_176 : 171|11@0+ (0.05,-60) [-60|42.35] "m/s"  RR,ADCU
 SG_ LR_Velocity_177 : 251|11@0+ (0.05,-60) [-60|42.35] "m/s"  RR,ADCU
 SG_ LR_Velocity_178 : 331|11@0+ (0.05,-60) [-60|42.35] "m/s"  RR,ADCU
 SG_ LR_Velocity_179 : 411|11@0+ (0.05,-60) [-60|42.35] "m/s"  RR,ADCU

BO_ 287 LR_RDI_180_185: 64 LR
 SG_ LR_AzimuthAng_180 : 39|11@0+ (0.1,-90) [-90|114.7] "deg"  RR,ADCU
 SG_ LR_AzimuthAng_181 : 119|11@0+ (0.1,-90) [-90|114.7] "deg"  RR,ADCU
 SG_ LR_AzimuthAng_182 : 199|11@0+ (0.1,-90) [-90|114.7] "deg"  RR,ADCU
 SG_ LR_AzimuthAng_183 : 279|11@0+ (0.1,-90) [-90|114.7] "deg"  RR,ADCU
 SG_ LR_AzimuthAng_184 : 359|11@0+ (0.1,-90) [-90|114.7] "deg"  RR,ADCU
 SG_ LR_AzimuthAng_185 : 439|11@0+ (0.1,-90) [-90|114.7] "deg"  RR,ADCU
 SG_ LR_AzimuthSNR_180 : 51|7@0+ (0.5,0) [0|63.5] "dB"  RR,ADCU
 SG_ LR_AzimuthSNR_181 : 131|7@0+ (0.5,0) [0|63.5] "dB"  RR,ADCU
 SG_ LR_AzimuthSNR_182 : 211|7@0+ (0.5,0) [0|63.5] "dB"  RR,ADCU
 SG_ LR_AzimuthSNR_183 : 291|7@0+ (0.5,0) [0|63.5] "dB"  RR,ADCU
 SG_ LR_AzimuthSNR_184 : 371|7@0+ (0.5,0) [0|63.5] "dB"  RR,ADCU
 SG_ LR_AzimuthSNR_185 : 451|7@0+ (0.5,0) [0|63.5] "dB"  RR,ADCU
 SG_ LR_ElevationAng_180 : 44|9@0+ (0.1,-25) [-25|26.1] "deg"  RR,ADCU
 SG_ LR_ElevationAng_181 : 124|9@0+ (0.1,-25) [-25|26.1] "deg"  RR,ADCU
 SG_ LR_ElevationAng_182 : 204|9@0+ (0.1,-25) [-25|26.1] "deg"  RR,ADCU
 SG_ LR_ElevationAng_183 : 284|9@0+ (0.1,-25) [-25|26.1] "deg"  RR,ADCU
 SG_ LR_ElevationAng_184 : 364|9@0+ (0.1,-25) [-25|26.1] "deg"  RR,ADCU
 SG_ LR_ElevationAng_185 : 444|9@0+ (0.1,-25) [-25|26.1] "deg"  RR,ADCU
 SG_ LR_ElevationSNR_180 : 60|7@0+ (0.5,0) [0|63.5] "dB"  RR,ADCU
 SG_ LR_ElevationSNR_181 : 140|7@0+ (0.5,0) [0|63.5] "dB"  RR,ADCU
 SG_ LR_ElevationSNR_182 : 220|7@0+ (0.5,0) [0|63.5] "dB"  RR,ADCU
 SG_ LR_ElevationSNR_183 : 300|7@0+ (0.5,0) [0|63.5] "dB"  RR,ADCU
 SG_ LR_ElevationSNR_184 : 380|7@0+ (0.5,0) [0|63.5] "dB"  RR,ADCU
 SG_ LR_ElevationSNR_185 : 460|7@0+ (0.5,0) [0|63.5] "dB"  RR,ADCU
 SG_ LR_Range_180 : 7|12@0+ (0.0625,0) [0|255.9375] "m"  RR,ADCU
 SG_ LR_Range_181 : 87|12@0+ (0.0625,0) [0|255.9375] "m"  RR,ADCU
 SG_ LR_Range_182 : 167|12@0+ (0.0625,0) [0|255.9375] "m"  RR,ADCU
 SG_ LR_Range_183 : 247|12@0+ (0.0625,0) [0|255.9375] "m"  RR,ADCU
 SG_ LR_Range_184 : 327|12@0+ (0.0625,0) [0|255.9375] "m"  RR,ADCU
 SG_ LR_Range_185 : 407|12@0+ (0.0625,0) [0|255.9375] "m"  RR,ADCU
 SG_ LR_RCS_180 : 16|9@0+ (0.2,-51.1) [-51.1|51.1] "dBsm"  RR,ADCU
 SG_ LR_RCS_181 : 96|9@0+ (0.2,-51.1) [-51.1|51.1] "dBsm"  RR,ADCU
 SG_ LR_RCS_182 : 176|9@0+ (0.2,-51.1) [-51.1|51.1] "dBsm"  RR,ADCU
 SG_ LR_RCS_183 : 256|9@0+ (0.2,-51.1) [-51.1|51.1] "dBsm"  RR,ADCU
 SG_ LR_RCS_184 : 336|9@0+ (0.2,-51.1) [-51.1|51.1] "dBsm"  RR,ADCU
 SG_ LR_RCS_185 : 416|9@0+ (0.2,-51.1) [-51.1|51.1] "dBsm"  RR,ADCU
 SG_ LR_RDI_180_185_AliveCounter : 499|4@0+ (1,0) [0|15] ""  RR,ADCU
 SG_ LR_RDI_180_185_CheckSum : 511|8@0+ (1,0) [0|255] ""  RR,ADCU
 SG_ LR_Status_180 : 79|8@0+ (1,0) [0|255] ""  RR,ADCU
 SG_ LR_Status_181 : 159|8@0+ (1,0) [0|255] ""  RR,ADCU
 SG_ LR_Status_182 : 239|8@0+ (1,0) [0|255] ""  RR,ADCU
 SG_ LR_Status_183 : 319|8@0+ (1,0) [0|255] ""  RR,ADCU
 SG_ LR_Status_184 : 399|8@0+ (1,0) [0|255] ""  RR,ADCU
 SG_ LR_Status_185 : 479|8@0+ (1,0) [0|255] ""  RR,ADCU
 SG_ LR_Tbd_180 : 69|6@0+ (1,0) [0|63] ""  RR,ADCU
 SG_ LR_Tbd_181 : 149|6@0+ (1,0) [0|63] ""  RR,ADCU
 SG_ LR_Tbd_182 : 229|6@0+ (1,0) [0|63] ""  RR,ADCU
 SG_ LR_Tbd_183 : 309|6@0+ (1,0) [0|63] ""  RR,ADCU
 SG_ LR_Tbd_184 : 389|6@0+ (1,0) [0|63] ""  RR,ADCU
 SG_ LR_Tbd_185 : 469|6@0+ (1,0) [0|63] ""  RR,ADCU
 SG_ LR_Velocity_180 : 11|11@0+ (0.05,-60) [-60|42.35] "m/s"  RR,ADCU
 SG_ LR_Velocity_181 : 91|11@0+ (0.05,-60) [-60|42.35] "m/s"  RR,ADCU
 SG_ LR_Velocity_182 : 171|11@0+ (0.05,-60) [-60|42.35] "m/s"  RR,ADCU
 SG_ LR_Velocity_183 : 251|11@0+ (0.05,-60) [-60|42.35] "m/s"  RR,ADCU
 SG_ LR_Velocity_184 : 331|11@0+ (0.05,-60) [-60|42.35] "m/s"  RR,ADCU
 SG_ LR_Velocity_185 : 411|11@0+ (0.05,-60) [-60|42.35] "m/s"  RR,ADCU

BO_ 288 LR_RDI_E_000_020: 64 LR
 SG_ LR_P00_Pxx_000 : 7|8@0+ (1,0) [0|255] ""  RR,ADCU
 SG_ LR_P00_Pxx_001 : 15|8@0+ (1,0) [0|255] ""  RR,ADCU
 SG_ LR_P00_Pxx_002 : 23|8@0+ (1,0) [0|255] ""  RR,ADCU
 SG_ LR_P00_Pxx_003 : 31|8@0+ (1,0) [0|255] ""  RR,ADCU
 SG_ LR_P00_Pxx_004 : 39|8@0+ (1,0) [0|255] ""  RR,ADCU
 SG_ LR_P00_Pxx_005 : 47|8@0+ (1,0) [0|255] ""  RR,ADCU
 SG_ LR_P00_Pxx_006 : 55|8@0+ (1,0) [0|255] ""  RR,ADCU
 SG_ LR_P00_Pxx_007 : 63|8@0+ (1,0) [0|255] ""  RR,ADCU
 SG_ LR_P00_Pxx_008 : 71|8@0+ (1,0) [0|255] ""  RR,ADCU
 SG_ LR_P00_Pxx_009 : 79|8@0+ (1,0) [0|255] ""  RR,ADCU
 SG_ LR_P00_Pxx_010 : 87|8@0+ (1,0) [0|255] ""  RR,ADCU
 SG_ LR_P00_Pxx_011 : 95|8@0+ (1,0) [0|255] ""  RR,ADCU
 SG_ LR_P00_Pxx_012 : 103|8@0+ (1,0) [0|255] ""  RR,ADCU
 SG_ LR_P00_Pxx_013 : 111|8@0+ (1,0) [0|255] ""  RR,ADCU
 SG_ LR_P00_Pxx_014 : 119|8@0+ (1,0) [0|255] ""  RR,ADCU
 SG_ LR_P00_Pxx_015 : 127|8@0+ (1,0) [0|255] ""  RR,ADCU
 SG_ LR_P00_Pxx_016 : 135|8@0+ (1,0) [0|255] ""  RR,ADCU
 SG_ LR_P00_Pxx_017 : 143|8@0+ (1,0) [0|255] ""  RR,ADCU
 SG_ LR_P00_Pxx_018 : 151|8@0+ (1,0) [0|255] ""  RR,ADCU
 SG_ LR_P00_Pxx_019 : 159|8@0+ (1,0) [0|255] ""  RR,ADCU
 SG_ LR_P00_Pxx_020 : 167|8@0+ (1,0) [0|255] ""  RR,ADCU
 SG_ LR_P12_Pxx_000 : 175|8@0+ (1,0) [0|255] ""  RR,ADCU
 SG_ LR_P12_Pxx_001 : 183|8@0+ (1,0) [0|255] ""  RR,ADCU
 SG_ LR_P12_Pxx_002 : 191|8@0+ (1,0) [0|255] ""  RR,ADCU
 SG_ LR_P12_Pxx_003 : 199|8@0+ (1,0) [0|255] ""  RR,ADCU
 SG_ LR_P12_Pxx_004 : 207|8@0+ (1,0) [0|255] ""  RR,ADCU
 SG_ LR_P12_Pxx_005 : 215|8@0+ (1,0) [0|255] ""  RR,ADCU
 SG_ LR_P12_Pxx_006 : 223|8@0+ (1,0) [0|255] ""  RR,ADCU
 SG_ LR_P12_Pxx_007 : 231|8@0+ (1,0) [0|255] ""  RR,ADCU
 SG_ LR_P12_Pxx_008 : 239|8@0+ (1,0) [0|255] ""  RR,ADCU
 SG_ LR_P12_Pxx_009 : 247|8@0+ (1,0) [0|255] ""  RR,ADCU
 SG_ LR_P12_Pxx_010 : 255|8@0+ (1,0) [0|255] ""  RR,ADCU
 SG_ LR_P12_Pxx_011 : 263|8@0+ (1,0) [0|255] ""  RR,ADCU
 SG_ LR_P12_Pxx_012 : 271|8@0+ (1,0) [0|255] ""  RR,ADCU
 SG_ LR_P12_Pxx_013 : 279|8@0+ (1,0) [0|255] ""  RR,ADCU
 SG_ LR_P12_Pxx_014 : 287|8@0+ (1,0) [0|255] ""  RR,ADCU
 SG_ LR_P12_Pxx_015 : 295|8@0+ (1,0) [0|255] ""  RR,ADCU
 SG_ LR_P12_Pxx_016 : 303|8@0+ (1,0) [0|255] ""  RR,ADCU
 SG_ LR_P12_Pxx_017 : 311|8@0+ (1,0) [0|255] ""  RR,ADCU
 SG_ LR_P12_Pxx_018 : 319|8@0+ (1,0) [0|255] ""  RR,ADCU
 SG_ LR_P12_Pxx_019 : 327|8@0+ (1,0) [0|255] ""  RR,ADCU
 SG_ LR_P12_Pxx_020 : 335|8@0+ (1,0) [0|255] ""  RR,ADCU
 SG_ LR_P1_P2_000 : 343|8@0+ (1,0) [0|255] ""  RR,ADCU
 SG_ LR_P1_P2_001 : 351|8@0+ (1,0) [0|255] ""  RR,ADCU
 SG_ LR_P1_P2_002 : 359|8@0+ (1,0) [0|255] ""  RR,ADCU
 SG_ LR_P1_P2_003 : 367|8@0+ (1,0) [0|255] ""  RR,ADCU
 SG_ LR_P1_P2_004 : 375|8@0+ (1,0) [0|255] ""  RR,ADCU
 SG_ LR_P1_P2_005 : 383|8@0+ (1,0) [0|255] ""  RR,ADCU
 SG_ LR_P1_P2_006 : 391|8@0+ (1,0) [0|255] ""  RR,ADCU
 SG_ LR_P1_P2_007 : 399|8@0+ (1,0) [0|255] ""  RR,ADCU
 SG_ LR_P1_P2_008 : 407|8@0+ (1,0) [0|255] ""  RR,ADCU
 SG_ LR_P1_P2_009 : 415|8@0+ (1,0) [0|255] ""  RR,ADCU
 SG_ LR_P1_P2_010 : 423|8@0+ (1,0) [0|255] ""  RR,ADCU
 SG_ LR_P1_P2_011 : 431|8@0+ (1,0) [0|255] ""  RR,ADCU
 SG_ LR_P1_P2_012 : 439|8@0+ (1,0) [0|255] ""  RR,ADCU
 SG_ LR_P1_P2_013 : 447|8@0+ (1,0) [0|255] ""  RR,ADCU
 SG_ LR_P1_P2_014 : 455|8@0+ (1,0) [0|255] ""  RR,ADCU
 SG_ LR_P1_P2_015 : 463|8@0+ (1,0) [0|255] ""  RR,ADCU
 SG_ LR_P1_P2_016 : 471|8@0+ (1,0) [0|255] ""  RR,ADCU
 SG_ LR_P1_P2_017 : 479|8@0+ (1,0) [0|255] ""  RR,ADCU
 SG_ LR_P1_P2_018 : 487|8@0+ (1,0) [0|255] ""  RR,ADCU
 SG_ LR_P1_P2_019 : 495|8@0+ (1,0) [0|255] ""  RR,ADCU
 SG_ LR_P1_P2_020 : 503|8@0+ (1,0) [0|255] ""  RR,ADCU
 SG_ LR_RDI_E_000_020_AliveCounter : 511|4@0+ (1,0) [0|15] ""  RR,ADCU
 SG_ LR_RDI_E_000_020_CheckSum : 507|4@0+ (1,0) [0|15] ""  RR,ADCU

BO_ 289 LR_RDI_E_021_041: 64 LR
 SG_ LR_P00_Pxx_021 : 7|8@0+ (1,0) [0|255] ""  RR,ADCU
 SG_ LR_P00_Pxx_022 : 15|8@0+ (1,0) [0|255] ""  RR,ADCU
 SG_ LR_P00_Pxx_023 : 23|8@0+ (1,0) [0|255] ""  RR,ADCU
 SG_ LR_P00_Pxx_024 : 31|8@0+ (1,0) [0|255] ""  RR,ADCU
 SG_ LR_P00_Pxx_025 : 39|8@0+ (1,0) [0|255] ""  RR,ADCU
 SG_ LR_P00_Pxx_026 : 47|8@0+ (1,0) [0|255] ""  RR,ADCU
 SG_ LR_P00_Pxx_027 : 55|8@0+ (1,0) [0|255] ""  RR,ADCU
 SG_ LR_P00_Pxx_028 : 63|8@0+ (1,0) [0|255] ""  RR,ADCU
 SG_ LR_P00_Pxx_029 : 71|8@0+ (1,0) [0|255] ""  RR,ADCU
 SG_ LR_P00_Pxx_030 : 79|8@0+ (1,0) [0|255] ""  RR,ADCU
 SG_ LR_P00_Pxx_031 : 87|8@0+ (1,0) [0|255] ""  RR,ADCU
 SG_ LR_P00_Pxx_032 : 95|8@0+ (1,0) [0|255] ""  RR,ADCU
 SG_ LR_P00_Pxx_033 : 103|8@0+ (1,0) [0|255] ""  RR,ADCU
 SG_ LR_P00_Pxx_034 : 111|8@0+ (1,0) [0|255] ""  RR,ADCU
 SG_ LR_P00_Pxx_035 : 119|8@0+ (1,0) [0|255] ""  RR,ADCU
 SG_ LR_P00_Pxx_036 : 127|8@0+ (1,0) [0|255] ""  RR,ADCU
 SG_ LR_P00_Pxx_037 : 135|8@0+ (1,0) [0|255] ""  RR,ADCU
 SG_ LR_P00_Pxx_038 : 143|8@0+ (1,0) [0|255] ""  RR,ADCU
 SG_ LR_P00_Pxx_039 : 151|8@0+ (1,0) [0|255] ""  RR,ADCU
 SG_ LR_P00_Pxx_040 : 159|8@0+ (1,0) [0|255] ""  RR,ADCU
 SG_ LR_P00_Pxx_041 : 167|8@0+ (1,0) [0|255] ""  RR,ADCU
 SG_ LR_P12_Pxx_021 : 175|8@0+ (1,0) [0|255] ""  RR,ADCU
 SG_ LR_P12_Pxx_022 : 183|8@0+ (1,0) [0|255] ""  RR,ADCU
 SG_ LR_P12_Pxx_023 : 191|8@0+ (1,0) [0|255] ""  RR,ADCU
 SG_ LR_P12_Pxx_024 : 199|8@0+ (1,0) [0|255] ""  RR,ADCU
 SG_ LR_P12_Pxx_025 : 207|8@0+ (1,0) [0|255] ""  RR,ADCU
 SG_ LR_P12_Pxx_026 : 215|8@0+ (1,0) [0|255] ""  RR,ADCU
 SG_ LR_P12_Pxx_027 : 223|8@0+ (1,0) [0|255] ""  RR,ADCU
 SG_ LR_P12_Pxx_028 : 231|8@0+ (1,0) [0|255] ""  RR,ADCU
 SG_ LR_P12_Pxx_029 : 239|8@0+ (1,0) [0|255] ""  RR,ADCU
 SG_ LR_P12_Pxx_030 : 247|8@0+ (1,0) [0|255] ""  RR,ADCU
 SG_ LR_P12_Pxx_031 : 255|8@0+ (1,0) [0|255] ""  RR,ADCU
 SG_ LR_P12_Pxx_032 : 263|8@0+ (1,0) [0|255] ""  RR,ADCU
 SG_ LR_P12_Pxx_033 : 271|8@0+ (1,0) [0|255] ""  RR,ADCU
 SG_ LR_P12_Pxx_034 : 279|8@0+ (1,0) [0|255] ""  RR,ADCU
 SG_ LR_P12_Pxx_035 : 287|8@0+ (1,0) [0|255] ""  RR,ADCU
 SG_ LR_P12_Pxx_036 : 295|8@0+ (1,0) [0|255] ""  RR,ADCU
 SG_ LR_P12_Pxx_037 : 303|8@0+ (1,0) [0|255] ""  RR,ADCU
 SG_ LR_P12_Pxx_038 : 311|8@0+ (1,0) [0|255] ""  RR,ADCU
 SG_ LR_P12_Pxx_039 : 319|8@0+ (1,0) [0|255] ""  RR,ADCU
 SG_ LR_P12_Pxx_040 : 327|8@0+ (1,0) [0|255] ""  RR,ADCU
 SG_ LR_P12_Pxx_041 : 335|8@0+ (1,0) [0|255] ""  RR,ADCU
 SG_ LR_P1_P2_021 : 343|8@0+ (1,0) [0|255] ""  RR,ADCU
 SG_ LR_P1_P2_022 : 351|8@0+ (1,0) [0|255] ""  RR,ADCU
 SG_ LR_P1_P2_023 : 359|8@0+ (1,0) [0|255] ""  RR,ADCU
 SG_ LR_P1_P2_024 : 367|8@0+ (1,0) [0|255] ""  RR,ADCU
 SG_ LR_P1_P2_025 : 375|8@0+ (1,0) [0|255] ""  RR,ADCU
 SG_ LR_P1_P2_026 : 383|8@0+ (1,0) [0|255] ""  RR,ADCU
 SG_ LR_P1_P2_027 : 391|8@0+ (1,0) [0|255] ""  RR,ADCU
 SG_ LR_P1_P2_028 : 399|8@0+ (1,0) [0|255] ""  RR,ADCU
 SG_ LR_P1_P2_029 : 407|8@0+ (1,0) [0|255] ""  RR,ADCU
 SG_ LR_P1_P2_030 : 415|8@0+ (1,0) [0|255] ""  RR,ADCU
 SG_ LR_P1_P2_031 : 423|8@0+ (1,0) [0|255] ""  RR,ADCU
 SG_ LR_P1_P2_032 : 431|8@0+ (1,0) [0|255] ""  RR,ADCU
 SG_ LR_P1_P2_033 : 439|8@0+ (1,0) [0|255] ""  RR,ADCU
 SG_ LR_P1_P2_034 : 447|8@0+ (1,0) [0|255] ""  RR,ADCU
 SG_ LR_P1_P2_035 : 455|8@0+ (1,0) [0|255] ""  RR,ADCU
 SG_ LR_P1_P2_036 : 463|8@0+ (1,0) [0|255] ""  RR,ADCU
 SG_ LR_P1_P2_037 : 471|8@0+ (1,0) [0|255] ""  RR,ADCU
 SG_ LR_P1_P2_038 : 479|8@0+ (1,0) [0|255] ""  RR,ADCU
 SG_ LR_P1_P2_039 : 487|8@0+ (1,0) [0|255] ""  RR,ADCU
 SG_ LR_P1_P2_040 : 495|8@0+ (1,0) [0|255] ""  RR,ADCU
 SG_ LR_P1_P2_041 : 503|8@0+ (1,0) [0|255] ""  RR,ADCU
 SG_ LR_RDI_E_021_041_AliveCounter : 511|4@0+ (1,0) [0|15] ""  RR,ADCU
 SG_ LR_RDI_E_021_041_CheckSum : 507|4@0+ (1,0) [0|15] ""  RR,ADCU

BO_ 290 LR_RDI_E_042_062: 64 LR
 SG_ LR_P00_Pxx_042 : 7|8@0+ (1,0) [0|255] ""  RR,ADCU
 SG_ LR_P00_Pxx_043 : 15|8@0+ (1,0) [0|255] ""  RR,ADCU
 SG_ LR_P00_Pxx_044 : 23|8@0+ (1,0) [0|255] ""  RR,ADCU
 SG_ LR_P00_Pxx_045 : 31|8@0+ (1,0) [0|255] ""  RR,ADCU
 SG_ LR_P00_Pxx_046 : 39|8@0+ (1,0) [0|255] ""  RR,ADCU
 SG_ LR_P00_Pxx_047 : 47|8@0+ (1,0) [0|255] ""  RR,ADCU
 SG_ LR_P00_Pxx_048 : 55|8@0+ (1,0) [0|255] ""  RR,ADCU
 SG_ LR_P00_Pxx_049 : 63|8@0+ (1,0) [0|255] ""  RR,ADCU
 SG_ LR_P00_Pxx_050 : 71|8@0+ (1,0) [0|255] ""  RR,ADCU
 SG_ LR_P00_Pxx_051 : 79|8@0+ (1,0) [0|255] ""  RR,ADCU
 SG_ LR_P00_Pxx_052 : 87|8@0+ (1,0) [0|255] ""  RR,ADCU
 SG_ LR_P00_Pxx_053 : 95|8@0+ (1,0) [0|255] ""  RR,ADCU
 SG_ LR_P00_Pxx_054 : 103|8@0+ (1,0) [0|255] ""  RR,ADCU
 SG_ LR_P00_Pxx_055 : 111|8@0+ (1,0) [0|255] ""  RR,ADCU
 SG_ LR_P00_Pxx_056 : 119|8@0+ (1,0) [0|255] ""  RR,ADCU
 SG_ LR_P00_Pxx_057 : 127|8@0+ (1,0) [0|255] ""  RR,ADCU
 SG_ LR_P00_Pxx_058 : 135|8@0+ (1,0) [0|255] ""  RR,ADCU
 SG_ LR_P00_Pxx_059 : 143|8@0+ (1,0) [0|255] ""  RR,ADCU
 SG_ LR_P00_Pxx_060 : 151|8@0+ (1,0) [0|255] ""  RR,ADCU
 SG_ LR_P00_Pxx_061 : 159|8@0+ (1,0) [0|255] ""  RR,ADCU
 SG_ LR_P00_Pxx_062 : 167|8@0+ (1,0) [0|255] ""  RR,ADCU
 SG_ LR_P12_Pxx_042 : 175|8@0+ (1,0) [0|255] ""  RR,ADCU
 SG_ LR_P12_Pxx_043 : 183|8@0+ (1,0) [0|255] ""  RR,ADCU
 SG_ LR_P12_Pxx_044 : 191|8@0+ (1,0) [0|255] ""  RR,ADCU
 SG_ LR_P12_Pxx_045 : 199|8@0+ (1,0) [0|255] ""  RR,ADCU
 SG_ LR_P12_Pxx_046 : 207|8@0+ (1,0) [0|255] ""  RR,ADCU
 SG_ LR_P12_Pxx_047 : 215|8@0+ (1,0) [0|255] ""  RR,ADCU
 SG_ LR_P12_Pxx_048 : 223|8@0+ (1,0) [0|255] ""  RR,ADCU
 SG_ LR_P12_Pxx_049 : 231|8@0+ (1,0) [0|255] ""  RR,ADCU
 SG_ LR_P12_Pxx_050 : 239|8@0+ (1,0) [0|255] ""  RR,ADCU
 SG_ LR_P12_Pxx_051 : 247|8@0+ (1,0) [0|255] ""  RR,ADCU
 SG_ LR_P12_Pxx_052 : 255|8@0+ (1,0) [0|255] ""  RR,ADCU
 SG_ LR_P12_Pxx_053 : 263|8@0+ (1,0) [0|255] ""  RR,ADCU
 SG_ LR_P12_Pxx_054 : 271|8@0+ (1,0) [0|255] ""  RR,ADCU
 SG_ LR_P12_Pxx_055 : 279|8@0+ (1,0) [0|255] ""  RR,ADCU
 SG_ LR_P12_Pxx_056 : 287|8@0+ (1,0) [0|255] ""  RR,ADCU
 SG_ LR_P12_Pxx_057 : 295|8@0+ (1,0) [0|255] ""  RR,ADCU
 SG_ LR_P12_Pxx_058 : 303|8@0+ (1,0) [0|255] ""  RR,ADCU
 SG_ LR_P12_Pxx_059 : 311|8@0+ (1,0) [0|255] ""  RR,ADCU
 SG_ LR_P12_Pxx_060 : 319|8@0+ (1,0) [0|255] ""  RR,ADCU
 SG_ LR_P12_Pxx_061 : 327|8@0+ (1,0) [0|255] ""  RR,ADCU
 SG_ LR_P12_Pxx_062 : 335|8@0+ (1,0) [0|255] ""  RR,ADCU
 SG_ LR_P1_P2_042 : 343|8@0+ (1,0) [0|255] ""  RR,ADCU
 SG_ LR_P1_P2_043 : 351|8@0+ (1,0) [0|255] ""  RR,ADCU
 SG_ LR_P1_P2_044 : 359|8@0+ (1,0) [0|255] ""  RR,ADCU
 SG_ LR_P1_P2_045 : 367|8@0+ (1,0) [0|255] ""  RR,ADCU
 SG_ LR_P1_P2_046 : 375|8@0+ (1,0) [0|255] ""  RR,ADCU
 SG_ LR_P1_P2_047 : 383|8@0+ (1,0) [0|255] ""  RR,ADCU
 SG_ LR_P1_P2_048 : 391|8@0+ (1,0) [0|255] ""  RR,ADCU
 SG_ LR_P1_P2_049 : 399|8@0+ (1,0) [0|255] ""  RR,ADCU
 SG_ LR_P1_P2_050 : 407|8@0+ (1,0) [0|255] ""  RR,ADCU
 SG_ LR_P1_P2_051 : 415|8@0+ (1,0) [0|255] ""  RR,ADCU
 SG_ LR_P1_P2_052 : 423|8@0+ (1,0) [0|255] ""  RR,ADCU
 SG_ LR_P1_P2_053 : 431|8@0+ (1,0) [0|255] ""  RR,ADCU
 SG_ LR_P1_P2_054 : 439|8@0+ (1,0) [0|255] ""  RR,ADCU
 SG_ LR_P1_P2_055 : 447|8@0+ (1,0) [0|255] ""  RR,ADCU
 SG_ LR_P1_P2_056 : 455|8@0+ (1,0) [0|255] ""  RR,ADCU
 SG_ LR_P1_P2_057 : 463|8@0+ (1,0) [0|255] ""  RR,ADCU
 SG_ LR_P1_P2_058 : 471|8@0+ (1,0) [0|255] ""  RR,ADCU
 SG_ LR_P1_P2_059 : 479|8@0+ (1,0) [0|255] ""  RR,ADCU
 SG_ LR_P1_P2_060 : 487|8@0+ (1,0) [0|255] ""  RR,ADCU
 SG_ LR_P1_P2_061 : 495|8@0+ (1,0) [0|255] ""  RR,ADCU
 SG_ LR_P1_P2_062 : 503|8@0+ (1,0) [0|255] ""  RR,ADCU
 SG_ LR_RDI_E_042_062_AliveCounter : 511|4@0+ (1,0) [0|15] ""  RR,ADCU
 SG_ LR_RDI_E_042_062_CheckSum : 507|4@0+ (1,0) [0|15] ""  RR,ADCU

BO_ 291 LR_RDI_E_063_083: 64 LR
 SG_ LR_P00_Pxx_063 : 7|8@0+ (1,0) [0|255] ""  RR,ADCU
 SG_ LR_P00_Pxx_064 : 15|8@0+ (1,0) [0|255] ""  RR,ADCU
 SG_ LR_P00_Pxx_065 : 23|8@0+ (1,0) [0|255] ""  RR,ADCU
 SG_ LR_P00_Pxx_066 : 31|8@0+ (1,0) [0|255] ""  RR,ADCU
 SG_ LR_P00_Pxx_067 : 39|8@0+ (1,0) [0|255] ""  RR,ADCU
 SG_ LR_P00_Pxx_068 : 47|8@0+ (1,0) [0|255] ""  RR,ADCU
 SG_ LR_P00_Pxx_069 : 55|8@0+ (1,0) [0|255] ""  RR,ADCU
 SG_ LR_P00_Pxx_070 : 63|8@0+ (1,0) [0|255] ""  RR,ADCU
 SG_ LR_P00_Pxx_071 : 71|8@0+ (1,0) [0|255] ""  RR,ADCU
 SG_ LR_P00_Pxx_072 : 79|8@0+ (1,0) [0|255] ""  RR,ADCU
 SG_ LR_P00_Pxx_073 : 87|8@0+ (1,0) [0|255] ""  RR,ADCU
 SG_ LR_P00_Pxx_074 : 95|8@0+ (1,0) [0|255] ""  RR,ADCU
 SG_ LR_P00_Pxx_075 : 103|8@0+ (1,0) [0|255] ""  RR,ADCU
 SG_ LR_P00_Pxx_076 : 111|8@0+ (1,0) [0|255] ""  RR,ADCU
 SG_ LR_P00_Pxx_077 : 119|8@0+ (1,0) [0|255] ""  RR,ADCU
 SG_ LR_P00_Pxx_078 : 127|8@0+ (1,0) [0|255] ""  RR,ADCU
 SG_ LR_P00_Pxx_079 : 135|8@0+ (1,0) [0|255] ""  RR,ADCU
 SG_ LR_P00_Pxx_080 : 143|8@0+ (1,0) [0|255] ""  RR,ADCU
 SG_ LR_P00_Pxx_081 : 151|8@0+ (1,0) [0|255] ""  RR,ADCU
 SG_ LR_P00_Pxx_082 : 159|8@0+ (1,0) [0|255] ""  RR,ADCU
 SG_ LR_P00_Pxx_083 : 167|8@0+ (1,0) [0|255] ""  RR,ADCU
 SG_ LR_P12_Pxx_063 : 175|8@0+ (1,0) [0|255] ""  RR,ADCU
 SG_ LR_P12_Pxx_064 : 183|8@0+ (1,0) [0|255] ""  RR,ADCU
 SG_ LR_P12_Pxx_065 : 191|8@0+ (1,0) [0|255] ""  RR,ADCU
 SG_ LR_P12_Pxx_066 : 199|8@0+ (1,0) [0|255] ""  RR,ADCU
 SG_ LR_P12_Pxx_067 : 207|8@0+ (1,0) [0|255] ""  RR,ADCU
 SG_ LR_P12_Pxx_068 : 215|8@0+ (1,0) [0|255] ""  RR,ADCU
 SG_ LR_P12_Pxx_069 : 223|8@0+ (1,0) [0|255] ""  RR,ADCU
 SG_ LR_P12_Pxx_070 : 231|8@0+ (1,0) [0|255] ""  RR,ADCU
 SG_ LR_P12_Pxx_071 : 239|8@0+ (1,0) [0|255] ""  RR,ADCU
 SG_ LR_P12_Pxx_072 : 247|8@0+ (1,0) [0|255] ""  RR,ADCU
 SG_ LR_P12_Pxx_073 : 255|8@0+ (1,0) [0|255] ""  RR,ADCU
 SG_ LR_P12_Pxx_074 : 263|8@0+ (1,0) [0|255] ""  RR,ADCU
 SG_ LR_P12_Pxx_075 : 271|8@0+ (1,0) [0|255] ""  RR,ADCU
 SG_ LR_P12_Pxx_076 : 279|8@0+ (1,0) [0|255] ""  RR,ADCU
 SG_ LR_P12_Pxx_077 : 287|8@0+ (1,0) [0|255] ""  RR,ADCU
 SG_ LR_P12_Pxx_078 : 295|8@0+ (1,0) [0|255] ""  RR,ADCU
 SG_ LR_P12_Pxx_079 : 303|8@0+ (1,0) [0|255] ""  RR,ADCU
 SG_ LR_P12_Pxx_080 : 311|8@0+ (1,0) [0|255] ""  RR,ADCU
 SG_ LR_P12_Pxx_081 : 319|8@0+ (1,0) [0|255] ""  RR,ADCU
 SG_ LR_P12_Pxx_082 : 327|8@0+ (1,0) [0|255] ""  RR,ADCU
 SG_ LR_P12_Pxx_083 : 335|8@0+ (1,0) [0|255] ""  RR,ADCU
 SG_ LR_P1_P2_063 : 343|8@0+ (1,0) [0|255] ""  RR,ADCU
 SG_ LR_P1_P2_064 : 351|8@0+ (1,0) [0|255] ""  RR,ADCU
 SG_ LR_P1_P2_065 : 359|8@0+ (1,0) [0|255] ""  RR,ADCU
 SG_ LR_P1_P2_066 : 367|8@0+ (1,0) [0|255] ""  RR,ADCU
 SG_ LR_P1_P2_067 : 375|8@0+ (1,0) [0|255] ""  RR,ADCU
 SG_ LR_P1_P2_068 : 383|8@0+ (1,0) [0|255] ""  RR,ADCU
 SG_ LR_P1_P2_069 : 391|8@0+ (1,0) [0|255] ""  RR,ADCU
 SG_ LR_P1_P2_070 : 399|8@0+ (1,0) [0|255] ""  RR,ADCU
 SG_ LR_P1_P2_071 : 407|8@0+ (1,0) [0|255] ""  RR,ADCU
 SG_ LR_P1_P2_072 : 415|8@0+ (1,0) [0|255] ""  RR,ADCU
 SG_ LR_P1_P2_073 : 423|8@0+ (1,0) [0|255] ""  RR,ADCU
 SG_ LR_P1_P2_074 : 431|8@0+ (1,0) [0|255] ""  RR,ADCU
 SG_ LR_P1_P2_075 : 439|8@0+ (1,0) [0|255] ""  RR,ADCU
 SG_ LR_P1_P2_076 : 447|8@0+ (1,0) [0|255] ""  RR,ADCU
 SG_ LR_P1_P2_077 : 455|8@0+ (1,0) [0|255] ""  RR,ADCU
 SG_ LR_P1_P2_078 : 463|8@0+ (1,0) [0|255] ""  RR,ADCU
 SG_ LR_P1_P2_079 : 471|8@0+ (1,0) [0|255] ""  RR,ADCU
 SG_ LR_P1_P2_080 : 479|8@0+ (1,0) [0|255] ""  RR,ADCU
 SG_ LR_P1_P2_081 : 487|8@0+ (1,0) [0|255] ""  RR,ADCU
 SG_ LR_P1_P2_082 : 495|8@0+ (1,0) [0|255] ""  RR,ADCU
 SG_ LR_P1_P2_083 : 503|8@0+ (1,0) [0|255] ""  RR,ADCU
 SG_ LR_RDI_E_063_083_AliveCounter : 511|4@0+ (1,0) [0|15] ""  RR,ADCU
 SG_ LR_RDI_E_063_083_CheckSum : 507|4@0+ (1,0) [0|15] ""  RR,ADCU

BO_ 292 LR_RDI_E_084_104: 64 LR
 SG_ LR_P00_Pxx_084 : 7|8@0+ (1,0) [0|255] ""  RR,ADCU
 SG_ LR_P00_Pxx_085 : 15|8@0+ (1,0) [0|255] ""  RR,ADCU
 SG_ LR_P00_Pxx_086 : 23|8@0+ (1,0) [0|255] ""  RR,ADCU
 SG_ LR_P00_Pxx_087 : 31|8@0+ (1,0) [0|255] ""  RR,ADCU
 SG_ LR_P00_Pxx_088 : 39|8@0+ (1,0) [0|255] ""  RR,ADCU
 SG_ LR_P00_Pxx_089 : 47|8@0+ (1,0) [0|255] ""  RR,ADCU
 SG_ LR_P00_Pxx_090 : 55|8@0+ (1,0) [0|255] ""  RR,ADCU
 SG_ LR_P00_Pxx_091 : 63|8@0+ (1,0) [0|255] ""  RR,ADCU
 SG_ LR_P00_Pxx_092 : 71|8@0+ (1,0) [0|255] ""  RR,ADCU
 SG_ LR_P00_Pxx_093 : 79|8@0+ (1,0) [0|255] ""  RR,ADCU
 SG_ LR_P00_Pxx_094 : 87|8@0+ (1,0) [0|255] ""  RR,ADCU
 SG_ LR_P00_Pxx_095 : 95|8@0+ (1,0) [0|255] ""  RR,ADCU
 SG_ LR_P00_Pxx_096 : 103|8@0+ (1,0) [0|255] ""  RR,ADCU
 SG_ LR_P00_Pxx_097 : 111|8@0+ (1,0) [0|255] ""  RR,ADCU
 SG_ LR_P00_Pxx_098 : 119|8@0+ (1,0) [0|255] ""  RR,ADCU
 SG_ LR_P00_Pxx_099 : 127|8@0+ (1,0) [0|255] ""  RR,ADCU
 SG_ LR_P00_Pxx_100 : 135|8@0+ (1,0) [0|255] ""  RR,ADCU
 SG_ LR_P00_Pxx_101 : 143|8@0+ (1,0) [0|255] ""  RR,ADCU
 SG_ LR_P00_Pxx_102 : 151|8@0+ (1,0) [0|255] ""  RR,ADCU
 SG_ LR_P00_Pxx_103 : 159|8@0+ (1,0) [0|255] ""  RR,ADCU
 SG_ LR_P00_Pxx_104 : 167|8@0+ (1,0) [0|255] ""  RR,ADCU
 SG_ LR_P12_Pxx_084 : 175|8@0+ (1,0) [0|255] ""  RR,ADCU
 SG_ LR_P12_Pxx_085 : 183|8@0+ (1,0) [0|255] ""  RR,ADCU
 SG_ LR_P12_Pxx_086 : 191|8@0+ (1,0) [0|255] ""  RR,ADCU
 SG_ LR_P12_Pxx_087 : 199|8@0+ (1,0) [0|255] ""  RR,ADCU
 SG_ LR_P12_Pxx_088 : 207|8@0+ (1,0) [0|255] ""  RR,ADCU
 SG_ LR_P12_Pxx_089 : 215|8@0+ (1,0) [0|255] ""  RR,ADCU
 SG_ LR_P12_Pxx_090 : 223|8@0+ (1,0) [0|255] ""  RR,ADCU
 SG_ LR_P12_Pxx_091 : 231|8@0+ (1,0) [0|255] ""  RR,ADCU
 SG_ LR_P12_Pxx_092 : 239|8@0+ (1,0) [0|255] ""  RR,ADCU
 SG_ LR_P12_Pxx_093 : 247|8@0+ (1,0) [0|255] ""  RR,ADCU
 SG_ LR_P12_Pxx_094 : 255|8@0+ (1,0) [0|255] ""  RR,ADCU
 SG_ LR_P12_Pxx_095 : 263|8@0+ (1,0) [0|255] ""  RR,ADCU
 SG_ LR_P12_Pxx_096 : 271|8@0+ (1,0) [0|255] ""  RR,ADCU
 SG_ LR_P12_Pxx_097 : 279|8@0+ (1,0) [0|255] ""  RR,ADCU
 SG_ LR_P12_Pxx_098 : 287|8@0+ (1,0) [0|255] ""  RR,ADCU
 SG_ LR_P12_Pxx_099 : 295|8@0+ (1,0) [0|255] ""  RR,ADCU
 SG_ LR_P12_Pxx_100 : 303|8@0+ (1,0) [0|255] ""  RR,ADCU
 SG_ LR_P12_Pxx_101 : 311|8@0+ (1,0) [0|255] ""  RR,ADCU
 SG_ LR_P12_Pxx_102 : 319|8@0+ (1,0) [0|255] ""  RR,ADCU
 SG_ LR_P12_Pxx_103 : 327|8@0+ (1,0) [0|255] ""  RR,ADCU
 SG_ LR_P12_Pxx_104 : 335|8@0+ (1,0) [0|255] ""  RR,ADCU
 SG_ LR_P1_P2_084 : 343|8@0+ (1,0) [0|255] ""  RR,ADCU
 SG_ LR_P1_P2_085 : 351|8@0+ (1,0) [0|255] ""  RR,ADCU
 SG_ LR_P1_P2_086 : 359|8@0+ (1,0) [0|255] ""  RR,ADCU
 SG_ LR_P1_P2_087 : 367|8@0+ (1,0) [0|255] ""  RR,ADCU
 SG_ LR_P1_P2_088 : 375|8@0+ (1,0) [0|255] ""  RR,ADCU
 SG_ LR_P1_P2_089 : 383|8@0+ (1,0) [0|255] ""  RR,ADCU
 SG_ LR_P1_P2_090 : 391|8@0+ (1,0) [0|255] ""  RR,ADCU
 SG_ LR_P1_P2_091 : 399|8@0+ (1,0) [0|255] ""  RR,ADCU
 SG_ LR_P1_P2_092 : 407|8@0+ (1,0) [0|255] ""  RR,ADCU
 SG_ LR_P1_P2_093 : 415|8@0+ (1,0) [0|255] ""  RR,ADCU
 SG_ LR_P1_P2_094 : 423|8@0+ (1,0) [0|255] ""  RR,ADCU
 SG_ LR_P1_P2_095 : 431|8@0+ (1,0) [0|255] ""  RR,ADCU
 SG_ LR_P1_P2_096 : 439|8@0+ (1,0) [0|255] ""  RR,ADCU
 SG_ LR_P1_P2_097 : 447|8@0+ (1,0) [0|255] ""  RR,ADCU
 SG_ LR_P1_P2_098 : 455|8@0+ (1,0) [0|255] ""  RR,ADCU
 SG_ LR_P1_P2_099 : 463|8@0+ (1,0) [0|255] ""  RR,ADCU
 SG_ LR_P1_P2_100 : 471|8@0+ (1,0) [0|255] ""  RR,ADCU
 SG_ LR_P1_P2_101 : 479|8@0+ (1,0) [0|255] ""  RR,ADCU
 SG_ LR_P1_P2_102 : 487|8@0+ (1,0) [0|255] ""  RR,ADCU
 SG_ LR_P1_P2_103 : 495|8@0+ (1,0) [0|255] ""  RR,ADCU
 SG_ LR_P1_P2_104 : 503|8@0+ (1,0) [0|255] ""  RR,ADCU
 SG_ LR_RDI_E_084_104_AliveCounter : 511|4@0+ (1,0) [0|15] ""  RR,ADCU
 SG_ LR_RDI_E_084_104_CheckSum : 507|4@0+ (1,0) [0|15] ""  RR,ADCU

BO_ 293 LR_RDI_E_105_125: 64 LR
 SG_ LR_P00_Pxx_105 : 7|8@0+ (1,0) [0|255] ""  RR,ADCU
 SG_ LR_P00_Pxx_106 : 15|8@0+ (1,0) [0|255] ""  RR,ADCU
 SG_ LR_P00_Pxx_107 : 23|8@0+ (1,0) [0|255] ""  RR,ADCU
 SG_ LR_P00_Pxx_108 : 31|8@0+ (1,0) [0|255] ""  RR,ADCU
 SG_ LR_P00_Pxx_109 : 39|8@0+ (1,0) [0|255] ""  RR,ADCU
 SG_ LR_P00_Pxx_110 : 47|8@0+ (1,0) [0|255] ""  RR,ADCU
 SG_ LR_P00_Pxx_111 : 55|8@0+ (1,0) [0|255] ""  RR,ADCU
 SG_ LR_P00_Pxx_112 : 63|8@0+ (1,0) [0|255] ""  RR,ADCU
 SG_ LR_P00_Pxx_113 : 71|8@0+ (1,0) [0|255] ""  RR,ADCU
 SG_ LR_P00_Pxx_114 : 79|8@0+ (1,0) [0|255] ""  RR,ADCU
 SG_ LR_P00_Pxx_115 : 87|8@0+ (1,0) [0|255] ""  RR,ADCU
 SG_ LR_P00_Pxx_116 : 95|8@0+ (1,0) [0|255] ""  RR,ADCU
 SG_ LR_P00_Pxx_117 : 103|8@0+ (1,0) [0|255] ""  RR,ADCU
 SG_ LR_P00_Pxx_118 : 111|8@0+ (1,0) [0|255] ""  RR,ADCU
 SG_ LR_P00_Pxx_119 : 119|8@0+ (1,0) [0|255] ""  RR,ADCU
 SG_ LR_P00_Pxx_120 : 127|8@0+ (1,0) [0|255] ""  RR,ADCU
 SG_ LR_P00_Pxx_121 : 135|8@0+ (1,0) [0|255] ""  RR,ADCU
 SG_ LR_P00_Pxx_122 : 143|8@0+ (1,0) [0|255] ""  RR,ADCU
 SG_ LR_P00_Pxx_123 : 151|8@0+ (1,0) [0|255] ""  RR,ADCU
 SG_ LR_P00_Pxx_124 : 159|8@0+ (1,0) [0|255] ""  RR,ADCU
 SG_ LR_P00_Pxx_125 : 167|8@0+ (1,0) [0|255] ""  RR,ADCU
 SG_ LR_P12_Pxx_105 : 175|8@0+ (1,0) [0|255] ""  RR,ADCU
 SG_ LR_P12_Pxx_106 : 183|8@0+ (1,0) [0|255] ""  RR,ADCU
 SG_ LR_P12_Pxx_107 : 191|8@0+ (1,0) [0|255] ""  RR,ADCU
 SG_ LR_P12_Pxx_108 : 199|8@0+ (1,0) [0|255] ""  RR,ADCU
 SG_ LR_P12_Pxx_109 : 207|8@0+ (1,0) [0|255] ""  RR,ADCU
 SG_ LR_P12_Pxx_110 : 215|8@0+ (1,0) [0|255] ""  RR,ADCU
 SG_ LR_P12_Pxx_111 : 223|8@0+ (1,0) [0|255] ""  RR,ADCU
 SG_ LR_P12_Pxx_112 : 231|8@0+ (1,0) [0|255] ""  RR,ADCU
 SG_ LR_P12_Pxx_113 : 239|8@0+ (1,0) [0|255] ""  RR,ADCU
 SG_ LR_P12_Pxx_114 : 247|8@0+ (1,0) [0|255] ""  RR,ADCU
 SG_ LR_P12_Pxx_115 : 255|8@0+ (1,0) [0|255] ""  RR,ADCU
 SG_ LR_P12_Pxx_116 : 263|8@0+ (1,0) [0|255] ""  RR,ADCU
 SG_ LR_P12_Pxx_117 : 271|8@0+ (1,0) [0|255] ""  RR,ADCU
 SG_ LR_P12_Pxx_118 : 279|8@0+ (1,0) [0|255] ""  RR,ADCU
 SG_ LR_P12_Pxx_119 : 287|8@0+ (1,0) [0|255] ""  RR,ADCU
 SG_ LR_P12_Pxx_120 : 295|8@0+ (1,0) [0|255] ""  RR,ADCU
 SG_ LR_P12_Pxx_121 : 303|8@0+ (1,0) [0|255] ""  RR,ADCU
 SG_ LR_P12_Pxx_122 : 311|8@0+ (1,0) [0|255] ""  RR,ADCU
 SG_ LR_P12_Pxx_123 : 319|8@0+ (1,0) [0|255] ""  RR,ADCU
 SG_ LR_P12_Pxx_124 : 327|8@0+ (1,0) [0|255] ""  RR,ADCU
 SG_ LR_P12_Pxx_125 : 335|8@0+ (1,0) [0|255] ""  RR,ADCU
 SG_ LR_P1_P2_105 : 343|8@0+ (1,0) [0|255] ""  RR,ADCU
 SG_ LR_P1_P2_106 : 351|8@0+ (1,0) [0|255] ""  RR,ADCU
 SG_ LR_P1_P2_107 : 359|8@0+ (1,0) [0|255] ""  RR,ADCU
 SG_ LR_P1_P2_108 : 367|8@0+ (1,0) [0|255] ""  RR,ADCU
 SG_ LR_P1_P2_109 : 375|8@0+ (1,0) [0|255] ""  RR,ADCU
 SG_ LR_P1_P2_110 : 383|8@0+ (1,0) [0|255] ""  RR,ADCU
 SG_ LR_P1_P2_111 : 391|8@0+ (1,0) [0|255] ""  RR,ADCU
 SG_ LR_P1_P2_112 : 399|8@0+ (1,0) [0|255] ""  RR,ADCU
 SG_ LR_P1_P2_113 : 407|8@0+ (1,0) [0|255] ""  RR,ADCU
 SG_ LR_P1_P2_114 : 415|8@0+ (1,0) [0|255] ""  RR,ADCU
 SG_ LR_P1_P2_115 : 423|8@0+ (1,0) [0|255] ""  RR,ADCU
 SG_ LR_P1_P2_116 : 431|8@0+ (1,0) [0|255] ""  RR,ADCU
 SG_ LR_P1_P2_117 : 439|8@0+ (1,0) [0|255] ""  RR,ADCU
 SG_ LR_P1_P2_118 : 447|8@0+ (1,0) [0|255] ""  RR,ADCU
 SG_ LR_P1_P2_119 : 455|8@0+ (1,0) [0|255] ""  RR,ADCU
 SG_ LR_P1_P2_120 : 463|8@0+ (1,0) [0|255] ""  RR,ADCU
 SG_ LR_P1_P2_121 : 471|8@0+ (1,0) [0|255] ""  RR,ADCU
 SG_ LR_P1_P2_122 : 479|8@0+ (1,0) [0|255] ""  RR,ADCU
 SG_ LR_P1_P2_123 : 487|8@0+ (1,0) [0|255] ""  RR,ADCU
 SG_ LR_P1_P2_124 : 495|8@0+ (1,0) [0|255] ""  RR,ADCU
 SG_ LR_P1_P2_125 : 503|8@0+ (1,0) [0|255] ""  RR,ADCU
 SG_ LR_RDI_E_105_125_AliveCounter : 511|4@0+ (1,0) [0|15] ""  RR,ADCU
 SG_ LR_RDI_E_105_125_CheckSum : 507|4@0+ (1,0) [0|15] ""  RR,ADCU

BO_ 294 LR_RDI_E_126_146: 64 LR
 SG_ LR_P00_Pxx_126 : 7|8@0+ (1,0) [0|255] ""  RR,ADCU
 SG_ LR_P00_Pxx_127 : 15|8@0+ (1,0) [0|255] ""  RR,ADCU
 SG_ LR_P00_Pxx_128 : 23|8@0+ (1,0) [0|255] ""  RR,ADCU
 SG_ LR_P00_Pxx_129 : 31|8@0+ (1,0) [0|255] ""  RR,ADCU
 SG_ LR_P00_Pxx_130 : 39|8@0+ (1,0) [0|255] ""  RR,ADCU
 SG_ LR_P00_Pxx_131 : 47|8@0+ (1,0) [0|255] ""  RR,ADCU
 SG_ LR_P00_Pxx_132 : 55|8@0+ (1,0) [0|255] ""  RR,ADCU
 SG_ LR_P00_Pxx_133 : 63|8@0+ (1,0) [0|255] ""  RR,ADCU
 SG_ LR_P00_Pxx_134 : 71|8@0+ (1,0) [0|255] ""  RR,ADCU
 SG_ LR_P00_Pxx_135 : 79|8@0+ (1,0) [0|255] ""  RR,ADCU
 SG_ LR_P00_Pxx_136 : 87|8@0+ (1,0) [0|255] ""  RR,ADCU
 SG_ LR_P00_Pxx_137 : 95|8@0+ (1,0) [0|255] ""  RR,ADCU
 SG_ LR_P00_Pxx_138 : 103|8@0+ (1,0) [0|255] ""  RR,ADCU
 SG_ LR_P00_Pxx_139 : 111|8@0+ (1,0) [0|255] ""  RR,ADCU
 SG_ LR_P00_Pxx_140 : 119|8@0+ (1,0) [0|255] ""  RR,ADCU
 SG_ LR_P00_Pxx_141 : 127|8@0+ (1,0) [0|255] ""  RR,ADCU
 SG_ LR_P00_Pxx_142 : 135|8@0+ (1,0) [0|255] ""  RR,ADCU
 SG_ LR_P00_Pxx_143 : 143|8@0+ (1,0) [0|255] ""  RR,ADCU
 SG_ LR_P00_Pxx_144 : 151|8@0+ (1,0) [0|255] ""  RR,ADCU
 SG_ LR_P00_Pxx_145 : 159|8@0+ (1,0) [0|255] ""  RR,ADCU
 SG_ LR_P00_Pxx_146 : 167|8@0+ (1,0) [0|255] ""  RR,ADCU
 SG_ LR_P12_Pxx_126 : 175|8@0+ (1,0) [0|255] ""  RR,ADCU
 SG_ LR_P12_Pxx_127 : 183|8@0+ (1,0) [0|255] ""  RR,ADCU
 SG_ LR_P12_Pxx_128 : 191|8@0+ (1,0) [0|255] ""  RR,ADCU
 SG_ LR_P12_Pxx_129 : 199|8@0+ (1,0) [0|255] ""  RR,ADCU
 SG_ LR_P12_Pxx_130 : 207|8@0+ (1,0) [0|255] ""  RR,ADCU
 SG_ LR_P12_Pxx_131 : 215|8@0+ (1,0) [0|255] ""  RR,ADCU
 SG_ LR_P12_Pxx_132 : 223|8@0+ (1,0) [0|255] ""  RR,ADCU
 SG_ LR_P12_Pxx_133 : 231|8@0+ (1,0) [0|255] ""  RR,ADCU
 SG_ LR_P12_Pxx_134 : 239|8@0+ (1,0) [0|255] ""  RR,ADCU
 SG_ LR_P12_Pxx_135 : 247|8@0+ (1,0) [0|255] ""  RR,ADCU
 SG_ LR_P12_Pxx_136 : 255|8@0+ (1,0) [0|255] ""  RR,ADCU
 SG_ LR_P12_Pxx_137 : 263|8@0+ (1,0) [0|255] ""  RR,ADCU
 SG_ LR_P12_Pxx_138 : 271|8@0+ (1,0) [0|255] ""  RR,ADCU
 SG_ LR_P12_Pxx_139 : 279|8@0+ (1,0) [0|255] ""  RR,ADCU
 SG_ LR_P12_Pxx_140 : 287|8@0+ (1,0) [0|255] ""  RR,ADCU
 SG_ LR_P12_Pxx_141 : 295|8@0+ (1,0) [0|255] ""  RR,ADCU
 SG_ LR_P12_Pxx_142 : 303|8@0+ (1,0) [0|255] ""  RR,ADCU
 SG_ LR_P12_Pxx_143 : 311|8@0+ (1,0) [0|255] ""  RR,ADCU
 SG_ LR_P12_Pxx_144 : 319|8@0+ (1,0) [0|255] ""  RR,ADCU
 SG_ LR_P12_Pxx_145 : 327|8@0+ (1,0) [0|255] ""  RR,ADCU
 SG_ LR_P12_Pxx_146 : 335|8@0+ (1,0) [0|255] ""  RR,ADCU
 SG_ LR_P1_P2_126 : 343|8@0+ (1,0) [0|255] ""  RR,ADCU
 SG_ LR_P1_P2_127 : 351|8@0+ (1,0) [0|255] ""  RR,ADCU
 SG_ LR_P1_P2_128 : 359|8@0+ (1,0) [0|255] ""  RR,ADCU
 SG_ LR_P1_P2_129 : 367|8@0+ (1,0) [0|255] ""  RR,ADCU
 SG_ LR_P1_P2_130 : 375|8@0+ (1,0) [0|255] ""  RR,ADCU
 SG_ LR_P1_P2_131 : 383|8@0+ (1,0) [0|255] ""  RR,ADCU
 SG_ LR_P1_P2_132 : 391|8@0+ (1,0) [0|255] ""  RR,ADCU
 SG_ LR_P1_P2_133 : 399|8@0+ (1,0) [0|255] ""  RR,ADCU
 SG_ LR_P1_P2_134 : 407|8@0+ (1,0) [0|255] ""  RR,ADCU
 SG_ LR_P1_P2_135 : 415|8@0+ (1,0) [0|255] ""  RR,ADCU
 SG_ LR_P1_P2_136 : 423|8@0+ (1,0) [0|255] ""  RR,ADCU
 SG_ LR_P1_P2_137 : 431|8@0+ (1,0) [0|255] ""  RR,ADCU
 SG_ LR_P1_P2_138 : 439|8@0+ (1,0) [0|255] ""  RR,ADCU
 SG_ LR_P1_P2_139 : 447|8@0+ (1,0) [0|255] ""  RR,ADCU
 SG_ LR_P1_P2_140 : 455|8@0+ (1,0) [0|255] ""  RR,ADCU
 SG_ LR_P1_P2_141 : 463|8@0+ (1,0) [0|255] ""  RR,ADCU
 SG_ LR_P1_P2_142 : 471|8@0+ (1,0) [0|255] ""  RR,ADCU
 SG_ LR_P1_P2_143 : 479|8@0+ (1,0) [0|255] ""  RR,ADCU
 SG_ LR_P1_P2_144 : 487|8@0+ (1,0) [0|255] ""  RR,ADCU
 SG_ LR_P1_P2_145 : 495|8@0+ (1,0) [0|255] ""  RR,ADCU
 SG_ LR_P1_P2_146 : 503|8@0+ (1,0) [0|255] ""  RR,ADCU
 SG_ LR_RDI_E_126_146_AliveCounter : 511|4@0+ (1,0) [0|15] ""  RR,ADCU
 SG_ LR_RDI_E_126_146_CheckSum : 507|4@0+ (1,0) [0|15] ""  RR,ADCU

CM_ SG_ 267 LR_AzimuthAng_060 "Azimuth angle of point_060";
CM_ SG_ 267 LR_AzimuthAng_061 "Azimuth angle of point_061";
CM_ SG_ 267 LR_AzimuthAng_062 "Azimuth angle of point_062";
CM_ SG_ 267 LR_AzimuthAng_063 "Azimuth angle of point_063";
CM_ SG_ 267 LR_AzimuthAng_064 "Azimuth angle of point_064";
CM_ SG_ 267 LR_AzimuthAng_065 "Azimuth angle of point_065";
CM_ SG_ 267 LR_AzimuthSNR_060 "Azimuth SNR of point_060";
CM_ SG_ 267 LR_AzimuthSNR_061 "Azimuth SNR of point_061";
CM_ SG_ 267 LR_AzimuthSNR_062 "Azimuth SNR of point_062";
CM_ SG_ 267 LR_AzimuthSNR_063 "Azimuth SNR of point_063";
CM_ SG_ 267 LR_AzimuthSNR_064 "Azimuth SNR of point_064";
CM_ SG_ 267 LR_AzimuthSNR_065 "Azimuth SNR of point_065";
CM_ SG_ 267 LR_ElevationAng_060 "Elevation angle of point_060";
CM_ SG_ 267 LR_ElevationAng_061 "Elevation angle of point_061";
CM_ SG_ 267 LR_ElevationAng_062 "Elevation angle of point_062";
CM_ SG_ 267 LR_ElevationAng_063 "Elevation angle of point_063";
CM_ SG_ 267 LR_ElevationAng_064 "Elevation angle of point_064";
CM_ SG_ 267 LR_ElevationAng_065 "Elevation angle of point_065";
CM_ SG_ 267 LR_ElevationSNR_060 "Elevation SNR of point_060";
CM_ SG_ 267 LR_ElevationSNR_061 "Elevation SNR of point_061";
CM_ SG_ 267 LR_ElevationSNR_062 "Elevation SNR of point_062";
CM_ SG_ 267 LR_ElevationSNR_063 "Elevation SNR of point_063";
CM_ SG_ 267 LR_ElevationSNR_064 "Elevation SNR of point_064";
CM_ SG_ 267 LR_ElevationSNR_065 "Elevation SNR of point_065";
CM_ SG_ 267 LR_Range_060 "Range of point_060";
CM_ SG_ 267 LR_Range_061 "Range of point_061";
CM_ SG_ 267 LR_Range_062 "Range of point_062";
CM_ SG_ 267 LR_Range_063 "Range of point_063";
CM_ SG_ 267 LR_Range_064 "Range of point_064";
CM_ SG_ 267 LR_Range_065 "Range of point_065";
CM_ SG_ 267 LR_RCS_060 "RCS of point_060";
CM_ SG_ 267 LR_RCS_061 "RCS of point_061";
CM_ SG_ 267 LR_RCS_062 "RCS of point_062";
CM_ SG_ 267 LR_RCS_063 "RCS of point_063";
CM_ SG_ 267 LR_RCS_064 "RCS of point_064";
CM_ SG_ 267 LR_RCS_065 "RCS of point_065";
CM_ SG_ 267 LR_Status_060 "Status of point_060";
CM_ SG_ 267 LR_Status_061 "Status of point_061";
CM_ SG_ 267 LR_Status_062 "Status of point_062";
CM_ SG_ 267 LR_Status_063 "Status of point_063";
CM_ SG_ 267 LR_Status_064 "Status of point_064";
CM_ SG_ 267 LR_Status_065 "Status of point_065";
CM_ SG_ 267 LR_Tbd_060 "To be defined";
CM_ SG_ 267 LR_Tbd_061 "To be defined";
CM_ SG_ 267 LR_Tbd_062 "To be defined";
CM_ SG_ 267 LR_Tbd_063 "To be defined";
CM_ SG_ 267 LR_Tbd_064 "To be defined";
CM_ SG_ 267 LR_Tbd_065 "To be defined";
CM_ SG_ 267 LR_Velocity_060 "Relative radial velocity of point_060";
CM_ SG_ 267 LR_Velocity_061 "Relative radial velocity of point_061";
CM_ SG_ 267 LR_Velocity_062 "Relative radial velocity of point_062";
CM_ SG_ 267 LR_Velocity_063 "Relative radial velocity of point_063";
CM_ SG_ 267 LR_Velocity_064 "Relative radial velocity of point_064";
CM_ SG_ 267 LR_Velocity_065 "Relative radial velocity of point_065";
CM_ SG_ 268 LR_AzimuthAng_066 "Azimuth angle of point_066";
CM_ SG_ 268 LR_AzimuthAng_067 "Azimuth angle of point_067";
CM_ SG_ 268 LR_AzimuthAng_068 "Azimuth angle of point_068";
CM_ SG_ 268 LR_AzimuthAng_069 "Azimuth angle of point_069";
CM_ SG_ 268 LR_AzimuthAng_070 "Azimuth angle of point_070";
CM_ SG_ 268 LR_AzimuthAng_071 "Azimuth angle of point_071";
CM_ SG_ 268 LR_AzimuthSNR_066 "Azimuth SNR of point_066";
CM_ SG_ 268 LR_AzimuthSNR_067 "Azimuth SNR of point_067";
CM_ SG_ 268 LR_AzimuthSNR_068 "Azimuth SNR of point_068";
CM_ SG_ 268 LR_AzimuthSNR_069 "Azimuth SNR of point_069";
CM_ SG_ 268 LR_AzimuthSNR_070 "Azimuth SNR of point_070";
CM_ SG_ 268 LR_AzimuthSNR_071 "Azimuth SNR of point_071";
CM_ SG_ 268 LR_ElevationAng_066 "Elevation angle of point_066";
CM_ SG_ 268 LR_ElevationAng_067 "Elevation angle of point_067";
CM_ SG_ 268 LR_ElevationAng_068 "Elevation angle of point_068";
CM_ SG_ 268 LR_ElevationAng_069 "Elevation angle of point_069";
CM_ SG_ 268 LR_ElevationAng_070 "Elevation angle of point_070";
CM_ SG_ 268 LR_ElevationAng_071 "Elevation angle of point_071";
CM_ SG_ 268 LR_ElevationSNR_066 "Elevation SNR of point_066";
CM_ SG_ 268 LR_ElevationSNR_067 "Elevation SNR of point_067";
CM_ SG_ 268 LR_ElevationSNR_068 "Elevation SNR of point_068";
CM_ SG_ 268 LR_ElevationSNR_069 "Elevation SNR of point_069";
CM_ SG_ 268 LR_ElevationSNR_070 "Elevation SNR of point_070";
CM_ SG_ 268 LR_ElevationSNR_071 "Elevation SNR of point_071";
CM_ SG_ 268 LR_Range_066 "Range of point_066";
CM_ SG_ 268 LR_Range_067 "Range of point_067";
CM_ SG_ 268 LR_Range_068 "Range of point_068";
CM_ SG_ 268 LR_Range_069 "Range of point_069";
CM_ SG_ 268 LR_Range_070 "Range of point_070";
CM_ SG_ 268 LR_Range_071 "Range of point_071";
CM_ SG_ 268 LR_RCS_066 "RCS of point_066";
CM_ SG_ 268 LR_RCS_067 "RCS of point_067";
CM_ SG_ 268 LR_RCS_068 "RCS of point_068";
CM_ SG_ 268 LR_RCS_069 "RCS of point_069";
CM_ SG_ 268 LR_RCS_070 "RCS of point_070";
CM_ SG_ 268 LR_RCS_071 "RCS of point_071";
CM_ SG_ 268 LR_Status_066 "Status of point_066";
CM_ SG_ 268 LR_Status_067 "Status of point_067";
CM_ SG_ 268 LR_Status_068 "Status of point_068";
CM_ SG_ 268 LR_Status_069 "Status of point_069";
CM_ SG_ 268 LR_Status_070 "Status of point_070";
CM_ SG_ 268 LR_Status_071 "Status of point_071";
CM_ SG_ 268 LR_Tbd_066 "To be defined";
CM_ SG_ 268 LR_Tbd_067 "To be defined";
CM_ SG_ 268 LR_Tbd_068 "To be defined";
CM_ SG_ 268 LR_Tbd_069 "To be defined";
CM_ SG_ 268 LR_Tbd_070 "To be defined";
CM_ SG_ 268 LR_Tbd_071 "To be defined";
CM_ SG_ 268 LR_Velocity_066 "Relative radial velocity of point_066";
CM_ SG_ 268 LR_Velocity_067 "Relative radial velocity of point_067";
CM_ SG_ 268 LR_Velocity_068 "Relative radial velocity of point_068";
CM_ SG_ 268 LR_Velocity_069 "Relative radial velocity of point_069";
CM_ SG_ 268 LR_Velocity_070 "Relative radial velocity of point_070";
CM_ SG_ 268 LR_Velocity_071 "Relative radial velocity of point_071";
CM_ SG_ 269 LR_AzimuthAng_072 "Azimuth angle of point_072";
CM_ SG_ 269 LR_AzimuthAng_073 "Azimuth angle of point_073";
CM_ SG_ 269 LR_AzimuthAng_074 "Azimuth angle of point_074";
CM_ SG_ 269 LR_AzimuthAng_075 "Azimuth angle of point_075";
CM_ SG_ 269 LR_AzimuthAng_076 "Azimuth angle of point_076";
CM_ SG_ 269 LR_AzimuthAng_077 "Azimuth angle of point_077";
CM_ SG_ 269 LR_AzimuthSNR_072 "Azimuth SNR of point_072";
CM_ SG_ 269 LR_AzimuthSNR_073 "Azimuth SNR of point_073";
CM_ SG_ 269 LR_AzimuthSNR_074 "Azimuth SNR of point_074";
CM_ SG_ 269 LR_AzimuthSNR_075 "Azimuth SNR of point_075";
CM_ SG_ 269 LR_AzimuthSNR_076 "Azimuth SNR of point_076";
CM_ SG_ 269 LR_AzimuthSNR_077 "Azimuth SNR of point_077";
CM_ SG_ 269 LR_ElevationAng_072 "Elevation angle of point_072";
CM_ SG_ 269 LR_ElevationAng_073 "Elevation angle of point_073";
CM_ SG_ 269 LR_ElevationAng_074 "Elevation angle of point_074";
CM_ SG_ 269 LR_ElevationAng_075 "Elevation angle of point_075";
CM_ SG_ 269 LR_ElevationAng_076 "Elevation angle of point_076";
CM_ SG_ 269 LR_ElevationAng_077 "Elevation angle of point_077";
CM_ SG_ 269 LR_ElevationSNR_072 "Elevation SNR of point_072";
CM_ SG_ 269 LR_ElevationSNR_073 "Elevation SNR of point_073";
CM_ SG_ 269 LR_ElevationSNR_074 "Elevation SNR of point_074";
CM_ SG_ 269 LR_ElevationSNR_075 "Elevation SNR of point_075";
CM_ SG_ 269 LR_ElevationSNR_076 "Elevation SNR of point_076";
CM_ SG_ 269 LR_ElevationSNR_077 "Elevation SNR of point_077";
CM_ SG_ 269 LR_Range_072 "Range of point_072";
CM_ SG_ 269 LR_Range_073 "Range of point_073";
CM_ SG_ 269 LR_Range_074 "Range of point_074";
CM_ SG_ 269 LR_Range_075 "Range of point_075";
CM_ SG_ 269 LR_Range_076 "Range of point_076";
CM_ SG_ 269 LR_Range_077 "Range of point_077";
CM_ SG_ 269 LR_RCS_072 "RCS of point_072";
CM_ SG_ 269 LR_RCS_073 "RCS of point_073";
CM_ SG_ 269 LR_RCS_074 "RCS of point_074";
CM_ SG_ 269 LR_RCS_075 "RCS of point_075";
CM_ SG_ 269 LR_RCS_076 "RCS of point_076";
CM_ SG_ 269 LR_RCS_077 "RCS of point_077";
CM_ SG_ 269 LR_Status_072 "Status of point_072";
CM_ SG_ 269 LR_Status_073 "Status of point_073";
CM_ SG_ 269 LR_Status_074 "Status of point_074";
CM_ SG_ 269 LR_Status_075 "Status of point_075";
CM_ SG_ 269 LR_Status_076 "Status of point_076";
CM_ SG_ 269 LR_Status_077 "Status of point_077";
CM_ SG_ 269 LR_Tbd_072 "To be defined";
CM_ SG_ 269 LR_Tbd_073 "To be defined";
CM_ SG_ 269 LR_Tbd_074 "To be defined";
CM_ SG_ 269 LR_Tbd_075 "To be defined";
CM_ SG_ 269 LR_Tbd_076 "To be defined";
CM_ SG_ 269 LR_Tbd_077 "To be defined";
CM_ SG_ 269 LR_Velocity_072 "Relative radial velocity of point_072";
CM_ SG_ 269 LR_Velocity_073 "Relative radial velocity of point_073";
CM_ SG_ 269 LR_Velocity_074 "Relative radial velocity of point_074";
CM_ SG_ 269 LR_Velocity_075 "Relative radial velocity of point_075";
CM_ SG_ 269 LR_Velocity_076 "Relative radial velocity of point_076";
CM_ SG_ 269 LR_Velocity_077 "Relative radial velocity of point_077";
CM_ SG_ 270 LR_AzimuthAng_078 "Azimuth angle of point_078";
CM_ SG_ 270 LR_AzimuthAng_079 "Azimuth angle of point_079";
CM_ SG_ 270 LR_AzimuthAng_080 "Azimuth angle of point_080";
CM_ SG_ 270 LR_AzimuthAng_081 "Azimuth angle of point_081";
CM_ SG_ 270 LR_AzimuthAng_082 "Azimuth angle of point_082";
CM_ SG_ 270 LR_AzimuthAng_083 "Azimuth angle of point_083";
CM_ SG_ 270 LR_AzimuthSNR_078 "Azimuth SNR of point_078";
CM_ SG_ 270 LR_AzimuthSNR_079 "Azimuth SNR of point_079";
CM_ SG_ 270 LR_AzimuthSNR_080 "Azimuth SNR of point_080";
CM_ SG_ 270 LR_AzimuthSNR_081 "Azimuth SNR of point_081";
CM_ SG_ 270 LR_AzimuthSNR_082 "Azimuth SNR of point_082";
CM_ SG_ 270 LR_AzimuthSNR_083 "Azimuth SNR of point_083";
CM_ SG_ 270 LR_ElevationAng_078 "Elevation angle of point_078";
CM_ SG_ 270 LR_ElevationAng_079 "Elevation angle of point_079";
CM_ SG_ 270 LR_ElevationAng_080 "Elevation angle of point_080";
CM_ SG_ 270 LR_ElevationAng_081 "Elevation angle of point_081";
CM_ SG_ 270 LR_ElevationAng_082 "Elevation angle of point_082";
CM_ SG_ 270 LR_ElevationAng_083 "Elevation angle of point_083";
CM_ SG_ 270 LR_ElevationSNR_078 "Elevation SNR of point_078";
CM_ SG_ 270 LR_ElevationSNR_079 "Elevation SNR of point_079";
CM_ SG_ 270 LR_ElevationSNR_080 "Elevation SNR of point_080";
CM_ SG_ 270 LR_ElevationSNR_081 "Elevation SNR of point_081";
CM_ SG_ 270 LR_ElevationSNR_082 "Elevation SNR of point_082";
CM_ SG_ 270 LR_ElevationSNR_083 "Elevation SNR of point_083";
CM_ SG_ 270 LR_Range_078 "Range of point_078";
CM_ SG_ 270 LR_Range_079 "Range of point_079";
CM_ SG_ 270 LR_Range_080 "Range of point_080";
CM_ SG_ 270 LR_Range_081 "Range of point_081";
CM_ SG_ 270 LR_Range_082 "Range of point_082";
CM_ SG_ 270 LR_Range_083 "Range of point_083";
CM_ SG_ 270 LR_RCS_078 "RCS of point_078";
CM_ SG_ 270 LR_RCS_079 "RCS of point_079";
CM_ SG_ 270 LR_RCS_080 "RCS of point_080";
CM_ SG_ 270 LR_RCS_081 "RCS of point_081";
CM_ SG_ 270 LR_RCS_082 "RCS of point_082";
CM_ SG_ 270 LR_RCS_083 "RCS of point_083";
CM_ SG_ 270 LR_Status_078 "Status of point_078";
CM_ SG_ 270 LR_Status_079 "Status of point_079";
CM_ SG_ 270 LR_Status_080 "Status of point_080";
CM_ SG_ 270 LR_Status_081 "Status of point_081";
CM_ SG_ 270 LR_Status_082 "Status of point_082";
CM_ SG_ 270 LR_Status_083 "Status of point_083";
CM_ SG_ 270 LR_Tbd_078 "To be defined";
CM_ SG_ 270 LR_Tbd_079 "To be defined";
CM_ SG_ 270 LR_Tbd_080 "To be defined";
CM_ SG_ 270 LR_Tbd_081 "To be defined";
CM_ SG_ 270 LR_Tbd_082 "To be defined";
CM_ SG_ 270 LR_Tbd_083 "To be defined";
CM_ SG_ 270 LR_Velocity_078 "Relative radial velocity of point_078";
CM_ SG_ 270 LR_Velocity_079 "Relative radial velocity of point_079";
CM_ SG_ 270 LR_Velocity_080 "Relative radial velocity of point_080";
CM_ SG_ 270 LR_Velocity_081 "Relative radial velocity of point_081";
CM_ SG_ 270 LR_Velocity_082 "Relative radial velocity of point_082";
CM_ SG_ 270 LR_Velocity_083 "Relative radial velocity of point_083";
CM_ SG_ 271 LR_AzimuthAng_084 "Azimuth angle of point_084";
CM_ SG_ 271 LR_AzimuthAng_085 "Azimuth angle of point_085";
CM_ SG_ 271 LR_AzimuthAng_086 "Azimuth angle of point_086";
CM_ SG_ 271 LR_AzimuthAng_087 "Azimuth angle of point_087";
CM_ SG_ 271 LR_AzimuthAng_088 "Azimuth angle of point_088";
CM_ SG_ 271 LR_AzimuthAng_089 "Azimuth angle of point_089";
CM_ SG_ 271 LR_AzimuthSNR_084 "Azimuth SNR of point_084";
CM_ SG_ 271 LR_AzimuthSNR_085 "Azimuth SNR of point_085";
CM_ SG_ 271 LR_AzimuthSNR_086 "Azimuth SNR of point_086";
CM_ SG_ 271 LR_AzimuthSNR_087 "Azimuth SNR of point_087";
CM_ SG_ 271 LR_AzimuthSNR_088 "Azimuth SNR of point_088";
CM_ SG_ 271 LR_AzimuthSNR_089 "Azimuth SNR of point_089";
CM_ SG_ 271 LR_ElevationAng_084 "Elevation angle of point_084";
CM_ SG_ 271 LR_ElevationAng_085 "Elevation angle of point_085";
CM_ SG_ 271 LR_ElevationAng_086 "Elevation angle of point_086";
CM_ SG_ 271 LR_ElevationAng_087 "Elevation angle of point_087";
CM_ SG_ 271 LR_ElevationAng_088 "Elevation angle of point_088";
CM_ SG_ 271 LR_ElevationAng_089 "Elevation angle of point_089";
CM_ SG_ 271 LR_ElevationSNR_084 "Elevation SNR of point_084";
CM_ SG_ 271 LR_ElevationSNR_085 "Elevation SNR of point_085";
CM_ SG_ 271 LR_ElevationSNR_086 "Elevation SNR of point_086";
CM_ SG_ 271 LR_ElevationSNR_087 "Elevation SNR of point_087";
CM_ SG_ 271 LR_ElevationSNR_088 "Elevation SNR of point_088";
CM_ SG_ 271 LR_ElevationSNR_089 "Elevation SNR of point_089";
CM_ SG_ 271 LR_Range_084 "Range of point_084";
CM_ SG_ 271 LR_Range_085 "Range of point_085";
CM_ SG_ 271 LR_Range_086 "Range of point_086";
CM_ SG_ 271 LR_Range_087 "Range of point_087";
CM_ SG_ 271 LR_Range_088 "Range of point_088";
CM_ SG_ 271 LR_Range_089 "Range of point_089";
CM_ SG_ 271 LR_RCS_084 "RCS of point_084";
CM_ SG_ 271 LR_RCS_085 "RCS of point_085";
CM_ SG_ 271 LR_RCS_086 "RCS of point_086";
CM_ SG_ 271 LR_RCS_087 "RCS of point_087";
CM_ SG_ 271 LR_RCS_088 "RCS of point_088";
CM_ SG_ 271 LR_RCS_089 "RCS of point_089";
CM_ SG_ 271 LR_Status_084 "Status of point_084";
CM_ SG_ 271 LR_Status_085 "Status of point_085";
CM_ SG_ 271 LR_Status_086 "Status of point_086";
CM_ SG_ 271 LR_Status_087 "Status of point_087";
CM_ SG_ 271 LR_Status_088 "Status of point_088";
CM_ SG_ 271 LR_Status_089 "Status of point_089";
CM_ SG_ 271 LR_Tbd_084 "To be defined";
CM_ SG_ 271 LR_Tbd_085 "To be defined";
CM_ SG_ 271 LR_Tbd_086 "To be defined";
CM_ SG_ 271 LR_Tbd_087 "To be defined";
CM_ SG_ 271 LR_Tbd_088 "To be defined";
CM_ SG_ 271 LR_Tbd_089 "To be defined";
CM_ SG_ 271 LR_Velocity_084 "Relative radial velocity of point_084";
CM_ SG_ 271 LR_Velocity_085 "Relative radial velocity of point_085";
CM_ SG_ 271 LR_Velocity_086 "Relative radial velocity of point_086";
CM_ SG_ 271 LR_Velocity_087 "Relative radial velocity of point_087";
CM_ SG_ 271 LR_Velocity_088 "Relative radial velocity of point_088";
CM_ SG_ 271 LR_Velocity_089 "Relative radial velocity of point_089";
CM_ SG_ 272 LR_AzimuthAng_090 "Azimuth angle of point_090";
CM_ SG_ 272 LR_AzimuthAng_091 "Azimuth angle of point_091";
CM_ SG_ 272 LR_AzimuthAng_092 "Azimuth angle of point_092";
CM_ SG_ 272 LR_AzimuthAng_093 "Azimuth angle of point_093";
CM_ SG_ 272 LR_AzimuthAng_094 "Azimuth angle of point_094";
CM_ SG_ 272 LR_AzimuthAng_095 "Azimuth angle of point_095";
CM_ SG_ 272 LR_AzimuthSNR_090 "Azimuth SNR of point_090";
CM_ SG_ 272 LR_AzimuthSNR_091 "Azimuth SNR of point_091";
CM_ SG_ 272 LR_AzimuthSNR_092 "Azimuth SNR of point_092";
CM_ SG_ 272 LR_AzimuthSNR_093 "Azimuth SNR of point_093";
CM_ SG_ 272 LR_AzimuthSNR_094 "Azimuth SNR of point_094";
CM_ SG_ 272 LR_AzimuthSNR_095 "Azimuth SNR of point_095";
CM_ SG_ 272 LR_ElevationAng_090 "Elevation angle of point_090";
CM_ SG_ 272 LR_ElevationAng_091 "Elevation angle of point_091";
CM_ SG_ 272 LR_ElevationAng_092 "Elevation angle of point_092";
CM_ SG_ 272 LR_ElevationAng_093 "Elevation angle of point_093";
CM_ SG_ 272 LR_ElevationAng_094 "Elevation angle of point_094";
CM_ SG_ 272 LR_ElevationAng_095 "Elevation angle of point_095";
CM_ SG_ 272 LR_ElevationSNR_090 "Elevation SNR of point_090";
CM_ SG_ 272 LR_ElevationSNR_091 "Elevation SNR of point_091";
CM_ SG_ 272 LR_ElevationSNR_092 "Elevation SNR of point_092";
CM_ SG_ 272 LR_ElevationSNR_093 "Elevation SNR of point_093";
CM_ SG_ 272 LR_ElevationSNR_094 "Elevation SNR of point_094";
CM_ SG_ 272 LR_ElevationSNR_095 "Elevation SNR of point_095";
CM_ SG_ 272 LR_Range_090 "Range of point_090";
CM_ SG_ 272 LR_Range_091 "Range of point_091";
CM_ SG_ 272 LR_Range_092 "Range of point_092";
CM_ SG_ 272 LR_Range_093 "Range of point_093";
CM_ SG_ 272 LR_Range_094 "Range of point_094";
CM_ SG_ 272 LR_Range_095 "Range of point_095";
CM_ SG_ 272 LR_RCS_090 "RCS of point_090";
CM_ SG_ 272 LR_RCS_091 "RCS of point_091";
CM_ SG_ 272 LR_RCS_092 "RCS of point_092";
CM_ SG_ 272 LR_RCS_093 "RCS of point_093";
CM_ SG_ 272 LR_RCS_094 "RCS of point_094";
CM_ SG_ 272 LR_RCS_095 "RCS of point_095";
CM_ SG_ 272 LR_Status_090 "Status of point_090";
CM_ SG_ 272 LR_Status_091 "Status of point_091";
CM_ SG_ 272 LR_Status_092 "Status of point_092";
CM_ SG_ 272 LR_Status_093 "Status of point_093";
CM_ SG_ 272 LR_Status_094 "Status of point_094";
CM_ SG_ 272 LR_Status_095 "Status of point_095";
CM_ SG_ 272 LR_Tbd_090 "To be defined";
CM_ SG_ 272 LR_Tbd_091 "To be defined";
CM_ SG_ 272 LR_Tbd_092 "To be defined";
CM_ SG_ 272 LR_Tbd_093 "To be defined";
CM_ SG_ 272 LR_Tbd_094 "To be defined";
CM_ SG_ 272 LR_Tbd_095 "To be defined";
CM_ SG_ 272 LR_Velocity_090 "Relative radial velocity of point_090";
CM_ SG_ 272 LR_Velocity_091 "Relative radial velocity of point_091";
CM_ SG_ 272 LR_Velocity_092 "Relative radial velocity of point_092";
CM_ SG_ 272 LR_Velocity_093 "Relative radial velocity of point_093";
CM_ SG_ 272 LR_Velocity_094 "Relative radial velocity of point_094";
CM_ SG_ 272 LR_Velocity_095 "Relative radial velocity of point_095";
CM_ SG_ 273 LR_AzimuthAng_096 "Azimuth angle of point_096";
CM_ SG_ 273 LR_AzimuthAng_097 "Azimuth angle of point_097";
CM_ SG_ 273 LR_AzimuthAng_098 "Azimuth angle of point_098";
CM_ SG_ 273 LR_AzimuthAng_099 "Azimuth angle of point_099";
CM_ SG_ 273 LR_AzimuthAng_100 "Azimuth angle of point_100";
CM_ SG_ 273 LR_AzimuthAng_101 "Azimuth angle of point_101";
CM_ SG_ 273 LR_AzimuthSNR_096 "Azimuth SNR of point_096";
CM_ SG_ 273 LR_AzimuthSNR_097 "Azimuth SNR of point_097";
CM_ SG_ 273 LR_AzimuthSNR_098 "Azimuth SNR of point_098";
CM_ SG_ 273 LR_AzimuthSNR_099 "Azimuth SNR of point_099";
CM_ SG_ 273 LR_AzimuthSNR_100 "Azimuth SNR of point_100";
CM_ SG_ 273 LR_AzimuthSNR_101 "Azimuth SNR of point_101";
CM_ SG_ 273 LR_ElevationAng_096 "Elevation angle of point_096";
CM_ SG_ 273 LR_ElevationAng_097 "Elevation angle of point_097";
CM_ SG_ 273 LR_ElevationAng_098 "Elevation angle of point_098";
CM_ SG_ 273 LR_ElevationAng_099 "Elevation angle of point_099";
CM_ SG_ 273 LR_ElevationAng_100 "Elevation angle of point_100";
CM_ SG_ 273 LR_ElevationAng_101 "Elevation angle of point_101";
CM_ SG_ 273 LR_ElevationSNR_096 "Elevation SNR of point_096";
CM_ SG_ 273 LR_ElevationSNR_097 "Elevation SNR of point_097";
CM_ SG_ 273 LR_ElevationSNR_098 "Elevation SNR of point_098";
CM_ SG_ 273 LR_ElevationSNR_099 "Elevation SNR of point_099";
CM_ SG_ 273 LR_ElevationSNR_100 "Elevation SNR of point_100";
CM_ SG_ 273 LR_ElevationSNR_101 "Elevation SNR of point_101";
CM_ SG_ 273 LR_Range_096 "Range of point_096";
CM_ SG_ 273 LR_Range_097 "Range of point_097";
CM_ SG_ 273 LR_Range_098 "Range of point_098";
CM_ SG_ 273 LR_Range_099 "Range of point_099";
CM_ SG_ 273 LR_Range_100 "Range of point_100";
CM_ SG_ 273 LR_Range_101 "Range of point_101";
CM_ SG_ 273 LR_RCS_096 "RCS of point_096";
CM_ SG_ 273 LR_RCS_097 "RCS of point_097";
CM_ SG_ 273 LR_RCS_098 "RCS of point_098";
CM_ SG_ 273 LR_RCS_099 "RCS of point_099";
CM_ SG_ 273 LR_RCS_100 "RCS of point_100";
CM_ SG_ 273 LR_RCS_101 "RCS of point_101";
CM_ SG_ 273 LR_Status_096 "Status of point_096";
CM_ SG_ 273 LR_Status_097 "Status of point_097";
CM_ SG_ 273 LR_Status_098 "Status of point_098";
CM_ SG_ 273 LR_Status_099 "Status of point_099";
CM_ SG_ 273 LR_Status_100 "Status of point_100";
CM_ SG_ 273 LR_Status_101 "Status of point_101";
CM_ SG_ 273 LR_Tbd_096 "To be defined";
CM_ SG_ 273 LR_Tbd_097 "To be defined";
CM_ SG_ 273 LR_Tbd_098 "To be defined";
CM_ SG_ 273 LR_Tbd_099 "To be defined";
CM_ SG_ 273 LR_Tbd_100 "To be defined";
CM_ SG_ 273 LR_Tbd_101 "To be defined";
CM_ SG_ 273 LR_Velocity_096 "Relative radial velocity of point_096";
CM_ SG_ 273 LR_Velocity_097 "Relative radial velocity of point_097";
CM_ SG_ 273 LR_Velocity_098 "Relative radial velocity of point_098";
CM_ SG_ 273 LR_Velocity_099 "Relative radial velocity of point_099";
CM_ SG_ 273 LR_Velocity_100 "Relative radial velocity of point_100";
CM_ SG_ 273 LR_Velocity_101 "Relative radial velocity of point_101";
CM_ SG_ 274 LR_AzimuthAng_102 "Azimuth angle of point_102";
CM_ SG_ 274 LR_AzimuthAng_103 "Azimuth angle of point_103";
CM_ SG_ 274 LR_AzimuthAng_104 "Azimuth angle of point_104";
CM_ SG_ 274 LR_AzimuthAng_105 "Azimuth angle of point_105";
CM_ SG_ 274 LR_AzimuthAng_106 "Azimuth angle of point_106";
CM_ SG_ 274 LR_AzimuthAng_107 "Azimuth angle of point_107";
CM_ SG_ 274 LR_AzimuthSNR_102 "Azimuth SNR of point_102";
CM_ SG_ 274 LR_AzimuthSNR_103 "Azimuth SNR of point_103";
CM_ SG_ 274 LR_AzimuthSNR_104 "Azimuth SNR of point_104";
CM_ SG_ 274 LR_AzimuthSNR_105 "Azimuth SNR of point_105";
CM_ SG_ 274 LR_AzimuthSNR_106 "Azimuth SNR of point_106";
CM_ SG_ 274 LR_AzimuthSNR_107 "Azimuth SNR of point_107";
CM_ SG_ 274 LR_ElevationAng_102 "Elevation angle of point_102";
CM_ SG_ 274 LR_ElevationAng_103 "Elevation angle of point_103";
CM_ SG_ 274 LR_ElevationAng_104 "Elevation angle of point_104";
CM_ SG_ 274 LR_ElevationAng_105 "Elevation angle of point_105";
CM_ SG_ 274 LR_ElevationAng_106 "Elevation angle of point_106";
CM_ SG_ 274 LR_ElevationAng_107 "Elevation angle of point_107";
CM_ SG_ 274 LR_ElevationSNR_102 "Elevation SNR of point_102";
CM_ SG_ 274 LR_ElevationSNR_103 "Elevation SNR of point_103";
CM_ SG_ 274 LR_ElevationSNR_104 "Elevation SNR of point_104";
CM_ SG_ 274 LR_ElevationSNR_105 "Elevation SNR of point_105";
CM_ SG_ 274 LR_ElevationSNR_106 "Elevation SNR of point_106";
CM_ SG_ 274 LR_ElevationSNR_107 "Elevation SNR of point_107";
CM_ SG_ 274 LR_Range_102 "Range of point_102";
CM_ SG_ 274 LR_Range_103 "Range of point_103";
CM_ SG_ 274 LR_Range_104 "Range of point_104";
CM_ SG_ 274 LR_Range_105 "Range of point_105";
CM_ SG_ 274 LR_Range_106 "Range of point_106";
CM_ SG_ 274 LR_Range_107 "Range of point_107";
CM_ SG_ 274 LR_RCS_102 "RCS of point_102";
CM_ SG_ 274 LR_RCS_103 "RCS of point_103";
CM_ SG_ 274 LR_RCS_104 "RCS of point_104";
CM_ SG_ 274 LR_RCS_105 "RCS of point_105";
CM_ SG_ 274 LR_RCS_106 "RCS of point_106";
CM_ SG_ 274 LR_RCS_107 "RCS of point_107";
CM_ SG_ 274 LR_Status_102 "Status of point_102";
CM_ SG_ 274 LR_Status_103 "Status of point_103";
CM_ SG_ 274 LR_Status_104 "Status of point_104";
CM_ SG_ 274 LR_Status_105 "Status of point_105";
CM_ SG_ 274 LR_Status_106 "Status of point_106";
CM_ SG_ 274 LR_Status_107 "Status of point_107";
CM_ SG_ 274 LR_Tbd_102 "To be defined";
CM_ SG_ 274 LR_Tbd_103 "To be defined";
CM_ SG_ 274 LR_Tbd_104 "To be defined";
CM_ SG_ 274 LR_Tbd_105 "To be defined";
CM_ SG_ 274 LR_Tbd_106 "To be defined";
CM_ SG_ 274 LR_Tbd_107 "To be defined";
CM_ SG_ 274 LR_Velocity_102 "Relative radial velocity of point_102";
CM_ SG_ 274 LR_Velocity_103 "Relative radial velocity of point_103";
CM_ SG_ 274 LR_Velocity_104 "Relative radial velocity of point_104";
CM_ SG_ 274 LR_Velocity_105 "Relative radial velocity of point_105";
CM_ SG_ 274 LR_Velocity_106 "Relative radial velocity of point_106";
CM_ SG_ 274 LR_Velocity_107 "Relative radial velocity of point_107";
CM_ SG_ 275 LR_AzimuthAng_108 "Azimuth angle of point_108";
CM_ SG_ 275 LR_AzimuthAng_109 "Azimuth angle of point_109";
CM_ SG_ 275 LR_AzimuthAng_110 "Azimuth angle of point_110";
CM_ SG_ 275 LR_AzimuthAng_111 "Azimuth angle of point_111";
CM_ SG_ 275 LR_AzimuthAng_112 "Azimuth angle of point_112";
CM_ SG_ 275 LR_AzimuthAng_113 "Azimuth angle of point_113";
CM_ SG_ 275 LR_AzimuthSNR_108 "Azimuth SNR of point_108";
CM_ SG_ 275 LR_AzimuthSNR_109 "Azimuth SNR of point_109";
CM_ SG_ 275 LR_AzimuthSNR_110 "Azimuth SNR of point_110";
CM_ SG_ 275 LR_AzimuthSNR_111 "Azimuth SNR of point_111";
CM_ SG_ 275 LR_AzimuthSNR_112 "Azimuth SNR of point_112";
CM_ SG_ 275 LR_AzimuthSNR_113 "Azimuth SNR of point_113";
CM_ SG_ 275 LR_ElevationAng_108 "Elevation angle of point_108";
CM_ SG_ 275 LR_ElevationAng_109 "Elevation angle of point_109";
CM_ SG_ 275 LR_ElevationAng_110 "Elevation angle of point_110";
CM_ SG_ 275 LR_ElevationAng_111 "Elevation angle of point_111";
CM_ SG_ 275 LR_ElevationAng_112 "Elevation angle of point_112";
CM_ SG_ 275 LR_ElevationAng_113 "Elevation angle of point_113";
CM_ SG_ 275 LR_ElevationSNR_108 "Elevation SNR of point_108";
CM_ SG_ 275 LR_ElevationSNR_109 "Elevation SNR of point_109";
CM_ SG_ 275 LR_ElevationSNR_110 "Elevation SNR of point_110";
CM_ SG_ 275 LR_ElevationSNR_111 "Elevation SNR of point_111";
CM_ SG_ 275 LR_ElevationSNR_112 "Elevation SNR of point_112";
CM_ SG_ 275 LR_ElevationSNR_113 "Elevation SNR of point_113";
CM_ SG_ 275 LR_Range_108 "Range of point_108";
CM_ SG_ 275 LR_Range_109 "Range of point_109";
CM_ SG_ 275 LR_Range_110 "Range of point_110";
CM_ SG_ 275 LR_Range_111 "Range of point_111";
CM_ SG_ 275 LR_Range_112 "Range of point_112";
CM_ SG_ 275 LR_Range_113 "Range of point_113";
CM_ SG_ 275 LR_RCS_108 "RCS of point_108";
CM_ SG_ 275 LR_RCS_109 "RCS of point_109";
CM_ SG_ 275 LR_RCS_110 "RCS of point_110";
CM_ SG_ 275 LR_RCS_111 "RCS of point_111";
CM_ SG_ 275 LR_RCS_112 "RCS of point_112";
CM_ SG_ 275 LR_RCS_113 "RCS of point_113";
CM_ SG_ 275 LR_Status_108 "Status of point_108";
CM_ SG_ 275 LR_Status_109 "Status of point_109";
CM_ SG_ 275 LR_Status_110 "Status of point_110";
CM_ SG_ 275 LR_Status_111 "Status of point_111";
CM_ SG_ 275 LR_Status_112 "Status of point_112";
CM_ SG_ 275 LR_Status_113 "Status of point_113";
CM_ SG_ 275 LR_Tbd_108 "To be defined";
CM_ SG_ 275 LR_Tbd_109 "To be defined";
CM_ SG_ 275 LR_Tbd_110 "To be defined";
CM_ SG_ 275 LR_Tbd_111 "To be defined";
CM_ SG_ 275 LR_Tbd_112 "To be defined";
CM_ SG_ 275 LR_Tbd_113 "To be defined";
CM_ SG_ 275 LR_Velocity_108 "Relative radial velocity of point_108";
CM_ SG_ 275 LR_Velocity_109 "Relative radial velocity of point_109";
CM_ SG_ 275 LR_Velocity_110 "Relative radial velocity of point_110";
CM_ SG_ 275 LR_Velocity_111 "Relative radial velocity of point_111";
CM_ SG_ 275 LR_Velocity_112 "Relative radial velocity of point_112";
CM_ SG_ 275 LR_Velocity_113 "Relative radial velocity of point_113";
CM_ SG_ 276 LR_AzimuthAng_114 "Azimuth angle of point_114";
CM_ SG_ 276 LR_AzimuthAng_115 "Azimuth angle of point_115";
CM_ SG_ 276 LR_AzimuthAng_116 "Azimuth angle of point_116";
CM_ SG_ 276 LR_AzimuthAng_117 "Azimuth angle of point_117";
CM_ SG_ 276 LR_AzimuthAng_118 "Azimuth angle of point_118";
CM_ SG_ 276 LR_AzimuthAng_119 "Azimuth angle of point_119";
CM_ SG_ 276 LR_AzimuthSNR_114 "Azimuth SNR of point_114";
CM_ SG_ 276 LR_AzimuthSNR_115 "Azimuth SNR of point_115";
CM_ SG_ 276 LR_AzimuthSNR_116 "Azimuth SNR of point_116";
CM_ SG_ 276 LR_AzimuthSNR_117 "Azimuth SNR of point_117";
CM_ SG_ 276 LR_AzimuthSNR_118 "Azimuth SNR of point_118";
CM_ SG_ 276 LR_AzimuthSNR_119 "Azimuth SNR of point_119";
CM_ SG_ 276 LR_ElevationAng_114 "Elevation angle of point_114";
CM_ SG_ 276 LR_ElevationAng_115 "Elevation angle of point_115";
CM_ SG_ 276 LR_ElevationAng_116 "Elevation angle of point_116";
CM_ SG_ 276 LR_ElevationAng_117 "Elevation angle of point_117";
CM_ SG_ 276 LR_ElevationAng_118 "Elevation angle of point_118";
CM_ SG_ 276 LR_ElevationAng_119 "Elevation angle of point_119";
CM_ SG_ 276 LR_ElevationSNR_114 "Elevation SNR of point_114";
CM_ SG_ 276 LR_ElevationSNR_115 "Elevation SNR of point_115";
CM_ SG_ 276 LR_ElevationSNR_116 "Elevation SNR of point_116";
CM_ SG_ 276 LR_ElevationSNR_117 "Elevation SNR of point_117";
CM_ SG_ 276 LR_ElevationSNR_118 "Elevation SNR of point_118";
CM_ SG_ 276 LR_ElevationSNR_119 "Elevation SNR of point_119";
CM_ SG_ 276 LR_Range_114 "Range of point_114";
CM_ SG_ 276 LR_Range_115 "Range of point_115";
CM_ SG_ 276 LR_Range_116 "Range of point_116";
CM_ SG_ 276 LR_Range_117 "Range of point_117";
CM_ SG_ 276 LR_Range_118 "Range of point_118";
CM_ SG_ 276 LR_Range_119 "Range of point_119";
CM_ SG_ 276 LR_RCS_114 "RCS of point_114";
CM_ SG_ 276 LR_RCS_115 "RCS of point_115";
CM_ SG_ 276 LR_RCS_116 "RCS of point_116";
CM_ SG_ 276 LR_RCS_117 "RCS of point_117";
CM_ SG_ 276 LR_RCS_118 "RCS of point_118";
CM_ SG_ 276 LR_RCS_119 "RCS of point_119";
CM_ SG_ 276 LR_Status_114 "Status of point_114";
CM_ SG_ 276 LR_Status_115 "Status of point_115";
CM_ SG_ 276 LR_Status_116 "Status of point_116";
CM_ SG_ 276 LR_Status_117 "Status of point_117";
CM_ SG_ 276 LR_Status_118 "Status of point_118";
CM_ SG_ 276 LR_Status_119 "Status of point_119";
CM_ SG_ 276 LR_Tbd_114 "To be defined";
CM_ SG_ 276 LR_Tbd_115 "To be defined";
CM_ SG_ 276 LR_Tbd_116 "To be defined";
CM_ SG_ 276 LR_Tbd_117 "To be defined";
CM_ SG_ 276 LR_Tbd_118 "To be defined";
CM_ SG_ 276 LR_Tbd_119 "To be defined";
CM_ SG_ 276 LR_Velocity_114 "Relative radial velocity of point_114";
CM_ SG_ 276 LR_Velocity_115 "Relative radial velocity of point_115";
CM_ SG_ 276 LR_Velocity_116 "Relative radial velocity of point_116";
CM_ SG_ 276 LR_Velocity_117 "Relative radial velocity of point_117";
CM_ SG_ 276 LR_Velocity_118 "Relative radial velocity of point_118";
CM_ SG_ 276 LR_Velocity_119 "Relative radial velocity of point_119";
CM_ SG_ 277 LR_AzimuthAng_120 "Azimuth angle of point_120";
CM_ SG_ 277 LR_AzimuthAng_121 "Azimuth angle of point_121";
CM_ SG_ 277 LR_AzimuthAng_122 "Azimuth angle of point_122";
CM_ SG_ 277 LR_AzimuthAng_123 "Azimuth angle of point_123";
CM_ SG_ 277 LR_AzimuthAng_124 "Azimuth angle of point_124";
CM_ SG_ 277 LR_AzimuthAng_125 "Azimuth angle of point_125";
CM_ SG_ 277 LR_AzimuthSNR_120 "Azimuth SNR of point_120";
CM_ SG_ 277 LR_AzimuthSNR_121 "Azimuth SNR of point_121";
CM_ SG_ 277 LR_AzimuthSNR_122 "Azimuth SNR of point_122";
CM_ SG_ 277 LR_AzimuthSNR_123 "Azimuth SNR of point_123";
CM_ SG_ 277 LR_AzimuthSNR_124 "Azimuth SNR of point_124";
CM_ SG_ 277 LR_AzimuthSNR_125 "Azimuth SNR of point_125";
CM_ SG_ 277 LR_ElevationAng_120 "Elevation angle of point_120";
CM_ SG_ 277 LR_ElevationAng_121 "Elevation angle of point_121";
CM_ SG_ 277 LR_ElevationAng_122 "Elevation angle of point_122";
CM_ SG_ 277 LR_ElevationAng_123 "Elevation angle of point_123";
CM_ SG_ 277 LR_ElevationAng_124 "Elevation angle of point_124";
CM_ SG_ 277 LR_ElevationAng_125 "Elevation angle of point_125";
CM_ SG_ 277 LR_ElevationSNR_120 "Elevation SNR of point_120";
CM_ SG_ 277 LR_ElevationSNR_121 "Elevation SNR of point_121";
CM_ SG_ 277 LR_ElevationSNR_122 "Elevation SNR of point_122";
CM_ SG_ 277 LR_ElevationSNR_123 "Elevation SNR of point_123";
CM_ SG_ 277 LR_ElevationSNR_124 "Elevation SNR of point_124";
CM_ SG_ 277 LR_ElevationSNR_125 "Elevation SNR of point_125";
CM_ SG_ 277 LR_Range_120 "Range of point_120";
CM_ SG_ 277 LR_Range_121 "Range of point_121";
CM_ SG_ 277 LR_Range_122 "Range of point_122";
CM_ SG_ 277 LR_Range_123 "Range of point_123";
CM_ SG_ 277 LR_Range_124 "Range of point_124";
CM_ SG_ 277 LR_Range_125 "Range of point_125";
CM_ SG_ 277 LR_RCS_120 "RCS of point_120";
CM_ SG_ 277 LR_RCS_121 "RCS of point_121";
CM_ SG_ 277 LR_RCS_122 "RCS of point_122";
CM_ SG_ 277 LR_RCS_123 "RCS of point_123";
CM_ SG_ 277 LR_RCS_124 "RCS of point_124";
CM_ SG_ 277 LR_RCS_125 "RCS of point_125";
CM_ SG_ 277 LR_Status_120 "Status of point_120";
CM_ SG_ 277 LR_Status_121 "Status of point_121";
CM_ SG_ 277 LR_Status_122 "Status of point_122";
CM_ SG_ 277 LR_Status_123 "Status of point_123";
CM_ SG_ 277 LR_Status_124 "Status of point_124";
CM_ SG_ 277 LR_Status_125 "Status of point_125";
CM_ SG_ 277 LR_Tbd_120 "To be defined";
CM_ SG_ 277 LR_Tbd_121 "To be defined";
CM_ SG_ 277 LR_Tbd_122 "To be defined";
CM_ SG_ 277 LR_Tbd_123 "To be defined";
CM_ SG_ 277 LR_Tbd_124 "To be defined";
CM_ SG_ 277 LR_Tbd_125 "To be defined";
CM_ SG_ 277 LR_Velocity_120 "Relative radial velocity of point_120";
CM_ SG_ 277 LR_Velocity_121 "Relative radial velocity of point_121";
CM_ SG_ 277 LR_Velocity_122 "Relative radial velocity of point_122";
CM_ SG_ 277 LR_Velocity_123 "Relative radial velocity of point_123";
CM_ SG_ 277 LR_Velocity_124 "Relative radial velocity of point_124";
CM_ SG_ 277 LR_Velocity_125 "Relative radial velocity of point_125";
CM_ SG_ 278 LR_AzimuthAng_126 "Azimuth angle of point_126";
CM_ SG_ 278 LR_AzimuthAng_127 "Azimuth angle of point_127";
CM_ SG_ 278 LR_AzimuthAng_128 "Azimuth angle of point_128";
CM_ SG_ 278 LR_AzimuthAng_129 "Azimuth angle of point_129";
CM_ SG_ 278 LR_AzimuthAng_130 "Azimuth angle of point_130";
CM_ SG_ 278 LR_AzimuthAng_131 "Azimuth angle of point_131";
CM_ SG_ 278 LR_AzimuthSNR_126 "Azimuth SNR of point_126";
CM_ SG_ 278 LR_AzimuthSNR_127 "Azimuth SNR of point_127";
CM_ SG_ 278 LR_AzimuthSNR_128 "Azimuth SNR of point_128";
CM_ SG_ 278 LR_AzimuthSNR_129 "Azimuth SNR of point_129";
CM_ SG_ 278 LR_AzimuthSNR_130 "Azimuth SNR of point_130";
CM_ SG_ 278 LR_AzimuthSNR_131 "Azimuth SNR of point_131";
CM_ SG_ 278 LR_ElevationAng_126 "Elevation angle of point_126";
CM_ SG_ 278 LR_ElevationAng_127 "Elevation angle of point_127";
CM_ SG_ 278 LR_ElevationAng_128 "Elevation angle of point_128";
CM_ SG_ 278 LR_ElevationAng_129 "Elevation angle of point_129";
CM_ SG_ 278 LR_ElevationAng_130 "Elevation angle of point_130";
CM_ SG_ 278 LR_ElevationAng_131 "Elevation angle of point_131";
CM_ SG_ 278 LR_ElevationSNR_126 "Elevation SNR of point_126";
CM_ SG_ 278 LR_ElevationSNR_127 "Elevation SNR of point_127";
CM_ SG_ 278 LR_ElevationSNR_128 "Elevation SNR of point_128";
CM_ SG_ 278 LR_ElevationSNR_129 "Elevation SNR of point_129";
CM_ SG_ 278 LR_ElevationSNR_130 "Elevation SNR of point_130";
CM_ SG_ 278 LR_ElevationSNR_131 "Elevation SNR of point_131";
CM_ SG_ 278 LR_Range_126 "Range of point_126";
CM_ SG_ 278 LR_Range_127 "Range of point_127";
CM_ SG_ 278 LR_Range_128 "Range of point_128";
CM_ SG_ 278 LR_Range_129 "Range of point_129";
CM_ SG_ 278 LR_Range_130 "Range of point_130";
CM_ SG_ 278 LR_Range_131 "Range of point_131";
CM_ SG_ 278 LR_RCS_126 "RCS of point_126";
CM_ SG_ 278 LR_RCS_127 "RCS of point_127";
CM_ SG_ 278 LR_RCS_128 "RCS of point_128";
CM_ SG_ 278 LR_RCS_129 "RCS of point_129";
CM_ SG_ 278 LR_RCS_130 "RCS of point_130";
CM_ SG_ 278 LR_RCS_131 "RCS of point_131";
CM_ SG_ 278 LR_Status_126 "Status of point_126";
CM_ SG_ 278 LR_Status_127 "Status of point_127";
CM_ SG_ 278 LR_Status_128 "Status of point_128";
CM_ SG_ 278 LR_Status_129 "Status of point_129";
CM_ SG_ 278 LR_Status_130 "Status of point_130";
CM_ SG_ 278 LR_Status_131 "Status of point_131";
CM_ SG_ 278 LR_Tbd_126 "To be defined";
CM_ SG_ 278 LR_Tbd_127 "To be defined";
CM_ SG_ 278 LR_Tbd_128 "To be defined";
CM_ SG_ 278 LR_Tbd_129 "To be defined";
CM_ SG_ 278 LR_Tbd_130 "To be defined";
CM_ SG_ 278 LR_Tbd_131 "To be defined";
CM_ SG_ 278 LR_Velocity_126 "Relative radial velocity of point_126";
CM_ SG_ 278 LR_Velocity_127 "Relative radial velocity of point_127";
CM_ SG_ 278 LR_Velocity_128 "Relative radial velocity of point_128";
CM_ SG_ 278 LR_Velocity_129 "Relative radial velocity of point_129";
CM_ SG_ 278 LR_Velocity_130 "Relative radial velocity of point_130";
CM_ SG_ 278 LR_Velocity_131 "Relative radial velocity of point_131";
CM_ SG_ 279 LR_AzimuthAng_132 "Azimuth angle of point_132";
CM_ SG_ 279 LR_AzimuthAng_133 "Azimuth angle of point_133";
CM_ SG_ 279 LR_AzimuthAng_134 "Azimuth angle of point_134";
CM_ SG_ 279 LR_AzimuthAng_135 "Azimuth angle of point_135";
CM_ SG_ 279 LR_AzimuthAng_136 "Azimuth angle of point_136";
CM_ SG_ 279 LR_AzimuthAng_137 "Azimuth angle of point_137";
CM_ SG_ 279 LR_AzimuthSNR_132 "Azimuth SNR of point_132";
CM_ SG_ 279 LR_AzimuthSNR_133 "Azimuth SNR of point_133";
CM_ SG_ 279 LR_AzimuthSNR_134 "Azimuth SNR of point_134";
CM_ SG_ 279 LR_AzimuthSNR_135 "Azimuth SNR of point_135";
CM_ SG_ 279 LR_AzimuthSNR_136 "Azimuth SNR of point_136";
CM_ SG_ 279 LR_AzimuthSNR_137 "Azimuth SNR of point_137";
CM_ SG_ 279 LR_ElevationAng_132 "Elevation angle of point_132";
CM_ SG_ 279 LR_ElevationAng_133 "Elevation angle of point_133";
CM_ SG_ 279 LR_ElevationAng_134 "Elevation angle of point_134";
CM_ SG_ 279 LR_ElevationAng_135 "Elevation angle of point_135";
CM_ SG_ 279 LR_ElevationAng_136 "Elevation angle of point_136";
CM_ SG_ 279 LR_ElevationAng_137 "Elevation angle of point_137";
CM_ SG_ 279 LR_ElevationSNR_132 "Elevation SNR of point_132";
CM_ SG_ 279 LR_ElevationSNR_133 "Elevation SNR of point_133";
CM_ SG_ 279 LR_ElevationSNR_134 "Elevation SNR of point_134";
CM_ SG_ 279 LR_ElevationSNR_135 "Elevation SNR of point_135";
CM_ SG_ 279 LR_ElevationSNR_136 "Elevation SNR of point_136";
CM_ SG_ 279 LR_ElevationSNR_137 "Elevation SNR of point_137";
CM_ SG_ 279 LR_Range_132 "Range of point_132";
CM_ SG_ 279 LR_Range_133 "Range of point_133";
CM_ SG_ 279 LR_Range_134 "Range of point_134";
CM_ SG_ 279 LR_Range_135 "Range of point_135";
CM_ SG_ 279 LR_Range_136 "Range of point_136";
CM_ SG_ 279 LR_Range_137 "Range of point_137";
CM_ SG_ 279 LR_RCS_132 "RCS of point_132";
CM_ SG_ 279 LR_RCS_133 "RCS of point_133";
CM_ SG_ 279 LR_RCS_134 "RCS of point_134";
CM_ SG_ 279 LR_RCS_135 "RCS of point_135";
CM_ SG_ 279 LR_RCS_136 "RCS of point_136";
CM_ SG_ 279 LR_RCS_137 "RCS of point_137";
CM_ SG_ 279 LR_Status_132 "Status of point_132";
CM_ SG_ 279 LR_Status_133 "Status of point_133";
CM_ SG_ 279 LR_Status_134 "Status of point_134";
CM_ SG_ 279 LR_Status_135 "Status of point_135";
CM_ SG_ 279 LR_Status_136 "Status of point_136";
CM_ SG_ 279 LR_Status_137 "Status of point_137";
CM_ SG_ 279 LR_Tbd_132 "To be defined";
CM_ SG_ 279 LR_Tbd_133 "To be defined";
CM_ SG_ 279 LR_Tbd_134 "To be defined";
CM_ SG_ 279 LR_Tbd_135 "To be defined";
CM_ SG_ 279 LR_Tbd_136 "To be defined";
CM_ SG_ 279 LR_Tbd_137 "To be defined";
CM_ SG_ 279 LR_Velocity_132 "Relative radial velocity of point_132";
CM_ SG_ 279 LR_Velocity_133 "Relative radial velocity of point_133";
CM_ SG_ 279 LR_Velocity_134 "Relative radial velocity of point_134";
CM_ SG_ 279 LR_Velocity_135 "Relative radial velocity of point_135";
CM_ SG_ 279 LR_Velocity_136 "Relative radial velocity of point_136";
CM_ SG_ 279 LR_Velocity_137 "Relative radial velocity of point_137";
CM_ SG_ 280 LR_AzimuthAng_138 "Azimuth angle of point_138";
CM_ SG_ 280 LR_AzimuthAng_139 "Azimuth angle of point_139";
CM_ SG_ 280 LR_AzimuthAng_140 "Azimuth angle of point_140";
CM_ SG_ 280 LR_AzimuthAng_141 "Azimuth angle of point_141";
CM_ SG_ 280 LR_AzimuthAng_142 "Azimuth angle of point_142";
CM_ SG_ 280 LR_AzimuthAng_143 "Azimuth angle of point_143";
CM_ SG_ 280 LR_AzimuthSNR_138 "Azimuth SNR of point_138";
CM_ SG_ 280 LR_AzimuthSNR_139 "Azimuth SNR of point_139";
CM_ SG_ 280 LR_AzimuthSNR_140 "Azimuth SNR of point_140";
CM_ SG_ 280 LR_AzimuthSNR_141 "Azimuth SNR of point_141";
CM_ SG_ 280 LR_AzimuthSNR_142 "Azimuth SNR of point_142";
CM_ SG_ 280 LR_AzimuthSNR_143 "Azimuth SNR of point_143";
CM_ SG_ 280 LR_ElevationAng_138 "Elevation angle of point_138";
CM_ SG_ 280 LR_ElevationAng_139 "Elevation angle of point_139";
CM_ SG_ 280 LR_ElevationAng_140 "Elevation angle of point_140";
CM_ SG_ 280 LR_ElevationAng_141 "Elevation angle of point_141";
CM_ SG_ 280 LR_ElevationAng_142 "Elevation angle of point_142";
CM_ SG_ 280 LR_ElevationAng_143 "Elevation angle of point_143";
CM_ SG_ 280 LR_ElevationSNR_138 "Elevation SNR of point_138";
CM_ SG_ 280 LR_ElevationSNR_139 "Elevation SNR of point_139";
CM_ SG_ 280 LR_ElevationSNR_140 "Elevation SNR of point_140";
CM_ SG_ 280 LR_ElevationSNR_141 "Elevation SNR of point_141";
CM_ SG_ 280 LR_ElevationSNR_142 "Elevation SNR of point_142";
CM_ SG_ 280 LR_ElevationSNR_143 "Elevation SNR of point_143";
CM_ SG_ 280 LR_Range_138 "Range of point_138";
CM_ SG_ 280 LR_Range_139 "Range of point_139";
CM_ SG_ 280 LR_Range_140 "Range of point_140";
CM_ SG_ 280 LR_Range_141 "Range of point_141";
CM_ SG_ 280 LR_Range_142 "Range of point_142";
CM_ SG_ 280 LR_Range_143 "Range of point_143";
CM_ SG_ 280 LR_RCS_138 "RCS of point_138";
CM_ SG_ 280 LR_RCS_139 "RCS of point_139";
CM_ SG_ 280 LR_RCS_140 "RCS of point_140";
CM_ SG_ 280 LR_RCS_141 "RCS of point_141";
CM_ SG_ 280 LR_RCS_142 "RCS of point_142";
CM_ SG_ 280 LR_RCS_143 "RCS of point_143";
CM_ SG_ 280 LR_Status_138 "Status of point_138";
CM_ SG_ 280 LR_Status_139 "Status of point_139";
CM_ SG_ 280 LR_Status_140 "Status of point_140";
CM_ SG_ 280 LR_Status_141 "Status of point_141";
CM_ SG_ 280 LR_Status_142 "Status of point_142";
CM_ SG_ 280 LR_Status_143 "Status of point_143";
CM_ SG_ 280 LR_Tbd_138 "To be defined";
CM_ SG_ 280 LR_Tbd_139 "To be defined";
CM_ SG_ 280 LR_Tbd_140 "To be defined";
CM_ SG_ 280 LR_Tbd_141 "To be defined";
CM_ SG_ 280 LR_Tbd_142 "To be defined";
CM_ SG_ 280 LR_Tbd_143 "To be defined";
CM_ SG_ 280 LR_Velocity_138 "Relative radial velocity of point_138";
CM_ SG_ 280 LR_Velocity_139 "Relative radial velocity of point_139";
CM_ SG_ 280 LR_Velocity_140 "Relative radial velocity of point_140";
CM_ SG_ 280 LR_Velocity_141 "Relative radial velocity of point_141";
CM_ SG_ 280 LR_Velocity_142 "Relative radial velocity of point_142";
CM_ SG_ 280 LR_Velocity_143 "Relative radial velocity of point_143";
CM_ SG_ 281 LR_AzimuthAng_144 "Azimuth angle of point_144";
CM_ SG_ 281 LR_AzimuthAng_145 "Azimuth angle of point_145";
CM_ SG_ 281 LR_AzimuthAng_146 "Azimuth angle of point_146";
CM_ SG_ 281 LR_AzimuthAng_147 "Azimuth angle of point_147";
CM_ SG_ 281 LR_AzimuthAng_148 "Azimuth angle of point_148";
CM_ SG_ 281 LR_AzimuthAng_149 "Azimuth angle of point_149";
CM_ SG_ 281 LR_AzimuthSNR_144 "Azimuth SNR of point_144";
CM_ SG_ 281 LR_AzimuthSNR_145 "Azimuth SNR of point_145";
CM_ SG_ 281 LR_AzimuthSNR_146 "Azimuth SNR of point_146";
CM_ SG_ 281 LR_AzimuthSNR_147 "Azimuth SNR of point_147";
CM_ SG_ 281 LR_AzimuthSNR_148 "Azimuth SNR of point_148";
CM_ SG_ 281 LR_AzimuthSNR_149 "Azimuth SNR of point_149";
CM_ SG_ 281 LR_ElevationAng_144 "Elevation angle of point_144";
CM_ SG_ 281 LR_ElevationAng_145 "Elevation angle of point_145";
CM_ SG_ 281 LR_ElevationAng_146 "Elevation angle of point_146";
CM_ SG_ 281 LR_ElevationAng_147 "Elevation angle of point_147";
CM_ SG_ 281 LR_ElevationAng_148 "Elevation angle of point_148";
CM_ SG_ 281 LR_ElevationAng_149 "Elevation angle of point_149";
CM_ SG_ 281 LR_ElevationSNR_144 "Elevation SNR of point_144";
CM_ SG_ 281 LR_ElevationSNR_145 "Elevation SNR of point_145";
CM_ SG_ 281 LR_ElevationSNR_146 "Elevation SNR of point_146";
CM_ SG_ 281 LR_ElevationSNR_147 "Elevation SNR of point_147";
CM_ SG_ 281 LR_ElevationSNR_148 "Elevation SNR of point_148";
CM_ SG_ 281 LR_ElevationSNR_149 "Elevation SNR of point_149";
CM_ SG_ 281 LR_Range_144 "Range of point_144";
CM_ SG_ 281 LR_Range_145 "Range of point_145";
CM_ SG_ 281 LR_Range_146 "Range of point_146";
CM_ SG_ 281 LR_Range_147 "Range of point_147";
CM_ SG_ 281 LR_Range_148 "Range of point_148";
CM_ SG_ 281 LR_Range_149 "Range of point_149";
CM_ SG_ 281 LR_RCS_144 "RCS of point_144";
CM_ SG_ 281 LR_RCS_145 "RCS of point_145";
CM_ SG_ 281 LR_RCS_146 "RCS of point_146";
CM_ SG_ 281 LR_RCS_147 "RCS of point_147";
CM_ SG_ 281 LR_RCS_148 "RCS of point_148";
CM_ SG_ 281 LR_RCS_149 "RCS of point_149";
CM_ SG_ 281 LR_Status_144 "Status of point_144";
CM_ SG_ 281 LR_Status_145 "Status of point_145";
CM_ SG_ 281 LR_Status_146 "Status of point_146";
CM_ SG_ 281 LR_Status_147 "Status of point_147";
CM_ SG_ 281 LR_Status_148 "Status of point_148";
CM_ SG_ 281 LR_Status_149 "Status of point_149";
CM_ SG_ 281 LR_Tbd_144 "To be defined";
CM_ SG_ 281 LR_Tbd_145 "To be defined";
CM_ SG_ 281 LR_Tbd_146 "To be defined";
CM_ SG_ 281 LR_Tbd_147 "To be defined";
CM_ SG_ 281 LR_Tbd_148 "To be defined";
CM_ SG_ 281 LR_Tbd_149 "To be defined";
CM_ SG_ 281 LR_Velocity_144 "Relative radial velocity of point_144";
CM_ SG_ 281 LR_Velocity_145 "Relative radial velocity of point_145";
CM_ SG_ 281 LR_Velocity_146 "Relative radial velocity of point_146";
CM_ SG_ 281 LR_Velocity_147 "Relative radial velocity of point_147";
CM_ SG_ 281 LR_Velocity_148 "Relative radial velocity of point_148";
CM_ SG_ 281 LR_Velocity_149 "Relative radial velocity of point_149";
CM_ SG_ 282 LR_AzimuthAng_150 "Azimuth angle of point_150";
CM_ SG_ 282 LR_AzimuthAng_151 "Azimuth angle of point_151";
CM_ SG_ 282 LR_AzimuthAng_152 "Azimuth angle of point_152";
CM_ SG_ 282 LR_AzimuthAng_153 "Azimuth angle of point_153";
CM_ SG_ 282 LR_AzimuthAng_154 "Azimuth angle of point_154";
CM_ SG_ 282 LR_AzimuthAng_155 "Azimuth angle of point_155";
CM_ SG_ 282 LR_AzimuthSNR_150 "Azimuth SNR of point_150";
CM_ SG_ 282 LR_AzimuthSNR_151 "Azimuth SNR of point_151";
CM_ SG_ 282 LR_AzimuthSNR_152 "Azimuth SNR of point_152";
CM_ SG_ 282 LR_AzimuthSNR_153 "Azimuth SNR of point_153";
CM_ SG_ 282 LR_AzimuthSNR_154 "Azimuth SNR of point_154";
CM_ SG_ 282 LR_AzimuthSNR_155 "Azimuth SNR of point_155";
CM_ SG_ 282 LR_ElevationAng_150 "Elevation angle of point_150";
CM_ SG_ 282 LR_ElevationAng_151 "Elevation angle of point_151";
CM_ SG_ 282 LR_ElevationAng_152 "Elevation angle of point_152";
CM_ SG_ 282 LR_ElevationAng_153 "Elevation angle of point_153";
CM_ SG_ 282 LR_ElevationAng_154 "Elevation angle of point_154";
CM_ SG_ 282 LR_ElevationAng_155 "Elevation angle of point_155";
CM_ SG_ 282 LR_ElevationSNR_150 "Elevation SNR of point_150";
CM_ SG_ 282 LR_ElevationSNR_151 "Elevation SNR of point_151";
CM_ SG_ 282 LR_ElevationSNR_152 "Elevation SNR of point_152";
CM_ SG_ 282 LR_ElevationSNR_153 "Elevation SNR of point_153";
CM_ SG_ 282 LR_ElevationSNR_154 "Elevation SNR of point_154";
CM_ SG_ 282 LR_ElevationSNR_155 "Elevation SNR of point_155";
CM_ SG_ 282 LR_Range_150 "Range of point_150";
CM_ SG_ 282 LR_Range_151 "Range of point_151";
CM_ SG_ 282 LR_Range_152 "Range of point_152";
CM_ SG_ 282 LR_Range_153 "Range of point_153";
CM_ SG_ 282 LR_Range_154 "Range of point_154";
CM_ SG_ 282 LR_Range_155 "Range of point_155";
CM_ SG_ 282 LR_RCS_150 "RCS of point_150";
CM_ SG_ 282 LR_RCS_151 "RCS of point_151";
CM_ SG_ 282 LR_RCS_152 "RCS of point_152";
CM_ SG_ 282 LR_RCS_153 "RCS of point_153";
CM_ SG_ 282 LR_RCS_154 "RCS of point_154";
CM_ SG_ 282 LR_RCS_155 "RCS of point_155";
CM_ SG_ 282 LR_Status_150 "Status of point_150";
CM_ SG_ 282 LR_Status_151 "Status of point_151";
CM_ SG_ 282 LR_Status_152 "Status of point_152";
CM_ SG_ 282 LR_Status_153 "Status of point_153";
CM_ SG_ 282 LR_Status_154 "Status of point_154";
CM_ SG_ 282 LR_Status_155 "Status of point_155";
CM_ SG_ 282 LR_Tbd_150 "To be defined";
CM_ SG_ 282 LR_Tbd_151 "To be defined";
CM_ SG_ 282 LR_Tbd_152 "To be defined";
CM_ SG_ 282 LR_Tbd_153 "To be defined";
CM_ SG_ 282 LR_Tbd_154 "To be defined";
CM_ SG_ 282 LR_Tbd_155 "To be defined";
CM_ SG_ 282 LR_Velocity_150 "Relative radial velocity of point_150";
CM_ SG_ 282 LR_Velocity_151 "Relative radial velocity of point_151";
CM_ SG_ 282 LR_Velocity_152 "Relative radial velocity of point_152";
CM_ SG_ 282 LR_Velocity_153 "Relative radial velocity of point_153";
CM_ SG_ 282 LR_Velocity_154 "Relative radial velocity of point_154";
CM_ SG_ 282 LR_Velocity_155 "Relative radial velocity of point_155";
CM_ SG_ 283 LR_AzimuthAng_156 "Azimuth angle of point_156";
CM_ SG_ 283 LR_AzimuthAng_157 "Azimuth angle of point_157";
CM_ SG_ 283 LR_AzimuthAng_158 "Azimuth angle of point_158";
CM_ SG_ 283 LR_AzimuthAng_159 "Azimuth angle of point_159";
CM_ SG_ 283 LR_AzimuthAng_160 "Azimuth angle of point_160";
CM_ SG_ 283 LR_AzimuthAng_161 "Azimuth angle of point_161";
CM_ SG_ 283 LR_AzimuthSNR_156 "Azimuth SNR of point_156";
CM_ SG_ 283 LR_AzimuthSNR_157 "Azimuth SNR of point_157";
CM_ SG_ 283 LR_AzimuthSNR_158 "Azimuth SNR of point_158";
CM_ SG_ 283 LR_AzimuthSNR_159 "Azimuth SNR of point_159";
CM_ SG_ 283 LR_AzimuthSNR_160 "Azimuth SNR of point_160";
CM_ SG_ 283 LR_AzimuthSNR_161 "Azimuth SNR of point_161";
CM_ SG_ 283 LR_ElevationAng_156 "Elevation angle of point_156";
CM_ SG_ 283 LR_ElevationAng_157 "Elevation angle of point_157";
CM_ SG_ 283 LR_ElevationAng_158 "Elevation angle of point_158";
CM_ SG_ 283 LR_ElevationAng_159 "Elevation angle of point_159";
CM_ SG_ 283 LR_ElevationAng_160 "Elevation angle of point_160";
CM_ SG_ 283 LR_ElevationAng_161 "Elevation angle of point_161";
CM_ SG_ 283 LR_ElevationSNR_156 "Elevation SNR of point_156";
CM_ SG_ 283 LR_ElevationSNR_157 "Elevation SNR of point_157";
CM_ SG_ 283 LR_ElevationSNR_158 "Elevation SNR of point_158";
CM_ SG_ 283 LR_ElevationSNR_159 "Elevation SNR of point_159";
CM_ SG_ 283 LR_ElevationSNR_160 "Elevation SNR of point_160";
CM_ SG_ 283 LR_ElevationSNR_161 "Elevation SNR of point_161";
CM_ SG_ 283 LR_Range_156 "Range of point_156";
CM_ SG_ 283 LR_Range_157 "Range of point_157";
CM_ SG_ 283 LR_Range_158 "Range of point_158";
CM_ SG_ 283 LR_Range_159 "Range of point_159";
CM_ SG_ 283 LR_Range_160 "Range of point_160";
CM_ SG_ 283 LR_Range_161 "Range of point_161";
CM_ SG_ 283 LR_RCS_156 "RCS of point_156";
CM_ SG_ 283 LR_RCS_157 "RCS of point_157";
CM_ SG_ 283 LR_RCS_158 "RCS of point_158";
CM_ SG_ 283 LR_RCS_159 "RCS of point_159";
CM_ SG_ 283 LR_RCS_160 "RCS of point_160";
CM_ SG_ 283 LR_RCS_161 "RCS of point_161";
CM_ SG_ 283 LR_Status_156 "Status of point_156";
CM_ SG_ 283 LR_Status_157 "Status of point_157";
CM_ SG_ 283 LR_Status_158 "Status of point_158";
CM_ SG_ 283 LR_Status_159 "Status of point_159";
CM_ SG_ 283 LR_Status_160 "Status of point_160";
CM_ SG_ 283 LR_Status_161 "Status of point_161";
CM_ SG_ 283 LR_Tbd_156 "To be defined";
CM_ SG_ 283 LR_Tbd_157 "To be defined";
CM_ SG_ 283 LR_Tbd_158 "To be defined";
CM_ SG_ 283 LR_Tbd_159 "To be defined";
CM_ SG_ 283 LR_Tbd_160 "To be defined";
CM_ SG_ 283 LR_Tbd_161 "To be defined";
CM_ SG_ 283 LR_Velocity_156 "Relative radial velocity of point_156";
CM_ SG_ 283 LR_Velocity_157 "Relative radial velocity of point_157";
CM_ SG_ 283 LR_Velocity_158 "Relative radial velocity of point_158";
CM_ SG_ 283 LR_Velocity_159 "Relative radial velocity of point_159";
CM_ SG_ 283 LR_Velocity_160 "Relative radial velocity of point_160";
CM_ SG_ 283 LR_Velocity_161 "Relative radial velocity of point_161";
CM_ SG_ 284 LR_AzimuthAng_162 "Azimuth angle of point_162";
CM_ SG_ 284 LR_AzimuthAng_163 "Azimuth angle of point_163";
CM_ SG_ 284 LR_AzimuthAng_164 "Azimuth angle of point_164";
CM_ SG_ 284 LR_AzimuthAng_165 "Azimuth angle of point_165";
CM_ SG_ 284 LR_AzimuthAng_166 "Azimuth angle of point_166";
CM_ SG_ 284 LR_AzimuthAng_167 "Azimuth angle of point_167";
CM_ SG_ 284 LR_AzimuthSNR_162 "Azimuth SNR of point_162";
CM_ SG_ 284 LR_AzimuthSNR_163 "Azimuth SNR of point_163";
CM_ SG_ 284 LR_AzimuthSNR_164 "Azimuth SNR of point_164";
CM_ SG_ 284 LR_AzimuthSNR_165 "Azimuth SNR of point_165";
CM_ SG_ 284 LR_AzimuthSNR_166 "Azimuth SNR of point_166";
CM_ SG_ 284 LR_AzimuthSNR_167 "Azimuth SNR of point_167";
CM_ SG_ 284 LR_ElevationAng_162 "Elevation angle of point_162";
CM_ SG_ 284 LR_ElevationAng_163 "Elevation angle of point_163";
CM_ SG_ 284 LR_ElevationAng_164 "Elevation angle of point_164";
CM_ SG_ 284 LR_ElevationAng_165 "Elevation angle of point_165";
CM_ SG_ 284 LR_ElevationAng_166 "Elevation angle of point_166";
CM_ SG_ 284 LR_ElevationAng_167 "Elevation angle of point_167";
CM_ SG_ 284 LR_ElevationSNR_162 "Elevation SNR of point_162";
CM_ SG_ 284 LR_ElevationSNR_163 "Elevation SNR of point_163";
CM_ SG_ 284 LR_ElevationSNR_164 "Elevation SNR of point_164";
CM_ SG_ 284 LR_ElevationSNR_165 "Elevation SNR of point_165";
CM_ SG_ 284 LR_ElevationSNR_166 "Elevation SNR of point_166";
CM_ SG_ 284 LR_ElevationSNR_167 "Elevation SNR of point_167";
CM_ SG_ 284 LR_Range_162 "Range of point_162";
CM_ SG_ 284 LR_Range_163 "Range of point_163";
CM_ SG_ 284 LR_Range_164 "Range of point_164";
CM_ SG_ 284 LR_Range_165 "Range of point_165";
CM_ SG_ 284 LR_Range_166 "Range of point_166";
CM_ SG_ 284 LR_Range_167 "Range of point_167";
CM_ SG_ 284 LR_RCS_162 "RCS of point_162";
CM_ SG_ 284 LR_RCS_163 "RCS of point_163";
CM_ SG_ 284 LR_RCS_164 "RCS of point_164";
CM_ SG_ 284 LR_RCS_165 "RCS of point_165";
CM_ SG_ 284 LR_RCS_166 "RCS of point_166";
CM_ SG_ 284 LR_RCS_167 "RCS of point_167";
CM_ SG_ 284 LR_Status_162 "Status of point_162";
CM_ SG_ 284 LR_Status_163 "Status of point_163";
CM_ SG_ 284 LR_Status_164 "Status of point_164";
CM_ SG_ 284 LR_Status_165 "Status of point_165";
CM_ SG_ 284 LR_Status_166 "Status of point_166";
CM_ SG_ 284 LR_Status_167 "Status of point_167";
CM_ SG_ 284 LR_Tbd_162 "To be defined";
CM_ SG_ 284 LR_Tbd_163 "To be defined";
CM_ SG_ 284 LR_Tbd_164 "To be defined";
CM_ SG_ 284 LR_Tbd_165 "To be defined";
CM_ SG_ 284 LR_Tbd_166 "To be defined";
CM_ SG_ 284 LR_Tbd_167 "To be defined";
CM_ SG_ 284 LR_Velocity_162 "Relative radial velocity of point_162";
CM_ SG_ 284 LR_Velocity_163 "Relative radial velocity of point_163";
CM_ SG_ 284 LR_Velocity_164 "Relative radial velocity of point_164";
CM_ SG_ 284 LR_Velocity_165 "Relative radial velocity of point_165";
CM_ SG_ 284 LR_Velocity_166 "Relative radial velocity of point_166";
CM_ SG_ 284 LR_Velocity_167 "Relative radial velocity of point_167";
CM_ SG_ 285 LR_AzimuthAng_168 "Azimuth angle of point_168";
CM_ SG_ 285 LR_AzimuthAng_169 "Azimuth angle of point_169";
CM_ SG_ 285 LR_AzimuthAng_170 "Azimuth angle of point_170";
CM_ SG_ 285 LR_AzimuthAng_171 "Azimuth angle of point_171";
CM_ SG_ 285 LR_AzimuthAng_172 "Azimuth angle of point_172";
CM_ SG_ 285 LR_AzimuthAng_173 "Azimuth angle of point_173";
CM_ SG_ 285 LR_AzimuthSNR_168 "Azimuth SNR of point_168";
CM_ SG_ 285 LR_AzimuthSNR_169 "Azimuth SNR of point_169";
CM_ SG_ 285 LR_AzimuthSNR_170 "Azimuth SNR of point_170";
CM_ SG_ 285 LR_AzimuthSNR_171 "Azimuth SNR of point_171";
CM_ SG_ 285 LR_AzimuthSNR_172 "Azimuth SNR of point_172";
CM_ SG_ 285 LR_AzimuthSNR_173 "Azimuth SNR of point_173";
CM_ SG_ 285 LR_ElevationAng_168 "Elevation angle of point_168";
CM_ SG_ 285 LR_ElevationAng_169 "Elevation angle of point_169";
CM_ SG_ 285 LR_ElevationAng_170 "Elevation angle of point_170";
CM_ SG_ 285 LR_ElevationAng_171 "Elevation angle of point_171";
CM_ SG_ 285 LR_ElevationAng_172 "Elevation angle of point_172";
CM_ SG_ 285 LR_ElevationAng_173 "Elevation angle of point_173";
CM_ SG_ 285 LR_ElevationSNR_168 "Elevation SNR of point_168";
CM_ SG_ 285 LR_ElevationSNR_169 "Elevation SNR of point_169";
CM_ SG_ 285 LR_ElevationSNR_170 "Elevation SNR of point_170";
CM_ SG_ 285 LR_ElevationSNR_171 "Elevation SNR of point_171";
CM_ SG_ 285 LR_ElevationSNR_172 "Elevation SNR of point_172";
CM_ SG_ 285 LR_ElevationSNR_173 "Elevation SNR of point_173";
CM_ SG_ 285 LR_Range_168 "Range of point_168";
CM_ SG_ 285 LR_Range_169 "Range of point_169";
CM_ SG_ 285 LR_Range_170 "Range of point_170";
CM_ SG_ 285 LR_Range_171 "Range of point_171";
CM_ SG_ 285 LR_Range_172 "Range of point_172";
CM_ SG_ 285 LR_Range_173 "Range of point_173";
CM_ SG_ 285 LR_RCS_168 "RCS of point_168";
CM_ SG_ 285 LR_RCS_169 "RCS of point_169";
CM_ SG_ 285 LR_RCS_170 "RCS of point_170";
CM_ SG_ 285 LR_RCS_171 "RCS of point_171";
CM_ SG_ 285 LR_RCS_172 "RCS of point_172";
CM_ SG_ 285 LR_RCS_173 "RCS of point_173";
CM_ SG_ 285 LR_Status_168 "Status of point_168";
CM_ SG_ 285 LR_Status_169 "Status of point_169";
CM_ SG_ 285 LR_Status_170 "Status of point_170";
CM_ SG_ 285 LR_Status_171 "Status of point_171";
CM_ SG_ 285 LR_Status_172 "Status of point_172";
CM_ SG_ 285 LR_Status_173 "Status of point_173";
CM_ SG_ 285 LR_Tbd_168 "To be defined";
CM_ SG_ 285 LR_Tbd_169 "To be defined";
CM_ SG_ 285 LR_Tbd_170 "To be defined";
CM_ SG_ 285 LR_Tbd_171 "To be defined";
CM_ SG_ 285 LR_Tbd_172 "To be defined";
CM_ SG_ 285 LR_Tbd_173 "To be defined";
CM_ SG_ 285 LR_Velocity_168 "Relative radial velocity of point_168";
CM_ SG_ 285 LR_Velocity_169 "Relative radial velocity of point_169";
CM_ SG_ 285 LR_Velocity_170 "Relative radial velocity of point_170";
CM_ SG_ 285 LR_Velocity_171 "Relative radial velocity of point_171";
CM_ SG_ 285 LR_Velocity_172 "Relative radial velocity of point_172";
CM_ SG_ 285 LR_Velocity_173 "Relative radial velocity of point_173";
CM_ SG_ 286 LR_AzimuthAng_174 "Azimuth angle of point_174";
CM_ SG_ 286 LR_AzimuthAng_175 "Azimuth angle of point_175";
CM_ SG_ 286 LR_AzimuthAng_176 "Azimuth angle of point_176";
CM_ SG_ 286 LR_AzimuthAng_177 "Azimuth angle of point_177";
CM_ SG_ 286 LR_AzimuthAng_178 "Azimuth angle of point_178";
CM_ SG_ 286 LR_AzimuthAng_179 "Azimuth angle of point_179";
CM_ SG_ 286 LR_AzimuthSNR_174 "Azimuth SNR of point_174";
CM_ SG_ 286 LR_AzimuthSNR_175 "Azimuth SNR of point_175";
CM_ SG_ 286 LR_AzimuthSNR_176 "Azimuth SNR of point_176";
CM_ SG_ 286 LR_AzimuthSNR_177 "Azimuth SNR of point_177";
CM_ SG_ 286 LR_AzimuthSNR_178 "Azimuth SNR of point_178";
CM_ SG_ 286 LR_AzimuthSNR_179 "Azimuth SNR of point_179";
CM_ SG_ 286 LR_ElevationAng_174 "Elevation angle of point_174";
CM_ SG_ 286 LR_ElevationAng_175 "Elevation angle of point_175";
CM_ SG_ 286 LR_ElevationAng_176 "Elevation angle of point_176";
CM_ SG_ 286 LR_ElevationAng_177 "Elevation angle of point_177";
CM_ SG_ 286 LR_ElevationAng_178 "Elevation angle of point_178";
CM_ SG_ 286 LR_ElevationAng_179 "Elevation angle of point_179";
CM_ SG_ 286 LR_ElevationSNR_174 "Elevation SNR of point_174";
CM_ SG_ 286 LR_ElevationSNR_175 "Elevation SNR of point_175";
CM_ SG_ 286 LR_ElevationSNR_176 "Elevation SNR of point_176";
CM_ SG_ 286 LR_ElevationSNR_177 "Elevation SNR of point_177";
CM_ SG_ 286 LR_ElevationSNR_178 "Elevation SNR of point_178";
CM_ SG_ 286 LR_ElevationSNR_179 "Elevation SNR of point_179";
CM_ SG_ 286 LR_Range_174 "Range of point_174";
CM_ SG_ 286 LR_Range_175 "Range of point_175";
CM_ SG_ 286 LR_Range_176 "Range of point_176";
CM_ SG_ 286 LR_Range_177 "Range of point_177";
CM_ SG_ 286 LR_Range_178 "Range of point_178";
CM_ SG_ 286 LR_Range_179 "Range of point_179";
CM_ SG_ 286 LR_RCS_174 "RCS of point_174";
CM_ SG_ 286 LR_RCS_175 "RCS of point_175";
CM_ SG_ 286 LR_RCS_176 "RCS of point_176";
CM_ SG_ 286 LR_RCS_177 "RCS of point_177";
CM_ SG_ 286 LR_RCS_178 "RCS of point_178";
CM_ SG_ 286 LR_RCS_179 "RCS of point_179";
CM_ SG_ 286 LR_Status_174 "Status of point_174";
CM_ SG_ 286 LR_Status_175 "Status of point_175";
CM_ SG_ 286 LR_Status_176 "Status of point_176";
CM_ SG_ 286 LR_Status_177 "Status of point_177";
CM_ SG_ 286 LR_Status_178 "Status of point_178";
CM_ SG_ 286 LR_Status_179 "Status of point_179";
CM_ SG_ 286 LR_Tbd_174 "To be defined";
CM_ SG_ 286 LR_Tbd_175 "To be defined";
CM_ SG_ 286 LR_Tbd_176 "To be defined";
CM_ SG_ 286 LR_Tbd_177 "To be defined";
CM_ SG_ 286 LR_Tbd_178 "To be defined";
CM_ SG_ 286 LR_Tbd_179 "To be defined";
CM_ SG_ 286 LR_Velocity_174 "Relative radial velocity of point_174";
CM_ SG_ 286 LR_Velocity_175 "Relative radial velocity of point_175";
CM_ SG_ 286 LR_Velocity_176 "Relative radial velocity of point_176";
CM_ SG_ 286 LR_Velocity_177 "Relative radial velocity of point_177";
CM_ SG_ 286 LR_Velocity_178 "Relative radial velocity of point_178";
CM_ SG_ 286 LR_Velocity_179 "Relative radial velocity of point_179";
CM_ SG_ 287 LR_AzimuthAng_180 "Azimuth angle of point_180";
CM_ SG_ 287 LR_AzimuthAng_181 "Azimuth angle of point_181";
CM_ SG_ 287 LR_AzimuthAng_182 "Azimuth angle of point_182";
CM_ SG_ 287 LR_AzimuthAng_183 "Azimuth angle of point_183";
CM_ SG_ 287 LR_AzimuthAng_184 "Azimuth angle of point_184";
CM_ SG_ 287 LR_AzimuthAng_185 "Azimuth angle of point_185";
CM_ SG_ 287 LR_AzimuthSNR_180 "Azimuth SNR of point_180";
CM_ SG_ 287 LR_AzimuthSNR_181 "Azimuth SNR of point_181";
CM_ SG_ 287 LR_AzimuthSNR_182 "Azimuth SNR of point_182";
CM_ SG_ 287 LR_AzimuthSNR_183 "Azimuth SNR of point_183";
CM_ SG_ 287 LR_AzimuthSNR_184 "Azimuth SNR of point_184";
CM_ SG_ 287 LR_AzimuthSNR_185 "Azimuth SNR of point_185";
CM_ SG_ 287 LR_ElevationAng_180 "Elevation angle of point_180";
CM_ SG_ 287 LR_ElevationAng_181 "Elevation angle of point_181";
CM_ SG_ 287 LR_ElevationAng_182 "Elevation angle of point_182";
CM_ SG_ 287 LR_ElevationAng_183 "Elevation angle of point_183";
CM_ SG_ 287 LR_ElevationAng_184 "Elevation angle of point_184";
CM_ SG_ 287 LR_ElevationAng_185 "Elevation angle of point_185";
CM_ SG_ 287 LR_ElevationSNR_180 "Elevation SNR of point_180";
CM_ SG_ 287 LR_ElevationSNR_181 "Elevation SNR of point_181";
CM_ SG_ 287 LR_ElevationSNR_182 "Elevation SNR of point_182";
CM_ SG_ 287 LR_ElevationSNR_183 "Elevation SNR of point_183";
CM_ SG_ 287 LR_ElevationSNR_184 "Elevation SNR of point_184";
CM_ SG_ 287 LR_ElevationSNR_185 "Elevation SNR of point_185";
CM_ SG_ 287 LR_Range_180 "Range of point_180";
CM_ SG_ 287 LR_Range_181 "Range of point_181";
CM_ SG_ 287 LR_Range_182 "Range of point_182";
CM_ SG_ 287 LR_Range_183 "Range of point_183";
CM_ SG_ 287 LR_Range_184 "Range of point_184";
CM_ SG_ 287 LR_Range_185 "Range of point_185";
CM_ SG_ 287 LR_RCS_180 "RCS of point_180";
CM_ SG_ 287 LR_RCS_181 "RCS of point_181";
CM_ SG_ 287 LR_RCS_182 "RCS of point_182";
CM_ SG_ 287 LR_RCS_183 "RCS of point_183";
CM_ SG_ 287 LR_RCS_184 "RCS of point_184";
CM_ SG_ 287 LR_RCS_185 "RCS of point_185";
CM_ SG_ 287 LR_Status_180 "Status of point_180";
CM_ SG_ 287 LR_Status_181 "Status of point_181";
CM_ SG_ 287 LR_Status_182 "Status of point_182";
CM_ SG_ 287 LR_Status_183 "Status of point_183";
CM_ SG_ 287 LR_Status_184 "Status of point_184";
CM_ SG_ 287 LR_Status_185 "Status of point_185";
CM_ SG_ 287 LR_Tbd_180 "To be defined";
CM_ SG_ 287 LR_Tbd_181 "To be defined";
CM_ SG_ 287 LR_Tbd_182 "To be defined";
CM_ SG_ 287 LR_Tbd_183 "To be defined";
CM_ SG_ 287 LR_Tbd_184 "To be defined";
CM_ SG_ 287 LR_Tbd_185 "To be defined";
CM_ SG_ 287 LR_Velocity_180 "Relative radial velocity of point_180";
CM_ SG_ 287 LR_Velocity_181 "Relative radial velocity of point_181";
CM_ SG_ 287 LR_Velocity_182 "Relative radial velocity of point_182";
CM_ SG_ 287 LR_Velocity_183 "Relative radial velocity of point_183";
CM_ SG_ 287 LR_Velocity_184 "Relative radial velocity of point_184";
CM_ SG_ 287 LR_Velocity_185 "Relative radial velocity of point_185";
BA_DEF_ BO_  "GenMsgCycleTime" INT 0 0;
BA_DEF_ BO_  "GenMsgSendType" ENUM  "Cyclic","NotUsed","Event","NotUsed","NotUsed","NotUsed","NotUsed","IfActive","NoMsgSendType","NotUsed";
BA_DEF_ BO_  "VFrameFormat" ENUM  "StandardCAN","ExtendedCAN","reserved","reserved","reserved","reserved","reserved","reserved","reserved","reserved","reserved","reserved","reserved","reserved","StandardCAN_FD","ExtendedCAN_FD";
BA_DEF_ BO_  "GenSigSendType" ENUM  "Cyclic","OnWrite","OnWriteWithRepetition","OnChange","OnChangeWithRepetition";
BA_DEF_ SG_  "GenSigStartValue" INT 0 0;
BA_DEF_ BO_  "CANFD_BRS" ENUM  "0","1";
BA_DEF_DEF_  "GenMsgCycleTime" 0;
BA_DEF_DEF_  "GenMsgSendType" "Cyclic";
BA_DEF_DEF_  "VFrameFormat" "ExtendedCAN_FD";
BA_DEF_DEF_  "GenSigSendType" "Cyclic";
BA_DEF_DEF_  "GenSigStartValue" 0;
BA_DEF_DEF_  "CANFD_BRS" "1";
BA_ "GenMsgSendType" BO_ 267 2;
BA_ "VFrameFormat" BO_ 267 14;
BA_ "GenMsgSendType" BO_ 268 2;
BA_ "VFrameFormat" BO_ 268 14;
BA_ "GenMsgSendType" BO_ 269 2;
BA_ "VFrameFormat" BO_ 269 14;
BA_ "GenMsgSendType" BO_ 270 2;
BA_ "VFrameFormat" BO_ 270 14;
BA_ "GenMsgSendType" BO_ 271 2;
BA_ "VFrameFormat" BO_ 271 14;
BA_ "GenMsgSendType" BO_ 272 2;
BA_ "VFrameFormat" BO_ 272 14;
BA_ "GenMsgSendType" BO_ 273 2;
BA_ "VFrameFormat" BO_ 273 14;
BA_ "GenMsgSendType" BO_ 274 2;
BA_ "VFrameFormat" BO_ 274 14;
BA_ "GenMsgSendType" BO_ 275 2;
BA_ "VFrameFormat" BO_ 275 14;
BA_ "GenMsgSendType" BO_ 276 2;
BA_ "VFrameFormat" BO_ 276 14;
BA_ "GenMsgSendType" BO_ 277 2;
BA_ "VFrameFormat" BO_ 277 14;
BA_ "GenMsgSendType" BO_ 278 2;
BA_ "VFrameFormat" BO_ 278 14;
BA_ "GenMsgSendType" BO_ 279 2;
BA_ "VFrameFormat" BO_ 279 14;
BA_ "GenMsgSendType" BO_ 280 2;
BA_ "VFrameFormat" BO_ 280 14;
BA_ "GenMsgSendType" BO_ 281 2;
BA_ "VFrameFormat" BO_ 281 14;
BA_ "GenMsgSendType" BO_ 282 2;
BA_ "VFrameFormat" BO_ 282 14;
BA_ "GenMsgSendType" BO_ 283 2;
BA_ "VFrameFormat" BO_ 283 14;
BA_ "GenMsgSendType" BO_ 284 2;
BA_ "VFrameFormat" BO_ 284 14;
BA_ "GenMsgSendType" BO_ 285 2;
BA_ "VFrameFormat" BO_ 285 14;
BA_ "GenMsgSendType" BO_ 286 2;
BA_ "VFrameFormat" BO_ 286 14;
BA_ "GenMsgSendType" BO_ 287 2;
BA_ "VFrameFormat" BO_ 287 14;
BA_ "GenMsgSendType" BO_ 288 2;
BA_ "VFrameFormat" BO_ 288 14;
BA_ "GenMsgSendType" BO_ 289 2;
BA_ "VFrameFormat" BO_ 289 14;
BA_ "GenMsgSendType" BO_ 290 2;
BA_ "VFrameFormat" BO_ 290 14;
BA_ "VFrameFormat" BO_ 291 14;
BA_ "GenMsgSendType" BO_ 292 2;
BA_ "VFrameFormat" BO_ 292 14;
BA_ "GenMsgSendType" BO_ 293 2;
BA_ "VFrameFormat" BO_ 293 14;
BA_ "GenMsgSendType" BO_ 294 2;
BA_ "VFrameFormat" BO_ 294 14;
