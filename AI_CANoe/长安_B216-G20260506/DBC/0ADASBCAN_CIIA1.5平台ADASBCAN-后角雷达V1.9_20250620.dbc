VERSION ""

NS_ :

BS_:
BU_: RLR_L RRR_L mADC
BO_ 836 RLR_L_344: 64 RLR_L
 SG_ RLR_CRCCheck_344 : 503|16@0+ (1.0000000000,0.0000000000) [0.0000000000|65535.0000000000] ""  RRR_L,mADC
 SG_ RLR_RollingCounter_344 : 491|4@0+ (1.0000000000,0.0000000000) [0.0000000000|15.0000000000] ""  RRR_L,mADC
 SG_ RLR_SenceMode : 12|2@0+ (1.0000000000,0.0000000000) [0.0000000000|3.0000000000] ""  RRR_L,mADC
 SG_ RLR_WorkSenceMode : 14|2@0+ (1.0000000000,0.0000000000) [0.0000000000|3.0000000000] ""  RRR_L,mADC
 SG_ RLR_WorkMode : 0|2@0+ (1.0000000000,0.0000000000) [0.0000000000|3.0000000000] ""  RRR_L,mADC
 SG_ RLR_ObjCount : 7|7@0+ (1.0000000000,0.0000000000) [0.0000000000|127.0000000000] "-"  RRR_L,mADC
 SG_ RLR_ped_azi : 211|2@0+ (1.0000000000,0.0000000000) [0.0000000000|3.0000000000] "-"  RRR_L,mADC
 SG_ RLR_ped_Ym : 206|11@0+ (0.1250000000,-128.0000000000) [-128.0000000000|127.8750000000] "m"  RRR_L,mADC
 SG_ RLR_ped_Xm : 187|13@0+ (0.0625000000,-256.0000000000) [-256.0000000000|255.9380000000] "m"  RRR_L,mADC
 SG_ RLR_ped_ConRidence : 177|6@0+ (2.0000000000,0.0000000000) [0.0000000000|100.0000000000] "%"  RRR_L,mADC
 SG_ RLR_ped_result : 178|1@0+ (1.0000000000,0.0000000000) [0.0000000000|1.0000000000] "m"  RRR_L,mADC

BO_ 840 RLR_L_348: 64 RLR_L
 SG_ RLR_Suppliers : 75|4@0+ (1.0000000000,0.0000000000) [0.0000000000|15.0000000000] ""  RRR_L,mADC
 SG_ RLR_CRCCheck_348 : 503|16@0+ (1.0000000000,0.0000000000) [0.0000000000|65535.0000000000] ""  RRR_L,mADC
 SG_ RLR_RollingCounter_348 : 491|4@0+ (1.0000000000,0.0000000000) [0.0000000000|15.0000000000] ""  RRR_L,mADC
 SG_ RLR_SystemStatus : 137|3@0+ (1.0000000000,0.0000000000) [0.0000000000|7.0000000000] ""  RRR_L,mADC
 SG_ RLR_MCUTiStamp : 239|16@0+ (1.0000000000,0.0000000000) [0.0000000000|65536.0000000000] "um"  RRR_L,mADC
 SG_ RLR_SyncTiStamp : 255|64@0+ (0.0001000000,0.0000000000) [0.0000000000|1844674407370950.0000000000] "s"  RRR_L,mADC
 SG_ RLR_OBJ_TiOut : 77|1@0+ (1.0000000000,0.0000000000) [0.0000000000|1.0000000000] "-"  RRR_L,mADC
 SG_ RLR_OBJ_TiLeap : 78|1@0+ (1.0000000000,0.0000000000) [0.0000000000|1.0000000000] "-"  RRR_L,mADC
 SG_ RLR_OBJ_TiBas : 79|1@0+ (1.0000000000,0.0000000000) [0.0000000000|1.0000000000] "-"  RRR_L,mADC
 SG_ RLR_OBJTi_Stamp : 15|64@0+ (0.0001000000,0.0000000000) [0.0000000000|1844674407370950.0000000000] "s"  RRR_L,mADC
 SG_ RLR_ObjDelay : 7|8@0+ (1.0000000000,0.0000000000) [0.0000000000|255.0000000000] "ms"  RRR_L,mADC

BO_ 848 RLR_L_350: 64 RLR_L
 SG_ RLR_OBJ2_LostCnt : 483|4@0+ (1.0000000000,0.0000000000) [0.0000000000|15.0000000000] ""  RRR_L,mADC
 SG_ RLR_OBJ1_LostCnt : 495|4@0+ (1.0000000000,0.0000000000) [0.0000000000|15.0000000000] ""  RRR_L,mADC
 SG_ RLR_OBJ2_Dx : 230|13@0+ (0.0625000000,-256.0000000000) [-256.0000000000|255.9380000000] "m"  RRR_L,mADC
 SG_ RLR_OBJ2_Dy : 209|11@0+ (0.1250000000,-128.0000000000) [-128.0000000000|127.8750000000] "m"  RRR_L,mADC
 SG_ RLR_OBJ1_Dx : 59|13@0+ (0.0625000000,-256.0000000000) [-256.0000000000|255.9380000000] "m"  RRR_L,mADC
 SG_ RLR_OBJ1_Dy : 54|11@0+ (0.1250000000,-128.0000000000) [-128.0000000000|127.8750000000] "m"  RRR_L,mADC
 SG_ RLR_OBJ2_Vx : 310|12@0+ (0.0625000000,-128.0000000000) [-128.0000000000|127.9380000000] "m/s"  RRR_L,mADC
 SG_ RLR_OBJ2_Vy : 288|10@0+ (0.0625000000,-32.0000000000) [-32.0000000000|31.9375000000] "m/s"  RRR_L,mADC
 SG_ RLR_OBJ2_Convergence : 458|1@0+ (1.0000000000,0.0000000000) [0.0000000000|1.0000000000] ""  RRR_L,mADC
 SG_ RLR_OBJ2_DelayTime : 453|10@0+ (1.0000000000,0.0000000000) [0.0000000000|1023.0000000000] "ms"  RRR_L,mADC
 SG_ RLR_OBJ2_HeightGround : 424|9@0+ (0.1000000000,0.0000000000) [0.0000000000|51.1000000000] "m"  RRR_L,mADC
 SG_ RLR_OBJ2_MotionStatus : 470|3@0+ (1.0000000000,0.0000000000) [0.0000000000|7.0000000000] ""  RRR_L,mADC
 SG_ RLR_OBJ2_RelVx_std : 413|12@0+ (0.0625000000,0.0000000000) [0.0000000000|255.9375000000] "m/s"  RRR_L,mADC
 SG_ RLR_OBJ2_RelVy_std : 407|10@0+ (0.1250000000,0.0000000000) [0.0000000000|127.8750000000] "m/s"  RRR_L,mADC
 SG_ RLR_OBJ2_Dx_Vnce : 389|14@0+ (0.0500000000,0.0000000000) [0.0000000000|50.0000000000] "m2"  RRR_L,mADC
 SG_ RLR_OBJ2_Dy_Vnce : 383|10@0+ (0.0200000000,0.0000000000) [0.0000000000|20.0000000000] "m2"  RRR_L,mADC
 SG_ RLR_OBJ1_Vx : 139|12@0+ (0.0625000000,-128.0000000000) [-128.0000000000|127.9380000000] "m/s"  RRR_L,mADC
 SG_ RLR_OBJ1_Vy : 133|10@0+ (0.0625000000,-32.0000000000) [-32.0000000000|31.9375000000] "m/s"  RRR_L,mADC
 SG_ RLR_OBJ1_Convergence : 459|1@0+ (1.0000000000,0.0000000000) [0.0000000000|1.0000000000] ""  RRR_L,mADC
 SG_ RLR_OBJ1_DelayTime : 447|10@0+ (1.0000000000,0.0000000000) [0.0000000000|1023.0000000000] "ms"  RRR_L,mADC
 SG_ RLR_OBJ1_HeightGround : 417|9@0+ (0.1000000000,0.0000000000) [0.0000000000|51.1000000000] "m"  RRR_L,mADC
 SG_ RLR_OBJ1_MotionStatus : 457|3@0+ (1.0000000000,0.0000000000) [0.0000000000|7.0000000000] ""  RRR_L,mADC
 SG_ RLR_OBJ1_RelVx_std : 363|12@0+ (0.0625000000,0.0000000000) [0.0000000000|255.9375000000] "m/s"  RRR_L,mADC
 SG_ RLR_OBJ1_RelVy_std : 357|10@0+ (0.1250000000,0.0000000000) [0.0000000000|127.8750000000] "m/s"  RRR_L,mADC
 SG_ RLR_OBJ1_Dx_Vnce : 339|14@0+ (0.0500000000,0.0000000000) [0.0000000000|50.0000000000] "m2"  RRR_L,mADC
 SG_ RLR_OBJ1_Dy_Vnce : 333|10@0+ (0.0200000000,0.0000000000) [0.0000000000|20.0000000000] "m2"  RRR_L,mADC
 SG_ RLR_CRCCheck_350 : 503|16@0+ (1.0000000000,0.0000000000) [0.0000000000|65535.0000000000] ""  RRR_L,mADC
 SG_ RLR_RollingCounter_350 : 491|4@0+ (1.0000000000,0.0000000000) [0.0000000000|15.0000000000] ""  RRR_L,mADC
 SG_ RLR_OBJ2_Track_Age : 325|8@0+ (1.0000000000,0.0000000000) [0.0000000000|255.0000000000] ""  RRR_L,mADC
 SG_ RLR_OBJ2_ReRPointLoc : 312|3@0+ (1.0000000000,0.0000000000) [0.0000000000|7.0000000000] ""  RRR_L,mADC
 SG_ RLR_OBJ2_ObstacleProb : 294|6@0+ (2.0000000000,0.0000000000) [0.0000000000|100.0000000000] "%"  RRR_L,mADC
 SG_ RLR_OBJ2_Measured : 280|2@0+ (1.0000000000,0.0000000000) [0.0000000000|3.0000000000] ""  RRR_L,mADC
 SG_ RLR_OBJ2_ExistProb : 286|6@0+ (2.0000000000,0.0000000000) [0.0000000000|100.0000000000] "%"  RRR_L,mADC
 SG_ RLR_OBJ2_Location : 272|2@0+ (1.0000000000,0.0000000000) [0.0000000000|3.0000000000] ""  RRR_L,mADC
 SG_ RLR_OBJ2_RelAx : 265|9@0+ (0.0625000000,-16.0000000000) [-16.0000000000|15.9375000000] "m/s2"  RRR_L,mADC
 SG_ RLR_OBJ2_RelAy : 259|10@0+ (0.0312500000,-16.0000000000) [-16.0000000000|15.9688000000] "m/s2"  RRR_L,mADC
 SG_ RLR_OBJ2_RelVx : 255|12@0+ (0.0625000000,-128.0000000000) [-128.0000000000|127.9380000000] "m/s"  RRR_L,mADC
 SG_ RLR_OBJ2_RelVy : 233|10@0+ (0.0625000000,-32.0000000000) [-32.0000000000|63.8750000000] "m/s"  RRR_L,mADC
 SG_ RLR_OBJ2_HeadingAngle : 203|10@0+ (0.0100000000,-3.1400000000) [-3.1400000000|3.1400000000] "rad"  RRR_L,mADC
 SG_ RLR_OBJ2_Length : 196|9@0+ (0.0500000000,0.0000000000) [0.0000000000|25.5000000000] "m"  RRR_L,mADC
 SG_ RLR_OBJ2_Height : 189|9@0+ (0.0100000000,0.0000000000) [0.0000000000|5.1100000000] "m"  RRR_L,mADC
 SG_ RLR_OBJ2_Width : 168|11@0+ (0.0100000000,0.0000000000) [0.0000000000|12.0000000000] "m"  RRR_L,mADC
 SG_ RLR_OBJ2_Type : 171|3@0+ (1.0000000000,0.0000000000) [0.0000000000|7.0000000000] ""  RRR_L,mADC
 SG_ RLR_OBJ2_Track_ID : 162|7@0+ (1.0000000000,0.0000000000) [0.0000000000|127.0000000000] ""  RRR_L,mADC
 SG_ RLR_OBJ1_Track_Age : 154|8@0+ (1.0000000000,0.0000000000) [0.0000000000|255.0000000000] ""  RRR_L,mADC
 SG_ RLR_OBJ1_ReRPointLoc : 157|3@0+ (1.0000000000,0.0000000000) [0.0000000000|7.0000000000] ""  RRR_L,mADC
 SG_ RLR_OBJ1_ObstacleProb : 123|6@0+ (2.0000000000,0.0000000000) [0.0000000000|100.0000000000] "%"  RRR_L,mADC
 SG_ RLR_OBJ1_Measured : 125|2@0+ (1.0000000000,0.0000000000) [0.0000000000|3.0000000000] ""  RRR_L,mADC
 SG_ RLR_OBJ1_ExistProb : 115|6@0+ (2.0000000000,0.0000000000) [0.0000000000|100.0000000000] "%"  RRR_L,mADC
 SG_ RLR_OBJ1_Location : 117|2@0+ (1.0000000000,0.0000000000) [0.0000000000|3.0000000000] ""  RRR_L,mADC
 SG_ RLR_OBJ1_RelAx : 110|9@0+ (0.0625000000,-16.0000000000) [-16.0000000000|15.9375000000] "m/s2"  RRR_L,mADC
 SG_ RLR_OBJ1_RelAy : 88|10@0+ (0.0312500000,-16.0000000000) [-16.0000000000|15.9688000000] "m/s2"  RRR_L,mADC
 SG_ RLR_OBJ1_RelVx : 84|12@0+ (0.0625000000,-128.0000000000) [-128.0000000000|127.9380000000] "m/s"  RRR_L,mADC
 SG_ RLR_OBJ1_RelVy : 78|10@0+ (0.0625000000,-32.0000000000) [-32.0000000000|63.8750000000] "m/s"  RRR_L,mADC
 SG_ RLR_OBJ1_HeadingAngle : 32|10@0+ (0.0100000000,-3.1400000000) [-3.1400000000|3.1400000000] "rad"  RRR_L,mADC
 SG_ RLR_OBJ1_Length : 25|9@0+ (0.0500000000,0.0000000000) [0.0000000000|25.5000000000] ""  RRR_L,mADC
 SG_ RLR_OBJ1_Height : 18|9@0+ (0.0100000000,0.0000000000) [0.0000000000|5.1100000000] "m"  RRR_L,mADC
 SG_ RLR_OBJ1_Width : 13|11@0+ (0.0100000000,0.0000000000) [0.0000000000|12.0000000000] "m"  RRR_L,mADC
 SG_ RLR_OBJ1_Type : 0|3@0+ (1.0000000000,0.0000000000) [0.0000000000|7.0000000000] ""  RRR_L,mADC
 SG_ RLR_OBJ1_Track_ID : 7|7@0+ (1.0000000000,0.0000000000) [0.0000000000|127.0000000000] ""  RRR_L,mADC

BO_ 849 RLR_L_351: 64 RLR_L
 SG_ RLR_OBJ4_LostCnt : 483|4@0+ (1.0000000000,0.0000000000) [0.0000000000|15.0000000000] ""  RRR_L,mADC
 SG_ RLR_OBJ3_LostCnt : 495|4@0+ (1.0000000000,0.0000000000) [0.0000000000|15.0000000000] ""  RRR_L,mADC
 SG_ RLR_OBJ4_Dx : 230|13@0+ (0.0625000000,-256.0000000000) [-256.0000000000|255.9380000000] "m"  RRR_L,mADC
 SG_ RLR_OBJ4_Dy : 209|11@0+ (0.1250000000,-128.0000000000) [-128.0000000000|127.8750000000] "m"  RRR_L,mADC
 SG_ RLR_OBJ3_Dx : 59|13@0+ (0.0625000000,-256.0000000000) [-256.0000000000|255.9380000000] "m"  RRR_L,mADC
 SG_ RLR_OBJ3_Dy : 54|11@0+ (0.1250000000,-128.0000000000) [-128.0000000000|127.8750000000] "m"  RRR_L,mADC
 SG_ RLR_OBJ4_Vx : 310|12@0+ (0.0625000000,-128.0000000000) [-128.0000000000|127.9380000000] "m/s"  RRR_L,mADC
 SG_ RLR_OBJ4_Vy : 288|10@0+ (0.0625000000,-32.0000000000) [-32.0000000000|31.9375000000] "m/s"  RRR_L,mADC
 SG_ RLR_OBJ4_Convergence : 458|1@0+ (1.0000000000,0.0000000000) [0.0000000000|1.0000000000] ""  RRR_L,mADC
 SG_ RLR_OBJ4_DelayTime : 453|10@0+ (1.0000000000,0.0000000000) [0.0000000000|1023.0000000000] "ms"  RRR_L,mADC
 SG_ RLR_OBJ4_HeightGround : 424|9@0+ (0.1000000000,0.0000000000) [0.0000000000|51.1000000000] "m"  RRR_L,mADC
 SG_ RLR_OBJ4_MotionStatus : 470|3@0+ (1.0000000000,0.0000000000) [0.0000000000|7.0000000000] ""  RRR_L,mADC
 SG_ RLR_OBJ4_RelVx_std : 413|12@0+ (0.0625000000,0.0000000000) [0.0000000000|255.9375000000] "m/s"  RRR_L,mADC
 SG_ RLR_OBJ4_RelVy_std : 407|10@0+ (0.1250000000,0.0000000000) [0.0000000000|127.8750000000] "m/s"  RRR_L,mADC
 SG_ RLR_OBJ4_Dx_Vnce : 389|14@0+ (0.0500000000,0.0000000000) [0.0000000000|50.0000000000] "m2"  RRR_L,mADC
 SG_ RLR_OBJ4_Dy_Vnce : 383|10@0+ (0.0200000000,0.0000000000) [0.0000000000|20.0000000000] "m2"  RRR_L,mADC
 SG_ RLR_OBJ3_Vx : 139|12@0+ (0.0625000000,-128.0000000000) [-128.0000000000|127.9380000000] "m/s"  RRR_L,mADC
 SG_ RLR_OBJ3_Vy : 133|10@0+ (0.0625000000,-32.0000000000) [-32.0000000000|31.9375000000] "m/s"  RRR_L,mADC
 SG_ RLR_OBJ3_Convergence : 459|1@0+ (1.0000000000,0.0000000000) [0.0000000000|1.0000000000] ""  RRR_L,mADC
 SG_ RLR_OBJ3_DelayTime : 447|10@0+ (1.0000000000,0.0000000000) [0.0000000000|1023.0000000000] "ms"  RRR_L,mADC
 SG_ RLR_OBJ3_HeightGround : 417|9@0+ (0.1000000000,0.0000000000) [0.0000000000|51.1000000000] "m"  RRR_L,mADC
 SG_ RLR_OBJ3_MotionStatus : 457|3@0+ (1.0000000000,0.0000000000) [0.0000000000|7.0000000000] ""  RRR_L,mADC
 SG_ RLR_OBJ3_RelVx_std : 363|12@0+ (0.0625000000,0.0000000000) [0.0000000000|255.9375000000] "m/s"  RRR_L,mADC
 SG_ RLR_OBJ3_RelVy_std : 357|10@0+ (0.1250000000,0.0000000000) [0.0000000000|127.8750000000] "m/s"  RRR_L,mADC
 SG_ RLR_OBJ3_Dx_Vnce : 339|14@0+ (0.0500000000,0.0000000000) [0.0000000000|50.0000000000] "m2"  RRR_L,mADC
 SG_ RLR_OBJ3_Dy_Vnce : 333|10@0+ (0.0200000000,0.0000000000) [0.0000000000|20.0000000000] "m2"  RRR_L,mADC
 SG_ RLR_CRCCheck_351 : 503|16@0+ (1.0000000000,0.0000000000) [0.0000000000|65535.0000000000] ""  RRR_L,mADC
 SG_ RLR_RollingCounter_351 : 491|4@0+ (1.0000000000,0.0000000000) [0.0000000000|15.0000000000] ""  RRR_L,mADC
 SG_ RLR_OBJ4_Track_Age : 325|8@0+ (1.0000000000,0.0000000000) [0.0000000000|255.0000000000] ""  RRR_L,mADC
 SG_ RLR_OBJ4_ReRPointLoc : 312|3@0+ (1.0000000000,0.0000000000) [0.0000000000|7.0000000000] ""  RRR_L,mADC
 SG_ RLR_OBJ4_ObstacleProb : 294|6@0+ (2.0000000000,0.0000000000) [0.0000000000|100.0000000000] "%"  RRR_L,mADC
 SG_ RLR_OBJ4_Measured : 280|2@0+ (1.0000000000,0.0000000000) [0.0000000000|3.0000000000] ""  RRR_L,mADC
 SG_ RLR_OBJ4_ExistProb : 286|6@0+ (2.0000000000,0.0000000000) [0.0000000000|100.0000000000] "%"  RRR_L,mADC
 SG_ RLR_OBJ4_Location : 272|2@0+ (1.0000000000,0.0000000000) [0.0000000000|3.0000000000] ""  RRR_L,mADC
 SG_ RLR_OBJ4_RelAx : 265|9@0+ (0.0625000000,-16.0000000000) [-16.0000000000|15.9375000000] "m/s2"  RRR_L,mADC
 SG_ RLR_OBJ4_RelAy : 259|10@0+ (0.0312500000,-16.0000000000) [-16.0000000000|15.9688000000] "m/s2"  RRR_L,mADC
 SG_ RLR_OBJ4_RelVx : 255|12@0+ (0.0625000000,-128.0000000000) [-128.0000000000|127.9380000000] "m/s"  RRR_L,mADC
 SG_ RLR_OBJ4_RelVy : 233|10@0+ (0.0625000000,-32.0000000000) [-32.0000000000|63.8750000000] "m/s"  RRR_L,mADC
 SG_ RLR_OBJ4_HeadingAngle : 203|10@0+ (0.0100000000,-3.1400000000) [-3.1400000000|3.1400000000] "rad"  RRR_L,mADC
 SG_ RLR_OBJ4_Length : 196|9@0+ (0.0500000000,0.0000000000) [0.0000000000|25.5000000000] "m"  RRR_L,mADC
 SG_ RLR_OBJ4_Height : 189|9@0+ (0.0100000000,0.0000000000) [0.0000000000|5.1100000000] "m"  RRR_L,mADC
 SG_ RLR_OBJ4_Width : 168|11@0+ (0.0100000000,0.0000000000) [0.0000000000|12.0000000000] "m"  RRR_L,mADC
 SG_ RLR_OBJ4_Type : 171|3@0+ (1.0000000000,0.0000000000) [0.0000000000|7.0000000000] ""  RRR_L,mADC
 SG_ RLR_OBJ4_Track_ID : 162|7@0+ (1.0000000000,0.0000000000) [0.0000000000|127.0000000000] ""  RRR_L,mADC
 SG_ RLR_OBJ3_Track_Age : 154|8@0+ (1.0000000000,0.0000000000) [0.0000000000|255.0000000000] ""  RRR_L,mADC
 SG_ RLR_OBJ3_ReRPointLoc : 157|3@0+ (1.0000000000,0.0000000000) [0.0000000000|7.0000000000] ""  RRR_L,mADC
 SG_ RLR_OBJ3_ObstacleProb : 123|6@0+ (2.0000000000,0.0000000000) [0.0000000000|100.0000000000] "%"  RRR_L,mADC
 SG_ RLR_OBJ3_Measured : 125|2@0+ (1.0000000000,0.0000000000) [0.0000000000|3.0000000000] ""  RRR_L,mADC
 SG_ RLR_OBJ3_ExistProb : 115|6@0+ (2.0000000000,0.0000000000) [0.0000000000|100.0000000000] "%"  RRR_L,mADC
 SG_ RLR_OBJ3_Location : 117|2@0+ (1.0000000000,0.0000000000) [0.0000000000|3.0000000000] ""  RRR_L,mADC
 SG_ RLR_OBJ3_RelAx : 110|9@0+ (0.0625000000,-16.0000000000) [-16.0000000000|15.9375000000] "m/s2"  RRR_L,mADC
 SG_ RLR_OBJ3_RelAy : 88|10@0+ (0.0312500000,-16.0000000000) [-16.0000000000|15.9688000000] "m/s2"  RRR_L,mADC
 SG_ RLR_OBJ3_RelVx : 84|12@0+ (0.0625000000,-128.0000000000) [-128.0000000000|127.9380000000] "m/s"  RRR_L,mADC
 SG_ RLR_OBJ3_RelVy : 78|10@0+ (0.0625000000,-32.0000000000) [-32.0000000000|63.8750000000] "m/s"  RRR_L,mADC
 SG_ RLR_OBJ3_HeadingAngle : 32|10@0+ (0.0100000000,-3.1400000000) [-3.1400000000|3.1400000000] "rad"  RRR_L,mADC
 SG_ RLR_OBJ3_Length : 25|9@0+ (0.0500000000,0.0000000000) [0.0000000000|25.5000000000] "m"  RRR_L,mADC
 SG_ RLR_OBJ3_Height : 18|9@0+ (0.0100000000,0.0000000000) [0.0000000000|5.1100000000] "m"  RRR_L,mADC
 SG_ RLR_OBJ3_Width : 13|11@0+ (0.0100000000,0.0000000000) [0.0000000000|12.0000000000] "m"  RRR_L,mADC
 SG_ RLR_OBJ3_Type : 0|3@0+ (1.0000000000,0.0000000000) [0.0000000000|7.0000000000] ""  RRR_L,mADC
 SG_ RLR_OBJ3_Track_ID : 7|7@0+ (1.0000000000,0.0000000000) [0.0000000000|127.0000000000] ""  RRR_L,mADC

BO_ 850 RLR_L_352: 64 RLR_L
 SG_ RLR_OBJ6_LostCnt : 483|4@0+ (1.0000000000,0.0000000000) [0.0000000000|15.0000000000] ""  RRR_L,mADC
 SG_ RLR_OBJ5_LostCnt : 495|4@0+ (1.0000000000,0.0000000000) [0.0000000000|15.0000000000] ""  RRR_L,mADC
 SG_ RLR_OBJ6_Dx : 230|13@0+ (0.0625000000,-256.0000000000) [-256.0000000000|255.9380000000] "m"  RRR_L,mADC
 SG_ RLR_OBJ6_Dy : 209|11@0+ (0.1250000000,-128.0000000000) [-128.0000000000|127.8750000000] "m"  RRR_L,mADC
 SG_ RLR_OBJ5_Dx : 59|13@0+ (0.0625000000,-256.0000000000) [-256.0000000000|255.9380000000] "m"  RRR_L,mADC
 SG_ RLR_OBJ5_Dy : 54|11@0+ (0.1250000000,-128.0000000000) [-128.0000000000|127.8750000000] "m"  RRR_L,mADC
 SG_ RLR_OBJ6_Vx : 310|12@0+ (0.0625000000,-128.0000000000) [-128.0000000000|127.9380000000] "m/s"  RRR_L,mADC
 SG_ RLR_OBJ6_Vy : 288|10@0+ (0.0625000000,-32.0000000000) [-32.0000000000|31.9375000000] "m/s"  RRR_L,mADC
 SG_ RLR_OBJ6_Convergence : 458|1@0+ (1.0000000000,0.0000000000) [0.0000000000|1.0000000000] ""  RRR_L,mADC
 SG_ RLR_OBJ6_DelayTime : 453|10@0+ (1.0000000000,0.0000000000) [0.0000000000|1023.0000000000] "ms"  RRR_L,mADC
 SG_ RLR_OBJ6_HeightGround : 424|9@0+ (0.1000000000,0.0000000000) [0.0000000000|51.1000000000] "m"  RRR_L,mADC
 SG_ RLR_OBJ6_MotionStatus : 470|3@0+ (1.0000000000,0.0000000000) [0.0000000000|7.0000000000] ""  RRR_L,mADC
 SG_ RLR_OBJ6_RelVx_std : 413|12@0+ (0.0625000000,0.0000000000) [0.0000000000|255.9375000000] "m/s"  RRR_L,mADC
 SG_ RLR_OBJ6_RelVy_std : 407|10@0+ (0.1250000000,0.0000000000) [0.0000000000|127.8750000000] "m/s"  RRR_L,mADC
 SG_ RLR_OBJ6_Dx_Vnce : 389|14@0+ (0.0500000000,0.0000000000) [0.0000000000|50.0000000000] "m2"  RRR_L,mADC
 SG_ RLR_OBJ6_Dy_Vnce : 383|10@0+ (0.0200000000,0.0000000000) [0.0000000000|20.0000000000] "m2"  RRR_L,mADC
 SG_ RLR_OBJ5_Vx : 139|12@0+ (0.0625000000,-128.0000000000) [-128.0000000000|127.9380000000] "m/s"  RRR_L,mADC
 SG_ RLR_OBJ5_Vy : 133|10@0+ (0.0625000000,-32.0000000000) [-32.0000000000|31.9375000000] "m/s"  RRR_L,mADC
 SG_ RLR_OBJ5_Convergence : 459|1@0+ (1.0000000000,0.0000000000) [0.0000000000|1.0000000000] ""  RRR_L,mADC
 SG_ RLR_OBJ5_DelayTime : 447|10@0+ (1.0000000000,0.0000000000) [0.0000000000|1023.0000000000] "ms"  RRR_L,mADC
 SG_ RLR_OBJ5_HeightGround : 417|9@0+ (0.1000000000,0.0000000000) [0.0000000000|51.1000000000] "m"  RRR_L,mADC
 SG_ RLR_OBJ5_MotionStatus : 457|3@0+ (1.0000000000,0.0000000000) [0.0000000000|7.0000000000] ""  RRR_L,mADC
 SG_ RLR_OBJ5_RelVx_std : 363|12@0+ (0.0625000000,0.0000000000) [0.0000000000|255.9375000000] "m/s"  RRR_L,mADC
 SG_ RLR_OBJ5_RelVy_std : 357|10@0+ (0.1250000000,0.0000000000) [0.0000000000|127.8750000000] "m/s"  RRR_L,mADC
 SG_ RLR_OBJ5_Dx_Vnce : 339|14@0+ (0.0500000000,0.0000000000) [0.0000000000|50.0000000000] "m2"  RRR_L,mADC
 SG_ RLR_OBJ5_Dy_Vnce : 333|10@0+ (0.0200000000,0.0000000000) [0.0000000000|20.0000000000] "m2"  RRR_L,mADC
 SG_ RLR_CRCCheck_352 : 503|16@0+ (1.0000000000,0.0000000000) [0.0000000000|65535.0000000000] ""  RRR_L,mADC
 SG_ RLR_RollingCounter_352 : 491|4@0+ (1.0000000000,0.0000000000) [0.0000000000|15.0000000000] ""  RRR_L,mADC
 SG_ RLR_OBJ6_Track_Age : 325|8@0+ (1.0000000000,0.0000000000) [0.0000000000|255.0000000000] ""  RRR_L,mADC
 SG_ RLR_OBJ6_ReRPointLoc : 312|3@0+ (1.0000000000,0.0000000000) [0.0000000000|7.0000000000] ""  RRR_L,mADC
 SG_ RLR_OBJ6_ObstacleProb : 294|6@0+ (2.0000000000,0.0000000000) [0.0000000000|100.0000000000] "%"  RRR_L,mADC
 SG_ RLR_OBJ6_Measured : 280|2@0+ (1.0000000000,0.0000000000) [0.0000000000|3.0000000000] ""  RRR_L,mADC
 SG_ RLR_OBJ6_ExistProb : 286|6@0+ (2.0000000000,0.0000000000) [0.0000000000|100.0000000000] "%"  RRR_L,mADC
 SG_ RLR_OBJ6_Location : 272|2@0+ (1.0000000000,0.0000000000) [0.0000000000|3.0000000000] ""  RRR_L,mADC
 SG_ RLR_OBJ6_RelAx : 265|9@0+ (0.0625000000,-16.0000000000) [-16.0000000000|15.9375000000] "m/s2"  RRR_L,mADC
 SG_ RLR_OBJ6_RelAy : 259|10@0+ (0.0312500000,-16.0000000000) [-16.0000000000|15.9688000000] "m/s2"  RRR_L,mADC
 SG_ RLR_OBJ6_RelVx : 255|12@0+ (0.0625000000,-128.0000000000) [-128.0000000000|127.9380000000] "m/s"  RRR_L,mADC
 SG_ RLR_OBJ6_RelVy : 233|10@0+ (0.0625000000,-32.0000000000) [-32.0000000000|63.8750000000] "m/s"  RRR_L,mADC
 SG_ RLR_OBJ6_HeadingAngle : 203|10@0+ (0.0100000000,-3.1400000000) [-3.1400000000|3.1400000000] "rad"  RRR_L,mADC
 SG_ RLR_OBJ6_Length : 196|9@0+ (0.0500000000,0.0000000000) [0.0000000000|25.5000000000] "m"  RRR_L,mADC
 SG_ RLR_OBJ6_Height : 189|9@0+ (0.0100000000,0.0000000000) [0.0000000000|5.1100000000] "m"  RRR_L,mADC
 SG_ RLR_OBJ6_Width : 168|11@0+ (0.0100000000,0.0000000000) [0.0000000000|12.0000000000] "m"  RRR_L,mADC
 SG_ RLR_OBJ6_Type : 171|3@0+ (1.0000000000,0.0000000000) [0.0000000000|7.0000000000] ""  RRR_L,mADC
 SG_ RLR_OBJ6_Track_ID : 162|7@0+ (1.0000000000,0.0000000000) [0.0000000000|127.0000000000] ""  RRR_L,mADC
 SG_ RLR_OBJ5_Track_Age : 154|8@0+ (1.0000000000,0.0000000000) [0.0000000000|255.0000000000] ""  RRR_L,mADC
 SG_ RLR_OBJ5_ReRPointLoc : 157|3@0+ (1.0000000000,0.0000000000) [0.0000000000|7.0000000000] ""  RRR_L,mADC
 SG_ RLR_OBJ5_ObstacleProb : 123|6@0+ (2.0000000000,0.0000000000) [0.0000000000|100.0000000000] "%"  RRR_L,mADC
 SG_ RLR_OBJ5_Measured : 125|2@0+ (1.0000000000,0.0000000000) [0.0000000000|3.0000000000] ""  RRR_L,mADC
 SG_ RLR_OBJ5_ExistProb : 115|6@0+ (2.0000000000,0.0000000000) [0.0000000000|100.0000000000] "%"  RRR_L,mADC
 SG_ RLR_OBJ5_Location : 117|2@0+ (1.0000000000,0.0000000000) [0.0000000000|3.0000000000] ""  RRR_L,mADC
 SG_ RLR_OBJ5_RelAx : 110|9@0+ (0.0625000000,-16.0000000000) [-16.0000000000|15.9375000000] "m/s2"  RRR_L,mADC
 SG_ RLR_OBJ5_RelAy : 88|10@0+ (0.0312500000,-16.0000000000) [-16.0000000000|15.9688000000] "m/s2"  RRR_L,mADC
 SG_ RLR_OBJ5_RelVx : 84|12@0+ (0.0625000000,-128.0000000000) [-128.0000000000|127.9380000000] "m/s"  RRR_L,mADC
 SG_ RLR_OBJ5_RelVy : 78|10@0+ (0.0625000000,-32.0000000000) [-32.0000000000|63.8750000000] "m/s"  RRR_L,mADC
 SG_ RLR_OBJ5_HeadingAngle : 32|10@0+ (0.0100000000,-3.1400000000) [-3.1400000000|3.1400000000] "rad"  RRR_L,mADC
 SG_ RLR_OBJ5_Length : 25|9@0+ (0.0500000000,0.0000000000) [0.0000000000|25.5000000000] "m"  RRR_L,mADC
 SG_ RLR_OBJ5_Height : 18|9@0+ (0.0100000000,0.0000000000) [0.0000000000|5.1100000000] "m"  RRR_L,mADC
 SG_ RLR_OBJ5_Width : 13|11@0+ (0.0100000000,0.0000000000) [0.0000000000|12.0000000000] "m"  RRR_L,mADC
 SG_ RLR_OBJ5_Type : 0|3@0+ (1.0000000000,0.0000000000) [0.0000000000|7.0000000000] ""  RRR_L,mADC
 SG_ RLR_OBJ5_Track_ID : 7|7@0+ (1.0000000000,0.0000000000) [0.0000000000|127.0000000000] ""  RRR_L,mADC

BO_ 851 RLR_L_353: 64 RLR_L
 SG_ RLR_OBJ8_LostCnt : 483|4@0+ (1.0000000000,0.0000000000) [0.0000000000|15.0000000000] ""  RRR_L,mADC
 SG_ RLR_OBJ7_LostCnt : 495|4@0+ (1.0000000000,0.0000000000) [0.0000000000|15.0000000000] ""  RRR_L,mADC
 SG_ RLR_OBJ8_Dx : 230|13@0+ (0.0625000000,-256.0000000000) [-256.0000000000|255.9380000000] "m"  RRR_L,mADC
 SG_ RLR_OBJ8_Dy : 209|11@0+ (0.1250000000,-128.0000000000) [-128.0000000000|127.8750000000] "m"  RRR_L,mADC
 SG_ RLR_OBJ7_Dx : 59|13@0+ (0.0625000000,-256.0000000000) [-256.0000000000|255.9380000000] "m"  RRR_L,mADC
 SG_ RLR_OBJ7_Dy : 54|11@0+ (0.1250000000,-128.0000000000) [-128.0000000000|127.8750000000] "m"  RRR_L,mADC
 SG_ RLR_OBJ8_Vx : 310|12@0+ (0.0625000000,-128.0000000000) [-128.0000000000|127.9380000000] "m/s"  RRR_L,mADC
 SG_ RLR_OBJ8_Vy : 288|10@0+ (0.0625000000,-32.0000000000) [-32.0000000000|31.9375000000] "m/s"  RRR_L,mADC
 SG_ RLR_OBJ8_Convergence : 458|1@0+ (1.0000000000,0.0000000000) [0.0000000000|1.0000000000] ""  RRR_L,mADC
 SG_ RLR_OBJ8_DelayTime : 453|10@0+ (1.0000000000,0.0000000000) [0.0000000000|1023.0000000000] "ms"  RRR_L,mADC
 SG_ RLR_OBJ8_HeightGround : 424|9@0+ (0.1000000000,0.0000000000) [0.0000000000|51.1000000000] "m"  RRR_L,mADC
 SG_ RLR_OBJ8_MotionStatus : 470|3@0+ (1.0000000000,0.0000000000) [0.0000000000|7.0000000000] ""  RRR_L,mADC
 SG_ RLR_OBJ8_RelVx_std : 413|12@0+ (0.0625000000,0.0000000000) [0.0000000000|255.9375000000] "m/s"  RRR_L,mADC
 SG_ RLR_OBJ8_RelVy_std : 407|10@0+ (0.1250000000,0.0000000000) [0.0000000000|127.8750000000] "m/s"  RRR_L,mADC
 SG_ RLR_OBJ8_Dx_Vnce : 389|14@0+ (0.0500000000,0.0000000000) [0.0000000000|50.0000000000] "m2"  RRR_L,mADC
 SG_ RLR_OBJ8_Dy_Vnce : 383|10@0+ (0.0200000000,0.0000000000) [0.0000000000|20.0000000000] "m2"  RRR_L,mADC
 SG_ RLR_OBJ7_Vx : 139|12@0+ (0.0625000000,-128.0000000000) [-128.0000000000|127.9380000000] "m/s"  RRR_L,mADC
 SG_ RLR_OBJ7_Vy : 133|10@0+ (0.0625000000,-32.0000000000) [-32.0000000000|31.9375000000] "m/s"  RRR_L,mADC
 SG_ RLR_OBJ7_Convergence : 459|1@0+ (1.0000000000,0.0000000000) [0.0000000000|1.0000000000] ""  RRR_L,mADC
 SG_ RLR_OBJ7_DelayTime : 447|10@0+ (1.0000000000,0.0000000000) [0.0000000000|1023.0000000000] "ms"  RRR_L,mADC
 SG_ RLR_OBJ7_HeightGround : 417|9@0+ (0.1000000000,0.0000000000) [0.0000000000|51.1000000000] "m"  RRR_L,mADC
 SG_ RLR_OBJ7_MotionStatus : 457|3@0+ (1.0000000000,0.0000000000) [0.0000000000|7.0000000000] ""  RRR_L,mADC
 SG_ RLR_OBJ7_RelVx_std : 363|12@0+ (0.0625000000,0.0000000000) [0.0000000000|255.9375000000] "m/s"  RRR_L,mADC
 SG_ RLR_OBJ7_RelVy_std : 357|10@0+ (0.1250000000,0.0000000000) [0.0000000000|127.8750000000] "m/s"  RRR_L,mADC
 SG_ RLR_OBJ7_Dx_Vnce : 339|14@0+ (0.0500000000,0.0000000000) [0.0000000000|50.0000000000] "m2"  RRR_L,mADC
 SG_ RLR_OBJ7_Dy_Vnce : 333|10@0+ (0.0200000000,0.0000000000) [0.0000000000|20.0000000000] "m2"  RRR_L,mADC
 SG_ RLR_CRCCheck_353 : 503|16@0+ (1.0000000000,0.0000000000) [0.0000000000|65535.0000000000] ""  RRR_L,mADC
 SG_ RLR_RollingCounter_353 : 491|4@0+ (1.0000000000,0.0000000000) [0.0000000000|15.0000000000] ""  RRR_L,mADC
 SG_ RLR_OBJ8_Track_Age : 325|8@0+ (1.0000000000,0.0000000000) [0.0000000000|255.0000000000] ""  RRR_L,mADC
 SG_ RLR_OBJ8_ReRPointLoc : 312|3@0+ (1.0000000000,0.0000000000) [0.0000000000|7.0000000000] ""  RRR_L,mADC
 SG_ RLR_OBJ8_ObstacleProb : 294|6@0+ (2.0000000000,0.0000000000) [0.0000000000|100.0000000000] "%"  RRR_L,mADC
 SG_ RLR_OBJ8_Measured : 280|2@0+ (1.0000000000,0.0000000000) [0.0000000000|3.0000000000] ""  RRR_L,mADC
 SG_ RLR_OBJ8_ExistProb : 286|6@0+ (2.0000000000,0.0000000000) [0.0000000000|100.0000000000] "%"  RRR_L,mADC
 SG_ RLR_OBJ8_Location : 272|2@0+ (1.0000000000,0.0000000000) [0.0000000000|3.0000000000] ""  RRR_L,mADC
 SG_ RLR_OBJ8_RelAx : 265|9@0+ (0.0625000000,-16.0000000000) [-16.0000000000|15.9375000000] "m/s2"  RRR_L,mADC
 SG_ RLR_OBJ8_RelAy : 259|10@0+ (0.0312500000,-16.0000000000) [-16.0000000000|15.9688000000] "m/s2"  RRR_L,mADC
 SG_ RLR_OBJ8_RelVx : 255|12@0+ (0.0625000000,-128.0000000000) [-128.0000000000|127.9380000000] "m/s"  RRR_L,mADC
 SG_ RLR_OBJ8_RelVy : 233|10@0+ (0.0625000000,-32.0000000000) [-32.0000000000|63.8750000000] "m/s"  RRR_L,mADC
 SG_ RLR_OBJ8_HeadingAngle : 203|10@0+ (0.0100000000,-3.1400000000) [-3.1400000000|3.1400000000] "rad"  RRR_L,mADC
 SG_ RLR_OBJ8_Length : 196|9@0+ (0.0500000000,0.0000000000) [0.0000000000|25.5000000000] "m"  RRR_L,mADC
 SG_ RLR_OBJ8_Height : 189|9@0+ (0.0100000000,0.0000000000) [0.0000000000|5.1100000000] "m"  RRR_L,mADC
 SG_ RLR_OBJ8_Width : 168|11@0+ (0.0100000000,0.0000000000) [0.0000000000|12.0000000000] "m"  RRR_L,mADC
 SG_ RLR_OBJ8_Type : 171|3@0+ (1.0000000000,0.0000000000) [0.0000000000|7.0000000000] ""  RRR_L,mADC
 SG_ RLR_OBJ8_Track_ID : 162|7@0+ (1.0000000000,0.0000000000) [0.0000000000|127.0000000000] ""  RRR_L,mADC
 SG_ RLR_OBJ7_Track_Age : 154|8@0+ (1.0000000000,0.0000000000) [0.0000000000|255.0000000000] ""  RRR_L,mADC
 SG_ RLR_OBJ7_ReRPointLoc : 157|3@0+ (1.0000000000,0.0000000000) [0.0000000000|7.0000000000] ""  RRR_L,mADC
 SG_ RLR_OBJ7_ObstacleProb : 123|6@0+ (2.0000000000,0.0000000000) [0.0000000000|100.0000000000] "%"  RRR_L,mADC
 SG_ RLR_OBJ7_Measured : 125|2@0+ (1.0000000000,0.0000000000) [0.0000000000|3.0000000000] ""  RRR_L,mADC
 SG_ RLR_OBJ7_ExistProb : 115|6@0+ (2.0000000000,0.0000000000) [0.0000000000|100.0000000000] "%"  RRR_L,mADC
 SG_ RLR_OBJ7_Location : 117|2@0+ (1.0000000000,0.0000000000) [0.0000000000|3.0000000000] ""  RRR_L,mADC
 SG_ RLR_OBJ7_RelAx : 110|9@0+ (0.0625000000,-16.0000000000) [-16.0000000000|15.9375000000] "m/s2"  RRR_L,mADC
 SG_ RLR_OBJ7_RelAy : 88|10@0+ (0.0312500000,-16.0000000000) [-16.0000000000|15.9688000000] "m/s2"  RRR_L,mADC
 SG_ RLR_OBJ7_RelVx : 84|12@0+ (0.0625000000,-128.0000000000) [-128.0000000000|127.9380000000] "m/s"  RRR_L,mADC
 SG_ RLR_OBJ7_RelVy : 78|10@0+ (0.0625000000,-32.0000000000) [-32.0000000000|63.8750000000] "m/s"  RRR_L,mADC
 SG_ RLR_OBJ7_HeadingAngle : 32|10@0+ (0.0100000000,-3.1400000000) [-3.1400000000|3.1400000000] "rad"  RRR_L,mADC
 SG_ RLR_OBJ7_Length : 25|9@0+ (0.0500000000,0.0000000000) [0.0000000000|25.5000000000] "m"  RRR_L,mADC
 SG_ RLR_OBJ7_Height : 18|9@0+ (0.0100000000,0.0000000000) [0.0000000000|5.1100000000] "m"  RRR_L,mADC
 SG_ RLR_OBJ7_Width : 13|11@0+ (0.0100000000,0.0000000000) [0.0000000000|12.0000000000] "m"  RRR_L,mADC
 SG_ RLR_OBJ7_Type : 0|3@0+ (1.0000000000,0.0000000000) [0.0000000000|7.0000000000] ""  RRR_L,mADC
 SG_ RLR_OBJ7_Track_ID : 7|7@0+ (1.0000000000,0.0000000000) [0.0000000000|127.0000000000] ""  RRR_L,mADC

BO_ 852 RLR_L_354: 64 RLR_L
 SG_ RLR_OBJ10_LostCnt : 483|4@0+ (1.0000000000,0.0000000000) [0.0000000000|15.0000000000] ""  RRR_L,mADC
 SG_ RLR_OBJ9_LostCnt : 495|4@0+ (1.0000000000,0.0000000000) [0.0000000000|15.0000000000] ""  RRR_L,mADC
 SG_ RLR_OBJ10_Dx : 230|13@0+ (0.0625000000,-256.0000000000) [-256.0000000000|255.9380000000] "m"  RRR_L,mADC
 SG_ RLR_OBJ10_Dy : 209|11@0+ (0.1250000000,-128.0000000000) [-128.0000000000|127.8750000000] "m"  RRR_L,mADC
 SG_ RLR_OBJ9_Dx : 59|13@0+ (0.0625000000,-256.0000000000) [-256.0000000000|255.9380000000] "m"  RRR_L,mADC
 SG_ RLR_OBJ9_Dy : 54|11@0+ (0.1250000000,-128.0000000000) [-128.0000000000|127.8750000000] "m"  RRR_L,mADC
 SG_ RLR_OBJ10_Vx : 310|12@0+ (0.0625000000,-128.0000000000) [-128.0000000000|127.9380000000] "m/s"  RRR_L,mADC
 SG_ RLR_OBJ10_Vy : 288|10@0+ (0.0625000000,-32.0000000000) [-32.0000000000|31.9375000000] "m/s"  RRR_L,mADC
 SG_ RLR_OBJ10_Convergence : 458|1@0+ (1.0000000000,0.0000000000) [0.0000000000|1.0000000000] ""  RRR_L,mADC
 SG_ RLR_OBJ10_DelayTime : 453|10@0+ (1.0000000000,0.0000000000) [0.0000000000|1023.0000000000] "ms"  RRR_L,mADC
 SG_ RLR_OBJ10_HeightGround : 424|9@0+ (0.1000000000,0.0000000000) [0.0000000000|51.1000000000] "m"  RRR_L,mADC
 SG_ RLR_OBJ10_MotionStatus : 470|3@0+ (1.0000000000,0.0000000000) [0.0000000000|7.0000000000] ""  RRR_L,mADC
 SG_ RLR_OBJ10_RelVx_std : 413|12@0+ (0.0625000000,0.0000000000) [0.0000000000|255.9375000000] "m/s"  RRR_L,mADC
 SG_ RLR_OBJ10_RelVy_std : 407|10@0+ (0.1250000000,0.0000000000) [0.0000000000|127.8750000000] "m/s"  RRR_L,mADC
 SG_ RLR_OBJ10_Dx_Vnce : 389|14@0+ (0.0500000000,0.0000000000) [0.0000000000|50.0000000000] "m2"  RRR_L,mADC
 SG_ RLR_OBJ10_Dy_Vnce : 383|10@0+ (0.0200000000,0.0000000000) [0.0000000000|20.0000000000] "m2"  RRR_L,mADC
 SG_ RLR_OBJ9_Vx : 139|12@0+ (0.0625000000,-128.0000000000) [-128.0000000000|127.9380000000] "m/s"  RRR_L,mADC
 SG_ RLR_OBJ9_Vy : 133|10@0+ (0.0625000000,-32.0000000000) [-32.0000000000|31.9375000000] "m/s"  RRR_L,mADC
 SG_ RLR_OBJ9_Convergence : 459|1@0+ (1.0000000000,0.0000000000) [0.0000000000|1.0000000000] ""  RRR_L,mADC
 SG_ RLR_OBJ9_DelayTime : 447|10@0+ (1.0000000000,0.0000000000) [0.0000000000|1023.0000000000] "ms"  RRR_L,mADC
 SG_ RLR_OBJ9_HeightGround : 417|9@0+ (0.1000000000,0.0000000000) [0.0000000000|51.1000000000] "m"  RRR_L,mADC
 SG_ RLR_OBJ9_MotionStatus : 457|3@0+ (1.0000000000,0.0000000000) [0.0000000000|7.0000000000] ""  RRR_L,mADC
 SG_ RLR_OBJ9_RelVx_std : 363|12@0+ (0.0625000000,0.0000000000) [0.0000000000|255.9375000000] "m/s"  RRR_L,mADC
 SG_ RLR_OBJ9_RelVy_std : 357|10@0+ (0.1250000000,0.0000000000) [0.0000000000|127.8750000000] "m/s"  RRR_L,mADC
 SG_ RLR_OBJ9_Dx_Vnce : 339|14@0+ (0.0500000000,0.0000000000) [0.0000000000|50.0000000000] "m2"  RRR_L,mADC
 SG_ RLR_OBJ9_Dy_Vnce : 333|10@0+ (0.0200000000,0.0000000000) [0.0000000000|20.0000000000] "m2"  RRR_L,mADC
 SG_ RLR_CRCCheck_354 : 503|16@0+ (1.0000000000,0.0000000000) [0.0000000000|65535.0000000000] ""  RRR_L,mADC
 SG_ RLR_RollingCounter_354 : 491|4@0+ (1.0000000000,0.0000000000) [0.0000000000|15.0000000000] ""  RRR_L,mADC
 SG_ RLR_OBJ10_Track_Age : 325|8@0+ (1.0000000000,0.0000000000) [0.0000000000|255.0000000000] ""  RRR_L,mADC
 SG_ RLR_OBJ10_ReRPointLoc : 312|3@0+ (1.0000000000,0.0000000000) [0.0000000000|7.0000000000] ""  RRR_L,mADC
 SG_ RLR_OBJ10_ObstacleProb : 294|6@0+ (2.0000000000,0.0000000000) [0.0000000000|100.0000000000] "%"  RRR_L,mADC
 SG_ RLR_OBJ10_Measured : 280|2@0+ (1.0000000000,0.0000000000) [0.0000000000|3.0000000000] ""  RRR_L,mADC
 SG_ RLR_OBJ10_ExistProb : 286|6@0+ (2.0000000000,0.0000000000) [0.0000000000|100.0000000000] "%"  RRR_L,mADC
 SG_ RLR_OBJ10_Location : 272|2@0+ (1.0000000000,0.0000000000) [0.0000000000|3.0000000000] ""  RRR_L,mADC
 SG_ RLR_OBJ10_RelAx : 265|9@0+ (0.0625000000,-16.0000000000) [-16.0000000000|15.9375000000] "m/s2"  RRR_L,mADC
 SG_ RLR_OBJ10_RelAy : 259|10@0+ (0.0312500000,-16.0000000000) [-16.0000000000|15.9688000000] "m/s2"  RRR_L,mADC
 SG_ RLR_OBJ10_RelVx : 255|12@0+ (0.0625000000,-128.0000000000) [-128.0000000000|127.9380000000] "m/s"  RRR_L,mADC
 SG_ RLR_OBJ10_RelVy : 233|10@0+ (0.0625000000,-32.0000000000) [-32.0000000000|63.8750000000] "m/s"  RRR_L,mADC
 SG_ RLR_OBJ10_HeadingAngle : 203|10@0+ (0.0100000000,-3.1400000000) [-3.1400000000|3.1400000000] "rad"  RRR_L,mADC
 SG_ RLR_OBJ10_Length : 196|9@0+ (0.0500000000,0.0000000000) [0.0000000000|25.5000000000] "m"  RRR_L,mADC
 SG_ RLR_OBJ10_Height : 189|9@0+ (0.0100000000,0.0000000000) [0.0000000000|5.1100000000] "m"  RRR_L,mADC
 SG_ RLR_OBJ10_Width : 168|11@0+ (0.0100000000,0.0000000000) [0.0000000000|12.0000000000] "m"  RRR_L,mADC
 SG_ RLR_OBJ10_Type : 171|3@0+ (1.0000000000,0.0000000000) [0.0000000000|7.0000000000] ""  RRR_L,mADC
 SG_ RLR_OBJ10_Track_ID : 162|7@0+ (1.0000000000,0.0000000000) [0.0000000000|127.0000000000] ""  RRR_L,mADC
 SG_ RLR_OBJ9_Track_Age : 154|8@0+ (1.0000000000,0.0000000000) [0.0000000000|255.0000000000] ""  RRR_L,mADC
 SG_ RLR_OBJ9_ReRPointLoc : 157|3@0+ (1.0000000000,0.0000000000) [0.0000000000|7.0000000000] ""  RRR_L,mADC
 SG_ RLR_OBJ9_ObstacleProb : 123|6@0+ (2.0000000000,0.0000000000) [0.0000000000|100.0000000000] "%"  RRR_L,mADC
 SG_ RLR_OBJ9_Measured : 125|2@0+ (1.0000000000,0.0000000000) [0.0000000000|3.0000000000] ""  RRR_L,mADC
 SG_ RLR_OBJ9_ExistProb : 115|6@0+ (2.0000000000,0.0000000000) [0.0000000000|100.0000000000] "%"  RRR_L,mADC
 SG_ RLR_OBJ9_Location : 117|2@0+ (1.0000000000,0.0000000000) [0.0000000000|3.0000000000] ""  RRR_L,mADC
 SG_ RLR_OBJ9_RelAx : 110|9@0+ (0.0625000000,-16.0000000000) [-16.0000000000|15.9375000000] "m/s2"  RRR_L,mADC
 SG_ RLR_OBJ9_RelAy : 88|10@0+ (0.0312500000,-16.0000000000) [-16.0000000000|15.9688000000] "m/s2"  RRR_L,mADC
 SG_ RLR_OBJ9_RelVx : 84|12@0+ (0.0625000000,-128.0000000000) [-128.0000000000|127.9380000000] "m/s"  RRR_L,mADC
 SG_ RLR_OBJ9_RelVy : 78|10@0+ (0.0625000000,-32.0000000000) [-32.0000000000|63.8750000000] "m/s"  RRR_L,mADC
 SG_ RLR_OBJ9_HeadingAngle : 32|10@0+ (0.0100000000,-3.1400000000) [-3.1400000000|3.1400000000] "rad"  RRR_L,mADC
 SG_ RLR_OBJ9_Length : 25|9@0+ (0.0500000000,0.0000000000) [0.0000000000|25.5000000000] "m"  RRR_L,mADC
 SG_ RLR_OBJ9_Height : 18|9@0+ (0.0100000000,0.0000000000) [0.0000000000|5.1100000000] "m"  RRR_L,mADC
 SG_ RLR_OBJ9_Width : 13|11@0+ (0.0100000000,0.0000000000) [0.0000000000|12.0000000000] "m"  RRR_L,mADC
 SG_ RLR_OBJ9_Type : 0|3@0+ (1.0000000000,0.0000000000) [0.0000000000|7.0000000000] ""  RRR_L,mADC
 SG_ RLR_OBJ9_Track_ID : 7|7@0+ (1.0000000000,0.0000000000) [0.0000000000|127.0000000000] ""  RRR_L,mADC

BO_ 853 RLR_L_355: 64 RLR_L
 SG_ RLR_OBJ12_LostCnt : 483|4@0+ (1.0000000000,0.0000000000) [0.0000000000|15.0000000000] ""  RRR_L,mADC
 SG_ RLR_OBJ11_LostCnt : 495|4@0+ (1.0000000000,0.0000000000) [0.0000000000|15.0000000000] ""  RRR_L,mADC
 SG_ RLR_OBJ12_Dx : 230|13@0+ (0.0625000000,-256.0000000000) [-256.0000000000|255.9380000000] "m"  RRR_L,mADC
 SG_ RLR_OBJ12_Dy : 209|11@0+ (0.1250000000,-128.0000000000) [-128.0000000000|127.8750000000] "m"  RRR_L,mADC
 SG_ RLR_OBJ11_Dx : 59|13@0+ (0.0625000000,-256.0000000000) [-256.0000000000|255.9380000000] "m"  RRR_L,mADC
 SG_ RLR_OBJ11_Dy : 54|11@0+ (0.1250000000,-128.0000000000) [-128.0000000000|127.8750000000] "m"  RRR_L,mADC
 SG_ RLR_OBJ12_Vx : 310|12@0+ (0.0625000000,-128.0000000000) [-128.0000000000|127.9380000000] "m/s"  RRR_L,mADC
 SG_ RLR_OBJ12_Vy : 288|10@0+ (0.0625000000,-32.0000000000) [-32.0000000000|31.9375000000] "m/s"  RRR_L,mADC
 SG_ RLR_OBJ12_Convergence : 458|1@0+ (1.0000000000,0.0000000000) [0.0000000000|1.0000000000] ""  RRR_L,mADC
 SG_ RLR_OBJ12_DelayTime : 453|10@0+ (1.0000000000,0.0000000000) [0.0000000000|1023.0000000000] "ms"  RRR_L,mADC
 SG_ RLR_OBJ12_HeightGround : 424|9@0+ (0.1000000000,0.0000000000) [0.0000000000|51.1000000000] "m"  RRR_L,mADC
 SG_ RLR_OBJ12_MotionStatus : 470|3@0+ (1.0000000000,0.0000000000) [0.0000000000|7.0000000000] ""  RRR_L,mADC
 SG_ RLR_OBJ12_RelVx_std : 413|12@0+ (0.0625000000,0.0000000000) [0.0000000000|255.9375000000] "m/s"  RRR_L,mADC
 SG_ RLR_OBJ12_RelVy_std : 407|10@0+ (0.1250000000,0.0000000000) [0.0000000000|127.8750000000] "m/s"  RRR_L,mADC
 SG_ RLR_OBJ12_Dx_Vnce : 389|14@0+ (0.0500000000,0.0000000000) [0.0000000000|50.0000000000] "m2"  RRR_L,mADC
 SG_ RLR_OBJ12_Dy_Vnce : 383|10@0+ (0.0200000000,0.0000000000) [0.0000000000|20.0000000000] "m2"  RRR_L,mADC
 SG_ RLR_OBJ11_Vx : 139|12@0+ (0.0625000000,-128.0000000000) [-128.0000000000|127.9380000000] "m/s"  RRR_L,mADC
 SG_ RLR_OBJ11_Vy : 133|10@0+ (0.0625000000,-32.0000000000) [-32.0000000000|31.9375000000] "m/s"  RRR_L,mADC
 SG_ RLR_OBJ11_Convergence : 459|1@0+ (1.0000000000,0.0000000000) [0.0000000000|1.0000000000] ""  RRR_L,mADC
 SG_ RLR_OBJ11_DelayTime : 447|10@0+ (1.0000000000,0.0000000000) [0.0000000000|1023.0000000000] "ms"  RRR_L,mADC
 SG_ RLR_OBJ11_HeightGround : 417|9@0+ (0.1000000000,0.0000000000) [0.0000000000|51.1000000000] "m"  RRR_L,mADC
 SG_ RLR_OBJ11_MotionStatus : 457|3@0+ (1.0000000000,0.0000000000) [0.0000000000|7.0000000000] ""  RRR_L,mADC
 SG_ RLR_OBJ11_RelVx_std : 363|12@0+ (0.0625000000,0.0000000000) [0.0000000000|255.9375000000] "m/s"  RRR_L,mADC
 SG_ RLR_OBJ11_RelVy_std : 357|10@0+ (0.1250000000,0.0000000000) [0.0000000000|127.8750000000] "m/s"  RRR_L,mADC
 SG_ RLR_OBJ11_Dx_Vnce : 339|14@0+ (0.0500000000,0.0000000000) [0.0000000000|50.0000000000] "m2"  RRR_L,mADC
 SG_ RLR_OBJ11_Dy_Vnce : 333|10@0+ (0.0200000000,0.0000000000) [0.0000000000|20.0000000000] "m2"  RRR_L,mADC
 SG_ RLR_CRCCheck_355 : 503|16@0+ (1.0000000000,0.0000000000) [0.0000000000|65535.0000000000] ""  RRR_L,mADC
 SG_ RLR_RollingCounter_355 : 491|4@0+ (1.0000000000,0.0000000000) [0.0000000000|15.0000000000] ""  RRR_L,mADC
 SG_ RLR_OBJ12_Track_Age : 325|8@0+ (1.0000000000,0.0000000000) [0.0000000000|255.0000000000] ""  RRR_L,mADC
 SG_ RLR_OBJ12_ReRPointLoc : 312|3@0+ (1.0000000000,0.0000000000) [0.0000000000|7.0000000000] ""  RRR_L,mADC
 SG_ RLR_OBJ12_ObstacleProb : 294|6@0+ (2.0000000000,0.0000000000) [0.0000000000|100.0000000000] "%"  RRR_L,mADC
 SG_ RLR_OBJ12_Measured : 280|2@0+ (1.0000000000,0.0000000000) [0.0000000000|3.0000000000] ""  RRR_L,mADC
 SG_ RLR_OBJ12_ExistProb : 286|6@0+ (2.0000000000,0.0000000000) [0.0000000000|100.0000000000] "%"  RRR_L,mADC
 SG_ RLR_OBJ12_Location : 272|2@0+ (1.0000000000,0.0000000000) [0.0000000000|3.0000000000] ""  RRR_L,mADC
 SG_ RLR_OBJ12_RelAx : 265|9@0+ (0.0625000000,-16.0000000000) [-16.0000000000|15.9375000000] "m/s2"  RRR_L,mADC
 SG_ RLR_OBJ12_RelAy : 259|10@0+ (0.0312500000,-16.0000000000) [-16.0000000000|15.9688000000] "m/s2"  RRR_L,mADC
 SG_ RLR_OBJ12_RelVx : 255|12@0+ (0.0625000000,-128.0000000000) [-128.0000000000|127.9380000000] "m/s"  RRR_L,mADC
 SG_ RLR_OBJ12_RelVy : 233|10@0+ (0.0625000000,-32.0000000000) [-32.0000000000|63.8750000000] "m/s"  RRR_L,mADC
 SG_ RLR_OBJ12_HeadingAngle : 203|10@0+ (0.0100000000,-3.1400000000) [-3.1400000000|3.1400000000] "rad"  RRR_L,mADC
 SG_ RLR_OBJ12_Length : 196|9@0+ (0.0500000000,0.0000000000) [0.0000000000|25.5000000000] "m"  RRR_L,mADC
 SG_ RLR_OBJ12_Height : 189|9@0+ (0.0100000000,0.0000000000) [0.0000000000|5.1100000000] "m"  RRR_L,mADC
 SG_ RLR_OBJ12_Width : 168|11@0+ (0.0100000000,0.0000000000) [0.0000000000|12.0000000000] "m"  RRR_L,mADC
 SG_ RLR_OBJ12_Type : 171|3@0+ (1.0000000000,0.0000000000) [0.0000000000|7.0000000000] ""  RRR_L,mADC
 SG_ RLR_OBJ12_Track_ID : 162|7@0+ (1.0000000000,0.0000000000) [0.0000000000|127.0000000000] ""  RRR_L,mADC
 SG_ RLR_OBJ11_Track_Age : 154|8@0+ (1.0000000000,0.0000000000) [0.0000000000|255.0000000000] ""  RRR_L,mADC
 SG_ RLR_OBJ11_ReRPointLoc : 157|3@0+ (1.0000000000,0.0000000000) [0.0000000000|7.0000000000] ""  RRR_L,mADC
 SG_ RLR_OBJ11_ObstacleProb : 123|6@0+ (2.0000000000,0.0000000000) [0.0000000000|100.0000000000] "%"  RRR_L,mADC
 SG_ RLR_OBJ11_Measured : 125|2@0+ (1.0000000000,0.0000000000) [0.0000000000|3.0000000000] ""  RRR_L,mADC
 SG_ RLR_OBJ11_ExistProb : 115|6@0+ (2.0000000000,0.0000000000) [0.0000000000|100.0000000000] "%"  RRR_L,mADC
 SG_ RLR_OBJ11_Location : 117|2@0+ (1.0000000000,0.0000000000) [0.0000000000|3.0000000000] ""  RRR_L,mADC
 SG_ RLR_OBJ11_RelAx : 110|9@0+ (0.0625000000,-16.0000000000) [-16.0000000000|15.9375000000] "m/s2"  RRR_L,mADC
 SG_ RLR_OBJ11_RelAy : 88|10@0+ (0.0312500000,-16.0000000000) [-16.0000000000|15.9688000000] "m/s2"  RRR_L,mADC
 SG_ RLR_OBJ11_RelVx : 84|12@0+ (0.0625000000,-128.0000000000) [-128.0000000000|127.9380000000] "m/s"  RRR_L,mADC
 SG_ RLR_OBJ11_RelVy : 78|10@0+ (0.0625000000,-32.0000000000) [-32.0000000000|63.8750000000] "m/s"  RRR_L,mADC
 SG_ RLR_OBJ11_HeadingAngle : 32|10@0+ (0.0100000000,-3.1400000000) [-3.1400000000|3.1400000000] "rad"  RRR_L,mADC
 SG_ RLR_OBJ11_Length : 25|9@0+ (0.0500000000,0.0000000000) [0.0000000000|25.5000000000] "m"  RRR_L,mADC
 SG_ RLR_OBJ11_Height : 18|9@0+ (0.0100000000,0.0000000000) [0.0000000000|5.1100000000] "m"  RRR_L,mADC
 SG_ RLR_OBJ11_Width : 13|11@0+ (0.0100000000,0.0000000000) [0.0000000000|12.0000000000] "m"  RRR_L,mADC
 SG_ RLR_OBJ11_Type : 0|3@0+ (1.0000000000,0.0000000000) [0.0000000000|7.0000000000] ""  RRR_L,mADC
 SG_ RLR_OBJ11_Track_ID : 7|7@0+ (1.0000000000,0.0000000000) [0.0000000000|127.0000000000] ""  RRR_L,mADC

BO_ 865 RLR_L_361: 64 RLR_L
 SG_ RLR_OBJ14_LostCnt : 483|4@0+ (1.0000000000,0.0000000000) [0.0000000000|15.0000000000] ""  RRR_L,mADC
 SG_ RLR_OBJ13_LostCnt : 495|4@0+ (1.0000000000,0.0000000000) [0.0000000000|15.0000000000] ""  RRR_L,mADC
 SG_ RLR_OBJ14_Dx : 230|13@0+ (0.0625000000,-256.0000000000) [-256.0000000000|255.9380000000] "m"  RRR_L,mADC
 SG_ RLR_OBJ14_Dy : 209|11@0+ (0.1250000000,-128.0000000000) [-128.0000000000|127.8750000000] "m"  RRR_L,mADC
 SG_ RLR_OBJ13_Dx : 59|13@0+ (0.0625000000,-256.0000000000) [-256.0000000000|255.9380000000] "m"  RRR_L,mADC
 SG_ RLR_OBJ13_Dy : 54|11@0+ (0.1250000000,-128.0000000000) [-128.0000000000|127.8750000000] "m"  RRR_L,mADC
 SG_ RLR_OBJ14_Vx : 310|12@0+ (0.0625000000,-128.0000000000) [-128.0000000000|127.9380000000] "m/s"  RRR_L,mADC
 SG_ RLR_OBJ14_Vy : 288|10@0+ (0.0625000000,-32.0000000000) [-32.0000000000|31.9375000000] "m/s"  RRR_L,mADC
 SG_ RLR_OBJ14_Convergence : 458|1@0+ (1.0000000000,0.0000000000) [0.0000000000|1.0000000000] ""  RRR_L,mADC
 SG_ RLR_OBJ14_DelayTime : 453|10@0+ (1.0000000000,0.0000000000) [0.0000000000|1023.0000000000] "ms"  RRR_L,mADC
 SG_ RLR_OBJ14_HeightGround : 424|9@0+ (0.1000000000,0.0000000000) [0.0000000000|51.1000000000] "m"  RRR_L,mADC
 SG_ RLR_OBJ14_MotionStatus : 470|3@0+ (1.0000000000,0.0000000000) [0.0000000000|7.0000000000] ""  RRR_L,mADC
 SG_ RLR_OBJ14_RelVx_std : 413|12@0+ (0.0625000000,0.0000000000) [0.0000000000|255.9375000000] "m/s"  RRR_L,mADC
 SG_ RLR_OBJ14_RelVy_std : 407|10@0+ (0.1250000000,0.0000000000) [0.0000000000|127.8750000000] "m/s"  RRR_L,mADC
 SG_ RLR_OBJ14_Dx_Vnce : 389|14@0+ (0.0500000000,0.0000000000) [0.0000000000|50.0000000000] "m2"  RRR_L,mADC
 SG_ RLR_OBJ14_Dy_Vnce : 383|10@0+ (0.0200000000,0.0000000000) [0.0000000000|20.0000000000] "m2"  RRR_L,mADC
 SG_ RLR_OBJ13_Vx : 139|12@0+ (0.0625000000,-128.0000000000) [-128.0000000000|127.9380000000] "m/s"  RRR_L,mADC
 SG_ RLR_OBJ13_Vy : 133|10@0+ (0.0625000000,-32.0000000000) [-32.0000000000|31.9375000000] "m/s"  RRR_L,mADC
 SG_ RLR_OBJ13_Convergence : 459|1@0+ (1.0000000000,0.0000000000) [0.0000000000|1.0000000000] ""  RRR_L,mADC
 SG_ RLR_OBJ13_DelayTime : 447|10@0+ (1.0000000000,0.0000000000) [0.0000000000|1023.0000000000] "ms"  RRR_L,mADC
 SG_ RLR_OBJ13_HeightGround : 417|9@0+ (0.1000000000,0.0000000000) [0.0000000000|51.1000000000] "m"  RRR_L,mADC
 SG_ RLR_OBJ13_MotionStatus : 457|3@0+ (1.0000000000,0.0000000000) [0.0000000000|7.0000000000] ""  RRR_L,mADC
 SG_ RLR_OBJ13_RelVx_std : 363|12@0+ (0.0625000000,0.0000000000) [0.0000000000|255.9375000000] "m/s"  RRR_L,mADC
 SG_ RLR_OBJ13_RelVy_std : 357|10@0+ (0.1250000000,0.0000000000) [0.0000000000|127.8750000000] "m/s"  RRR_L,mADC
 SG_ RLR_OBJ13_Dx_Vnce : 339|14@0+ (0.0500000000,0.0000000000) [0.0000000000|50.0000000000] "m2"  RRR_L,mADC
 SG_ RLR_OBJ13_Dy_Vnce : 333|10@0+ (0.0200000000,0.0000000000) [0.0000000000|20.0000000000] "m2"  RRR_L,mADC
 SG_ RLR_CRCCheck_356 : 503|16@0+ (1.0000000000,0.0000000000) [0.0000000000|65535.0000000000] ""  RRR_L,mADC
 SG_ RLR_RollingCounter_356 : 491|4@0+ (1.0000000000,0.0000000000) [0.0000000000|15.0000000000] ""  RRR_L,mADC
 SG_ RLR_OBJ14_Track_Age : 325|8@0+ (1.0000000000,0.0000000000) [0.0000000000|255.0000000000] ""  RRR_L,mADC
 SG_ RLR_OBJ14_ReRPointLoc : 312|3@0+ (1.0000000000,0.0000000000) [0.0000000000|7.0000000000] ""  RRR_L,mADC
 SG_ RLR_OBJ14_ObstacleProb : 294|6@0+ (2.0000000000,0.0000000000) [0.0000000000|100.0000000000] "%"  RRR_L,mADC
 SG_ RLR_OBJ14_Measured : 280|2@0+ (1.0000000000,0.0000000000) [0.0000000000|3.0000000000] ""  RRR_L,mADC
 SG_ RLR_OBJ14_ExistProb : 286|6@0+ (2.0000000000,0.0000000000) [0.0000000000|100.0000000000] "%"  RRR_L,mADC
 SG_ RLR_OBJ14_Location : 272|2@0+ (1.0000000000,0.0000000000) [0.0000000000|3.0000000000] ""  RRR_L,mADC
 SG_ RLR_OBJ14_RelAx : 265|9@0+ (0.0625000000,-16.0000000000) [-16.0000000000|15.9375000000] "m/s2"  RRR_L,mADC
 SG_ RLR_OBJ14_RelAy : 259|10@0+ (0.0312500000,-16.0000000000) [-16.0000000000|15.9688000000] "m/s2"  RRR_L,mADC
 SG_ RLR_OBJ14_RelVx : 255|12@0+ (0.0625000000,-128.0000000000) [-128.0000000000|127.9380000000] "m/s"  RRR_L,mADC
 SG_ RLR_OBJ14_RelVy : 233|10@0+ (0.0625000000,-32.0000000000) [-32.0000000000|63.8750000000] "m/s"  RRR_L,mADC
 SG_ RLR_OBJ14_HeadingAngle : 203|10@0+ (0.0100000000,-3.1400000000) [-3.1400000000|3.1400000000] "rad"  RRR_L,mADC
 SG_ RLR_OBJ14_Length : 196|9@0+ (0.0500000000,0.0000000000) [0.0000000000|25.5000000000] "m"  RRR_L,mADC
 SG_ RLR_OBJ14_Height : 189|9@0+ (0.0100000000,0.0000000000) [0.0000000000|5.1100000000] "m"  RRR_L,mADC
 SG_ RLR_OBJ14_Width : 168|11@0+ (0.0100000000,0.0000000000) [0.0000000000|12.0000000000] "m"  RRR_L,mADC
 SG_ RLR_OBJ14_Type : 171|3@0+ (1.0000000000,0.0000000000) [0.0000000000|7.0000000000] ""  RRR_L,mADC
 SG_ RLR_OBJ14_Track_ID : 162|7@0+ (1.0000000000,0.0000000000) [0.0000000000|127.0000000000] ""  RRR_L,mADC
 SG_ RLR_OBJ13_Track_Age : 154|8@0+ (1.0000000000,0.0000000000) [0.0000000000|255.0000000000] ""  RRR_L,mADC
 SG_ RLR_OBJ13_ReRPointLoc : 157|3@0+ (1.0000000000,0.0000000000) [0.0000000000|7.0000000000] ""  RRR_L,mADC
 SG_ RLR_OBJ13_ObstacleProb : 123|6@0+ (2.0000000000,0.0000000000) [0.0000000000|100.0000000000] "%"  RRR_L,mADC
 SG_ RLR_OBJ13_Measured : 125|2@0+ (1.0000000000,0.0000000000) [0.0000000000|3.0000000000] ""  RRR_L,mADC
 SG_ RLR_OBJ13_ExistProb : 115|6@0+ (2.0000000000,0.0000000000) [0.0000000000|100.0000000000] "%"  RRR_L,mADC
 SG_ RLR_OBJ13_Location : 117|2@0+ (1.0000000000,0.0000000000) [0.0000000000|3.0000000000] ""  RRR_L,mADC
 SG_ RLR_OBJ13_RelAx : 110|9@0+ (0.0625000000,-16.0000000000) [-16.0000000000|15.9375000000] "m/s2"  RRR_L,mADC
 SG_ RLR_OBJ13_RelAy : 88|10@0+ (0.0312500000,-16.0000000000) [-16.0000000000|15.9688000000] "m/s2"  RRR_L,mADC
 SG_ RLR_OBJ13_RelVx : 84|12@0+ (0.0625000000,-128.0000000000) [-128.0000000000|127.9380000000] "m/s"  RRR_L,mADC
 SG_ RLR_OBJ13_RelVy : 78|10@0+ (0.0625000000,-32.0000000000) [-32.0000000000|63.8750000000] "m/s"  RRR_L,mADC
 SG_ RLR_OBJ13_HeadingAngle : 32|10@0+ (0.0100000000,-3.1400000000) [-3.1400000000|3.1400000000] "rad"  RRR_L,mADC
 SG_ RLR_OBJ13_Length : 25|9@0+ (0.0500000000,0.0000000000) [0.0000000000|25.5000000000] "m"  RRR_L,mADC
 SG_ RLR_OBJ13_Height : 18|9@0+ (0.0100000000,0.0000000000) [0.0000000000|5.1100000000] "m"  RRR_L,mADC
 SG_ RLR_OBJ13_Width : 13|11@0+ (0.0100000000,0.0000000000) [0.0000000000|12.0000000000] "m"  RRR_L,mADC
 SG_ RLR_OBJ13_Type : 0|3@0+ (1.0000000000,0.0000000000) [0.0000000000|7.0000000000] ""  RRR_L,mADC
 SG_ RLR_OBJ13_Track_ID : 7|7@0+ (1.0000000000,0.0000000000) [0.0000000000|127.0000000000] ""  RRR_L,mADC

BO_ 855 RLR_L_357: 64 RLR_L
 SG_ RLR_OBJ16_LostCnt : 483|4@0+ (1.0000000000,0.0000000000) [0.0000000000|15.0000000000] ""  RRR_L,mADC
 SG_ RLR_OBJ15_LostCnt : 495|4@0+ (1.0000000000,0.0000000000) [0.0000000000|15.0000000000] ""  RRR_L,mADC
 SG_ RLR_OBJ16_Dx : 230|13@0+ (0.0625000000,-256.0000000000) [-256.0000000000|255.9380000000] "m"  RRR_L,mADC
 SG_ RLR_OBJ16_Dy : 209|11@0+ (0.1250000000,-128.0000000000) [-128.0000000000|127.8750000000] "m"  RRR_L,mADC
 SG_ RLR_OBJ15_Dx : 59|13@0+ (0.0625000000,-256.0000000000) [-256.0000000000|255.9380000000] "m"  RRR_L,mADC
 SG_ RLR_OBJ15_Dy : 54|11@0+ (0.1250000000,-128.0000000000) [-128.0000000000|127.8750000000] "m"  RRR_L,mADC
 SG_ RLR_OBJ16_Vx : 310|12@0+ (0.0625000000,-128.0000000000) [-128.0000000000|127.9380000000] "m/s"  RRR_L,mADC
 SG_ RLR_OBJ16_Vy : 288|10@0+ (0.0625000000,-32.0000000000) [-32.0000000000|31.9375000000] "m/s"  RRR_L,mADC
 SG_ RLR_OBJ16_Convergence : 458|1@0+ (1.0000000000,0.0000000000) [0.0000000000|1.0000000000] ""  RRR_L,mADC
 SG_ RLR_OBJ16_DelayTime : 453|10@0+ (1.0000000000,0.0000000000) [0.0000000000|1023.0000000000] "ms"  RRR_L,mADC
 SG_ RLR_OBJ16_HeightGround : 424|9@0+ (0.1000000000,0.0000000000) [0.0000000000|51.1000000000] "m"  RRR_L,mADC
 SG_ RLR_OBJ16_MotionStatus : 470|3@0+ (1.0000000000,0.0000000000) [0.0000000000|7.0000000000] ""  RRR_L,mADC
 SG_ RLR_OBJ16_RelVx_std : 413|12@0+ (0.0625000000,0.0000000000) [0.0000000000|255.9375000000] "m/s"  RRR_L,mADC
 SG_ RLR_OBJ16_RelVy_std : 407|10@0+ (0.1250000000,0.0000000000) [0.0000000000|127.8750000000] "m/s"  RRR_L,mADC
 SG_ RLR_OBJ16_Dx_Vnce : 389|14@0+ (0.0500000000,0.0000000000) [0.0000000000|50.0000000000] "m2"  RRR_L,mADC
 SG_ RLR_OBJ16_Dy_Vnce : 383|10@0+ (0.0200000000,0.0000000000) [0.0000000000|20.0000000000] "m2"  RRR_L,mADC
 SG_ RLR_OBJ15_Vx : 139|12@0+ (0.0625000000,-128.0000000000) [-128.0000000000|127.9380000000] "m/s"  RRR_L,mADC
 SG_ RLR_OBJ15_Vy : 133|10@0+ (0.0625000000,-32.0000000000) [-32.0000000000|31.9375000000] "m/s"  RRR_L,mADC
 SG_ RLR_OBJ15_Convergence : 459|1@0+ (1.0000000000,0.0000000000) [0.0000000000|1.0000000000] ""  RRR_L,mADC
 SG_ RLR_OBJ15_DelayTime : 447|10@0+ (1.0000000000,0.0000000000) [0.0000000000|1023.0000000000] "ms"  RRR_L,mADC
 SG_ RLR_OBJ15_HeightGround : 417|9@0+ (0.1000000000,0.0000000000) [0.0000000000|51.1000000000] "m"  RRR_L,mADC
 SG_ RLR_OBJ15_MotionStatus : 457|3@0+ (1.0000000000,0.0000000000) [0.0000000000|7.0000000000] ""  RRR_L,mADC
 SG_ RLR_OBJ15_RelVx_std : 363|12@0+ (0.0625000000,0.0000000000) [0.0000000000|255.9375000000] "m/s"  RRR_L,mADC
 SG_ RLR_OBJ15_RelVy_std : 357|10@0+ (0.1250000000,0.0000000000) [0.0000000000|127.8750000000] "m/s"  RRR_L,mADC
 SG_ RLR_OBJ15_Dx_Vnce : 339|14@0+ (0.0500000000,0.0000000000) [0.0000000000|50.0000000000] "m2"  RRR_L,mADC
 SG_ RLR_OBJ15_Dy_Vnce : 333|10@0+ (0.0200000000,0.0000000000) [0.0000000000|20.0000000000] "m2"  RRR_L,mADC
 SG_ RLR_CRCCheck_357 : 503|16@0+ (1.0000000000,0.0000000000) [0.0000000000|65535.0000000000] ""  RRR_L,mADC
 SG_ RLR_RollingCounter_357 : 491|4@0+ (1.0000000000,0.0000000000) [0.0000000000|15.0000000000] ""  RRR_L,mADC
 SG_ RLR_OBJ16_Track_Age : 325|8@0+ (1.0000000000,0.0000000000) [0.0000000000|255.0000000000] ""  RRR_L,mADC
 SG_ RLR_OBJ16_ReRPointLoc : 312|3@0+ (1.0000000000,0.0000000000) [0.0000000000|7.0000000000] ""  RRR_L,mADC
 SG_ RLR_OBJ16_ObstacleProb : 294|6@0+ (2.0000000000,0.0000000000) [0.0000000000|100.0000000000] "%"  RRR_L,mADC
 SG_ RLR_OBJ16_Measured : 280|2@0+ (1.0000000000,0.0000000000) [0.0000000000|3.0000000000] ""  RRR_L,mADC
 SG_ RLR_OBJ16_ExistProb : 286|6@0+ (2.0000000000,0.0000000000) [0.0000000000|100.0000000000] "%"  RRR_L,mADC
 SG_ RLR_OBJ16_Location : 272|2@0+ (1.0000000000,0.0000000000) [0.0000000000|3.0000000000] ""  RRR_L,mADC
 SG_ RLR_OBJ16_RelAx : 265|9@0+ (0.0625000000,-16.0000000000) [-16.0000000000|15.9375000000] "m/s2"  RRR_L,mADC
 SG_ RLR_OBJ16_RelAy : 259|10@0+ (0.0312500000,-16.0000000000) [-16.0000000000|15.9688000000] "m/s2"  RRR_L,mADC
 SG_ RLR_OBJ16_RelVx : 255|12@0+ (0.0625000000,-128.0000000000) [-128.0000000000|127.9380000000] "m/s"  RRR_L,mADC
 SG_ RLR_OBJ16_RelVy : 233|10@0+ (0.0625000000,-32.0000000000) [-32.0000000000|63.8750000000] "m/s"  RRR_L,mADC
 SG_ RLR_OBJ16_HeadingAngle : 203|10@0+ (0.0100000000,-3.1400000000) [-3.1400000000|3.1400000000] "rad"  RRR_L,mADC
 SG_ RLR_OBJ16_Length : 196|9@0+ (0.0500000000,0.0000000000) [0.0000000000|25.5000000000] "m"  RRR_L,mADC
 SG_ RLR_OBJ16_Height : 189|9@0+ (0.0100000000,0.0000000000) [0.0000000000|5.1100000000] "m"  RRR_L,mADC
 SG_ RLR_OBJ16_Width : 168|11@0+ (0.0100000000,0.0000000000) [0.0000000000|12.0000000000] "m"  RRR_L,mADC
 SG_ RLR_OBJ16_Type : 171|3@0+ (1.0000000000,0.0000000000) [0.0000000000|7.0000000000] ""  RRR_L,mADC
 SG_ RLR_OBJ16_Track_ID : 162|7@0+ (1.0000000000,0.0000000000) [0.0000000000|127.0000000000] ""  RRR_L,mADC
 SG_ RLR_OBJ15_Track_Age : 154|8@0+ (1.0000000000,0.0000000000) [0.0000000000|255.0000000000] ""  RRR_L,mADC
 SG_ RLR_OBJ15_ReRPointLoc : 157|3@0+ (1.0000000000,0.0000000000) [0.0000000000|7.0000000000] ""  RRR_L,mADC
 SG_ RLR_OBJ15_ObstacleProb : 123|6@0+ (2.0000000000,0.0000000000) [0.0000000000|100.0000000000] "%"  RRR_L,mADC
 SG_ RLR_OBJ15_Measured : 125|2@0+ (1.0000000000,0.0000000000) [0.0000000000|3.0000000000] ""  RRR_L,mADC
 SG_ RLR_OBJ15_ExistProb : 115|6@0+ (2.0000000000,0.0000000000) [0.0000000000|100.0000000000] "%"  RRR_L,mADC
 SG_ RLR_OBJ15_Location : 117|2@0+ (1.0000000000,0.0000000000) [0.0000000000|3.0000000000] ""  RRR_L,mADC
 SG_ RLR_OBJ15_RelAx : 110|9@0+ (0.0625000000,-16.0000000000) [-16.0000000000|15.9375000000] "m/s2"  RRR_L,mADC
 SG_ RLR_OBJ15_RelAy : 88|10@0+ (0.0312500000,-16.0000000000) [-16.0000000000|15.9688000000] "m/s2"  RRR_L,mADC
 SG_ RLR_OBJ15_RelVx : 84|12@0+ (0.0625000000,-128.0000000000) [-128.0000000000|127.9380000000] "m/s"  RRR_L,mADC
 SG_ RLR_OBJ15_RelVy : 78|10@0+ (0.0625000000,-32.0000000000) [-32.0000000000|63.8750000000] "m/s"  RRR_L,mADC
 SG_ RLR_OBJ15_HeadingAngle : 32|10@0+ (0.0100000000,-3.1400000000) [-3.1400000000|3.1400000000] "rad"  RRR_L,mADC
 SG_ RLR_OBJ15_Length : 25|9@0+ (0.0500000000,0.0000000000) [0.0000000000|25.5000000000] "m"  RRR_L,mADC
 SG_ RLR_OBJ15_Height : 18|9@0+ (0.0100000000,0.0000000000) [0.0000000000|5.1100000000] "m"  RRR_L,mADC
 SG_ RLR_OBJ15_Width : 13|11@0+ (0.0100000000,0.0000000000) [0.0000000000|12.0000000000] "m"  RRR_L,mADC
 SG_ RLR_OBJ15_Type : 0|3@0+ (1.0000000000,0.0000000000) [0.0000000000|7.0000000000] ""  RRR_L,mADC
 SG_ RLR_OBJ15_Track_ID : 7|7@0+ (1.0000000000,0.0000000000) [0.0000000000|127.0000000000] ""  RRR_L,mADC

BO_ 856 RLR_L_358: 64 RLR_L
 SG_ RLR_OBJ18_LostCnt : 483|4@0+ (1.0000000000,0.0000000000) [0.0000000000|15.0000000000] ""  RRR_L,mADC
 SG_ RLR_OBJ17_LostCnt : 495|4@0+ (1.0000000000,0.0000000000) [0.0000000000|15.0000000000] ""  RRR_L,mADC
 SG_ RLR_OBJ18_Dx : 230|13@0+ (0.0625000000,-256.0000000000) [-256.0000000000|255.9380000000] "m"  RRR_L,mADC
 SG_ RLR_OBJ18_Dy : 209|11@0+ (0.1250000000,-128.0000000000) [-128.0000000000|127.8750000000] "m"  RRR_L,mADC
 SG_ RLR_OBJ17_Dx : 59|13@0+ (0.0625000000,-256.0000000000) [-256.0000000000|255.9380000000] "m"  RRR_L,mADC
 SG_ RLR_OBJ17_Dy : 54|11@0+ (0.1250000000,-128.0000000000) [-128.0000000000|127.8750000000] "m"  RRR_L,mADC
 SG_ RLR_OBJ18_Vx : 310|12@0+ (0.0625000000,-128.0000000000) [-128.0000000000|127.9380000000] "m/s"  RRR_L,mADC
 SG_ RLR_OBJ18_Vy : 288|10@0+ (0.0625000000,-32.0000000000) [-32.0000000000|31.9375000000] "m/s"  RRR_L,mADC
 SG_ RLR_OBJ18_Convergence : 458|1@0+ (1.0000000000,0.0000000000) [0.0000000000|1.0000000000] ""  RRR_L,mADC
 SG_ RLR_OBJ18_DelayTime : 453|10@0+ (1.0000000000,0.0000000000) [0.0000000000|1023.0000000000] "ms"  RRR_L,mADC
 SG_ RLR_OBJ18_HeightGround : 424|9@0+ (0.1000000000,0.0000000000) [0.0000000000|51.1000000000] "m"  RRR_L,mADC
 SG_ RLR_OBJ18_MotionStatus : 470|3@0+ (1.0000000000,0.0000000000) [0.0000000000|7.0000000000] ""  RRR_L,mADC
 SG_ RLR_OBJ18_RelVx_std : 413|12@0+ (0.0625000000,0.0000000000) [0.0000000000|255.9375000000] "m/s"  RRR_L,mADC
 SG_ RLR_OBJ18_RelVy_std : 407|10@0+ (0.1250000000,0.0000000000) [0.0000000000|127.8750000000] "m/s"  RRR_L,mADC
 SG_ RLR_OBJ18_Dx_Vnce : 389|14@0+ (0.0500000000,0.0000000000) [0.0000000000|50.0000000000] "m2"  RRR_L,mADC
 SG_ RLR_OBJ18_Dy_Vnce : 383|10@0+ (0.0200000000,0.0000000000) [0.0000000000|20.0000000000] "m2"  RRR_L,mADC
 SG_ RLR_OBJ17_Vx : 139|12@0+ (0.0625000000,-128.0000000000) [-128.0000000000|127.9380000000] "m/s"  RRR_L,mADC
 SG_ RLR_OBJ17_Vy : 133|10@0+ (0.0625000000,-32.0000000000) [-32.0000000000|31.9375000000] "m/s"  RRR_L,mADC
 SG_ RLR_OBJ17_Convergence : 459|1@0+ (1.0000000000,0.0000000000) [0.0000000000|1.0000000000] ""  RRR_L,mADC
 SG_ RLR_OBJ17_DelayTime : 447|10@0+ (1.0000000000,0.0000000000) [0.0000000000|1023.0000000000] "ms"  RRR_L,mADC
 SG_ RLR_OBJ17_HeightGround : 417|9@0+ (0.1000000000,0.0000000000) [0.0000000000|51.1000000000] "m"  RRR_L,mADC
 SG_ RLR_OBJ17_MotionStatus : 457|3@0+ (1.0000000000,0.0000000000) [0.0000000000|7.0000000000] ""  RRR_L,mADC
 SG_ RLR_OBJ17_RelVx_std : 363|12@0+ (0.0625000000,0.0000000000) [0.0000000000|255.9375000000] "m/s"  RRR_L,mADC
 SG_ RLR_OBJ17_RelVy_std : 357|10@0+ (0.1250000000,0.0000000000) [0.0000000000|127.8750000000] "m/s"  RRR_L,mADC
 SG_ RLR_OBJ17_Dx_Vnce : 339|14@0+ (0.0500000000,0.0000000000) [0.0000000000|50.0000000000] "m2"  RRR_L,mADC
 SG_ RLR_OBJ17_Dy_Vnce : 333|10@0+ (0.0200000000,0.0000000000) [0.0000000000|20.0000000000] "m2"  RRR_L,mADC
 SG_ RLR_CRCCheck_358 : 503|16@0+ (1.0000000000,0.0000000000) [0.0000000000|65535.0000000000] ""  RRR_L,mADC
 SG_ RLR_RollingCounter_358 : 491|4@0+ (1.0000000000,0.0000000000) [0.0000000000|15.0000000000] ""  RRR_L,mADC
 SG_ RLR_OBJ18_Track_Age : 325|8@0+ (1.0000000000,0.0000000000) [0.0000000000|255.0000000000] ""  RRR_L,mADC
 SG_ RLR_OBJ18_ReRPointLoc : 312|3@0+ (1.0000000000,0.0000000000) [0.0000000000|7.0000000000] ""  RRR_L,mADC
 SG_ RLR_OBJ18_ObstacleProb : 294|6@0+ (2.0000000000,0.0000000000) [0.0000000000|100.0000000000] "%"  RRR_L,mADC
 SG_ RLR_OBJ18_Measured : 280|2@0+ (1.0000000000,0.0000000000) [0.0000000000|3.0000000000] ""  RRR_L,mADC
 SG_ RLR_OBJ18_ExistProb : 286|6@0+ (2.0000000000,0.0000000000) [0.0000000000|100.0000000000] "%"  RRR_L,mADC
 SG_ RLR_OBJ18_Location : 272|2@0+ (1.0000000000,0.0000000000) [0.0000000000|3.0000000000] ""  RRR_L,mADC
 SG_ RLR_OBJ18_RelAx : 265|9@0+ (0.0625000000,-16.0000000000) [-16.0000000000|15.9375000000] "m/s2"  RRR_L,mADC
 SG_ RLR_OBJ18_RelAy : 259|10@0+ (0.0312500000,-16.0000000000) [-16.0000000000|15.9688000000] "m/s2"  RRR_L,mADC
 SG_ RLR_OBJ18_RelVx : 255|12@0+ (0.0625000000,-128.0000000000) [-128.0000000000|127.9380000000] "m/s"  RRR_L,mADC
 SG_ RLR_OBJ18_RelVy : 233|10@0+ (0.0625000000,-32.0000000000) [-32.0000000000|63.8750000000] "m/s"  RRR_L,mADC
 SG_ RLR_OBJ18_HeadingAngle : 203|10@0+ (0.0100000000,-3.1400000000) [-3.1400000000|3.1400000000] "rad"  RRR_L,mADC
 SG_ RLR_OBJ18_Length : 196|9@0+ (0.0500000000,0.0000000000) [0.0000000000|25.5000000000] "m"  RRR_L,mADC
 SG_ RLR_OBJ18_Height : 189|9@0+ (0.0100000000,0.0000000000) [0.0000000000|5.1100000000] "m"  RRR_L,mADC
 SG_ RLR_OBJ18_Width : 168|11@0+ (0.0100000000,0.0000000000) [0.0000000000|12.0000000000] "m"  RRR_L,mADC
 SG_ RLR_OBJ18_Type : 171|3@0+ (1.0000000000,0.0000000000) [0.0000000000|7.0000000000] ""  RRR_L,mADC
 SG_ RLR_OBJ18_Track_ID : 162|7@0+ (1.0000000000,0.0000000000) [0.0000000000|127.0000000000] ""  RRR_L,mADC
 SG_ RLR_OBJ17_Track_Age : 154|8@0+ (1.0000000000,0.0000000000) [0.0000000000|255.0000000000] ""  RRR_L,mADC
 SG_ RLR_OBJ17_ReRPointLoc : 157|3@0+ (1.0000000000,0.0000000000) [0.0000000000|7.0000000000] ""  RRR_L,mADC
 SG_ RLR_OBJ17_ObstacleProb : 123|6@0+ (2.0000000000,0.0000000000) [0.0000000000|100.0000000000] "%"  RRR_L,mADC
 SG_ RLR_OBJ17_Measured : 125|2@0+ (1.0000000000,0.0000000000) [0.0000000000|3.0000000000] ""  RRR_L,mADC
 SG_ RLR_OBJ17_ExistProb : 115|6@0+ (2.0000000000,0.0000000000) [0.0000000000|100.0000000000] "%"  RRR_L,mADC
 SG_ RLR_OBJ17_Location : 117|2@0+ (1.0000000000,0.0000000000) [0.0000000000|3.0000000000] ""  RRR_L,mADC
 SG_ RLR_OBJ17_RelAx : 110|9@0+ (0.0625000000,-16.0000000000) [-16.0000000000|15.9375000000] "m/s2"  RRR_L,mADC
 SG_ RLR_OBJ17_RelAy : 88|10@0+ (0.0312500000,-16.0000000000) [-16.0000000000|15.9688000000] "m/s2"  RRR_L,mADC
 SG_ RLR_OBJ17_RelVx : 84|12@0+ (0.0625000000,-128.0000000000) [-128.0000000000|127.9380000000] "m/s"  RRR_L,mADC
 SG_ RLR_OBJ17_RelVy : 78|10@0+ (0.0625000000,-32.0000000000) [-32.0000000000|63.8750000000] "m/s"  RRR_L,mADC
 SG_ RLR_OBJ17_HeadingAngle : 32|10@0+ (0.0100000000,-3.1400000000) [-3.1400000000|3.1400000000] "rad"  RRR_L,mADC
 SG_ RLR_OBJ17_Length : 25|9@0+ (0.0500000000,0.0000000000) [0.0000000000|25.5000000000] "m"  RRR_L,mADC
 SG_ RLR_OBJ17_Height : 18|9@0+ (0.0100000000,0.0000000000) [0.0000000000|5.1100000000] "m"  RRR_L,mADC
 SG_ RLR_OBJ17_Width : 13|11@0+ (0.0100000000,0.0000000000) [0.0000000000|12.0000000000] "m"  RRR_L,mADC
 SG_ RLR_OBJ17_Type : 0|3@0+ (1.0000000000,0.0000000000) [0.0000000000|7.0000000000] ""  RRR_L,mADC
 SG_ RLR_OBJ17_Track_ID : 7|7@0+ (1.0000000000,0.0000000000) [0.0000000000|127.0000000000] ""  RRR_L,mADC

BO_ 857 RLR_L_359: 64 RLR_L
 SG_ RLR_OBJ20_LostCnt : 483|4@0+ (1.0000000000,0.0000000000) [0.0000000000|15.0000000000] ""  RRR_L,mADC
 SG_ RLR_OBJ19_LostCnt : 495|4@0+ (1.0000000000,0.0000000000) [0.0000000000|15.0000000000] ""  RRR_L,mADC
 SG_ RLR_OBJ20_Dx : 230|13@0+ (0.0625000000,-256.0000000000) [-256.0000000000|255.9380000000] "m"  RRR_L,mADC
 SG_ RLR_OBJ20_Dy : 209|11@0+ (0.1250000000,-128.0000000000) [-128.0000000000|127.8750000000] "m"  RRR_L,mADC
 SG_ RLR_OBJ19_Dx : 59|13@0+ (0.0625000000,-256.0000000000) [-256.0000000000|255.9380000000] "m"  RRR_L,mADC
 SG_ RLR_OBJ19_Dy : 54|11@0+ (0.1250000000,-128.0000000000) [-128.0000000000|127.8750000000] "m"  RRR_L,mADC
 SG_ RLR_OBJ20_Vx : 310|12@0+ (0.0625000000,-128.0000000000) [-128.0000000000|127.9380000000] "m/s"  RRR_L,mADC
 SG_ RLR_OBJ20_Vy : 288|10@0+ (0.0625000000,-32.0000000000) [-32.0000000000|31.9375000000] "m/s"  RRR_L,mADC
 SG_ RLR_OBJ20_Convergence : 458|1@0+ (1.0000000000,0.0000000000) [0.0000000000|1.0000000000] ""  RRR_L,mADC
 SG_ RLR_OBJ20_DelayTime : 453|10@0+ (1.0000000000,0.0000000000) [0.0000000000|1023.0000000000] "ms"  RRR_L,mADC
 SG_ RLR_OBJ20_HeightGround : 424|9@0+ (0.1000000000,0.0000000000) [0.0000000000|51.1000000000] "m"  RRR_L,mADC
 SG_ RLR_OBJ20_MotionStatus : 470|3@0+ (1.0000000000,0.0000000000) [0.0000000000|7.0000000000] ""  RRR_L,mADC
 SG_ RLR_OBJ20_RelVx_std : 413|12@0+ (0.0625000000,0.0000000000) [0.0000000000|255.9375000000] "m/s"  RRR_L,mADC
 SG_ RLR_OBJ20_RelVy_std : 407|10@0+ (0.1250000000,0.0000000000) [0.0000000000|127.8750000000] "m/s"  RRR_L,mADC
 SG_ RLR_OBJ20_Dx_Vnce : 389|14@0+ (0.0500000000,0.0000000000) [0.0000000000|50.0000000000] "m2"  RRR_L,mADC
 SG_ RLR_OBJ20_Dy_Vnce : 383|10@0+ (0.0200000000,0.0000000000) [0.0000000000|20.0000000000] "m2"  RRR_L,mADC
 SG_ RLR_OBJ19_Vx : 139|12@0+ (0.0625000000,-128.0000000000) [-128.0000000000|127.9380000000] "m/s"  RRR_L,mADC
 SG_ RLR_OBJ19_Vy : 133|10@0+ (0.0625000000,-32.0000000000) [-32.0000000000|31.9375000000] "m/s"  RRR_L,mADC
 SG_ RLR_OBJ19_Convergence : 459|1@0+ (1.0000000000,0.0000000000) [0.0000000000|1.0000000000] ""  RRR_L,mADC
 SG_ RLR_OBJ19_DelayTime : 447|10@0+ (1.0000000000,0.0000000000) [0.0000000000|1023.0000000000] "ms"  RRR_L,mADC
 SG_ RLR_OBJ19_HeightGround : 417|9@0+ (0.1000000000,0.0000000000) [0.0000000000|51.1000000000] "m"  RRR_L,mADC
 SG_ RLR_OBJ19_MotionStatus : 457|3@0+ (1.0000000000,0.0000000000) [0.0000000000|7.0000000000] ""  RRR_L,mADC
 SG_ RLR_OBJ19_RelVx_std : 363|12@0+ (0.0625000000,0.0000000000) [0.0000000000|255.9375000000] "m/s"  RRR_L,mADC
 SG_ RLR_OBJ19_RelVy_std : 357|10@0+ (0.1250000000,0.0000000000) [0.0000000000|127.8750000000] "m/s"  RRR_L,mADC
 SG_ RLR_OBJ19_Dx_Vnce : 339|14@0+ (0.0500000000,0.0000000000) [0.0000000000|50.0000000000] "m2"  RRR_L,mADC
 SG_ RLR_OBJ19_Dy_Vnce : 333|10@0+ (0.0200000000,0.0000000000) [0.0000000000|20.0000000000] "m2"  RRR_L,mADC
 SG_ RLR_CRCCheck_359 : 503|16@0+ (1.0000000000,0.0000000000) [0.0000000000|65535.0000000000] ""  RRR_L,mADC
 SG_ RLR_RollingCounter_359 : 491|4@0+ (1.0000000000,0.0000000000) [0.0000000000|15.0000000000] ""  RRR_L,mADC
 SG_ RLR_OBJ20_Track_Age : 325|8@0+ (1.0000000000,0.0000000000) [0.0000000000|255.0000000000] ""  RRR_L,mADC
 SG_ RLR_OBJ20_ReRPointLoc : 312|3@0+ (1.0000000000,0.0000000000) [0.0000000000|7.0000000000] ""  RRR_L,mADC
 SG_ RLR_OBJ20_ObstacleProb : 294|6@0+ (2.0000000000,0.0000000000) [0.0000000000|100.0000000000] "%"  RRR_L,mADC
 SG_ RLR_OBJ20_Measured : 280|2@0+ (1.0000000000,0.0000000000) [0.0000000000|3.0000000000] ""  RRR_L,mADC
 SG_ RLR_OBJ20_ExistProb : 286|6@0+ (2.0000000000,0.0000000000) [0.0000000000|100.0000000000] "%"  RRR_L,mADC
 SG_ RLR_OBJ20_Location : 272|2@0+ (1.0000000000,0.0000000000) [0.0000000000|3.0000000000] ""  RRR_L,mADC
 SG_ RLR_OBJ20_RelAx : 265|9@0+ (0.0625000000,-16.0000000000) [-16.0000000000|15.9375000000] "m/s2"  RRR_L,mADC
 SG_ RLR_OBJ20_RelAy : 259|10@0+ (0.0312500000,-16.0000000000) [-16.0000000000|15.9688000000] "m/s2"  RRR_L,mADC
 SG_ RLR_OBJ20_RelVx : 255|12@0+ (0.0625000000,-128.0000000000) [-128.0000000000|127.9380000000] "m/s"  RRR_L,mADC
 SG_ RLR_OBJ20_RelVy : 233|10@0+ (0.0625000000,-32.0000000000) [-32.0000000000|63.8750000000] "m/s"  RRR_L,mADC
 SG_ RLR_OBJ20_HeadingAngle : 203|10@0+ (0.0100000000,-3.1400000000) [-3.1400000000|3.1400000000] "rad"  RRR_L,mADC
 SG_ RLR_OBJ20_Length : 196|9@0+ (0.0500000000,0.0000000000) [0.0000000000|25.5000000000] "m"  RRR_L,mADC
 SG_ RLR_OBJ20_Height : 189|9@0+ (0.0100000000,0.0000000000) [0.0000000000|5.1100000000] "m"  RRR_L,mADC
 SG_ RLR_OBJ20_Width : 168|11@0+ (0.0100000000,0.0000000000) [0.0000000000|12.0000000000] "m"  RRR_L,mADC
 SG_ RLR_OBJ20_Type : 171|3@0+ (1.0000000000,0.0000000000) [0.0000000000|7.0000000000] ""  RRR_L,mADC
 SG_ RLR_OBJ20_Track_ID : 162|7@0+ (1.0000000000,0.0000000000) [0.0000000000|127.0000000000] ""  RRR_L,mADC
 SG_ RLR_OBJ19_Track_Age : 154|8@0+ (1.0000000000,0.0000000000) [0.0000000000|255.0000000000] ""  RRR_L,mADC
 SG_ RLR_OBJ19_ReRPointLoc : 157|3@0+ (1.0000000000,0.0000000000) [0.0000000000|7.0000000000] ""  RRR_L,mADC
 SG_ RLR_OBJ19_ObstacleProb : 123|6@0+ (2.0000000000,0.0000000000) [0.0000000000|100.0000000000] "%"  RRR_L,mADC
 SG_ RLR_OBJ19_Measured : 125|2@0+ (1.0000000000,0.0000000000) [0.0000000000|3.0000000000] ""  RRR_L,mADC
 SG_ RLR_OBJ19_ExistProb : 115|6@0+ (2.0000000000,0.0000000000) [0.0000000000|100.0000000000] "%"  RRR_L,mADC
 SG_ RLR_OBJ19_Location : 117|2@0+ (1.0000000000,0.0000000000) [0.0000000000|3.0000000000] ""  RRR_L,mADC
 SG_ RLR_OBJ19_RelAx : 110|9@0+ (0.0625000000,-16.0000000000) [-16.0000000000|15.9375000000] "m/s2"  RRR_L,mADC
 SG_ RLR_OBJ19_RelAy : 88|10@0+ (0.0312500000,-16.0000000000) [-16.0000000000|15.9688000000] "m/s2"  RRR_L,mADC
 SG_ RLR_OBJ19_RelVx : 84|12@0+ (0.0625000000,-128.0000000000) [-128.0000000000|127.9380000000] "m/s"  RRR_L,mADC
 SG_ RLR_OBJ19_RelVy : 78|10@0+ (0.0625000000,-32.0000000000) [-32.0000000000|63.8750000000] "m/s"  RRR_L,mADC
 SG_ RLR_OBJ19_HeadingAngle : 32|10@0+ (0.0100000000,-3.1400000000) [-3.1400000000|3.1400000000] "rad"  RRR_L,mADC
 SG_ RLR_OBJ19_Length : 25|9@0+ (0.0500000000,0.0000000000) [0.0000000000|25.5000000000] "m"  RRR_L,mADC
 SG_ RLR_OBJ19_Height : 18|9@0+ (0.0100000000,0.0000000000) [0.0000000000|5.1100000000] "m"  RRR_L,mADC
 SG_ RLR_OBJ19_Width : 13|11@0+ (0.0100000000,0.0000000000) [0.0000000000|12.0000000000] "m"  RRR_L,mADC
 SG_ RLR_OBJ19_Type : 0|3@0+ (1.0000000000,0.0000000000) [0.0000000000|7.0000000000] ""  RRR_L,mADC
 SG_ RLR_OBJ19_Track_ID : 7|7@0+ (1.0000000000,0.0000000000) [0.0000000000|127.0000000000] ""  RRR_L,mADC

BO_ 858 RLR_L_35A: 64 RLR_L
 SG_ RLR_OBJ22_LostCnt : 483|4@0+ (1.0000000000,0.0000000000) [0.0000000000|15.0000000000] ""  RRR_L,mADC
 SG_ RLR_OBJ21_LostCnt : 495|4@0+ (1.0000000000,0.0000000000) [0.0000000000|15.0000000000] ""  RRR_L,mADC
 SG_ RLR_OBJ22_Dx : 230|13@0+ (0.0625000000,-256.0000000000) [-256.0000000000|255.9380000000] "m"  RRR_L,mADC
 SG_ RLR_OBJ22_Dy : 209|11@0+ (0.1250000000,-128.0000000000) [-128.0000000000|127.8750000000] "m"  RRR_L,mADC
 SG_ RLR_OBJ21_Dx : 59|13@0+ (0.0625000000,-256.0000000000) [-256.0000000000|255.9380000000] "m"  RRR_L,mADC
 SG_ RLR_OBJ21_Dy : 54|11@0+ (0.1250000000,-128.0000000000) [-128.0000000000|127.8750000000] "m"  RRR_L,mADC
 SG_ RLR_OBJ22_Vx : 310|12@0+ (0.0625000000,-128.0000000000) [-128.0000000000|127.9380000000] "m/s"  RRR_L,mADC
 SG_ RLR_OBJ22_Vy : 288|10@0+ (0.0625000000,-32.0000000000) [-32.0000000000|31.9375000000] "m/s"  RRR_L,mADC
 SG_ RLR_OBJ22_Convergence : 458|1@0+ (1.0000000000,0.0000000000) [0.0000000000|1.0000000000] ""  RRR_L,mADC
 SG_ RLR_OBJ22_DelayTime : 453|10@0+ (1.0000000000,0.0000000000) [0.0000000000|1023.0000000000] "ms"  RRR_L,mADC
 SG_ RLR_OBJ22_HeightGround : 424|9@0+ (0.1000000000,0.0000000000) [0.0000000000|51.1000000000] "m"  RRR_L,mADC
 SG_ RLR_OBJ22_MotionStatus : 470|3@0+ (1.0000000000,0.0000000000) [0.0000000000|7.0000000000] ""  RRR_L,mADC
 SG_ RLR_OBJ22_RelVx_std : 413|12@0+ (0.0625000000,0.0000000000) [0.0000000000|255.9375000000] "m/s"  RRR_L,mADC
 SG_ RLR_OBJ22_RelVy_std : 407|10@0+ (0.1250000000,0.0000000000) [0.0000000000|127.8750000000] "m/s"  RRR_L,mADC
 SG_ RLR_OBJ22_Dx_Vnce : 389|14@0+ (0.0500000000,0.0000000000) [0.0000000000|50.0000000000] "m2"  RRR_L,mADC
 SG_ RLR_OBJ22_Dy_Vnce : 383|10@0+ (0.0200000000,0.0000000000) [0.0000000000|20.0000000000] "m2"  RRR_L,mADC
 SG_ RLR_OBJ21_Vx : 139|12@0+ (0.0625000000,-128.0000000000) [-128.0000000000|127.9380000000] "m/s"  RRR_L,mADC
 SG_ RLR_OBJ21_Vy : 133|10@0+ (0.0625000000,-32.0000000000) [-32.0000000000|31.9375000000] "m/s"  RRR_L,mADC
 SG_ RLR_OBJ21_Convergence : 459|1@0+ (1.0000000000,0.0000000000) [0.0000000000|1.0000000000] ""  RRR_L,mADC
 SG_ RLR_OBJ21_DelayTime : 447|10@0+ (1.0000000000,0.0000000000) [0.0000000000|1023.0000000000] "ms"  RRR_L,mADC
 SG_ RLR_OBJ21_HeightGround : 417|9@0+ (0.1000000000,0.0000000000) [0.0000000000|51.1000000000] "m"  RRR_L,mADC
 SG_ RLR_OBJ21_MotionStatus : 457|3@0+ (1.0000000000,0.0000000000) [0.0000000000|7.0000000000] ""  RRR_L,mADC
 SG_ RLR_OBJ21_RelVx_std : 363|12@0+ (0.0625000000,0.0000000000) [0.0000000000|255.9375000000] "m/s"  RRR_L,mADC
 SG_ RLR_OBJ21_RelVy_std : 357|10@0+ (0.1250000000,0.0000000000) [0.0000000000|127.8750000000] "m/s"  RRR_L,mADC
 SG_ RLR_OBJ21_Dx_Vnce : 339|14@0+ (0.0500000000,0.0000000000) [0.0000000000|50.0000000000] "m2"  RRR_L,mADC
 SG_ RLR_OBJ21_Dy_Vnce : 333|10@0+ (0.0200000000,0.0000000000) [0.0000000000|20.0000000000] "m2"  RRR_L,mADC
 SG_ RLR_CRCCheck_35A : 503|16@0+ (1.0000000000,0.0000000000) [0.0000000000|65535.0000000000] ""  RRR_L,mADC
 SG_ RLR_RollingCounter_35A : 491|4@0+ (1.0000000000,0.0000000000) [0.0000000000|15.0000000000] ""  RRR_L,mADC
 SG_ RLR_OBJ22_Track_Age : 325|8@0+ (1.0000000000,0.0000000000) [0.0000000000|255.0000000000] ""  RRR_L,mADC
 SG_ RLR_OBJ22_ReRPointLoc : 312|3@0+ (1.0000000000,0.0000000000) [0.0000000000|7.0000000000] ""  RRR_L,mADC
 SG_ RLR_OBJ22_ObstacleProb : 294|6@0+ (2.0000000000,0.0000000000) [0.0000000000|100.0000000000] "%"  RRR_L,mADC
 SG_ RLR_OBJ22_Measured : 280|2@0+ (1.0000000000,0.0000000000) [0.0000000000|3.0000000000] ""  RRR_L,mADC
 SG_ RLR_OBJ22_ExistProb : 286|6@0+ (2.0000000000,0.0000000000) [0.0000000000|100.0000000000] "%"  RRR_L,mADC
 SG_ RLR_OBJ22_Location : 272|2@0+ (1.0000000000,0.0000000000) [0.0000000000|3.0000000000] ""  RRR_L,mADC
 SG_ RLR_OBJ22_RelAx : 265|9@0+ (0.0625000000,-16.0000000000) [-16.0000000000|15.9375000000] "m/s2"  RRR_L,mADC
 SG_ RLR_OBJ22_RelAy : 259|10@0+ (0.0312500000,-16.0000000000) [-16.0000000000|15.9688000000] "m/s2"  RRR_L,mADC
 SG_ RLR_OBJ22_RelVx : 255|12@0+ (0.0625000000,-128.0000000000) [-128.0000000000|127.9380000000] "m/s"  RRR_L,mADC
 SG_ RLR_OBJ22_RelVy : 233|10@0+ (0.0625000000,-32.0000000000) [-32.0000000000|63.8750000000] "m/s"  RRR_L,mADC
 SG_ RLR_OBJ22_HeadingAngle : 203|10@0+ (0.0100000000,-3.1400000000) [-3.1400000000|3.1400000000] "rad"  RRR_L,mADC
 SG_ RLR_OBJ22_Length : 196|9@0+ (0.0500000000,0.0000000000) [0.0000000000|25.5000000000] "m"  RRR_L,mADC
 SG_ RLR_OBJ22_Height : 189|9@0+ (0.0100000000,0.0000000000) [0.0000000000|5.1100000000] "m"  RRR_L,mADC
 SG_ RLR_OBJ22_Width : 168|11@0+ (0.0100000000,0.0000000000) [0.0000000000|12.0000000000] "m"  RRR_L,mADC
 SG_ RLR_OBJ22_Type : 171|3@0+ (1.0000000000,0.0000000000) [0.0000000000|7.0000000000] ""  RRR_L,mADC
 SG_ RLR_OBJ22_Track_ID : 162|7@0+ (1.0000000000,0.0000000000) [0.0000000000|127.0000000000] ""  RRR_L,mADC
 SG_ RLR_OBJ21_Track_Age : 154|8@0+ (1.0000000000,0.0000000000) [0.0000000000|255.0000000000] ""  RRR_L,mADC
 SG_ RLR_OBJ21_ReRPointLoc : 157|3@0+ (1.0000000000,0.0000000000) [0.0000000000|7.0000000000] ""  RRR_L,mADC
 SG_ RLR_OBJ21_ObstacleProb : 123|6@0+ (2.0000000000,0.0000000000) [0.0000000000|100.0000000000] "%"  RRR_L,mADC
 SG_ RLR_OBJ21_Measured : 125|2@0+ (1.0000000000,0.0000000000) [0.0000000000|3.0000000000] ""  RRR_L,mADC
 SG_ RLR_OBJ21_ExistProb : 115|6@0+ (2.0000000000,0.0000000000) [0.0000000000|100.0000000000] "%"  RRR_L,mADC
 SG_ RLR_OBJ21_Location : 117|2@0+ (1.0000000000,0.0000000000) [0.0000000000|3.0000000000] ""  RRR_L,mADC
 SG_ RLR_OBJ21_RelAx : 110|9@0+ (0.0625000000,-16.0000000000) [-16.0000000000|15.9375000000] "m/s2"  RRR_L,mADC
 SG_ RLR_OBJ21_RelAy : 88|10@0+ (0.0312500000,-16.0000000000) [-16.0000000000|15.9688000000] "m/s2"  RRR_L,mADC
 SG_ RLR_OBJ21_RelVx : 84|12@0+ (0.0625000000,-128.0000000000) [-128.0000000000|127.9380000000] "m/s"  RRR_L,mADC
 SG_ RLR_OBJ21_RelVy : 78|10@0+ (0.0625000000,-32.0000000000) [-32.0000000000|63.8750000000] "m/s"  RRR_L,mADC
 SG_ RLR_OBJ21_HeadingAngle : 32|10@0+ (0.0100000000,-3.1400000000) [-3.1400000000|3.1400000000] "rad"  RRR_L,mADC
 SG_ RLR_OBJ21_Length : 25|9@0+ (0.0500000000,0.0000000000) [0.0000000000|25.5000000000] "m"  RRR_L,mADC
 SG_ RLR_OBJ21_Height : 18|9@0+ (0.0100000000,0.0000000000) [0.0000000000|5.1100000000] "m"  RRR_L,mADC
 SG_ RLR_OBJ21_Width : 13|11@0+ (0.0100000000,0.0000000000) [0.0000000000|12.0000000000] "m"  RRR_L,mADC
 SG_ RLR_OBJ21_Type : 0|3@0+ (1.0000000000,0.0000000000) [0.0000000000|7.0000000000] ""  RRR_L,mADC
 SG_ RLR_OBJ21_Track_ID : 7|7@0+ (1.0000000000,0.0000000000) [0.0000000000|127.0000000000] ""  RRR_L,mADC

CM_ BO_ 836  "输出遮挡行人信号 ";
CM_ SG_ 836 RLR_CRCCheck_344  " ";
CM_ SG_ 836 RLR_RollingCounter_344  " ";
CM_ SG_ 836 RLR_SenceMode  " ";
CM_ SG_ 836 RLR_WorkSenceMode  " ";
CM_ SG_ 836 RLR_WorkMode  " ";
CM_ SG_ 836 RLR_ObjCount  " ";
CM_ SG_ 836 RLR_ped_azi  " ";
CM_ SG_ 836 RLR_ped_Ym  " ";
CM_ SG_ 836 RLR_ped_Xm  " ";
CM_ SG_ 836 RLR_ped_ConRidence  " ";
CM_ SG_ 836 RLR_ped_result  " ";

CM_ BO_ 840  "左后雷达的目标和点云/FS的时钟同步 ";
CM_ SG_ 840 RLR_Suppliers  " ";
CM_ SG_ 840 RLR_CRCCheck_348  " ";
CM_ SG_ 840 RLR_RollingCounter_348  " ";
CM_ SG_ 840 RLR_SystemStatus  " ";
CM_ SG_ 840 RLR_MCUTiStamp  " ";
CM_ SG_ 840 RLR_SyncTiStamp  " ";
CM_ SG_ 840 RLR_OBJ_TiOut  " ";
CM_ SG_ 840 RLR_OBJ_TiLeap  " ";
CM_ SG_ 840 RLR_OBJ_TiBas  " ";
CM_ SG_ 840 RLR_OBJTi_Stamp  " ";
CM_ SG_ 840 RLR_ObjDelay  " ";

CM_ BO_ 848  " ";
CM_ SG_ 848 RLR_OBJ2_LostCnt  " ";
CM_ SG_ 848 RLR_OBJ1_LostCnt  " ";
CM_ SG_ 848 RLR_OBJ2_Dx  " ";
CM_ SG_ 848 RLR_OBJ2_Dy  " ";
CM_ SG_ 848 RLR_OBJ1_Dx  " ";
CM_ SG_ 848 RLR_OBJ1_Dy  " ";
CM_ SG_ 848 RLR_OBJ2_Vx  " ";
CM_ SG_ 848 RLR_OBJ2_Vy  " ";
CM_ SG_ 848 RLR_OBJ2_Convergence  " ";
CM_ SG_ 848 RLR_OBJ2_DelayTime  " ";
CM_ SG_ 848 RLR_OBJ2_HeightGround  " ";
CM_ SG_ 848 RLR_OBJ2_MotionStatus  " ";
CM_ SG_ 848 RLR_OBJ2_RelVx_std  " ";
CM_ SG_ 848 RLR_OBJ2_RelVy_std  " ";
CM_ SG_ 848 RLR_OBJ2_Dx_Vnce  " ";
CM_ SG_ 848 RLR_OBJ2_Dy_Vnce  " ";
CM_ SG_ 848 RLR_OBJ1_Vx  " ";
CM_ SG_ 848 RLR_OBJ1_Vy  " ";
CM_ SG_ 848 RLR_OBJ1_Convergence  " ";
CM_ SG_ 848 RLR_OBJ1_DelayTime  " ";
CM_ SG_ 848 RLR_OBJ1_HeightGround  " ";
CM_ SG_ 848 RLR_OBJ1_MotionStatus  " ";
CM_ SG_ 848 RLR_OBJ1_RelVx_std  " ";
CM_ SG_ 848 RLR_OBJ1_RelVy_std  " ";
CM_ SG_ 848 RLR_OBJ1_Dx_Vnce  " ";
CM_ SG_ 848 RLR_OBJ1_Dy_Vnce  " ";
CM_ SG_ 848 RLR_CRCCheck_350  " ";
CM_ SG_ 848 RLR_RollingCounter_350  " ";
CM_ SG_ 848 RLR_OBJ2_Track_Age  " ";
CM_ SG_ 848 RLR_OBJ2_ReRPointLoc  " ";
CM_ SG_ 848 RLR_OBJ2_ObstacleProb  " ";
CM_ SG_ 848 RLR_OBJ2_Measured  " ";
CM_ SG_ 848 RLR_OBJ2_ExistProb  " ";
CM_ SG_ 848 RLR_OBJ2_Location  " ";
CM_ SG_ 848 RLR_OBJ2_RelAx  " ";
CM_ SG_ 848 RLR_OBJ2_RelAy  " ";
CM_ SG_ 848 RLR_OBJ2_RelVx  " ";
CM_ SG_ 848 RLR_OBJ2_RelVy  " ";
CM_ SG_ 848 RLR_OBJ2_HeadingAngle  " ";
CM_ SG_ 848 RLR_OBJ2_Length  " ";
CM_ SG_ 848 RLR_OBJ2_Height  " ";
CM_ SG_ 848 RLR_OBJ2_Width  " ";
CM_ SG_ 848 RLR_OBJ2_Type  " ";
CM_ SG_ 848 RLR_OBJ2_Track_ID  " ";
CM_ SG_ 848 RLR_OBJ1_Track_Age  " ";
CM_ SG_ 848 RLR_OBJ1_ReRPointLoc  " ";
CM_ SG_ 848 RLR_OBJ1_ObstacleProb  " ";
CM_ SG_ 848 RLR_OBJ1_Measured  " ";
CM_ SG_ 848 RLR_OBJ1_ExistProb  " ";
CM_ SG_ 848 RLR_OBJ1_Location  " ";
CM_ SG_ 848 RLR_OBJ1_RelAx  " ";
CM_ SG_ 848 RLR_OBJ1_RelAy  " ";
CM_ SG_ 848 RLR_OBJ1_RelVx  " ";
CM_ SG_ 848 RLR_OBJ1_RelVy  " ";
CM_ SG_ 848 RLR_OBJ1_HeadingAngle  " ";
CM_ SG_ 848 RLR_OBJ1_Length  " ";
CM_ SG_ 848 RLR_OBJ1_Height  " ";
CM_ SG_ 848 RLR_OBJ1_Width  " ";
CM_ SG_ 848 RLR_OBJ1_Type  " ";
CM_ SG_ 848 RLR_OBJ1_Track_ID  " ";

CM_ BO_ 849  " ";
CM_ SG_ 849 RLR_OBJ4_LostCnt  " ";
CM_ SG_ 849 RLR_OBJ3_LostCnt  " ";
CM_ SG_ 849 RLR_OBJ4_Dx  " ";
CM_ SG_ 849 RLR_OBJ4_Dy  " ";
CM_ SG_ 849 RLR_OBJ3_Dx  " ";
CM_ SG_ 849 RLR_OBJ3_Dy  " ";
CM_ SG_ 849 RLR_OBJ4_Vx  " ";
CM_ SG_ 849 RLR_OBJ4_Vy  " ";
CM_ SG_ 849 RLR_OBJ4_Convergence  " ";
CM_ SG_ 849 RLR_OBJ4_DelayTime  " ";
CM_ SG_ 849 RLR_OBJ4_HeightGround  " ";
CM_ SG_ 849 RLR_OBJ4_MotionStatus  " ";
CM_ SG_ 849 RLR_OBJ4_RelVx_std  " ";
CM_ SG_ 849 RLR_OBJ4_RelVy_std  " ";
CM_ SG_ 849 RLR_OBJ4_Dx_Vnce  " ";
CM_ SG_ 849 RLR_OBJ4_Dy_Vnce  " ";
CM_ SG_ 849 RLR_OBJ3_Vx  " ";
CM_ SG_ 849 RLR_OBJ3_Vy  " ";
CM_ SG_ 849 RLR_OBJ3_Convergence  " ";
CM_ SG_ 849 RLR_OBJ3_DelayTime  " ";
CM_ SG_ 849 RLR_OBJ3_HeightGround  " ";
CM_ SG_ 849 RLR_OBJ3_MotionStatus  " ";
CM_ SG_ 849 RLR_OBJ3_RelVx_std  " ";
CM_ SG_ 849 RLR_OBJ3_RelVy_std  " ";
CM_ SG_ 849 RLR_OBJ3_Dx_Vnce  " ";
CM_ SG_ 849 RLR_OBJ3_Dy_Vnce  " ";
CM_ SG_ 849 RLR_CRCCheck_351  " ";
CM_ SG_ 849 RLR_RollingCounter_351  " ";
CM_ SG_ 849 RLR_OBJ4_Track_Age  " ";
CM_ SG_ 849 RLR_OBJ4_ReRPointLoc  " ";
CM_ SG_ 849 RLR_OBJ4_ObstacleProb  " ";
CM_ SG_ 849 RLR_OBJ4_Measured  " ";
CM_ SG_ 849 RLR_OBJ4_ExistProb  " ";
CM_ SG_ 849 RLR_OBJ4_Location  " ";
CM_ SG_ 849 RLR_OBJ4_RelAx  " ";
CM_ SG_ 849 RLR_OBJ4_RelAy  " ";
CM_ SG_ 849 RLR_OBJ4_RelVx  " ";
CM_ SG_ 849 RLR_OBJ4_RelVy  " ";
CM_ SG_ 849 RLR_OBJ4_HeadingAngle  " ";
CM_ SG_ 849 RLR_OBJ4_Length  " ";
CM_ SG_ 849 RLR_OBJ4_Height  " ";
CM_ SG_ 849 RLR_OBJ4_Width  " ";
CM_ SG_ 849 RLR_OBJ4_Type  " ";
CM_ SG_ 849 RLR_OBJ4_Track_ID  " ";
CM_ SG_ 849 RLR_OBJ3_Track_Age  " ";
CM_ SG_ 849 RLR_OBJ3_ReRPointLoc  " ";
CM_ SG_ 849 RLR_OBJ3_ObstacleProb  " ";
CM_ SG_ 849 RLR_OBJ3_Measured  " ";
CM_ SG_ 849 RLR_OBJ3_ExistProb  " ";
CM_ SG_ 849 RLR_OBJ3_Location  " ";
CM_ SG_ 849 RLR_OBJ3_RelAx  " ";
CM_ SG_ 849 RLR_OBJ3_RelAy  " ";
CM_ SG_ 849 RLR_OBJ3_RelVx  " ";
CM_ SG_ 849 RLR_OBJ3_RelVy  " ";
CM_ SG_ 849 RLR_OBJ3_HeadingAngle  " ";
CM_ SG_ 849 RLR_OBJ3_Length  " ";
CM_ SG_ 849 RLR_OBJ3_Height  " ";
CM_ SG_ 849 RLR_OBJ3_Width  " ";
CM_ SG_ 849 RLR_OBJ3_Type  " ";
CM_ SG_ 849 RLR_OBJ3_Track_ID  " ";

CM_ BO_ 850  " ";
CM_ SG_ 850 RLR_OBJ6_LostCnt  " ";
CM_ SG_ 850 RLR_OBJ5_LostCnt  " ";
CM_ SG_ 850 RLR_OBJ6_Dx  " ";
CM_ SG_ 850 RLR_OBJ6_Dy  " ";
CM_ SG_ 850 RLR_OBJ5_Dx  " ";
CM_ SG_ 850 RLR_OBJ5_Dy  " ";
CM_ SG_ 850 RLR_OBJ6_Vx  " ";
CM_ SG_ 850 RLR_OBJ6_Vy  " ";
CM_ SG_ 850 RLR_OBJ6_Convergence  " ";
CM_ SG_ 850 RLR_OBJ6_DelayTime  " ";
CM_ SG_ 850 RLR_OBJ6_HeightGround  " ";
CM_ SG_ 850 RLR_OBJ6_MotionStatus  " ";
CM_ SG_ 850 RLR_OBJ6_RelVx_std  " ";
CM_ SG_ 850 RLR_OBJ6_RelVy_std  " ";
CM_ SG_ 850 RLR_OBJ6_Dx_Vnce  " ";
CM_ SG_ 850 RLR_OBJ6_Dy_Vnce  " ";
CM_ SG_ 850 RLR_OBJ5_Vx  " ";
CM_ SG_ 850 RLR_OBJ5_Vy  " ";
CM_ SG_ 850 RLR_OBJ5_Convergence  " ";
CM_ SG_ 850 RLR_OBJ5_DelayTime  " ";
CM_ SG_ 850 RLR_OBJ5_HeightGround  " ";
CM_ SG_ 850 RLR_OBJ5_MotionStatus  " ";
CM_ SG_ 850 RLR_OBJ5_RelVx_std  " ";
CM_ SG_ 850 RLR_OBJ5_RelVy_std  " ";
CM_ SG_ 850 RLR_OBJ5_Dx_Vnce  " ";
CM_ SG_ 850 RLR_OBJ5_Dy_Vnce  " ";
CM_ SG_ 850 RLR_CRCCheck_352  " ";
CM_ SG_ 850 RLR_RollingCounter_352  " ";
CM_ SG_ 850 RLR_OBJ6_Track_Age  " ";
CM_ SG_ 850 RLR_OBJ6_ReRPointLoc  " ";
CM_ SG_ 850 RLR_OBJ6_ObstacleProb  " ";
CM_ SG_ 850 RLR_OBJ6_Measured  " ";
CM_ SG_ 850 RLR_OBJ6_ExistProb  " ";
CM_ SG_ 850 RLR_OBJ6_Location  " ";
CM_ SG_ 850 RLR_OBJ6_RelAx  " ";
CM_ SG_ 850 RLR_OBJ6_RelAy  " ";
CM_ SG_ 850 RLR_OBJ6_RelVx  " ";
CM_ SG_ 850 RLR_OBJ6_RelVy  " ";
CM_ SG_ 850 RLR_OBJ6_HeadingAngle  " ";
CM_ SG_ 850 RLR_OBJ6_Length  " ";
CM_ SG_ 850 RLR_OBJ6_Height  " ";
CM_ SG_ 850 RLR_OBJ6_Width  " ";
CM_ SG_ 850 RLR_OBJ6_Type  " ";
CM_ SG_ 850 RLR_OBJ6_Track_ID  " ";
CM_ SG_ 850 RLR_OBJ5_Track_Age  " ";
CM_ SG_ 850 RLR_OBJ5_ReRPointLoc  " ";
CM_ SG_ 850 RLR_OBJ5_ObstacleProb  " ";
CM_ SG_ 850 RLR_OBJ5_Measured  " ";
CM_ SG_ 850 RLR_OBJ5_ExistProb  " ";
CM_ SG_ 850 RLR_OBJ5_Location  " ";
CM_ SG_ 850 RLR_OBJ5_RelAx  " ";
CM_ SG_ 850 RLR_OBJ5_RelAy  " ";
CM_ SG_ 850 RLR_OBJ5_RelVx  " ";
CM_ SG_ 850 RLR_OBJ5_RelVy  " ";
CM_ SG_ 850 RLR_OBJ5_HeadingAngle  " ";
CM_ SG_ 850 RLR_OBJ5_Length  " ";
CM_ SG_ 850 RLR_OBJ5_Height  " ";
CM_ SG_ 850 RLR_OBJ5_Width  " ";
CM_ SG_ 850 RLR_OBJ5_Type  " ";
CM_ SG_ 850 RLR_OBJ5_Track_ID  " ";

CM_ BO_ 851  " ";
CM_ SG_ 851 RLR_OBJ8_LostCnt  " ";
CM_ SG_ 851 RLR_OBJ7_LostCnt  " ";
CM_ SG_ 851 RLR_OBJ8_Dx  " ";
CM_ SG_ 851 RLR_OBJ8_Dy  " ";
CM_ SG_ 851 RLR_OBJ7_Dx  " ";
CM_ SG_ 851 RLR_OBJ7_Dy  " ";
CM_ SG_ 851 RLR_OBJ8_Vx  " ";
CM_ SG_ 851 RLR_OBJ8_Vy  " ";
CM_ SG_ 851 RLR_OBJ8_Convergence  " ";
CM_ SG_ 851 RLR_OBJ8_DelayTime  " ";
CM_ SG_ 851 RLR_OBJ8_HeightGround  " ";
CM_ SG_ 851 RLR_OBJ8_MotionStatus  " ";
CM_ SG_ 851 RLR_OBJ8_RelVx_std  " ";
CM_ SG_ 851 RLR_OBJ8_RelVy_std  " ";
CM_ SG_ 851 RLR_OBJ8_Dx_Vnce  " ";
CM_ SG_ 851 RLR_OBJ8_Dy_Vnce  " ";
CM_ SG_ 851 RLR_OBJ7_Vx  " ";
CM_ SG_ 851 RLR_OBJ7_Vy  " ";
CM_ SG_ 851 RLR_OBJ7_Convergence  " ";
CM_ SG_ 851 RLR_OBJ7_DelayTime  " ";
CM_ SG_ 851 RLR_OBJ7_HeightGround  " ";
CM_ SG_ 851 RLR_OBJ7_MotionStatus  " ";
CM_ SG_ 851 RLR_OBJ7_RelVx_std  " ";
CM_ SG_ 851 RLR_OBJ7_RelVy_std  " ";
CM_ SG_ 851 RLR_OBJ7_Dx_Vnce  " ";
CM_ SG_ 851 RLR_OBJ7_Dy_Vnce  " ";
CM_ SG_ 851 RLR_CRCCheck_353  " ";
CM_ SG_ 851 RLR_RollingCounter_353  " ";
CM_ SG_ 851 RLR_OBJ8_Track_Age  " ";
CM_ SG_ 851 RLR_OBJ8_ReRPointLoc  " ";
CM_ SG_ 851 RLR_OBJ8_ObstacleProb  " ";
CM_ SG_ 851 RLR_OBJ8_Measured  " ";
CM_ SG_ 851 RLR_OBJ8_ExistProb  " ";
CM_ SG_ 851 RLR_OBJ8_Location  " ";
CM_ SG_ 851 RLR_OBJ8_RelAx  " ";
CM_ SG_ 851 RLR_OBJ8_RelAy  " ";
CM_ SG_ 851 RLR_OBJ8_RelVx  " ";
CM_ SG_ 851 RLR_OBJ8_RelVy  " ";
CM_ SG_ 851 RLR_OBJ8_HeadingAngle  " ";
CM_ SG_ 851 RLR_OBJ8_Length  " ";
CM_ SG_ 851 RLR_OBJ8_Height  " ";
CM_ SG_ 851 RLR_OBJ8_Width  " ";
CM_ SG_ 851 RLR_OBJ8_Type  " ";
CM_ SG_ 851 RLR_OBJ8_Track_ID  " ";
CM_ SG_ 851 RLR_OBJ7_Track_Age  " ";
CM_ SG_ 851 RLR_OBJ7_ReRPointLoc  " ";
CM_ SG_ 851 RLR_OBJ7_ObstacleProb  " ";
CM_ SG_ 851 RLR_OBJ7_Measured  " ";
CM_ SG_ 851 RLR_OBJ7_ExistProb  " ";
CM_ SG_ 851 RLR_OBJ7_Location  " ";
CM_ SG_ 851 RLR_OBJ7_RelAx  " ";
CM_ SG_ 851 RLR_OBJ7_RelAy  " ";
CM_ SG_ 851 RLR_OBJ7_RelVx  " ";
CM_ SG_ 851 RLR_OBJ7_RelVy  " ";
CM_ SG_ 851 RLR_OBJ7_HeadingAngle  " ";
CM_ SG_ 851 RLR_OBJ7_Length  " ";
CM_ SG_ 851 RLR_OBJ7_Height  " ";
CM_ SG_ 851 RLR_OBJ7_Width  " ";
CM_ SG_ 851 RLR_OBJ7_Type  " ";
CM_ SG_ 851 RLR_OBJ7_Track_ID  " ";

CM_ BO_ 852  " ";
CM_ SG_ 852 RLR_OBJ10_LostCnt  " ";
CM_ SG_ 852 RLR_OBJ9_LostCnt  " ";
CM_ SG_ 852 RLR_OBJ10_Dx  " ";
CM_ SG_ 852 RLR_OBJ10_Dy  " ";
CM_ SG_ 852 RLR_OBJ9_Dx  " ";
CM_ SG_ 852 RLR_OBJ9_Dy  " ";
CM_ SG_ 852 RLR_OBJ10_Vx  " ";
CM_ SG_ 852 RLR_OBJ10_Vy  " ";
CM_ SG_ 852 RLR_OBJ10_Convergence  " ";
CM_ SG_ 852 RLR_OBJ10_DelayTime  " ";
CM_ SG_ 852 RLR_OBJ10_HeightGround  " ";
CM_ SG_ 852 RLR_OBJ10_MotionStatus  " ";
CM_ SG_ 852 RLR_OBJ10_RelVx_std  " ";
CM_ SG_ 852 RLR_OBJ10_RelVy_std  " ";
CM_ SG_ 852 RLR_OBJ10_Dx_Vnce  " ";
CM_ SG_ 852 RLR_OBJ10_Dy_Vnce  " ";
CM_ SG_ 852 RLR_OBJ9_Vx  " ";
CM_ SG_ 852 RLR_OBJ9_Vy  " ";
CM_ SG_ 852 RLR_OBJ9_Convergence  " ";
CM_ SG_ 852 RLR_OBJ9_DelayTime  " ";
CM_ SG_ 852 RLR_OBJ9_HeightGround  " ";
CM_ SG_ 852 RLR_OBJ9_MotionStatus  " ";
CM_ SG_ 852 RLR_OBJ9_RelVx_std  " ";
CM_ SG_ 852 RLR_OBJ9_RelVy_std  " ";
CM_ SG_ 852 RLR_OBJ9_Dx_Vnce  " ";
CM_ SG_ 852 RLR_OBJ9_Dy_Vnce  " ";
CM_ SG_ 852 RLR_CRCCheck_354  " ";
CM_ SG_ 852 RLR_RollingCounter_354  " ";
CM_ SG_ 852 RLR_OBJ10_Track_Age  " ";
CM_ SG_ 852 RLR_OBJ10_ReRPointLoc  " ";
CM_ SG_ 852 RLR_OBJ10_ObstacleProb  " ";
CM_ SG_ 852 RLR_OBJ10_Measured  " ";
CM_ SG_ 852 RLR_OBJ10_ExistProb  " ";
CM_ SG_ 852 RLR_OBJ10_Location  " ";
CM_ SG_ 852 RLR_OBJ10_RelAx  " ";
CM_ SG_ 852 RLR_OBJ10_RelAy  " ";
CM_ SG_ 852 RLR_OBJ10_RelVx  " ";
CM_ SG_ 852 RLR_OBJ10_RelVy  " ";
CM_ SG_ 852 RLR_OBJ10_HeadingAngle  " ";
CM_ SG_ 852 RLR_OBJ10_Length  " ";
CM_ SG_ 852 RLR_OBJ10_Height  " ";
CM_ SG_ 852 RLR_OBJ10_Width  " ";
CM_ SG_ 852 RLR_OBJ10_Type  " ";
CM_ SG_ 852 RLR_OBJ10_Track_ID  " ";
CM_ SG_ 852 RLR_OBJ9_Track_Age  " ";
CM_ SG_ 852 RLR_OBJ9_ReRPointLoc  " ";
CM_ SG_ 852 RLR_OBJ9_ObstacleProb  " ";
CM_ SG_ 852 RLR_OBJ9_Measured  " ";
CM_ SG_ 852 RLR_OBJ9_ExistProb  " ";
CM_ SG_ 852 RLR_OBJ9_Location  " ";
CM_ SG_ 852 RLR_OBJ9_RelAx  " ";
CM_ SG_ 852 RLR_OBJ9_RelAy  " ";
CM_ SG_ 852 RLR_OBJ9_RelVx  " ";
CM_ SG_ 852 RLR_OBJ9_RelVy  " ";
CM_ SG_ 852 RLR_OBJ9_HeadingAngle  " ";
CM_ SG_ 852 RLR_OBJ9_Length  " ";
CM_ SG_ 852 RLR_OBJ9_Height  " ";
CM_ SG_ 852 RLR_OBJ9_Width  " ";
CM_ SG_ 852 RLR_OBJ9_Type  " ";
CM_ SG_ 852 RLR_OBJ9_Track_ID  " ";

CM_ BO_ 853  " ";
CM_ SG_ 853 RLR_OBJ12_LostCnt  " ";
CM_ SG_ 853 RLR_OBJ11_LostCnt  " ";
CM_ SG_ 853 RLR_OBJ12_Dx  " ";
CM_ SG_ 853 RLR_OBJ12_Dy  " ";
CM_ SG_ 853 RLR_OBJ11_Dx  " ";
CM_ SG_ 853 RLR_OBJ11_Dy  " ";
CM_ SG_ 853 RLR_OBJ12_Vx  " ";
CM_ SG_ 853 RLR_OBJ12_Vy  " ";
CM_ SG_ 853 RLR_OBJ12_Convergence  " ";
CM_ SG_ 853 RLR_OBJ12_DelayTime  " ";
CM_ SG_ 853 RLR_OBJ12_HeightGround  " ";
CM_ SG_ 853 RLR_OBJ12_MotionStatus  " ";
CM_ SG_ 853 RLR_OBJ12_RelVx_std  " ";
CM_ SG_ 853 RLR_OBJ12_RelVy_std  " ";
CM_ SG_ 853 RLR_OBJ12_Dx_Vnce  " ";
CM_ SG_ 853 RLR_OBJ12_Dy_Vnce  " ";
CM_ SG_ 853 RLR_OBJ11_Vx  " ";
CM_ SG_ 853 RLR_OBJ11_Vy  " ";
CM_ SG_ 853 RLR_OBJ11_Convergence  " ";
CM_ SG_ 853 RLR_OBJ11_DelayTime  " ";
CM_ SG_ 853 RLR_OBJ11_HeightGround  " ";
CM_ SG_ 853 RLR_OBJ11_MotionStatus  " ";
CM_ SG_ 853 RLR_OBJ11_RelVx_std  " ";
CM_ SG_ 853 RLR_OBJ11_RelVy_std  " ";
CM_ SG_ 853 RLR_OBJ11_Dx_Vnce  " ";
CM_ SG_ 853 RLR_OBJ11_Dy_Vnce  " ";
CM_ SG_ 853 RLR_CRCCheck_355  " ";
CM_ SG_ 853 RLR_RollingCounter_355  " ";
CM_ SG_ 853 RLR_OBJ12_Track_Age  " ";
CM_ SG_ 853 RLR_OBJ12_ReRPointLoc  " ";
CM_ SG_ 853 RLR_OBJ12_ObstacleProb  " ";
CM_ SG_ 853 RLR_OBJ12_Measured  " ";
CM_ SG_ 853 RLR_OBJ12_ExistProb  " ";
CM_ SG_ 853 RLR_OBJ12_Location  " ";
CM_ SG_ 853 RLR_OBJ12_RelAx  " ";
CM_ SG_ 853 RLR_OBJ12_RelAy  " ";
CM_ SG_ 853 RLR_OBJ12_RelVx  " ";
CM_ SG_ 853 RLR_OBJ12_RelVy  " ";
CM_ SG_ 853 RLR_OBJ12_HeadingAngle  " ";
CM_ SG_ 853 RLR_OBJ12_Length  " ";
CM_ SG_ 853 RLR_OBJ12_Height  " ";
CM_ SG_ 853 RLR_OBJ12_Width  " ";
CM_ SG_ 853 RLR_OBJ12_Type  " ";
CM_ SG_ 853 RLR_OBJ12_Track_ID  " ";
CM_ SG_ 853 RLR_OBJ11_Track_Age  " ";
CM_ SG_ 853 RLR_OBJ11_ReRPointLoc  " ";
CM_ SG_ 853 RLR_OBJ11_ObstacleProb  " ";
CM_ SG_ 853 RLR_OBJ11_Measured  " ";
CM_ SG_ 853 RLR_OBJ11_ExistProb  " ";
CM_ SG_ 853 RLR_OBJ11_Location  " ";
CM_ SG_ 853 RLR_OBJ11_RelAx  " ";
CM_ SG_ 853 RLR_OBJ11_RelAy  " ";
CM_ SG_ 853 RLR_OBJ11_RelVx  " ";
CM_ SG_ 853 RLR_OBJ11_RelVy  " ";
CM_ SG_ 853 RLR_OBJ11_HeadingAngle  " ";
CM_ SG_ 853 RLR_OBJ11_Length  " ";
CM_ SG_ 853 RLR_OBJ11_Height  " ";
CM_ SG_ 853 RLR_OBJ11_Width  " ";
CM_ SG_ 853 RLR_OBJ11_Type  " ";
CM_ SG_ 853 RLR_OBJ11_Track_ID  " ";

CM_ BO_ 865  " ";
CM_ SG_ 865 RLR_OBJ14_LostCnt  " ";
CM_ SG_ 865 RLR_OBJ13_LostCnt  " ";
CM_ SG_ 865 RLR_OBJ14_Dx  " ";
CM_ SG_ 865 RLR_OBJ14_Dy  " ";
CM_ SG_ 865 RLR_OBJ13_Dx  " ";
CM_ SG_ 865 RLR_OBJ13_Dy  " ";
CM_ SG_ 865 RLR_OBJ14_Vx  " ";
CM_ SG_ 865 RLR_OBJ14_Vy  " ";
CM_ SG_ 865 RLR_OBJ14_Convergence  " ";
CM_ SG_ 865 RLR_OBJ14_DelayTime  " ";
CM_ SG_ 865 RLR_OBJ14_HeightGround  " ";
CM_ SG_ 865 RLR_OBJ14_MotionStatus  " ";
CM_ SG_ 865 RLR_OBJ14_RelVx_std  " ";
CM_ SG_ 865 RLR_OBJ14_RelVy_std  " ";
CM_ SG_ 865 RLR_OBJ14_Dx_Vnce  " ";
CM_ SG_ 865 RLR_OBJ14_Dy_Vnce  " ";
CM_ SG_ 865 RLR_OBJ13_Vx  " ";
CM_ SG_ 865 RLR_OBJ13_Vy  " ";
CM_ SG_ 865 RLR_OBJ13_Convergence  " ";
CM_ SG_ 865 RLR_OBJ13_DelayTime  " ";
CM_ SG_ 865 RLR_OBJ13_HeightGround  " ";
CM_ SG_ 865 RLR_OBJ13_MotionStatus  " ";
CM_ SG_ 865 RLR_OBJ13_RelVx_std  " ";
CM_ SG_ 865 RLR_OBJ13_RelVy_std  " ";
CM_ SG_ 865 RLR_OBJ13_Dx_Vnce  " ";
CM_ SG_ 865 RLR_OBJ13_Dy_Vnce  " ";
CM_ SG_ 865 RLR_CRCCheck_356  " ";
CM_ SG_ 865 RLR_RollingCounter_356  " ";
CM_ SG_ 865 RLR_OBJ14_Track_Age  " ";
CM_ SG_ 865 RLR_OBJ14_ReRPointLoc  " ";
CM_ SG_ 865 RLR_OBJ14_ObstacleProb  " ";
CM_ SG_ 865 RLR_OBJ14_Measured  " ";
CM_ SG_ 865 RLR_OBJ14_ExistProb  " ";
CM_ SG_ 865 RLR_OBJ14_Location  " ";
CM_ SG_ 865 RLR_OBJ14_RelAx  " ";
CM_ SG_ 865 RLR_OBJ14_RelAy  " ";
CM_ SG_ 865 RLR_OBJ14_RelVx  " ";
CM_ SG_ 865 RLR_OBJ14_RelVy  " ";
CM_ SG_ 865 RLR_OBJ14_HeadingAngle  " ";
CM_ SG_ 865 RLR_OBJ14_Length  " ";
CM_ SG_ 865 RLR_OBJ14_Height  " ";
CM_ SG_ 865 RLR_OBJ14_Width  " ";
CM_ SG_ 865 RLR_OBJ14_Type  " ";
CM_ SG_ 865 RLR_OBJ14_Track_ID  " ";
CM_ SG_ 865 RLR_OBJ13_Track_Age  " ";
CM_ SG_ 865 RLR_OBJ13_ReRPointLoc  " ";
CM_ SG_ 865 RLR_OBJ13_ObstacleProb  " ";
CM_ SG_ 865 RLR_OBJ13_Measured  " ";
CM_ SG_ 865 RLR_OBJ13_ExistProb  " ";
CM_ SG_ 865 RLR_OBJ13_Location  " ";
CM_ SG_ 865 RLR_OBJ13_RelAx  " ";
CM_ SG_ 865 RLR_OBJ13_RelAy  " ";
CM_ SG_ 865 RLR_OBJ13_RelVx  " ";
CM_ SG_ 865 RLR_OBJ13_RelVy  " ";
CM_ SG_ 865 RLR_OBJ13_HeadingAngle  " ";
CM_ SG_ 865 RLR_OBJ13_Length  " ";
CM_ SG_ 865 RLR_OBJ13_Height  " ";
CM_ SG_ 865 RLR_OBJ13_Width  " ";
CM_ SG_ 865 RLR_OBJ13_Type  " ";
CM_ SG_ 865 RLR_OBJ13_Track_ID  " ";

CM_ BO_ 855  " ";
CM_ SG_ 855 RLR_OBJ16_LostCnt  " ";
CM_ SG_ 855 RLR_OBJ15_LostCnt  " ";
CM_ SG_ 855 RLR_OBJ16_Dx  " ";
CM_ SG_ 855 RLR_OBJ16_Dy  " ";
CM_ SG_ 855 RLR_OBJ15_Dx  " ";
CM_ SG_ 855 RLR_OBJ15_Dy  " ";
CM_ SG_ 855 RLR_OBJ16_Vx  " ";
CM_ SG_ 855 RLR_OBJ16_Vy  " ";
CM_ SG_ 855 RLR_OBJ16_Convergence  " ";
CM_ SG_ 855 RLR_OBJ16_DelayTime  " ";
CM_ SG_ 855 RLR_OBJ16_HeightGround  " ";
CM_ SG_ 855 RLR_OBJ16_MotionStatus  " ";
CM_ SG_ 855 RLR_OBJ16_RelVx_std  " ";
CM_ SG_ 855 RLR_OBJ16_RelVy_std  " ";
CM_ SG_ 855 RLR_OBJ16_Dx_Vnce  " ";
CM_ SG_ 855 RLR_OBJ16_Dy_Vnce  " ";
CM_ SG_ 855 RLR_OBJ15_Vx  " ";
CM_ SG_ 855 RLR_OBJ15_Vy  " ";
CM_ SG_ 855 RLR_OBJ15_Convergence  " ";
CM_ SG_ 855 RLR_OBJ15_DelayTime  " ";
CM_ SG_ 855 RLR_OBJ15_HeightGround  " ";
CM_ SG_ 855 RLR_OBJ15_MotionStatus  " ";
CM_ SG_ 855 RLR_OBJ15_RelVx_std  " ";
CM_ SG_ 855 RLR_OBJ15_RelVy_std  " ";
CM_ SG_ 855 RLR_OBJ15_Dx_Vnce  " ";
CM_ SG_ 855 RLR_OBJ15_Dy_Vnce  " ";
CM_ SG_ 855 RLR_CRCCheck_357  " ";
CM_ SG_ 855 RLR_RollingCounter_357  " ";
CM_ SG_ 855 RLR_OBJ16_Track_Age  " ";
CM_ SG_ 855 RLR_OBJ16_ReRPointLoc  " ";
CM_ SG_ 855 RLR_OBJ16_ObstacleProb  " ";
CM_ SG_ 855 RLR_OBJ16_Measured  " ";
CM_ SG_ 855 RLR_OBJ16_ExistProb  " ";
CM_ SG_ 855 RLR_OBJ16_Location  " ";
CM_ SG_ 855 RLR_OBJ16_RelAx  " ";
CM_ SG_ 855 RLR_OBJ16_RelAy  " ";
CM_ SG_ 855 RLR_OBJ16_RelVx  " ";
CM_ SG_ 855 RLR_OBJ16_RelVy  " ";
CM_ SG_ 855 RLR_OBJ16_HeadingAngle  " ";
CM_ SG_ 855 RLR_OBJ16_Length  " ";
CM_ SG_ 855 RLR_OBJ16_Height  " ";
CM_ SG_ 855 RLR_OBJ16_Width  " ";
CM_ SG_ 855 RLR_OBJ16_Type  " ";
CM_ SG_ 855 RLR_OBJ16_Track_ID  " ";
CM_ SG_ 855 RLR_OBJ15_Track_Age  " ";
CM_ SG_ 855 RLR_OBJ15_ReRPointLoc  " ";
CM_ SG_ 855 RLR_OBJ15_ObstacleProb  " ";
CM_ SG_ 855 RLR_OBJ15_Measured  " ";
CM_ SG_ 855 RLR_OBJ15_ExistProb  " ";
CM_ SG_ 855 RLR_OBJ15_Location  " ";
CM_ SG_ 855 RLR_OBJ15_RelAx  " ";
CM_ SG_ 855 RLR_OBJ15_RelAy  " ";
CM_ SG_ 855 RLR_OBJ15_RelVx  " ";
CM_ SG_ 855 RLR_OBJ15_RelVy  " ";
CM_ SG_ 855 RLR_OBJ15_HeadingAngle  " ";
CM_ SG_ 855 RLR_OBJ15_Length  " ";
CM_ SG_ 855 RLR_OBJ15_Height  " ";
CM_ SG_ 855 RLR_OBJ15_Width  " ";
CM_ SG_ 855 RLR_OBJ15_Type  " ";
CM_ SG_ 855 RLR_OBJ15_Track_ID  " ";

CM_ BO_ 856  " ";
CM_ SG_ 856 RLR_OBJ18_LostCnt  " ";
CM_ SG_ 856 RLR_OBJ17_LostCnt  " ";
CM_ SG_ 856 RLR_OBJ18_Dx  " ";
CM_ SG_ 856 RLR_OBJ18_Dy  " ";
CM_ SG_ 856 RLR_OBJ17_Dx  " ";
CM_ SG_ 856 RLR_OBJ17_Dy  " ";
CM_ SG_ 856 RLR_OBJ18_Vx  " ";
CM_ SG_ 856 RLR_OBJ18_Vy  " ";
CM_ SG_ 856 RLR_OBJ18_Convergence  " ";
CM_ SG_ 856 RLR_OBJ18_DelayTime  " ";
CM_ SG_ 856 RLR_OBJ18_HeightGround  " ";
CM_ SG_ 856 RLR_OBJ18_MotionStatus  " ";
CM_ SG_ 856 RLR_OBJ18_RelVx_std  " ";
CM_ SG_ 856 RLR_OBJ18_RelVy_std  " ";
CM_ SG_ 856 RLR_OBJ18_Dx_Vnce  " ";
CM_ SG_ 856 RLR_OBJ18_Dy_Vnce  " ";
CM_ SG_ 856 RLR_OBJ17_Vx  " ";
CM_ SG_ 856 RLR_OBJ17_Vy  " ";
CM_ SG_ 856 RLR_OBJ17_Convergence  " ";
CM_ SG_ 856 RLR_OBJ17_DelayTime  " ";
CM_ SG_ 856 RLR_OBJ17_HeightGround  " ";
CM_ SG_ 856 RLR_OBJ17_MotionStatus  " ";
CM_ SG_ 856 RLR_OBJ17_RelVx_std  " ";
CM_ SG_ 856 RLR_OBJ17_RelVy_std  " ";
CM_ SG_ 856 RLR_OBJ17_Dx_Vnce  " ";
CM_ SG_ 856 RLR_OBJ17_Dy_Vnce  " ";
CM_ SG_ 856 RLR_CRCCheck_358  " ";
CM_ SG_ 856 RLR_RollingCounter_358  " ";
CM_ SG_ 856 RLR_OBJ18_Track_Age  " ";
CM_ SG_ 856 RLR_OBJ18_ReRPointLoc  " ";
CM_ SG_ 856 RLR_OBJ18_ObstacleProb  " ";
CM_ SG_ 856 RLR_OBJ18_Measured  " ";
CM_ SG_ 856 RLR_OBJ18_ExistProb  " ";
CM_ SG_ 856 RLR_OBJ18_Location  " ";
CM_ SG_ 856 RLR_OBJ18_RelAx  " ";
CM_ SG_ 856 RLR_OBJ18_RelAy  " ";
CM_ SG_ 856 RLR_OBJ18_RelVx  " ";
CM_ SG_ 856 RLR_OBJ18_RelVy  " ";
CM_ SG_ 856 RLR_OBJ18_HeadingAngle  " ";
CM_ SG_ 856 RLR_OBJ18_Length  " ";
CM_ SG_ 856 RLR_OBJ18_Height  " ";
CM_ SG_ 856 RLR_OBJ18_Width  " ";
CM_ SG_ 856 RLR_OBJ18_Type  " ";
CM_ SG_ 856 RLR_OBJ18_Track_ID  " ";
CM_ SG_ 856 RLR_OBJ17_Track_Age  " ";
CM_ SG_ 856 RLR_OBJ17_ReRPointLoc  " ";
CM_ SG_ 856 RLR_OBJ17_ObstacleProb  " ";
CM_ SG_ 856 RLR_OBJ17_Measured  " ";
CM_ SG_ 856 RLR_OBJ17_ExistProb  " ";
CM_ SG_ 856 RLR_OBJ17_Location  " ";
CM_ SG_ 856 RLR_OBJ17_RelAx  " ";
CM_ SG_ 856 RLR_OBJ17_RelAy  " ";
CM_ SG_ 856 RLR_OBJ17_RelVx  " ";
CM_ SG_ 856 RLR_OBJ17_RelVy  " ";
CM_ SG_ 856 RLR_OBJ17_HeadingAngle  " ";
CM_ SG_ 856 RLR_OBJ17_Length  " ";
CM_ SG_ 856 RLR_OBJ17_Height  " ";
CM_ SG_ 856 RLR_OBJ17_Width  " ";
CM_ SG_ 856 RLR_OBJ17_Type  " ";
CM_ SG_ 856 RLR_OBJ17_Track_ID  " ";

CM_ BO_ 857  " ";
CM_ SG_ 857 RLR_OBJ20_LostCnt  " ";
CM_ SG_ 857 RLR_OBJ19_LostCnt  " ";
CM_ SG_ 857 RLR_OBJ20_Dx  " ";
CM_ SG_ 857 RLR_OBJ20_Dy  " ";
CM_ SG_ 857 RLR_OBJ19_Dx  " ";
CM_ SG_ 857 RLR_OBJ19_Dy  " ";
CM_ SG_ 857 RLR_OBJ20_Vx  " ";
CM_ SG_ 857 RLR_OBJ20_Vy  " ";
CM_ SG_ 857 RLR_OBJ20_Convergence  " ";
CM_ SG_ 857 RLR_OBJ20_DelayTime  " ";
CM_ SG_ 857 RLR_OBJ20_HeightGround  " ";
CM_ SG_ 857 RLR_OBJ20_MotionStatus  " ";
CM_ SG_ 857 RLR_OBJ20_RelVx_std  " ";
CM_ SG_ 857 RLR_OBJ20_RelVy_std  " ";
CM_ SG_ 857 RLR_OBJ20_Dx_Vnce  " ";
CM_ SG_ 857 RLR_OBJ20_Dy_Vnce  " ";
CM_ SG_ 857 RLR_OBJ19_Vx  " ";
CM_ SG_ 857 RLR_OBJ19_Vy  " ";
CM_ SG_ 857 RLR_OBJ19_Convergence  " ";
CM_ SG_ 857 RLR_OBJ19_DelayTime  " ";
CM_ SG_ 857 RLR_OBJ19_HeightGround  " ";
CM_ SG_ 857 RLR_OBJ19_MotionStatus  " ";
CM_ SG_ 857 RLR_OBJ19_RelVx_std  " ";
CM_ SG_ 857 RLR_OBJ19_RelVy_std  " ";
CM_ SG_ 857 RLR_OBJ19_Dx_Vnce  " ";
CM_ SG_ 857 RLR_OBJ19_Dy_Vnce  " ";
CM_ SG_ 857 RLR_CRCCheck_359  " ";
CM_ SG_ 857 RLR_RollingCounter_359  " ";
CM_ SG_ 857 RLR_OBJ20_Track_Age  " ";
CM_ SG_ 857 RLR_OBJ20_ReRPointLoc  " ";
CM_ SG_ 857 RLR_OBJ20_ObstacleProb  " ";
CM_ SG_ 857 RLR_OBJ20_Measured  " ";
CM_ SG_ 857 RLR_OBJ20_ExistProb  " ";
CM_ SG_ 857 RLR_OBJ20_Location  " ";
CM_ SG_ 857 RLR_OBJ20_RelAx  " ";
CM_ SG_ 857 RLR_OBJ20_RelAy  " ";
CM_ SG_ 857 RLR_OBJ20_RelVx  " ";
CM_ SG_ 857 RLR_OBJ20_RelVy  " ";
CM_ SG_ 857 RLR_OBJ20_HeadingAngle  " ";
CM_ SG_ 857 RLR_OBJ20_Length  " ";
CM_ SG_ 857 RLR_OBJ20_Height  " ";
CM_ SG_ 857 RLR_OBJ20_Width  " ";
CM_ SG_ 857 RLR_OBJ20_Type  " ";
CM_ SG_ 857 RLR_OBJ20_Track_ID  " ";
CM_ SG_ 857 RLR_OBJ19_Track_Age  " ";
CM_ SG_ 857 RLR_OBJ19_ReRPointLoc  " ";
CM_ SG_ 857 RLR_OBJ19_ObstacleProb  " ";
CM_ SG_ 857 RLR_OBJ19_Measured  " ";
CM_ SG_ 857 RLR_OBJ19_ExistProb  " ";
CM_ SG_ 857 RLR_OBJ19_Location  " ";
CM_ SG_ 857 RLR_OBJ19_RelAx  " ";
CM_ SG_ 857 RLR_OBJ19_RelAy  " ";
CM_ SG_ 857 RLR_OBJ19_RelVx  " ";
CM_ SG_ 857 RLR_OBJ19_RelVy  " ";
CM_ SG_ 857 RLR_OBJ19_HeadingAngle  " ";
CM_ SG_ 857 RLR_OBJ19_Length  " ";
CM_ SG_ 857 RLR_OBJ19_Height  " ";
CM_ SG_ 857 RLR_OBJ19_Width  " ";
CM_ SG_ 857 RLR_OBJ19_Type  " ";
CM_ SG_ 857 RLR_OBJ19_Track_ID  " ";

CM_ BO_ 858  " ";
CM_ SG_ 858 RLR_OBJ22_LostCnt  " ";
CM_ SG_ 858 RLR_OBJ21_LostCnt  " ";
CM_ SG_ 858 RLR_OBJ22_Dx  " ";
CM_ SG_ 858 RLR_OBJ22_Dy  " ";
CM_ SG_ 858 RLR_OBJ21_Dx  " ";
CM_ SG_ 858 RLR_OBJ21_Dy  " ";
CM_ SG_ 858 RLR_OBJ22_Vx  " ";
CM_ SG_ 858 RLR_OBJ22_Vy  " ";
CM_ SG_ 858 RLR_OBJ22_Convergence  " ";
CM_ SG_ 858 RLR_OBJ22_DelayTime  " ";
CM_ SG_ 858 RLR_OBJ22_HeightGround  " ";
CM_ SG_ 858 RLR_OBJ22_MotionStatus  " ";
CM_ SG_ 858 RLR_OBJ22_RelVx_std  " ";
CM_ SG_ 858 RLR_OBJ22_RelVy_std  " ";
CM_ SG_ 858 RLR_OBJ22_Dx_Vnce  " ";
CM_ SG_ 858 RLR_OBJ22_Dy_Vnce  " ";
CM_ SG_ 858 RLR_OBJ21_Vx  " ";
CM_ SG_ 858 RLR_OBJ21_Vy  " ";
CM_ SG_ 858 RLR_OBJ21_Convergence  " ";
CM_ SG_ 858 RLR_OBJ21_DelayTime  " ";
CM_ SG_ 858 RLR_OBJ21_HeightGround  " ";
CM_ SG_ 858 RLR_OBJ21_MotionStatus  " ";
CM_ SG_ 858 RLR_OBJ21_RelVx_std  " ";
CM_ SG_ 858 RLR_OBJ21_RelVy_std  " ";
CM_ SG_ 858 RLR_OBJ21_Dx_Vnce  " ";
CM_ SG_ 858 RLR_OBJ21_Dy_Vnce  " ";
CM_ SG_ 858 RLR_CRCCheck_35A  " ";
CM_ SG_ 858 RLR_RollingCounter_35A  " ";
CM_ SG_ 858 RLR_OBJ22_Track_Age  " ";
CM_ SG_ 858 RLR_OBJ22_ReRPointLoc  " ";
CM_ SG_ 858 RLR_OBJ22_ObstacleProb  " ";
CM_ SG_ 858 RLR_OBJ22_Measured  " ";
CM_ SG_ 858 RLR_OBJ22_ExistProb  " ";
CM_ SG_ 858 RLR_OBJ22_Location  " ";
CM_ SG_ 858 RLR_OBJ22_RelAx  " ";
CM_ SG_ 858 RLR_OBJ22_RelAy  " ";
CM_ SG_ 858 RLR_OBJ22_RelVx  " ";
CM_ SG_ 858 RLR_OBJ22_RelVy  " ";
CM_ SG_ 858 RLR_OBJ22_HeadingAngle  " ";
CM_ SG_ 858 RLR_OBJ22_Length  " ";
CM_ SG_ 858 RLR_OBJ22_Height  " ";
CM_ SG_ 858 RLR_OBJ22_Width  " ";
CM_ SG_ 858 RLR_OBJ22_Type  " ";
CM_ SG_ 858 RLR_OBJ22_Track_ID  " ";
CM_ SG_ 858 RLR_OBJ21_Track_Age  " ";
CM_ SG_ 858 RLR_OBJ21_ReRPointLoc  " ";
CM_ SG_ 858 RLR_OBJ21_ObstacleProb  " ";
CM_ SG_ 858 RLR_OBJ21_Measured  " ";
CM_ SG_ 858 RLR_OBJ21_ExistProb  " ";
CM_ SG_ 858 RLR_OBJ21_Location  " ";
CM_ SG_ 858 RLR_OBJ21_RelAx  " ";
CM_ SG_ 858 RLR_OBJ21_RelAy  " ";
CM_ SG_ 858 RLR_OBJ21_RelVx  " ";
CM_ SG_ 858 RLR_OBJ21_RelVy  " ";
CM_ SG_ 858 RLR_OBJ21_HeadingAngle  " ";
CM_ SG_ 858 RLR_OBJ21_Length  " ";
CM_ SG_ 858 RLR_OBJ21_Height  " ";
CM_ SG_ 858 RLR_OBJ21_Width  " ";
CM_ SG_ 858 RLR_OBJ21_Type  " ";
CM_ SG_ 858 RLR_OBJ21_Track_ID  " ";

BA_DEF_ SG_  "GenSigStartValue" INT 0 0;
BA_DEF_ SG_  "GenSigInvalidValue" STRING  ;
BA_DEF_ SG_  "GenSigCycleTime" INT 0 0;
BA_DEF_ SG_  "GenSigSendType" ENUM  "Cyclic","OnWrite","OnWriteWithRepetition","OnChange","OnChangeWithRepetition","IfActive","IfActiveWithRepetition","NoSigSendType","NotUsed","NotUsed","NotUsed","NotUsed","NotUsed";
BA_DEF_  "Baudrate" INT 0 1000000;
BA_DEF_  "BusType" STRING ;
BA_DEF_  "NmType" STRING ;
BA_DEF_  "Manufacturer" STRING ;
BA_DEF_  "VersionYear" INT 2009 2210;
BA_DEF_  "VersionNumber" INT 0 65535;
BA_DEF_  "VersionMonth" INT 0 18;
BA_DEF_  "VersionDay" INT 0 49;
BA_DEF_ BU_  "NodeLayerModules" STRING ;
BA_DEF_ BU_  "ILUsed" ENUM  "No","Yes";
BA_DEF_  "GenNWMTalkNM" STRING ;
BA_DEF_  "GenNWMGotoMode_BusSleep" STRING ;
BA_DEF_  "GenNWMGotoMode_Awake" STRING ;
BA_DEF_  "GenNWMApCanWakeUp" STRING ;
BA_DEF_  "GenNWMApCanSleep" STRING ;
BA_DEF_  "GenNWMApCanOn" STRING ;
BA_DEF_  "GenNWMApCanOff" STRING ;
BA_DEF_  "GenNWMApCanNormal" STRING ;
BA_DEF_  "GenNWMApBusSleep" STRING ;
BA_DEF_ BO_  "GenMsgSendType" ENUM  "Cyclic","Event","Direct","NotUsed","NotUsed","Cyclic","NotUsed","IfActive","NoMsgSendType","NotUsed";
BA_DEF_ BO_  "GenMsgILSupport" ENUM  "No","Yes";
BA_DEF_ BO_  "GenMsgCycleTime" INT 0 65535;
BA_DEF_ BO_  "CANFD_BRS" ENUM  "0","1";
BA_DEF_ BO_  "VFrameFormat" ENUM  "StandardCAN","ExtendedCAN","reserved","reserved","reserved","reserved","reserved","reserved","reserved","reserved","reserved","reserved","reserved","reserved","StandardCAN_FD","ExtendedCAN_FD";
BA_DEF_DEF_  "GenSigStartValue" 0;
BA_DEF_DEF_  "GenSigInvalidValue" "/";
BA_DEF_DEF_  "GenSigCycleTime" 0;
BA_DEF_DEF_  "GenSigSendType" "Cyclic";
BA_DEF_DEF_  "Baudrate" 500000;
BA_DEF_DEF_  "BusType" "";
BA_DEF_DEF_  "NmType" "";
BA_DEF_DEF_  "Manufacturer" "CHANA";
BA_DEF_DEF_  "VersionYear" 2010;
BA_DEF_DEF_  "VersionNumber" 0;
BA_DEF_DEF_  "VersionMonth" 11;
BA_DEF_DEF_  "VersionDay" 0;
BA_DEF_DEF_  "NodeLayerModules" "CANoeILNLVector.dll";
BA_DEF_DEF_  "ILUsed" "Yes";
BA_DEF_DEF_  "GenNWMTalkNM" "TalkNM()";
BA_DEF_DEF_  "GenNWMGotoMode_BusSleep" "GotoMode_BusSleep()";
BA_DEF_DEF_  "GenNWMGotoMode_Awake" "GotoMode_Awake()";
BA_DEF_DEF_  "GenNWMApCanWakeUp" "apCanWakeUp()";
BA_DEF_DEF_  "GenNWMApCanSleep" "apCanSleep()";
BA_DEF_DEF_  "GenNWMApCanOn" "apCanOn()";
BA_DEF_DEF_  "GenNWMApCanOff" "apCanOff()";
BA_DEF_DEF_  "GenNWMApCanNormal" "apCanNormal()";
BA_DEF_DEF_  "GenNWMApBusSleep" "apBusSleep()";
BA_DEF_DEF_  "GenMsgSendType" "NoMsgSendType";
BA_DEF_DEF_  "GenMsgILSupport" "Yes";
BA_DEF_DEF_  "GenMsgCycleTime" 0;
BA_DEF_DEF_  "CANFD_BRS" "1";
BA_DEF_DEF_  "VFrameFormat" "StandardCAN";

BA_ "VersionYear" 2025;
BA_ "VersionNumber" 11;
BA_ "VersionMonth" 06;
BA_ "VersionDay" 20;
BA_ "Baudrate" 2000000;
BA_ "NmType" "OSEK";
BA_ "BusType" "CAN FD";
BA_ "GenMsgCycleTime" BO_ 836 50;
BA_ "GenMsgSendType" BO_ 836 0;
BA_ "VFrameFormat" BO_ 836 14;
BA_ "GenMsgCycleTime" BO_ 840 50;
BA_ "GenMsgSendType" BO_ 840 0;
BA_ "VFrameFormat" BO_ 840 14;
BA_ "GenMsgCycleTime" BO_ 848 50;
BA_ "GenMsgSendType" BO_ 848 0;
BA_ "VFrameFormat" BO_ 848 14;
BA_ "GenMsgCycleTime" BO_ 849 50;
BA_ "GenMsgSendType" BO_ 849 0;
BA_ "VFrameFormat" BO_ 849 14;
BA_ "GenMsgCycleTime" BO_ 850 50;
BA_ "GenMsgSendType" BO_ 850 0;
BA_ "VFrameFormat" BO_ 850 14;
BA_ "GenMsgCycleTime" BO_ 851 50;
BA_ "GenMsgSendType" BO_ 851 0;
BA_ "VFrameFormat" BO_ 851 14;
BA_ "GenMsgCycleTime" BO_ 852 50;
BA_ "GenMsgSendType" BO_ 852 0;
BA_ "VFrameFormat" BO_ 852 14;
BA_ "GenMsgCycleTime" BO_ 853 50;
BA_ "GenMsgSendType" BO_ 853 0;
BA_ "VFrameFormat" BO_ 853 14;
BA_ "GenMsgCycleTime" BO_ 865 50;
BA_ "GenMsgSendType" BO_ 865 0;
BA_ "VFrameFormat" BO_ 865 14;
BA_ "GenMsgCycleTime" BO_ 855 50;
BA_ "GenMsgSendType" BO_ 855 0;
BA_ "VFrameFormat" BO_ 855 14;
BA_ "GenMsgCycleTime" BO_ 856 50;
BA_ "GenMsgSendType" BO_ 856 0;
BA_ "VFrameFormat" BO_ 856 14;
BA_ "GenMsgCycleTime" BO_ 857 50;
BA_ "GenMsgSendType" BO_ 857 0;
BA_ "VFrameFormat" BO_ 857 14;
BA_ "GenMsgCycleTime" BO_ 858 50;
BA_ "GenMsgSendType" BO_ 858 0;
BA_ "VFrameFormat" BO_ 858 14;
BA_ "GenSigCycleTime" SG_ 836 RLR_CRCCheck_344 50;
BA_ "GenSigCycleTime" SG_ 836 RLR_RollingCounter_344 50;
BA_ "GenSigCycleTime" SG_ 836 RLR_SenceMode 50;
BA_ "GenSigCycleTime" SG_ 836 RLR_WorkSenceMode 50;
BA_ "GenSigCycleTime" SG_ 836 RLR_WorkMode 50;
BA_ "GenSigCycleTime" SG_ 836 RLR_ObjCount 50;
BA_ "GenSigCycleTime" SG_ 836 RLR_ped_azi 50;
BA_ "GenSigCycleTime" SG_ 836 RLR_ped_Ym 50;
BA_ "GenSigCycleTime" SG_ 836 RLR_ped_Xm 50;
BA_ "GenSigCycleTime" SG_ 836 RLR_ped_ConRidence 50;
BA_ "GenSigCycleTime" SG_ 836 RLR_ped_result 50;

BA_ "GenSigCycleTime" SG_ 840 RLR_Suppliers 50;
BA_ "GenSigCycleTime" SG_ 840 RLR_CRCCheck_348 50;
BA_ "GenSigCycleTime" SG_ 840 RLR_RollingCounter_348 50;
BA_ "GenSigCycleTime" SG_ 840 RLR_SystemStatus 50;
BA_ "GenSigStartValue" SG_ 840 RLR_SystemStatus 1.000000;
BA_ "GenSigInvalidValue" SG_ 840 RLR_SystemStatus "7";
BA_ "GenSigCycleTime" SG_ 840 RLR_MCUTiStamp 50;
BA_ "GenSigCycleTime" SG_ 840 RLR_SyncTiStamp 50;
BA_ "GenSigCycleTime" SG_ 840 RLR_OBJ_TiOut 50;
BA_ "GenSigCycleTime" SG_ 840 RLR_OBJ_TiLeap 50;
BA_ "GenSigCycleTime" SG_ 840 RLR_OBJ_TiBas 50;
BA_ "GenSigCycleTime" SG_ 840 RLR_OBJTi_Stamp 50;
BA_ "GenSigCycleTime" SG_ 840 RLR_ObjDelay 50;

BA_ "GenSigCycleTime" SG_ 848 RLR_OBJ2_LostCnt 50;
BA_ "GenSigCycleTime" SG_ 848 RLR_OBJ1_LostCnt 50;
BA_ "GenSigCycleTime" SG_ 848 RLR_OBJ2_Dx 50;
BA_ "GenSigCycleTime" SG_ 848 RLR_OBJ2_Dy 50;
BA_ "GenSigCycleTime" SG_ 848 RLR_OBJ1_Dx 50;
BA_ "GenSigCycleTime" SG_ 848 RLR_OBJ1_Dy 50;
BA_ "GenSigCycleTime" SG_ 848 RLR_OBJ2_Vx 50;
BA_ "GenSigCycleTime" SG_ 848 RLR_OBJ2_Vy 50;
BA_ "GenSigCycleTime" SG_ 848 RLR_OBJ2_Convergence 50;
BA_ "GenSigCycleTime" SG_ 848 RLR_OBJ2_DelayTime 50;
BA_ "GenSigCycleTime" SG_ 848 RLR_OBJ2_HeightGround 50;
BA_ "GenSigCycleTime" SG_ 848 RLR_OBJ2_MotionStatus 50;
BA_ "GenSigCycleTime" SG_ 848 RLR_OBJ2_RelVx_std 50;
BA_ "GenSigInvalidValue" SG_ 848 RLR_OBJ2_RelVx_std "4095";
BA_ "GenSigCycleTime" SG_ 848 RLR_OBJ2_RelVy_std 50;
BA_ "GenSigInvalidValue" SG_ 848 RLR_OBJ2_RelVy_std "1023";
BA_ "GenSigCycleTime" SG_ 848 RLR_OBJ2_Dx_Vnce 50;
BA_ "GenSigInvalidValue" SG_ 848 RLR_OBJ2_Dx_Vnce "16383";
BA_ "GenSigCycleTime" SG_ 848 RLR_OBJ2_Dy_Vnce 50;
BA_ "GenSigInvalidValue" SG_ 848 RLR_OBJ2_Dy_Vnce "1023";
BA_ "GenSigCycleTime" SG_ 848 RLR_OBJ1_Vx 50;
BA_ "GenSigCycleTime" SG_ 848 RLR_OBJ1_Vy 50;
BA_ "GenSigCycleTime" SG_ 848 RLR_OBJ1_Convergence 50;
BA_ "GenSigCycleTime" SG_ 848 RLR_OBJ1_DelayTime 50;
BA_ "GenSigCycleTime" SG_ 848 RLR_OBJ1_HeightGround 50;
BA_ "GenSigCycleTime" SG_ 848 RLR_OBJ1_MotionStatus 50;
BA_ "GenSigCycleTime" SG_ 848 RLR_OBJ1_RelVx_std 50;
BA_ "GenSigInvalidValue" SG_ 848 RLR_OBJ1_RelVx_std "4095";
BA_ "GenSigCycleTime" SG_ 848 RLR_OBJ1_RelVy_std 50;
BA_ "GenSigInvalidValue" SG_ 848 RLR_OBJ1_RelVy_std "1023";
BA_ "GenSigCycleTime" SG_ 848 RLR_OBJ1_Dx_Vnce 50;
BA_ "GenSigInvalidValue" SG_ 848 RLR_OBJ1_Dx_Vnce "16383";
BA_ "GenSigCycleTime" SG_ 848 RLR_OBJ1_Dy_Vnce 50;
BA_ "GenSigInvalidValue" SG_ 848 RLR_OBJ1_Dy_Vnce "1023";
BA_ "GenSigCycleTime" SG_ 848 RLR_CRCCheck_350 50;
BA_ "GenSigCycleTime" SG_ 848 RLR_RollingCounter_350 50;
BA_ "GenSigCycleTime" SG_ 848 RLR_OBJ2_Track_Age 50;
BA_ "GenSigCycleTime" SG_ 848 RLR_OBJ2_ReRPointLoc 50;
BA_ "GenSigCycleTime" SG_ 848 RLR_OBJ2_ObstacleProb 50;
BA_ "GenSigCycleTime" SG_ 848 RLR_OBJ2_Measured 50;
BA_ "GenSigInvalidValue" SG_ 848 RLR_OBJ2_Measured "0";
BA_ "GenSigCycleTime" SG_ 848 RLR_OBJ2_ExistProb 50;
BA_ "GenSigInvalidValue" SG_ 848 RLR_OBJ2_ExistProb "0";
BA_ "GenSigCycleTime" SG_ 848 RLR_OBJ2_Location 50;
BA_ "GenSigInvalidValue" SG_ 848 RLR_OBJ2_Location "0";
BA_ "GenSigCycleTime" SG_ 848 RLR_OBJ2_RelAx 50;
BA_ "GenSigCycleTime" SG_ 848 RLR_OBJ2_RelAy 50;
BA_ "GenSigCycleTime" SG_ 848 RLR_OBJ2_RelVx 50;
BA_ "GenSigCycleTime" SG_ 848 RLR_OBJ2_RelVy 50;
BA_ "GenSigCycleTime" SG_ 848 RLR_OBJ2_HeadingAngle 50;
BA_ "GenSigCycleTime" SG_ 848 RLR_OBJ2_Length 50;
BA_ "GenSigCycleTime" SG_ 848 RLR_OBJ2_Height 50;
BA_ "GenSigCycleTime" SG_ 848 RLR_OBJ2_Width 50;
BA_ "GenSigCycleTime" SG_ 848 RLR_OBJ2_Type 50;
BA_ "GenSigInvalidValue" SG_ 848 RLR_OBJ2_Type "0";
BA_ "GenSigCycleTime" SG_ 848 RLR_OBJ2_Track_ID 50;
BA_ "GenSigCycleTime" SG_ 848 RLR_OBJ1_Track_Age 50;
BA_ "GenSigCycleTime" SG_ 848 RLR_OBJ1_ReRPointLoc 50;
BA_ "GenSigCycleTime" SG_ 848 RLR_OBJ1_ObstacleProb 50;
BA_ "GenSigCycleTime" SG_ 848 RLR_OBJ1_Measured 50;
BA_ "GenSigInvalidValue" SG_ 848 RLR_OBJ1_Measured "0";
BA_ "GenSigCycleTime" SG_ 848 RLR_OBJ1_ExistProb 50;
BA_ "GenSigInvalidValue" SG_ 848 RLR_OBJ1_ExistProb "0";
BA_ "GenSigCycleTime" SG_ 848 RLR_OBJ1_Location 50;
BA_ "GenSigInvalidValue" SG_ 848 RLR_OBJ1_Location "0";
BA_ "GenSigCycleTime" SG_ 848 RLR_OBJ1_RelAx 50;
BA_ "GenSigCycleTime" SG_ 848 RLR_OBJ1_RelAy 50;
BA_ "GenSigCycleTime" SG_ 848 RLR_OBJ1_RelVx 50;
BA_ "GenSigCycleTime" SG_ 848 RLR_OBJ1_RelVy 50;
BA_ "GenSigCycleTime" SG_ 848 RLR_OBJ1_HeadingAngle 50;
BA_ "GenSigCycleTime" SG_ 848 RLR_OBJ1_Length 50;
BA_ "GenSigCycleTime" SG_ 848 RLR_OBJ1_Height 50;
BA_ "GenSigCycleTime" SG_ 848 RLR_OBJ1_Width 50;
BA_ "GenSigCycleTime" SG_ 848 RLR_OBJ1_Type 50;
BA_ "GenSigInvalidValue" SG_ 848 RLR_OBJ1_Type "0";
BA_ "GenSigCycleTime" SG_ 848 RLR_OBJ1_Track_ID 50;

BA_ "GenSigCycleTime" SG_ 849 RLR_OBJ4_LostCnt 50;
BA_ "GenSigCycleTime" SG_ 849 RLR_OBJ3_LostCnt 50;
BA_ "GenSigCycleTime" SG_ 849 RLR_OBJ4_Dx 50;
BA_ "GenSigCycleTime" SG_ 849 RLR_OBJ4_Dy 50;
BA_ "GenSigCycleTime" SG_ 849 RLR_OBJ3_Dx 50;
BA_ "GenSigCycleTime" SG_ 849 RLR_OBJ3_Dy 50;
BA_ "GenSigCycleTime" SG_ 849 RLR_OBJ4_Vx 50;
BA_ "GenSigCycleTime" SG_ 849 RLR_OBJ4_Vy 50;
BA_ "GenSigCycleTime" SG_ 849 RLR_OBJ4_Convergence 50;
BA_ "GenSigCycleTime" SG_ 849 RLR_OBJ4_DelayTime 50;
BA_ "GenSigCycleTime" SG_ 849 RLR_OBJ4_HeightGround 50;
BA_ "GenSigCycleTime" SG_ 849 RLR_OBJ4_MotionStatus 50;
BA_ "GenSigCycleTime" SG_ 849 RLR_OBJ4_RelVx_std 50;
BA_ "GenSigInvalidValue" SG_ 849 RLR_OBJ4_RelVx_std "4095";
BA_ "GenSigCycleTime" SG_ 849 RLR_OBJ4_RelVy_std 50;
BA_ "GenSigInvalidValue" SG_ 849 RLR_OBJ4_RelVy_std "1023";
BA_ "GenSigCycleTime" SG_ 849 RLR_OBJ4_Dx_Vnce 50;
BA_ "GenSigInvalidValue" SG_ 849 RLR_OBJ4_Dx_Vnce "16383";
BA_ "GenSigCycleTime" SG_ 849 RLR_OBJ4_Dy_Vnce 50;
BA_ "GenSigInvalidValue" SG_ 849 RLR_OBJ4_Dy_Vnce "1023";
BA_ "GenSigCycleTime" SG_ 849 RLR_OBJ3_Vx 50;
BA_ "GenSigCycleTime" SG_ 849 RLR_OBJ3_Vy 50;
BA_ "GenSigCycleTime" SG_ 849 RLR_OBJ3_Convergence 50;
BA_ "GenSigCycleTime" SG_ 849 RLR_OBJ3_DelayTime 50;
BA_ "GenSigCycleTime" SG_ 849 RLR_OBJ3_HeightGround 50;
BA_ "GenSigCycleTime" SG_ 849 RLR_OBJ3_MotionStatus 50;
BA_ "GenSigCycleTime" SG_ 849 RLR_OBJ3_RelVx_std 50;
BA_ "GenSigInvalidValue" SG_ 849 RLR_OBJ3_RelVx_std "4095";
BA_ "GenSigCycleTime" SG_ 849 RLR_OBJ3_RelVy_std 50;
BA_ "GenSigInvalidValue" SG_ 849 RLR_OBJ3_RelVy_std "1023";
BA_ "GenSigCycleTime" SG_ 849 RLR_OBJ3_Dx_Vnce 50;
BA_ "GenSigInvalidValue" SG_ 849 RLR_OBJ3_Dx_Vnce "16383";
BA_ "GenSigCycleTime" SG_ 849 RLR_OBJ3_Dy_Vnce 50;
BA_ "GenSigInvalidValue" SG_ 849 RLR_OBJ3_Dy_Vnce "1023";
BA_ "GenSigCycleTime" SG_ 849 RLR_CRCCheck_351 50;
BA_ "GenSigCycleTime" SG_ 849 RLR_RollingCounter_351 50;
BA_ "GenSigCycleTime" SG_ 849 RLR_OBJ4_Track_Age 50;
BA_ "GenSigCycleTime" SG_ 849 RLR_OBJ4_ReRPointLoc 50;
BA_ "GenSigCycleTime" SG_ 849 RLR_OBJ4_ObstacleProb 50;
BA_ "GenSigCycleTime" SG_ 849 RLR_OBJ4_Measured 50;
BA_ "GenSigInvalidValue" SG_ 849 RLR_OBJ4_Measured "0";
BA_ "GenSigCycleTime" SG_ 849 RLR_OBJ4_ExistProb 50;
BA_ "GenSigInvalidValue" SG_ 849 RLR_OBJ4_ExistProb "0";
BA_ "GenSigCycleTime" SG_ 849 RLR_OBJ4_Location 50;
BA_ "GenSigInvalidValue" SG_ 849 RLR_OBJ4_Location "0";
BA_ "GenSigCycleTime" SG_ 849 RLR_OBJ4_RelAx 50;
BA_ "GenSigCycleTime" SG_ 849 RLR_OBJ4_RelAy 50;
BA_ "GenSigCycleTime" SG_ 849 RLR_OBJ4_RelVx 50;
BA_ "GenSigCycleTime" SG_ 849 RLR_OBJ4_RelVy 50;
BA_ "GenSigCycleTime" SG_ 849 RLR_OBJ4_HeadingAngle 50;
BA_ "GenSigCycleTime" SG_ 849 RLR_OBJ4_Length 50;
BA_ "GenSigCycleTime" SG_ 849 RLR_OBJ4_Height 50;
BA_ "GenSigCycleTime" SG_ 849 RLR_OBJ4_Width 50;
BA_ "GenSigCycleTime" SG_ 849 RLR_OBJ4_Type 50;
BA_ "GenSigInvalidValue" SG_ 849 RLR_OBJ4_Type "0";
BA_ "GenSigCycleTime" SG_ 849 RLR_OBJ4_Track_ID 50;
BA_ "GenSigCycleTime" SG_ 849 RLR_OBJ3_Track_Age 50;
BA_ "GenSigCycleTime" SG_ 849 RLR_OBJ3_ReRPointLoc 50;
BA_ "GenSigCycleTime" SG_ 849 RLR_OBJ3_ObstacleProb 50;
BA_ "GenSigCycleTime" SG_ 849 RLR_OBJ3_Measured 50;
BA_ "GenSigInvalidValue" SG_ 849 RLR_OBJ3_Measured "0";
BA_ "GenSigCycleTime" SG_ 849 RLR_OBJ3_ExistProb 50;
BA_ "GenSigInvalidValue" SG_ 849 RLR_OBJ3_ExistProb "0";
BA_ "GenSigCycleTime" SG_ 849 RLR_OBJ3_Location 50;
BA_ "GenSigInvalidValue" SG_ 849 RLR_OBJ3_Location "0";
BA_ "GenSigCycleTime" SG_ 849 RLR_OBJ3_RelAx 50;
BA_ "GenSigCycleTime" SG_ 849 RLR_OBJ3_RelAy 50;
BA_ "GenSigCycleTime" SG_ 849 RLR_OBJ3_RelVx 50;
BA_ "GenSigCycleTime" SG_ 849 RLR_OBJ3_RelVy 50;
BA_ "GenSigCycleTime" SG_ 849 RLR_OBJ3_HeadingAngle 50;
BA_ "GenSigCycleTime" SG_ 849 RLR_OBJ3_Length 50;
BA_ "GenSigCycleTime" SG_ 849 RLR_OBJ3_Height 50;
BA_ "GenSigCycleTime" SG_ 849 RLR_OBJ3_Width 50;
BA_ "GenSigCycleTime" SG_ 849 RLR_OBJ3_Type 50;
BA_ "GenSigInvalidValue" SG_ 849 RLR_OBJ3_Type "0";
BA_ "GenSigCycleTime" SG_ 849 RLR_OBJ3_Track_ID 50;

BA_ "GenSigCycleTime" SG_ 850 RLR_OBJ6_LostCnt 50;
BA_ "GenSigCycleTime" SG_ 850 RLR_OBJ5_LostCnt 50;
BA_ "GenSigCycleTime" SG_ 850 RLR_OBJ6_Dx 50;
BA_ "GenSigCycleTime" SG_ 850 RLR_OBJ6_Dy 50;
BA_ "GenSigCycleTime" SG_ 850 RLR_OBJ5_Dx 50;
BA_ "GenSigCycleTime" SG_ 850 RLR_OBJ5_Dy 50;
BA_ "GenSigCycleTime" SG_ 850 RLR_OBJ6_Vx 50;
BA_ "GenSigCycleTime" SG_ 850 RLR_OBJ6_Vy 50;
BA_ "GenSigCycleTime" SG_ 850 RLR_OBJ6_Convergence 50;
BA_ "GenSigCycleTime" SG_ 850 RLR_OBJ6_DelayTime 50;
BA_ "GenSigCycleTime" SG_ 850 RLR_OBJ6_HeightGround 50;
BA_ "GenSigCycleTime" SG_ 850 RLR_OBJ6_MotionStatus 50;
BA_ "GenSigCycleTime" SG_ 850 RLR_OBJ6_RelVx_std 50;
BA_ "GenSigInvalidValue" SG_ 850 RLR_OBJ6_RelVx_std "4095";
BA_ "GenSigCycleTime" SG_ 850 RLR_OBJ6_RelVy_std 50;
BA_ "GenSigInvalidValue" SG_ 850 RLR_OBJ6_RelVy_std "1023";
BA_ "GenSigCycleTime" SG_ 850 RLR_OBJ6_Dx_Vnce 50;
BA_ "GenSigInvalidValue" SG_ 850 RLR_OBJ6_Dx_Vnce "16383";
BA_ "GenSigCycleTime" SG_ 850 RLR_OBJ6_Dy_Vnce 50;
BA_ "GenSigInvalidValue" SG_ 850 RLR_OBJ6_Dy_Vnce "1023";
BA_ "GenSigCycleTime" SG_ 850 RLR_OBJ5_Vx 50;
BA_ "GenSigCycleTime" SG_ 850 RLR_OBJ5_Vy 50;
BA_ "GenSigCycleTime" SG_ 850 RLR_OBJ5_Convergence 50;
BA_ "GenSigCycleTime" SG_ 850 RLR_OBJ5_DelayTime 50;
BA_ "GenSigCycleTime" SG_ 850 RLR_OBJ5_HeightGround 50;
BA_ "GenSigCycleTime" SG_ 850 RLR_OBJ5_MotionStatus 50;
BA_ "GenSigCycleTime" SG_ 850 RLR_OBJ5_RelVx_std 50;
BA_ "GenSigInvalidValue" SG_ 850 RLR_OBJ5_RelVx_std "4095";
BA_ "GenSigCycleTime" SG_ 850 RLR_OBJ5_RelVy_std 50;
BA_ "GenSigInvalidValue" SG_ 850 RLR_OBJ5_RelVy_std "1023";
BA_ "GenSigCycleTime" SG_ 850 RLR_OBJ5_Dx_Vnce 50;
BA_ "GenSigInvalidValue" SG_ 850 RLR_OBJ5_Dx_Vnce "16383";
BA_ "GenSigCycleTime" SG_ 850 RLR_OBJ5_Dy_Vnce 50;
BA_ "GenSigInvalidValue" SG_ 850 RLR_OBJ5_Dy_Vnce "1023";
BA_ "GenSigCycleTime" SG_ 850 RLR_CRCCheck_352 50;
BA_ "GenSigCycleTime" SG_ 850 RLR_RollingCounter_352 50;
BA_ "GenSigCycleTime" SG_ 850 RLR_OBJ6_Track_Age 50;
BA_ "GenSigCycleTime" SG_ 850 RLR_OBJ6_ReRPointLoc 50;
BA_ "GenSigCycleTime" SG_ 850 RLR_OBJ6_ObstacleProb 50;
BA_ "GenSigCycleTime" SG_ 850 RLR_OBJ6_Measured 50;
BA_ "GenSigInvalidValue" SG_ 850 RLR_OBJ6_Measured "0";
BA_ "GenSigCycleTime" SG_ 850 RLR_OBJ6_ExistProb 50;
BA_ "GenSigInvalidValue" SG_ 850 RLR_OBJ6_ExistProb "0";
BA_ "GenSigCycleTime" SG_ 850 RLR_OBJ6_Location 50;
BA_ "GenSigInvalidValue" SG_ 850 RLR_OBJ6_Location "0";
BA_ "GenSigCycleTime" SG_ 850 RLR_OBJ6_RelAx 50;
BA_ "GenSigCycleTime" SG_ 850 RLR_OBJ6_RelAy 50;
BA_ "GenSigCycleTime" SG_ 850 RLR_OBJ6_RelVx 50;
BA_ "GenSigCycleTime" SG_ 850 RLR_OBJ6_RelVy 50;
BA_ "GenSigCycleTime" SG_ 850 RLR_OBJ6_HeadingAngle 50;
BA_ "GenSigCycleTime" SG_ 850 RLR_OBJ6_Length 50;
BA_ "GenSigCycleTime" SG_ 850 RLR_OBJ6_Height 50;
BA_ "GenSigCycleTime" SG_ 850 RLR_OBJ6_Width 50;
BA_ "GenSigCycleTime" SG_ 850 RLR_OBJ6_Type 50;
BA_ "GenSigInvalidValue" SG_ 850 RLR_OBJ6_Type "0";
BA_ "GenSigCycleTime" SG_ 850 RLR_OBJ6_Track_ID 50;
BA_ "GenSigCycleTime" SG_ 850 RLR_OBJ5_Track_Age 50;
BA_ "GenSigCycleTime" SG_ 850 RLR_OBJ5_ReRPointLoc 50;
BA_ "GenSigCycleTime" SG_ 850 RLR_OBJ5_ObstacleProb 50;
BA_ "GenSigCycleTime" SG_ 850 RLR_OBJ5_Measured 50;
BA_ "GenSigInvalidValue" SG_ 850 RLR_OBJ5_Measured "0";
BA_ "GenSigCycleTime" SG_ 850 RLR_OBJ5_ExistProb 50;
BA_ "GenSigInvalidValue" SG_ 850 RLR_OBJ5_ExistProb "0";
BA_ "GenSigCycleTime" SG_ 850 RLR_OBJ5_Location 50;
BA_ "GenSigInvalidValue" SG_ 850 RLR_OBJ5_Location "0";
BA_ "GenSigCycleTime" SG_ 850 RLR_OBJ5_RelAx 50;
BA_ "GenSigCycleTime" SG_ 850 RLR_OBJ5_RelAy 50;
BA_ "GenSigCycleTime" SG_ 850 RLR_OBJ5_RelVx 50;
BA_ "GenSigCycleTime" SG_ 850 RLR_OBJ5_RelVy 50;
BA_ "GenSigCycleTime" SG_ 850 RLR_OBJ5_HeadingAngle 50;
BA_ "GenSigCycleTime" SG_ 850 RLR_OBJ5_Length 50;
BA_ "GenSigCycleTime" SG_ 850 RLR_OBJ5_Height 50;
BA_ "GenSigCycleTime" SG_ 850 RLR_OBJ5_Width 50;
BA_ "GenSigCycleTime" SG_ 850 RLR_OBJ5_Type 50;
BA_ "GenSigInvalidValue" SG_ 850 RLR_OBJ5_Type "0";
BA_ "GenSigCycleTime" SG_ 850 RLR_OBJ5_Track_ID 50;

BA_ "GenSigCycleTime" SG_ 851 RLR_OBJ8_LostCnt 50;
BA_ "GenSigCycleTime" SG_ 851 RLR_OBJ7_LostCnt 50;
BA_ "GenSigCycleTime" SG_ 851 RLR_OBJ8_Dx 50;
BA_ "GenSigCycleTime" SG_ 851 RLR_OBJ8_Dy 50;
BA_ "GenSigCycleTime" SG_ 851 RLR_OBJ7_Dx 50;
BA_ "GenSigCycleTime" SG_ 851 RLR_OBJ7_Dy 50;
BA_ "GenSigCycleTime" SG_ 851 RLR_OBJ8_Vx 50;
BA_ "GenSigCycleTime" SG_ 851 RLR_OBJ8_Vy 50;
BA_ "GenSigCycleTime" SG_ 851 RLR_OBJ8_Convergence 50;
BA_ "GenSigCycleTime" SG_ 851 RLR_OBJ8_DelayTime 50;
BA_ "GenSigCycleTime" SG_ 851 RLR_OBJ8_HeightGround 50;
BA_ "GenSigCycleTime" SG_ 851 RLR_OBJ8_MotionStatus 50;
BA_ "GenSigCycleTime" SG_ 851 RLR_OBJ8_RelVx_std 50;
BA_ "GenSigInvalidValue" SG_ 851 RLR_OBJ8_RelVx_std "4095";
BA_ "GenSigCycleTime" SG_ 851 RLR_OBJ8_RelVy_std 50;
BA_ "GenSigInvalidValue" SG_ 851 RLR_OBJ8_RelVy_std "1023";
BA_ "GenSigCycleTime" SG_ 851 RLR_OBJ8_Dx_Vnce 50;
BA_ "GenSigInvalidValue" SG_ 851 RLR_OBJ8_Dx_Vnce "16383";
BA_ "GenSigCycleTime" SG_ 851 RLR_OBJ8_Dy_Vnce 50;
BA_ "GenSigInvalidValue" SG_ 851 RLR_OBJ8_Dy_Vnce "1023";
BA_ "GenSigCycleTime" SG_ 851 RLR_OBJ7_Vx 50;
BA_ "GenSigCycleTime" SG_ 851 RLR_OBJ7_Vy 50;
BA_ "GenSigCycleTime" SG_ 851 RLR_OBJ7_Convergence 50;
BA_ "GenSigCycleTime" SG_ 851 RLR_OBJ7_DelayTime 50;
BA_ "GenSigCycleTime" SG_ 851 RLR_OBJ7_HeightGround 50;
BA_ "GenSigCycleTime" SG_ 851 RLR_OBJ7_MotionStatus 50;
BA_ "GenSigCycleTime" SG_ 851 RLR_OBJ7_RelVx_std 50;
BA_ "GenSigInvalidValue" SG_ 851 RLR_OBJ7_RelVx_std "4095";
BA_ "GenSigCycleTime" SG_ 851 RLR_OBJ7_RelVy_std 50;
BA_ "GenSigInvalidValue" SG_ 851 RLR_OBJ7_RelVy_std "1023";
BA_ "GenSigCycleTime" SG_ 851 RLR_OBJ7_Dx_Vnce 50;
BA_ "GenSigInvalidValue" SG_ 851 RLR_OBJ7_Dx_Vnce "16383";
BA_ "GenSigCycleTime" SG_ 851 RLR_OBJ7_Dy_Vnce 50;
BA_ "GenSigInvalidValue" SG_ 851 RLR_OBJ7_Dy_Vnce "1023";
BA_ "GenSigCycleTime" SG_ 851 RLR_CRCCheck_353 50;
BA_ "GenSigCycleTime" SG_ 851 RLR_RollingCounter_353 50;
BA_ "GenSigCycleTime" SG_ 851 RLR_OBJ8_Track_Age 50;
BA_ "GenSigCycleTime" SG_ 851 RLR_OBJ8_ReRPointLoc 50;
BA_ "GenSigCycleTime" SG_ 851 RLR_OBJ8_ObstacleProb 50;
BA_ "GenSigCycleTime" SG_ 851 RLR_OBJ8_Measured 50;
BA_ "GenSigInvalidValue" SG_ 851 RLR_OBJ8_Measured "0";
BA_ "GenSigCycleTime" SG_ 851 RLR_OBJ8_ExistProb 50;
BA_ "GenSigInvalidValue" SG_ 851 RLR_OBJ8_ExistProb "0";
BA_ "GenSigCycleTime" SG_ 851 RLR_OBJ8_Location 50;
BA_ "GenSigInvalidValue" SG_ 851 RLR_OBJ8_Location "0";
BA_ "GenSigCycleTime" SG_ 851 RLR_OBJ8_RelAx 50;
BA_ "GenSigCycleTime" SG_ 851 RLR_OBJ8_RelAy 50;
BA_ "GenSigCycleTime" SG_ 851 RLR_OBJ8_RelVx 50;
BA_ "GenSigCycleTime" SG_ 851 RLR_OBJ8_RelVy 50;
BA_ "GenSigCycleTime" SG_ 851 RLR_OBJ8_HeadingAngle 50;
BA_ "GenSigCycleTime" SG_ 851 RLR_OBJ8_Length 50;
BA_ "GenSigCycleTime" SG_ 851 RLR_OBJ8_Height 50;
BA_ "GenSigCycleTime" SG_ 851 RLR_OBJ8_Width 50;
BA_ "GenSigCycleTime" SG_ 851 RLR_OBJ8_Type 50;
BA_ "GenSigInvalidValue" SG_ 851 RLR_OBJ8_Type "0";
BA_ "GenSigCycleTime" SG_ 851 RLR_OBJ8_Track_ID 50;
BA_ "GenSigCycleTime" SG_ 851 RLR_OBJ7_Track_Age 50;
BA_ "GenSigCycleTime" SG_ 851 RLR_OBJ7_ReRPointLoc 50;
BA_ "GenSigCycleTime" SG_ 851 RLR_OBJ7_ObstacleProb 50;
BA_ "GenSigCycleTime" SG_ 851 RLR_OBJ7_Measured 50;
BA_ "GenSigInvalidValue" SG_ 851 RLR_OBJ7_Measured "0";
BA_ "GenSigCycleTime" SG_ 851 RLR_OBJ7_ExistProb 50;
BA_ "GenSigInvalidValue" SG_ 851 RLR_OBJ7_ExistProb "0";
BA_ "GenSigCycleTime" SG_ 851 RLR_OBJ7_Location 50;
BA_ "GenSigInvalidValue" SG_ 851 RLR_OBJ7_Location "0";
BA_ "GenSigCycleTime" SG_ 851 RLR_OBJ7_RelAx 50;
BA_ "GenSigCycleTime" SG_ 851 RLR_OBJ7_RelAy 50;
BA_ "GenSigCycleTime" SG_ 851 RLR_OBJ7_RelVx 50;
BA_ "GenSigCycleTime" SG_ 851 RLR_OBJ7_RelVy 50;
BA_ "GenSigCycleTime" SG_ 851 RLR_OBJ7_HeadingAngle 50;
BA_ "GenSigCycleTime" SG_ 851 RLR_OBJ7_Length 50;
BA_ "GenSigCycleTime" SG_ 851 RLR_OBJ7_Height 50;
BA_ "GenSigCycleTime" SG_ 851 RLR_OBJ7_Width 50;
BA_ "GenSigCycleTime" SG_ 851 RLR_OBJ7_Type 50;
BA_ "GenSigInvalidValue" SG_ 851 RLR_OBJ7_Type "0";
BA_ "GenSigCycleTime" SG_ 851 RLR_OBJ7_Track_ID 50;

BA_ "GenSigCycleTime" SG_ 852 RLR_OBJ10_LostCnt 50;
BA_ "GenSigCycleTime" SG_ 852 RLR_OBJ9_LostCnt 50;
BA_ "GenSigCycleTime" SG_ 852 RLR_OBJ10_Dx 50;
BA_ "GenSigCycleTime" SG_ 852 RLR_OBJ10_Dy 50;
BA_ "GenSigCycleTime" SG_ 852 RLR_OBJ9_Dx 50;
BA_ "GenSigCycleTime" SG_ 852 RLR_OBJ9_Dy 50;
BA_ "GenSigCycleTime" SG_ 852 RLR_OBJ10_Vx 50;
BA_ "GenSigCycleTime" SG_ 852 RLR_OBJ10_Vy 50;
BA_ "GenSigCycleTime" SG_ 852 RLR_OBJ10_Convergence 50;
BA_ "GenSigCycleTime" SG_ 852 RLR_OBJ10_DelayTime 50;
BA_ "GenSigCycleTime" SG_ 852 RLR_OBJ10_HeightGround 50;
BA_ "GenSigCycleTime" SG_ 852 RLR_OBJ10_MotionStatus 50;
BA_ "GenSigCycleTime" SG_ 852 RLR_OBJ10_RelVx_std 50;
BA_ "GenSigInvalidValue" SG_ 852 RLR_OBJ10_RelVx_std "4095";
BA_ "GenSigCycleTime" SG_ 852 RLR_OBJ10_RelVy_std 50;
BA_ "GenSigInvalidValue" SG_ 852 RLR_OBJ10_RelVy_std "1023";
BA_ "GenSigCycleTime" SG_ 852 RLR_OBJ10_Dx_Vnce 50;
BA_ "GenSigInvalidValue" SG_ 852 RLR_OBJ10_Dx_Vnce "16383";
BA_ "GenSigCycleTime" SG_ 852 RLR_OBJ10_Dy_Vnce 50;
BA_ "GenSigInvalidValue" SG_ 852 RLR_OBJ10_Dy_Vnce "1023";
BA_ "GenSigCycleTime" SG_ 852 RLR_OBJ9_Vx 50;
BA_ "GenSigCycleTime" SG_ 852 RLR_OBJ9_Vy 50;
BA_ "GenSigCycleTime" SG_ 852 RLR_OBJ9_Convergence 50;
BA_ "GenSigCycleTime" SG_ 852 RLR_OBJ9_DelayTime 50;
BA_ "GenSigCycleTime" SG_ 852 RLR_OBJ9_HeightGround 50;
BA_ "GenSigCycleTime" SG_ 852 RLR_OBJ9_MotionStatus 50;
BA_ "GenSigCycleTime" SG_ 852 RLR_OBJ9_RelVx_std 50;
BA_ "GenSigInvalidValue" SG_ 852 RLR_OBJ9_RelVx_std "4095";
BA_ "GenSigCycleTime" SG_ 852 RLR_OBJ9_RelVy_std 50;
BA_ "GenSigInvalidValue" SG_ 852 RLR_OBJ9_RelVy_std "1023";
BA_ "GenSigCycleTime" SG_ 852 RLR_OBJ9_Dx_Vnce 50;
BA_ "GenSigInvalidValue" SG_ 852 RLR_OBJ9_Dx_Vnce "16383";
BA_ "GenSigCycleTime" SG_ 852 RLR_OBJ9_Dy_Vnce 50;
BA_ "GenSigInvalidValue" SG_ 852 RLR_OBJ9_Dy_Vnce "1023";
BA_ "GenSigCycleTime" SG_ 852 RLR_CRCCheck_354 50;
BA_ "GenSigCycleTime" SG_ 852 RLR_RollingCounter_354 50;
BA_ "GenSigCycleTime" SG_ 852 RLR_OBJ10_Track_Age 50;
BA_ "GenSigCycleTime" SG_ 852 RLR_OBJ10_ReRPointLoc 50;
BA_ "GenSigCycleTime" SG_ 852 RLR_OBJ10_ObstacleProb 50;
BA_ "GenSigCycleTime" SG_ 852 RLR_OBJ10_Measured 50;
BA_ "GenSigInvalidValue" SG_ 852 RLR_OBJ10_Measured "0";
BA_ "GenSigCycleTime" SG_ 852 RLR_OBJ10_ExistProb 50;
BA_ "GenSigInvalidValue" SG_ 852 RLR_OBJ10_ExistProb "0";
BA_ "GenSigCycleTime" SG_ 852 RLR_OBJ10_Location 50;
BA_ "GenSigInvalidValue" SG_ 852 RLR_OBJ10_Location "0";
BA_ "GenSigCycleTime" SG_ 852 RLR_OBJ10_RelAx 50;
BA_ "GenSigCycleTime" SG_ 852 RLR_OBJ10_RelAy 50;
BA_ "GenSigCycleTime" SG_ 852 RLR_OBJ10_RelVx 50;
BA_ "GenSigCycleTime" SG_ 852 RLR_OBJ10_RelVy 50;
BA_ "GenSigCycleTime" SG_ 852 RLR_OBJ10_HeadingAngle 50;
BA_ "GenSigCycleTime" SG_ 852 RLR_OBJ10_Length 50;
BA_ "GenSigCycleTime" SG_ 852 RLR_OBJ10_Height 50;
BA_ "GenSigCycleTime" SG_ 852 RLR_OBJ10_Width 50;
BA_ "GenSigCycleTime" SG_ 852 RLR_OBJ10_Type 50;
BA_ "GenSigInvalidValue" SG_ 852 RLR_OBJ10_Type "0";
BA_ "GenSigCycleTime" SG_ 852 RLR_OBJ10_Track_ID 50;
BA_ "GenSigCycleTime" SG_ 852 RLR_OBJ9_Track_Age 50;
BA_ "GenSigCycleTime" SG_ 852 RLR_OBJ9_ReRPointLoc 50;
BA_ "GenSigCycleTime" SG_ 852 RLR_OBJ9_ObstacleProb 50;
BA_ "GenSigCycleTime" SG_ 852 RLR_OBJ9_Measured 50;
BA_ "GenSigInvalidValue" SG_ 852 RLR_OBJ9_Measured "0";
BA_ "GenSigCycleTime" SG_ 852 RLR_OBJ9_ExistProb 50;
BA_ "GenSigInvalidValue" SG_ 852 RLR_OBJ9_ExistProb "0";
BA_ "GenSigCycleTime" SG_ 852 RLR_OBJ9_Location 50;
BA_ "GenSigInvalidValue" SG_ 852 RLR_OBJ9_Location "0";
BA_ "GenSigCycleTime" SG_ 852 RLR_OBJ9_RelAx 50;
BA_ "GenSigCycleTime" SG_ 852 RLR_OBJ9_RelAy 50;
BA_ "GenSigCycleTime" SG_ 852 RLR_OBJ9_RelVx 50;
BA_ "GenSigCycleTime" SG_ 852 RLR_OBJ9_RelVy 50;
BA_ "GenSigCycleTime" SG_ 852 RLR_OBJ9_HeadingAngle 50;
BA_ "GenSigCycleTime" SG_ 852 RLR_OBJ9_Length 50;
BA_ "GenSigCycleTime" SG_ 852 RLR_OBJ9_Height 50;
BA_ "GenSigCycleTime" SG_ 852 RLR_OBJ9_Width 50;
BA_ "GenSigCycleTime" SG_ 852 RLR_OBJ9_Type 50;
BA_ "GenSigInvalidValue" SG_ 852 RLR_OBJ9_Type "0";
BA_ "GenSigCycleTime" SG_ 852 RLR_OBJ9_Track_ID 50;

BA_ "GenSigCycleTime" SG_ 853 RLR_OBJ12_LostCnt 50;
BA_ "GenSigCycleTime" SG_ 853 RLR_OBJ11_LostCnt 50;
BA_ "GenSigCycleTime" SG_ 853 RLR_OBJ12_Dx 50;
BA_ "GenSigCycleTime" SG_ 853 RLR_OBJ12_Dy 50;
BA_ "GenSigCycleTime" SG_ 853 RLR_OBJ11_Dx 50;
BA_ "GenSigCycleTime" SG_ 853 RLR_OBJ11_Dy 50;
BA_ "GenSigCycleTime" SG_ 853 RLR_OBJ12_Vx 50;
BA_ "GenSigCycleTime" SG_ 853 RLR_OBJ12_Vy 50;
BA_ "GenSigCycleTime" SG_ 853 RLR_OBJ12_Convergence 50;
BA_ "GenSigCycleTime" SG_ 853 RLR_OBJ12_DelayTime 50;
BA_ "GenSigCycleTime" SG_ 853 RLR_OBJ12_HeightGround 50;
BA_ "GenSigCycleTime" SG_ 853 RLR_OBJ12_MotionStatus 50;
BA_ "GenSigCycleTime" SG_ 853 RLR_OBJ12_RelVx_std 50;
BA_ "GenSigInvalidValue" SG_ 853 RLR_OBJ12_RelVx_std "4095";
BA_ "GenSigCycleTime" SG_ 853 RLR_OBJ12_RelVy_std 50;
BA_ "GenSigInvalidValue" SG_ 853 RLR_OBJ12_RelVy_std "1023";
BA_ "GenSigCycleTime" SG_ 853 RLR_OBJ12_Dx_Vnce 50;
BA_ "GenSigInvalidValue" SG_ 853 RLR_OBJ12_Dx_Vnce "16383";
BA_ "GenSigCycleTime" SG_ 853 RLR_OBJ12_Dy_Vnce 50;
BA_ "GenSigInvalidValue" SG_ 853 RLR_OBJ12_Dy_Vnce "1023";
BA_ "GenSigCycleTime" SG_ 853 RLR_OBJ11_Vx 50;
BA_ "GenSigCycleTime" SG_ 853 RLR_OBJ11_Vy 50;
BA_ "GenSigCycleTime" SG_ 853 RLR_OBJ11_Convergence 50;
BA_ "GenSigCycleTime" SG_ 853 RLR_OBJ11_DelayTime 50;
BA_ "GenSigCycleTime" SG_ 853 RLR_OBJ11_HeightGround 50;
BA_ "GenSigCycleTime" SG_ 853 RLR_OBJ11_MotionStatus 50;
BA_ "GenSigCycleTime" SG_ 853 RLR_OBJ11_RelVx_std 50;
BA_ "GenSigInvalidValue" SG_ 853 RLR_OBJ11_RelVx_std "4095";
BA_ "GenSigCycleTime" SG_ 853 RLR_OBJ11_RelVy_std 50;
BA_ "GenSigInvalidValue" SG_ 853 RLR_OBJ11_RelVy_std "1023";
BA_ "GenSigCycleTime" SG_ 853 RLR_OBJ11_Dx_Vnce 50;
BA_ "GenSigInvalidValue" SG_ 853 RLR_OBJ11_Dx_Vnce "16383";
BA_ "GenSigCycleTime" SG_ 853 RLR_OBJ11_Dy_Vnce 50;
BA_ "GenSigInvalidValue" SG_ 853 RLR_OBJ11_Dy_Vnce "1023";
BA_ "GenSigCycleTime" SG_ 853 RLR_CRCCheck_355 50;
BA_ "GenSigCycleTime" SG_ 853 RLR_RollingCounter_355 50;
BA_ "GenSigCycleTime" SG_ 853 RLR_OBJ12_Track_Age 50;
BA_ "GenSigCycleTime" SG_ 853 RLR_OBJ12_ReRPointLoc 50;
BA_ "GenSigCycleTime" SG_ 853 RLR_OBJ12_ObstacleProb 50;
BA_ "GenSigCycleTime" SG_ 853 RLR_OBJ12_Measured 50;
BA_ "GenSigInvalidValue" SG_ 853 RLR_OBJ12_Measured "0";
BA_ "GenSigCycleTime" SG_ 853 RLR_OBJ12_ExistProb 50;
BA_ "GenSigInvalidValue" SG_ 853 RLR_OBJ12_ExistProb "0";
BA_ "GenSigCycleTime" SG_ 853 RLR_OBJ12_Location 50;
BA_ "GenSigInvalidValue" SG_ 853 RLR_OBJ12_Location "0";
BA_ "GenSigCycleTime" SG_ 853 RLR_OBJ12_RelAx 50;
BA_ "GenSigCycleTime" SG_ 853 RLR_OBJ12_RelAy 50;
BA_ "GenSigCycleTime" SG_ 853 RLR_OBJ12_RelVx 50;
BA_ "GenSigCycleTime" SG_ 853 RLR_OBJ12_RelVy 50;
BA_ "GenSigCycleTime" SG_ 853 RLR_OBJ12_HeadingAngle 50;
BA_ "GenSigCycleTime" SG_ 853 RLR_OBJ12_Length 50;
BA_ "GenSigCycleTime" SG_ 853 RLR_OBJ12_Height 50;
BA_ "GenSigCycleTime" SG_ 853 RLR_OBJ12_Width 50;
BA_ "GenSigCycleTime" SG_ 853 RLR_OBJ12_Type 50;
BA_ "GenSigInvalidValue" SG_ 853 RLR_OBJ12_Type "0";
BA_ "GenSigCycleTime" SG_ 853 RLR_OBJ12_Track_ID 50;
BA_ "GenSigCycleTime" SG_ 853 RLR_OBJ11_Track_Age 50;
BA_ "GenSigCycleTime" SG_ 853 RLR_OBJ11_ReRPointLoc 50;
BA_ "GenSigCycleTime" SG_ 853 RLR_OBJ11_ObstacleProb 50;
BA_ "GenSigCycleTime" SG_ 853 RLR_OBJ11_Measured 50;
BA_ "GenSigInvalidValue" SG_ 853 RLR_OBJ11_Measured "0";
BA_ "GenSigCycleTime" SG_ 853 RLR_OBJ11_ExistProb 50;
BA_ "GenSigInvalidValue" SG_ 853 RLR_OBJ11_ExistProb "0";
BA_ "GenSigCycleTime" SG_ 853 RLR_OBJ11_Location 50;
BA_ "GenSigInvalidValue" SG_ 853 RLR_OBJ11_Location "0";
BA_ "GenSigCycleTime" SG_ 853 RLR_OBJ11_RelAx 50;
BA_ "GenSigCycleTime" SG_ 853 RLR_OBJ11_RelAy 50;
BA_ "GenSigCycleTime" SG_ 853 RLR_OBJ11_RelVx 50;
BA_ "GenSigCycleTime" SG_ 853 RLR_OBJ11_RelVy 50;
BA_ "GenSigCycleTime" SG_ 853 RLR_OBJ11_HeadingAngle 50;
BA_ "GenSigCycleTime" SG_ 853 RLR_OBJ11_Length 50;
BA_ "GenSigCycleTime" SG_ 853 RLR_OBJ11_Height 50;
BA_ "GenSigCycleTime" SG_ 853 RLR_OBJ11_Width 50;
BA_ "GenSigCycleTime" SG_ 853 RLR_OBJ11_Type 50;
BA_ "GenSigInvalidValue" SG_ 853 RLR_OBJ11_Type "0";
BA_ "GenSigCycleTime" SG_ 853 RLR_OBJ11_Track_ID 50;

BA_ "GenSigCycleTime" SG_ 865 RLR_OBJ14_LostCnt 50;
BA_ "GenSigCycleTime" SG_ 865 RLR_OBJ13_LostCnt 50;
BA_ "GenSigCycleTime" SG_ 865 RLR_OBJ14_Dx 50;
BA_ "GenSigCycleTime" SG_ 865 RLR_OBJ14_Dy 50;
BA_ "GenSigCycleTime" SG_ 865 RLR_OBJ13_Dx 50;
BA_ "GenSigCycleTime" SG_ 865 RLR_OBJ13_Dy 50;
BA_ "GenSigCycleTime" SG_ 865 RLR_OBJ14_Vx 50;
BA_ "GenSigCycleTime" SG_ 865 RLR_OBJ14_Vy 50;
BA_ "GenSigCycleTime" SG_ 865 RLR_OBJ14_Convergence 50;
BA_ "GenSigCycleTime" SG_ 865 RLR_OBJ14_DelayTime 50;
BA_ "GenSigCycleTime" SG_ 865 RLR_OBJ14_HeightGround 50;
BA_ "GenSigCycleTime" SG_ 865 RLR_OBJ14_MotionStatus 50;
BA_ "GenSigCycleTime" SG_ 865 RLR_OBJ14_RelVx_std 50;
BA_ "GenSigInvalidValue" SG_ 865 RLR_OBJ14_RelVx_std "4095";
BA_ "GenSigCycleTime" SG_ 865 RLR_OBJ14_RelVy_std 50;
BA_ "GenSigInvalidValue" SG_ 865 RLR_OBJ14_RelVy_std "1023";
BA_ "GenSigCycleTime" SG_ 865 RLR_OBJ14_Dx_Vnce 50;
BA_ "GenSigInvalidValue" SG_ 865 RLR_OBJ14_Dx_Vnce "16383";
BA_ "GenSigCycleTime" SG_ 865 RLR_OBJ14_Dy_Vnce 50;
BA_ "GenSigInvalidValue" SG_ 865 RLR_OBJ14_Dy_Vnce "1023";
BA_ "GenSigCycleTime" SG_ 865 RLR_OBJ13_Vx 50;
BA_ "GenSigCycleTime" SG_ 865 RLR_OBJ13_Vy 50;
BA_ "GenSigCycleTime" SG_ 865 RLR_OBJ13_Convergence 50;
BA_ "GenSigCycleTime" SG_ 865 RLR_OBJ13_DelayTime 50;
BA_ "GenSigCycleTime" SG_ 865 RLR_OBJ13_HeightGround 50;
BA_ "GenSigCycleTime" SG_ 865 RLR_OBJ13_MotionStatus 50;
BA_ "GenSigCycleTime" SG_ 865 RLR_OBJ13_RelVx_std 50;
BA_ "GenSigInvalidValue" SG_ 865 RLR_OBJ13_RelVx_std "4095";
BA_ "GenSigCycleTime" SG_ 865 RLR_OBJ13_RelVy_std 50;
BA_ "GenSigInvalidValue" SG_ 865 RLR_OBJ13_RelVy_std "1023";
BA_ "GenSigCycleTime" SG_ 865 RLR_OBJ13_Dx_Vnce 50;
BA_ "GenSigInvalidValue" SG_ 865 RLR_OBJ13_Dx_Vnce "16383";
BA_ "GenSigCycleTime" SG_ 865 RLR_OBJ13_Dy_Vnce 50;
BA_ "GenSigInvalidValue" SG_ 865 RLR_OBJ13_Dy_Vnce "1023";
BA_ "GenSigCycleTime" SG_ 865 RLR_CRCCheck_356 50;
BA_ "GenSigCycleTime" SG_ 865 RLR_RollingCounter_356 50;
BA_ "GenSigCycleTime" SG_ 865 RLR_OBJ14_Track_Age 50;
BA_ "GenSigCycleTime" SG_ 865 RLR_OBJ14_ReRPointLoc 50;
BA_ "GenSigCycleTime" SG_ 865 RLR_OBJ14_ObstacleProb 50;
BA_ "GenSigCycleTime" SG_ 865 RLR_OBJ14_Measured 50;
BA_ "GenSigInvalidValue" SG_ 865 RLR_OBJ14_Measured "0";
BA_ "GenSigCycleTime" SG_ 865 RLR_OBJ14_ExistProb 50;
BA_ "GenSigInvalidValue" SG_ 865 RLR_OBJ14_ExistProb "0";
BA_ "GenSigCycleTime" SG_ 865 RLR_OBJ14_Location 50;
BA_ "GenSigInvalidValue" SG_ 865 RLR_OBJ14_Location "0";
BA_ "GenSigCycleTime" SG_ 865 RLR_OBJ14_RelAx 50;
BA_ "GenSigCycleTime" SG_ 865 RLR_OBJ14_RelAy 50;
BA_ "GenSigCycleTime" SG_ 865 RLR_OBJ14_RelVx 50;
BA_ "GenSigCycleTime" SG_ 865 RLR_OBJ14_RelVy 50;
BA_ "GenSigCycleTime" SG_ 865 RLR_OBJ14_HeadingAngle 50;
BA_ "GenSigCycleTime" SG_ 865 RLR_OBJ14_Length 50;
BA_ "GenSigCycleTime" SG_ 865 RLR_OBJ14_Height 50;
BA_ "GenSigCycleTime" SG_ 865 RLR_OBJ14_Width 50;
BA_ "GenSigCycleTime" SG_ 865 RLR_OBJ14_Type 50;
BA_ "GenSigInvalidValue" SG_ 865 RLR_OBJ14_Type "0";
BA_ "GenSigCycleTime" SG_ 865 RLR_OBJ14_Track_ID 50;
BA_ "GenSigCycleTime" SG_ 865 RLR_OBJ13_Track_Age 50;
BA_ "GenSigCycleTime" SG_ 865 RLR_OBJ13_ReRPointLoc 50;
BA_ "GenSigCycleTime" SG_ 865 RLR_OBJ13_ObstacleProb 50;
BA_ "GenSigCycleTime" SG_ 865 RLR_OBJ13_Measured 50;
BA_ "GenSigInvalidValue" SG_ 865 RLR_OBJ13_Measured "0";
BA_ "GenSigCycleTime" SG_ 865 RLR_OBJ13_ExistProb 50;
BA_ "GenSigInvalidValue" SG_ 865 RLR_OBJ13_ExistProb "0";
BA_ "GenSigCycleTime" SG_ 865 RLR_OBJ13_Location 50;
BA_ "GenSigInvalidValue" SG_ 865 RLR_OBJ13_Location "0";
BA_ "GenSigCycleTime" SG_ 865 RLR_OBJ13_RelAx 50;
BA_ "GenSigCycleTime" SG_ 865 RLR_OBJ13_RelAy 50;
BA_ "GenSigCycleTime" SG_ 865 RLR_OBJ13_RelVx 50;
BA_ "GenSigCycleTime" SG_ 865 RLR_OBJ13_RelVy 50;
BA_ "GenSigCycleTime" SG_ 865 RLR_OBJ13_HeadingAngle 50;
BA_ "GenSigCycleTime" SG_ 865 RLR_OBJ13_Length 50;
BA_ "GenSigCycleTime" SG_ 865 RLR_OBJ13_Height 50;
BA_ "GenSigCycleTime" SG_ 865 RLR_OBJ13_Width 50;
BA_ "GenSigCycleTime" SG_ 865 RLR_OBJ13_Type 50;
BA_ "GenSigInvalidValue" SG_ 865 RLR_OBJ13_Type "0";
BA_ "GenSigCycleTime" SG_ 865 RLR_OBJ13_Track_ID 50;

BA_ "GenSigCycleTime" SG_ 855 RLR_OBJ16_LostCnt 50;
BA_ "GenSigCycleTime" SG_ 855 RLR_OBJ15_LostCnt 50;
BA_ "GenSigCycleTime" SG_ 855 RLR_OBJ16_Dx 50;
BA_ "GenSigCycleTime" SG_ 855 RLR_OBJ16_Dy 50;
BA_ "GenSigCycleTime" SG_ 855 RLR_OBJ15_Dx 50;
BA_ "GenSigCycleTime" SG_ 855 RLR_OBJ15_Dy 50;
BA_ "GenSigCycleTime" SG_ 855 RLR_OBJ16_Vx 50;
BA_ "GenSigCycleTime" SG_ 855 RLR_OBJ16_Vy 50;
BA_ "GenSigCycleTime" SG_ 855 RLR_OBJ16_Convergence 50;
BA_ "GenSigCycleTime" SG_ 855 RLR_OBJ16_DelayTime 50;
BA_ "GenSigCycleTime" SG_ 855 RLR_OBJ16_HeightGround 50;
BA_ "GenSigCycleTime" SG_ 855 RLR_OBJ16_MotionStatus 50;
BA_ "GenSigCycleTime" SG_ 855 RLR_OBJ16_RelVx_std 50;
BA_ "GenSigInvalidValue" SG_ 855 RLR_OBJ16_RelVx_std "4095";
BA_ "GenSigCycleTime" SG_ 855 RLR_OBJ16_RelVy_std 50;
BA_ "GenSigInvalidValue" SG_ 855 RLR_OBJ16_RelVy_std "1023";
BA_ "GenSigCycleTime" SG_ 855 RLR_OBJ16_Dx_Vnce 50;
BA_ "GenSigInvalidValue" SG_ 855 RLR_OBJ16_Dx_Vnce "16383";
BA_ "GenSigCycleTime" SG_ 855 RLR_OBJ16_Dy_Vnce 50;
BA_ "GenSigInvalidValue" SG_ 855 RLR_OBJ16_Dy_Vnce "1023";
BA_ "GenSigCycleTime" SG_ 855 RLR_OBJ15_Vx 50;
BA_ "GenSigCycleTime" SG_ 855 RLR_OBJ15_Vy 50;
BA_ "GenSigCycleTime" SG_ 855 RLR_OBJ15_Convergence 50;
BA_ "GenSigCycleTime" SG_ 855 RLR_OBJ15_DelayTime 50;
BA_ "GenSigCycleTime" SG_ 855 RLR_OBJ15_HeightGround 50;
BA_ "GenSigCycleTime" SG_ 855 RLR_OBJ15_MotionStatus 50;
BA_ "GenSigCycleTime" SG_ 855 RLR_OBJ15_RelVx_std 50;
BA_ "GenSigInvalidValue" SG_ 855 RLR_OBJ15_RelVx_std "4095";
BA_ "GenSigCycleTime" SG_ 855 RLR_OBJ15_RelVy_std 50;
BA_ "GenSigInvalidValue" SG_ 855 RLR_OBJ15_RelVy_std "1023";
BA_ "GenSigCycleTime" SG_ 855 RLR_OBJ15_Dx_Vnce 50;
BA_ "GenSigInvalidValue" SG_ 855 RLR_OBJ15_Dx_Vnce "16383";
BA_ "GenSigCycleTime" SG_ 855 RLR_OBJ15_Dy_Vnce 50;
BA_ "GenSigInvalidValue" SG_ 855 RLR_OBJ15_Dy_Vnce "1023";
BA_ "GenSigCycleTime" SG_ 855 RLR_CRCCheck_357 50;
BA_ "GenSigCycleTime" SG_ 855 RLR_RollingCounter_357 50;
BA_ "GenSigCycleTime" SG_ 855 RLR_OBJ16_Track_Age 50;
BA_ "GenSigCycleTime" SG_ 855 RLR_OBJ16_ReRPointLoc 50;
BA_ "GenSigCycleTime" SG_ 855 RLR_OBJ16_ObstacleProb 50;
BA_ "GenSigCycleTime" SG_ 855 RLR_OBJ16_Measured 50;
BA_ "GenSigInvalidValue" SG_ 855 RLR_OBJ16_Measured "0";
BA_ "GenSigCycleTime" SG_ 855 RLR_OBJ16_ExistProb 50;
BA_ "GenSigInvalidValue" SG_ 855 RLR_OBJ16_ExistProb "0";
BA_ "GenSigCycleTime" SG_ 855 RLR_OBJ16_Location 50;
BA_ "GenSigInvalidValue" SG_ 855 RLR_OBJ16_Location "0";
BA_ "GenSigCycleTime" SG_ 855 RLR_OBJ16_RelAx 50;
BA_ "GenSigCycleTime" SG_ 855 RLR_OBJ16_RelAy 50;
BA_ "GenSigCycleTime" SG_ 855 RLR_OBJ16_RelVx 50;
BA_ "GenSigCycleTime" SG_ 855 RLR_OBJ16_RelVy 50;
BA_ "GenSigCycleTime" SG_ 855 RLR_OBJ16_HeadingAngle 50;
BA_ "GenSigCycleTime" SG_ 855 RLR_OBJ16_Length 50;
BA_ "GenSigCycleTime" SG_ 855 RLR_OBJ16_Height 50;
BA_ "GenSigCycleTime" SG_ 855 RLR_OBJ16_Width 50;
BA_ "GenSigCycleTime" SG_ 855 RLR_OBJ16_Type 50;
BA_ "GenSigInvalidValue" SG_ 855 RLR_OBJ16_Type "0";
BA_ "GenSigCycleTime" SG_ 855 RLR_OBJ16_Track_ID 50;
BA_ "GenSigCycleTime" SG_ 855 RLR_OBJ15_Track_Age 50;
BA_ "GenSigCycleTime" SG_ 855 RLR_OBJ15_ReRPointLoc 50;
BA_ "GenSigCycleTime" SG_ 855 RLR_OBJ15_ObstacleProb 50;
BA_ "GenSigCycleTime" SG_ 855 RLR_OBJ15_Measured 50;
BA_ "GenSigInvalidValue" SG_ 855 RLR_OBJ15_Measured "0";
BA_ "GenSigCycleTime" SG_ 855 RLR_OBJ15_ExistProb 50;
BA_ "GenSigInvalidValue" SG_ 855 RLR_OBJ15_ExistProb "0";
BA_ "GenSigCycleTime" SG_ 855 RLR_OBJ15_Location 50;
BA_ "GenSigInvalidValue" SG_ 855 RLR_OBJ15_Location "0";
BA_ "GenSigCycleTime" SG_ 855 RLR_OBJ15_RelAx 50;
BA_ "GenSigCycleTime" SG_ 855 RLR_OBJ15_RelAy 50;
BA_ "GenSigCycleTime" SG_ 855 RLR_OBJ15_RelVx 50;
BA_ "GenSigCycleTime" SG_ 855 RLR_OBJ15_RelVy 50;
BA_ "GenSigCycleTime" SG_ 855 RLR_OBJ15_HeadingAngle 50;
BA_ "GenSigCycleTime" SG_ 855 RLR_OBJ15_Length 50;
BA_ "GenSigCycleTime" SG_ 855 RLR_OBJ15_Height 50;
BA_ "GenSigCycleTime" SG_ 855 RLR_OBJ15_Width 50;
BA_ "GenSigCycleTime" SG_ 855 RLR_OBJ15_Type 50;
BA_ "GenSigInvalidValue" SG_ 855 RLR_OBJ15_Type "0";
BA_ "GenSigCycleTime" SG_ 855 RLR_OBJ15_Track_ID 50;

BA_ "GenSigCycleTime" SG_ 856 RLR_OBJ18_LostCnt 50;
BA_ "GenSigCycleTime" SG_ 856 RLR_OBJ17_LostCnt 50;
BA_ "GenSigCycleTime" SG_ 856 RLR_OBJ18_Dx 50;
BA_ "GenSigCycleTime" SG_ 856 RLR_OBJ18_Dy 50;
BA_ "GenSigCycleTime" SG_ 856 RLR_OBJ17_Dx 50;
BA_ "GenSigCycleTime" SG_ 856 RLR_OBJ17_Dy 50;
BA_ "GenSigCycleTime" SG_ 856 RLR_OBJ18_Vx 50;
BA_ "GenSigCycleTime" SG_ 856 RLR_OBJ18_Vy 50;
BA_ "GenSigCycleTime" SG_ 856 RLR_OBJ18_Convergence 50;
BA_ "GenSigCycleTime" SG_ 856 RLR_OBJ18_DelayTime 50;
BA_ "GenSigCycleTime" SG_ 856 RLR_OBJ18_HeightGround 50;
BA_ "GenSigCycleTime" SG_ 856 RLR_OBJ18_MotionStatus 50;
BA_ "GenSigCycleTime" SG_ 856 RLR_OBJ18_RelVx_std 50;
BA_ "GenSigInvalidValue" SG_ 856 RLR_OBJ18_RelVx_std "4095";
BA_ "GenSigCycleTime" SG_ 856 RLR_OBJ18_RelVy_std 50;
BA_ "GenSigInvalidValue" SG_ 856 RLR_OBJ18_RelVy_std "1023";
BA_ "GenSigCycleTime" SG_ 856 RLR_OBJ18_Dx_Vnce 50;
BA_ "GenSigInvalidValue" SG_ 856 RLR_OBJ18_Dx_Vnce "16383";
BA_ "GenSigCycleTime" SG_ 856 RLR_OBJ18_Dy_Vnce 50;
BA_ "GenSigInvalidValue" SG_ 856 RLR_OBJ18_Dy_Vnce "1023";
BA_ "GenSigCycleTime" SG_ 856 RLR_OBJ17_Vx 50;
BA_ "GenSigCycleTime" SG_ 856 RLR_OBJ17_Vy 50;
BA_ "GenSigCycleTime" SG_ 856 RLR_OBJ17_Convergence 50;
BA_ "GenSigCycleTime" SG_ 856 RLR_OBJ17_DelayTime 50;
BA_ "GenSigCycleTime" SG_ 856 RLR_OBJ17_HeightGround 50;
BA_ "GenSigCycleTime" SG_ 856 RLR_OBJ17_MotionStatus 50;
BA_ "GenSigCycleTime" SG_ 856 RLR_OBJ17_RelVx_std 50;
BA_ "GenSigInvalidValue" SG_ 856 RLR_OBJ17_RelVx_std "4095";
BA_ "GenSigCycleTime" SG_ 856 RLR_OBJ17_RelVy_std 50;
BA_ "GenSigInvalidValue" SG_ 856 RLR_OBJ17_RelVy_std "1023";
BA_ "GenSigCycleTime" SG_ 856 RLR_OBJ17_Dx_Vnce 50;
BA_ "GenSigInvalidValue" SG_ 856 RLR_OBJ17_Dx_Vnce "16383";
BA_ "GenSigCycleTime" SG_ 856 RLR_OBJ17_Dy_Vnce 50;
BA_ "GenSigInvalidValue" SG_ 856 RLR_OBJ17_Dy_Vnce "1023";
BA_ "GenSigCycleTime" SG_ 856 RLR_CRCCheck_358 50;
BA_ "GenSigCycleTime" SG_ 856 RLR_RollingCounter_358 50;
BA_ "GenSigCycleTime" SG_ 856 RLR_OBJ18_Track_Age 50;
BA_ "GenSigCycleTime" SG_ 856 RLR_OBJ18_ReRPointLoc 50;
BA_ "GenSigCycleTime" SG_ 856 RLR_OBJ18_ObstacleProb 50;
BA_ "GenSigCycleTime" SG_ 856 RLR_OBJ18_Measured 50;
BA_ "GenSigInvalidValue" SG_ 856 RLR_OBJ18_Measured "0";
BA_ "GenSigCycleTime" SG_ 856 RLR_OBJ18_ExistProb 50;
BA_ "GenSigInvalidValue" SG_ 856 RLR_OBJ18_ExistProb "0";
BA_ "GenSigCycleTime" SG_ 856 RLR_OBJ18_Location 50;
BA_ "GenSigInvalidValue" SG_ 856 RLR_OBJ18_Location "0";
BA_ "GenSigCycleTime" SG_ 856 RLR_OBJ18_RelAx 50;
BA_ "GenSigCycleTime" SG_ 856 RLR_OBJ18_RelAy 50;
BA_ "GenSigCycleTime" SG_ 856 RLR_OBJ18_RelVx 50;
BA_ "GenSigCycleTime" SG_ 856 RLR_OBJ18_RelVy 50;
BA_ "GenSigCycleTime" SG_ 856 RLR_OBJ18_HeadingAngle 50;
BA_ "GenSigCycleTime" SG_ 856 RLR_OBJ18_Length 50;
BA_ "GenSigCycleTime" SG_ 856 RLR_OBJ18_Height 50;
BA_ "GenSigCycleTime" SG_ 856 RLR_OBJ18_Width 50;
BA_ "GenSigCycleTime" SG_ 856 RLR_OBJ18_Type 50;
BA_ "GenSigInvalidValue" SG_ 856 RLR_OBJ18_Type "0";
BA_ "GenSigCycleTime" SG_ 856 RLR_OBJ18_Track_ID 50;
BA_ "GenSigCycleTime" SG_ 856 RLR_OBJ17_Track_Age 50;
BA_ "GenSigCycleTime" SG_ 856 RLR_OBJ17_ReRPointLoc 50;
BA_ "GenSigCycleTime" SG_ 856 RLR_OBJ17_ObstacleProb 50;
BA_ "GenSigCycleTime" SG_ 856 RLR_OBJ17_Measured 50;
BA_ "GenSigInvalidValue" SG_ 856 RLR_OBJ17_Measured "0";
BA_ "GenSigCycleTime" SG_ 856 RLR_OBJ17_ExistProb 50;
BA_ "GenSigInvalidValue" SG_ 856 RLR_OBJ17_ExistProb "0";
BA_ "GenSigCycleTime" SG_ 856 RLR_OBJ17_Location 50;
BA_ "GenSigInvalidValue" SG_ 856 RLR_OBJ17_Location "0";
BA_ "GenSigCycleTime" SG_ 856 RLR_OBJ17_RelAx 50;
BA_ "GenSigCycleTime" SG_ 856 RLR_OBJ17_RelAy 50;
BA_ "GenSigCycleTime" SG_ 856 RLR_OBJ17_RelVx 50;
BA_ "GenSigCycleTime" SG_ 856 RLR_OBJ17_RelVy 50;
BA_ "GenSigCycleTime" SG_ 856 RLR_OBJ17_HeadingAngle 50;
BA_ "GenSigCycleTime" SG_ 856 RLR_OBJ17_Length 50;
BA_ "GenSigCycleTime" SG_ 856 RLR_OBJ17_Height 50;
BA_ "GenSigCycleTime" SG_ 856 RLR_OBJ17_Width 50;
BA_ "GenSigCycleTime" SG_ 856 RLR_OBJ17_Type 50;
BA_ "GenSigInvalidValue" SG_ 856 RLR_OBJ17_Type "0";
BA_ "GenSigCycleTime" SG_ 856 RLR_OBJ17_Track_ID 50;

BA_ "GenSigCycleTime" SG_ 857 RLR_OBJ20_LostCnt 50;
BA_ "GenSigCycleTime" SG_ 857 RLR_OBJ19_LostCnt 50;
BA_ "GenSigCycleTime" SG_ 857 RLR_OBJ20_Dx 50;
BA_ "GenSigCycleTime" SG_ 857 RLR_OBJ20_Dy 50;
BA_ "GenSigCycleTime" SG_ 857 RLR_OBJ19_Dx 50;
BA_ "GenSigCycleTime" SG_ 857 RLR_OBJ19_Dy 50;
BA_ "GenSigCycleTime" SG_ 857 RLR_OBJ20_Vx 50;
BA_ "GenSigCycleTime" SG_ 857 RLR_OBJ20_Vy 50;
BA_ "GenSigCycleTime" SG_ 857 RLR_OBJ20_Convergence 50;
BA_ "GenSigCycleTime" SG_ 857 RLR_OBJ20_DelayTime 50;
BA_ "GenSigCycleTime" SG_ 857 RLR_OBJ20_HeightGround 50;
BA_ "GenSigCycleTime" SG_ 857 RLR_OBJ20_MotionStatus 50;
BA_ "GenSigCycleTime" SG_ 857 RLR_OBJ20_RelVx_std 50;
BA_ "GenSigInvalidValue" SG_ 857 RLR_OBJ20_RelVx_std "4095";
BA_ "GenSigCycleTime" SG_ 857 RLR_OBJ20_RelVy_std 50;
BA_ "GenSigInvalidValue" SG_ 857 RLR_OBJ20_RelVy_std "1023";
BA_ "GenSigCycleTime" SG_ 857 RLR_OBJ20_Dx_Vnce 50;
BA_ "GenSigInvalidValue" SG_ 857 RLR_OBJ20_Dx_Vnce "16383";
BA_ "GenSigCycleTime" SG_ 857 RLR_OBJ20_Dy_Vnce 50;
BA_ "GenSigInvalidValue" SG_ 857 RLR_OBJ20_Dy_Vnce "1023";
BA_ "GenSigCycleTime" SG_ 857 RLR_OBJ19_Vx 50;
BA_ "GenSigCycleTime" SG_ 857 RLR_OBJ19_Vy 50;
BA_ "GenSigCycleTime" SG_ 857 RLR_OBJ19_Convergence 50;
BA_ "GenSigCycleTime" SG_ 857 RLR_OBJ19_DelayTime 50;
BA_ "GenSigCycleTime" SG_ 857 RLR_OBJ19_HeightGround 50;
BA_ "GenSigCycleTime" SG_ 857 RLR_OBJ19_MotionStatus 50;
BA_ "GenSigCycleTime" SG_ 857 RLR_OBJ19_RelVx_std 50;
BA_ "GenSigInvalidValue" SG_ 857 RLR_OBJ19_RelVx_std "4095";
BA_ "GenSigCycleTime" SG_ 857 RLR_OBJ19_RelVy_std 50;
BA_ "GenSigInvalidValue" SG_ 857 RLR_OBJ19_RelVy_std "1023";
BA_ "GenSigCycleTime" SG_ 857 RLR_OBJ19_Dx_Vnce 50;
BA_ "GenSigInvalidValue" SG_ 857 RLR_OBJ19_Dx_Vnce "16383";
BA_ "GenSigCycleTime" SG_ 857 RLR_OBJ19_Dy_Vnce 50;
BA_ "GenSigInvalidValue" SG_ 857 RLR_OBJ19_Dy_Vnce "1023";
BA_ "GenSigCycleTime" SG_ 857 RLR_CRCCheck_359 50;
BA_ "GenSigCycleTime" SG_ 857 RLR_RollingCounter_359 50;
BA_ "GenSigCycleTime" SG_ 857 RLR_OBJ20_Track_Age 50;
BA_ "GenSigCycleTime" SG_ 857 RLR_OBJ20_ReRPointLoc 50;
BA_ "GenSigCycleTime" SG_ 857 RLR_OBJ20_ObstacleProb 50;
BA_ "GenSigCycleTime" SG_ 857 RLR_OBJ20_Measured 50;
BA_ "GenSigInvalidValue" SG_ 857 RLR_OBJ20_Measured "0";
BA_ "GenSigCycleTime" SG_ 857 RLR_OBJ20_ExistProb 50;
BA_ "GenSigInvalidValue" SG_ 857 RLR_OBJ20_ExistProb "0";
BA_ "GenSigCycleTime" SG_ 857 RLR_OBJ20_Location 50;
BA_ "GenSigInvalidValue" SG_ 857 RLR_OBJ20_Location "0";
BA_ "GenSigCycleTime" SG_ 857 RLR_OBJ20_RelAx 50;
BA_ "GenSigCycleTime" SG_ 857 RLR_OBJ20_RelAy 50;
BA_ "GenSigCycleTime" SG_ 857 RLR_OBJ20_RelVx 50;
BA_ "GenSigCycleTime" SG_ 857 RLR_OBJ20_RelVy 50;
BA_ "GenSigCycleTime" SG_ 857 RLR_OBJ20_HeadingAngle 50;
BA_ "GenSigCycleTime" SG_ 857 RLR_OBJ20_Length 50;
BA_ "GenSigCycleTime" SG_ 857 RLR_OBJ20_Height 50;
BA_ "GenSigCycleTime" SG_ 857 RLR_OBJ20_Width 50;
BA_ "GenSigCycleTime" SG_ 857 RLR_OBJ20_Type 50;
BA_ "GenSigInvalidValue" SG_ 857 RLR_OBJ20_Type "0";
BA_ "GenSigCycleTime" SG_ 857 RLR_OBJ20_Track_ID 50;
BA_ "GenSigCycleTime" SG_ 857 RLR_OBJ19_Track_Age 50;
BA_ "GenSigCycleTime" SG_ 857 RLR_OBJ19_ReRPointLoc 50;
BA_ "GenSigCycleTime" SG_ 857 RLR_OBJ19_ObstacleProb 50;
BA_ "GenSigCycleTime" SG_ 857 RLR_OBJ19_Measured 50;
BA_ "GenSigInvalidValue" SG_ 857 RLR_OBJ19_Measured "0";
BA_ "GenSigCycleTime" SG_ 857 RLR_OBJ19_ExistProb 50;
BA_ "GenSigInvalidValue" SG_ 857 RLR_OBJ19_ExistProb "0";
BA_ "GenSigCycleTime" SG_ 857 RLR_OBJ19_Location 50;
BA_ "GenSigInvalidValue" SG_ 857 RLR_OBJ19_Location "0";
BA_ "GenSigCycleTime" SG_ 857 RLR_OBJ19_RelAx 50;
BA_ "GenSigCycleTime" SG_ 857 RLR_OBJ19_RelAy 50;
BA_ "GenSigCycleTime" SG_ 857 RLR_OBJ19_RelVx 50;
BA_ "GenSigCycleTime" SG_ 857 RLR_OBJ19_RelVy 50;
BA_ "GenSigCycleTime" SG_ 857 RLR_OBJ19_HeadingAngle 50;
BA_ "GenSigCycleTime" SG_ 857 RLR_OBJ19_Length 50;
BA_ "GenSigCycleTime" SG_ 857 RLR_OBJ19_Height 50;
BA_ "GenSigCycleTime" SG_ 857 RLR_OBJ19_Width 50;
BA_ "GenSigCycleTime" SG_ 857 RLR_OBJ19_Type 50;
BA_ "GenSigInvalidValue" SG_ 857 RLR_OBJ19_Type "0";
BA_ "GenSigCycleTime" SG_ 857 RLR_OBJ19_Track_ID 50;

BA_ "GenSigCycleTime" SG_ 858 RLR_OBJ22_LostCnt 50;
BA_ "GenSigCycleTime" SG_ 858 RLR_OBJ21_LostCnt 50;
BA_ "GenSigCycleTime" SG_ 858 RLR_OBJ22_Dx 50;
BA_ "GenSigCycleTime" SG_ 858 RLR_OBJ22_Dy 50;
BA_ "GenSigCycleTime" SG_ 858 RLR_OBJ21_Dx 50;
BA_ "GenSigCycleTime" SG_ 858 RLR_OBJ21_Dy 50;
BA_ "GenSigCycleTime" SG_ 858 RLR_OBJ22_Vx 50;
BA_ "GenSigCycleTime" SG_ 858 RLR_OBJ22_Vy 50;
BA_ "GenSigCycleTime" SG_ 858 RLR_OBJ22_Convergence 50;
BA_ "GenSigCycleTime" SG_ 858 RLR_OBJ22_DelayTime 50;
BA_ "GenSigCycleTime" SG_ 858 RLR_OBJ22_HeightGround 50;
BA_ "GenSigCycleTime" SG_ 858 RLR_OBJ22_MotionStatus 50;
BA_ "GenSigCycleTime" SG_ 858 RLR_OBJ22_RelVx_std 50;
BA_ "GenSigInvalidValue" SG_ 858 RLR_OBJ22_RelVx_std "4095";
BA_ "GenSigCycleTime" SG_ 858 RLR_OBJ22_RelVy_std 50;
BA_ "GenSigInvalidValue" SG_ 858 RLR_OBJ22_RelVy_std "1023";
BA_ "GenSigCycleTime" SG_ 858 RLR_OBJ22_Dx_Vnce 50;
BA_ "GenSigInvalidValue" SG_ 858 RLR_OBJ22_Dx_Vnce "16383";
BA_ "GenSigCycleTime" SG_ 858 RLR_OBJ22_Dy_Vnce 50;
BA_ "GenSigInvalidValue" SG_ 858 RLR_OBJ22_Dy_Vnce "1023";
BA_ "GenSigCycleTime" SG_ 858 RLR_OBJ21_Vx 50;
BA_ "GenSigCycleTime" SG_ 858 RLR_OBJ21_Vy 50;
BA_ "GenSigCycleTime" SG_ 858 RLR_OBJ21_Convergence 50;
BA_ "GenSigCycleTime" SG_ 858 RLR_OBJ21_DelayTime 50;
BA_ "GenSigCycleTime" SG_ 858 RLR_OBJ21_HeightGround 50;
BA_ "GenSigCycleTime" SG_ 858 RLR_OBJ21_MotionStatus 50;
BA_ "GenSigCycleTime" SG_ 858 RLR_OBJ21_RelVx_std 50;
BA_ "GenSigInvalidValue" SG_ 858 RLR_OBJ21_RelVx_std "4095";
BA_ "GenSigCycleTime" SG_ 858 RLR_OBJ21_RelVy_std 50;
BA_ "GenSigInvalidValue" SG_ 858 RLR_OBJ21_RelVy_std "1023";
BA_ "GenSigCycleTime" SG_ 858 RLR_OBJ21_Dx_Vnce 50;
BA_ "GenSigInvalidValue" SG_ 858 RLR_OBJ21_Dx_Vnce "16383";
BA_ "GenSigCycleTime" SG_ 858 RLR_OBJ21_Dy_Vnce 50;
BA_ "GenSigInvalidValue" SG_ 858 RLR_OBJ21_Dy_Vnce "1023";
BA_ "GenSigCycleTime" SG_ 858 RLR_CRCCheck_35A 50;
BA_ "GenSigCycleTime" SG_ 858 RLR_RollingCounter_35A 50;
BA_ "GenSigCycleTime" SG_ 858 RLR_OBJ22_Track_Age 50;
BA_ "GenSigCycleTime" SG_ 858 RLR_OBJ22_ReRPointLoc 50;
BA_ "GenSigCycleTime" SG_ 858 RLR_OBJ22_ObstacleProb 50;
BA_ "GenSigCycleTime" SG_ 858 RLR_OBJ22_Measured 50;
BA_ "GenSigInvalidValue" SG_ 858 RLR_OBJ22_Measured "0";
BA_ "GenSigCycleTime" SG_ 858 RLR_OBJ22_ExistProb 50;
BA_ "GenSigInvalidValue" SG_ 858 RLR_OBJ22_ExistProb "0";
BA_ "GenSigCycleTime" SG_ 858 RLR_OBJ22_Location 50;
BA_ "GenSigInvalidValue" SG_ 858 RLR_OBJ22_Location "0";
BA_ "GenSigCycleTime" SG_ 858 RLR_OBJ22_RelAx 50;
BA_ "GenSigCycleTime" SG_ 858 RLR_OBJ22_RelAy 50;
BA_ "GenSigCycleTime" SG_ 858 RLR_OBJ22_RelVx 50;
BA_ "GenSigCycleTime" SG_ 858 RLR_OBJ22_RelVy 50;
BA_ "GenSigCycleTime" SG_ 858 RLR_OBJ22_HeadingAngle 50;
BA_ "GenSigCycleTime" SG_ 858 RLR_OBJ22_Length 50;
BA_ "GenSigCycleTime" SG_ 858 RLR_OBJ22_Height 50;
BA_ "GenSigCycleTime" SG_ 858 RLR_OBJ22_Width 50;
BA_ "GenSigCycleTime" SG_ 858 RLR_OBJ22_Type 50;
BA_ "GenSigInvalidValue" SG_ 858 RLR_OBJ22_Type "0";
BA_ "GenSigCycleTime" SG_ 858 RLR_OBJ22_Track_ID 50;
BA_ "GenSigCycleTime" SG_ 858 RLR_OBJ21_Track_Age 50;
BA_ "GenSigCycleTime" SG_ 858 RLR_OBJ21_ReRPointLoc 50;
BA_ "GenSigCycleTime" SG_ 858 RLR_OBJ21_ObstacleProb 50;
BA_ "GenSigCycleTime" SG_ 858 RLR_OBJ21_Measured 50;
BA_ "GenSigInvalidValue" SG_ 858 RLR_OBJ21_Measured "0";
BA_ "GenSigCycleTime" SG_ 858 RLR_OBJ21_ExistProb 50;
BA_ "GenSigInvalidValue" SG_ 858 RLR_OBJ21_ExistProb "0";
BA_ "GenSigCycleTime" SG_ 858 RLR_OBJ21_Location 50;
BA_ "GenSigInvalidValue" SG_ 858 RLR_OBJ21_Location "0";
BA_ "GenSigCycleTime" SG_ 858 RLR_OBJ21_RelAx 50;
BA_ "GenSigCycleTime" SG_ 858 RLR_OBJ21_RelAy 50;
BA_ "GenSigCycleTime" SG_ 858 RLR_OBJ21_RelVx 50;
BA_ "GenSigCycleTime" SG_ 858 RLR_OBJ21_RelVy 50;
BA_ "GenSigCycleTime" SG_ 858 RLR_OBJ21_HeadingAngle 50;
BA_ "GenSigCycleTime" SG_ 858 RLR_OBJ21_Length 50;
BA_ "GenSigCycleTime" SG_ 858 RLR_OBJ21_Height 50;
BA_ "GenSigCycleTime" SG_ 858 RLR_OBJ21_Width 50;
BA_ "GenSigCycleTime" SG_ 858 RLR_OBJ21_Type 50;
BA_ "GenSigInvalidValue" SG_ 858 RLR_OBJ21_Type "0";
BA_ "GenSigCycleTime" SG_ 858 RLR_OBJ21_Track_ID 50;

VAL_ 836 RLR_SenceMode 0 "unkown
0x1=地库模式
0x2=非地库模式
0x3=预留";
VAL_ 836 RLR_WorkSenceMode 0 "非地库模式
0x1=地库模式
0x2=切换中
0x3=Reserved";
VAL_ 836 RLR_WorkMode 0 "Initial Value" 1 "行车模式" 2 "泊车模式" 3 "切换中";
VAL_ 836 RLR_ObjCount 0 "";
VAL_ 836 RLR_ped_azi 0 "未识别" 1 "左侧" 2 "=右侧";
VAL_ 836 RLR_ped_result 0 "无人 " 1 "有人";

VAL_ 840 RLR_Suppliers 0 " ZM
0x1 = SSTK
0x2~0x15=Reserve";
VAL_ 840 RLR_SystemStatus 0 "低功耗状态" 1 "StartUp" 2 "Running" 3 "Blocked" 4 "Calibration" 5 "ShutDown" 6 "Hot" 7 "Failure";
VAL_ 840 RLR_OBJ_TiOut 0 "no timeout" 1 "timeout";

VAL_ 848 RLR_OBJ2_Convergence 0 "收敛
0x1=不收敛";
VAL_ 848 RLR_OBJ2_MotionStatus 0 "unknown" 1 "moving " 2 "stopped" 3 "stationary" 4 "crossing" 5 "reserve;";
VAL_ 848 RLR_OBJ1_Convergence 0 "收敛
0x1=不收敛";
VAL_ 848 RLR_OBJ1_MotionStatus 0 "unknown" 1 "moving " 2 "stopped" 3 "stationary" 4 "crossing" 5 "reserve;";
VAL_ 848 RLR_OBJ2_Measured 0 "unknown" 1 "Measured" 2 "Predicted" 3 "Reserved";
VAL_ 848 RLR_OBJ2_Location 0 "unknown" 1 "LeRt Lane" 2 "Right  Lane" 3 "Ego Lane";
VAL_ 848 RLR_OBJ2_Type 0 "Not Detected" 1 "car" 2 "truck" 3 "bicycle/motorbike" 4 "pedestrian" 5 "general" 6 "animal" 7 "uncertain";
VAL_ 848 RLR_OBJ1_Measured 0 "unknown" 1 "Measured" 2 "Predicted" 3 "Reserved";
VAL_ 848 RLR_OBJ1_Location 0 "unknown" 1 "LeRt Lane" 2 "Right  Lane" 3 "Ego Lane";
VAL_ 848 RLR_OBJ1_Type 0 "Not Detected" 1 "car" 2 "truck" 3 "bicycle/motorbike" 4 "pedestrian" 5 "general" 6 "animal" 7 "uncertain";

VAL_ 849 RLR_OBJ4_Convergence 0 "收敛
0x1=不收敛";
VAL_ 849 RLR_OBJ4_MotionStatus 0 "unknown" 1 "moving " 2 "stopped" 3 "stationary" 4 "crossing" 5 "reserve;";
VAL_ 849 RLR_OBJ3_Convergence 0 "收敛
0x1=不收敛";
VAL_ 849 RLR_OBJ3_MotionStatus 0 "unknown" 1 "moving " 2 "stopped" 3 "stationary" 4 "crossing" 5 "reserve;";
VAL_ 849 RLR_OBJ4_Measured 0 "unknown" 1 "Measured" 2 "Predicted" 3 "Reserved";
VAL_ 849 RLR_OBJ4_Location 0 "unknown" 1 "LeRt Lane" 2 "Right  Lane" 3 "Ego Lane";
VAL_ 849 RLR_OBJ4_Type 0 "Not Detected" 1 "car" 2 "truck" 3 "bicycle/motorbike" 4 "pedestrian" 5 "general" 6 "animal" 7 "uncertain";
VAL_ 849 RLR_OBJ3_Measured 0 "unknown" 1 "Measured" 2 "Predicted" 3 "Reserved";
VAL_ 849 RLR_OBJ3_Location 0 "unknown" 1 "LeRt Lane" 2 "Right  Lane" 3 "Ego Lane";
VAL_ 849 RLR_OBJ3_Type 0 "Not Detected" 1 "car" 2 "truck" 3 "bicycle/motorbike" 4 "pedestrian" 5 "general" 6 "animal" 7 "uncertain";

VAL_ 850 RLR_OBJ6_Convergence 0 "收敛
0x1=不收敛";
VAL_ 850 RLR_OBJ6_MotionStatus 0 "unknown" 1 "moving " 2 "stopped" 3 "stationary" 4 "crossing" 5 "reserve;";
VAL_ 850 RLR_OBJ5_Convergence 0 "收敛
0x1=不收敛";
VAL_ 850 RLR_OBJ5_MotionStatus 0 "unknown" 1 "moving " 2 "stopped" 3 "stationary" 4 "crossing" 5 "reserve;";
VAL_ 850 RLR_OBJ6_Measured 0 "unknown" 1 "Measured" 2 "Predicted" 3 "Reserved";
VAL_ 850 RLR_OBJ6_Location 0 "unknown" 1 "LeRt Lane" 2 "Right  Lane" 3 "Ego Lane";
VAL_ 850 RLR_OBJ6_Type 0 "Not Detected" 1 "car" 2 "truck" 3 "bicycle/motorbike" 4 "pedestrian" 5 "general" 6 "animal" 7 "uncertain";
VAL_ 850 RLR_OBJ5_Measured 0 "unknown" 1 "Measured" 2 "Predicted" 3 "Reserved";
VAL_ 850 RLR_OBJ5_Location 0 "unknown" 1 "LeRt Lane" 2 "Right  Lane" 3 "Ego Lane";
VAL_ 850 RLR_OBJ5_Type 0 "Not Detected" 1 "car" 2 "truck" 3 "bicycle/motorbike" 4 "pedestrian" 5 "general" 6 "animal" 7 "uncertain";

VAL_ 851 RLR_OBJ8_Convergence 0 "收敛
0x1=不收敛";
VAL_ 851 RLR_OBJ8_MotionStatus 0 "unknown" 1 "moving " 2 "stopped" 3 "stationary" 4 "crossing" 5 "reserve;";
VAL_ 851 RLR_OBJ7_Convergence 0 "收敛
0x1=不收敛";
VAL_ 851 RLR_OBJ7_MotionStatus 0 "unknown" 1 "moving " 2 "stopped" 3 "stationary" 4 "crossing" 5 "reserve;";
VAL_ 851 RLR_OBJ8_Measured 0 "unknown" 1 "Measured" 2 "Predicted" 3 "Reserved";
VAL_ 851 RLR_OBJ8_Location 0 "unknown" 1 "LeRt Lane" 2 "Right  Lane" 3 "Ego Lane";
VAL_ 851 RLR_OBJ8_Type 0 "Not Detected" 1 "car" 2 "truck" 3 "bicycle/motorbike" 4 "pedestrian" 5 "general" 6 "animal" 7 "uncertain";
VAL_ 851 RLR_OBJ7_Measured 0 "unknown" 1 "Measured" 2 "Predicted" 3 "Reserved";
VAL_ 851 RLR_OBJ7_Location 0 "unknown" 1 "LeRt Lane" 2 "Right  Lane" 3 "Ego Lane";
VAL_ 851 RLR_OBJ7_Type 0 "Not Detected" 1 "car" 2 "truck" 3 "bicycle/motorbike" 4 "pedestrian" 5 "general" 6 "animal" 7 "uncertain";

VAL_ 852 RLR_OBJ10_Convergence 0 "收敛
0x1=不收敛";
VAL_ 852 RLR_OBJ10_MotionStatus 0 "unknown" 1 "moving " 2 "stopped" 3 "stationary" 4 "crossing" 5 "reserve;";
VAL_ 852 RLR_OBJ9_Convergence 0 "收敛
0x1=不收敛";
VAL_ 852 RLR_OBJ9_MotionStatus 0 "unknown" 1 "moving " 2 "stopped" 3 "stationary" 4 "crossing" 5 "reserve;";
VAL_ 852 RLR_OBJ10_Measured 0 "unknown" 1 "Measured" 2 "Predicted" 3 "Reserved";
VAL_ 852 RLR_OBJ10_Location 0 "unknown" 1 "LeRt Lane" 2 "Right  Lane" 3 "Ego Lane";
VAL_ 852 RLR_OBJ10_Type 0 "Not Detected" 1 "car" 2 "truck" 3 "bicycle/motorbike" 4 "pedestrian" 5 "general" 6 "animal" 7 "uncertain";
VAL_ 852 RLR_OBJ9_Measured 0 "unknown" 1 "Measured" 2 "Predicted" 3 "Reserved";
VAL_ 852 RLR_OBJ9_Location 0 "unknown" 1 "LeRt Lane" 2 "Right  Lane" 3 "Ego Lane";
VAL_ 852 RLR_OBJ9_Type 0 "Not Detected" 1 "car" 2 "truck" 3 "bicycle/motorbike" 4 "pedestrian" 5 "general" 6 "animal" 7 "uncertain";

VAL_ 853 RLR_OBJ12_Convergence 0 "收敛
0x1=不收敛";
VAL_ 853 RLR_OBJ12_MotionStatus 0 "unknown" 1 "moving " 2 "stopped" 3 "stationary" 4 "crossing" 5 "reserve;";
VAL_ 853 RLR_OBJ11_Convergence 0 "收敛
0x1=不收敛";
VAL_ 853 RLR_OBJ11_MotionStatus 0 "unknown" 1 "moving " 2 "stopped" 3 "stationary" 4 "crossing" 5 "reserve;";
VAL_ 853 RLR_OBJ12_Measured 0 "unknown" 1 "Measured" 2 "Predicted" 3 "Reserved";
VAL_ 853 RLR_OBJ12_Location 0 "unknown" 1 "LeRt Lane" 2 "Right  Lane" 3 "Ego Lane";
VAL_ 853 RLR_OBJ12_Type 0 "Not Detected" 1 "car" 2 "truck" 3 "bicycle/motorbike" 4 "pedestrian" 5 "general" 6 "animal" 7 "uncertain";
VAL_ 853 RLR_OBJ11_Measured 0 "unknown" 1 "Measured" 2 "Predicted" 3 "Reserved";
VAL_ 853 RLR_OBJ11_Location 0 "unknown" 1 "LeRt Lane" 2 "Right  Lane" 3 "Ego Lane";
VAL_ 853 RLR_OBJ11_Type 0 "Not Detected" 1 "car" 2 "truck" 3 "bicycle/motorbike" 4 "pedestrian" 5 "general" 6 "animal" 7 "uncertain";

VAL_ 865 RLR_OBJ14_Convergence 0 "收敛
0x1=不收敛";
VAL_ 865 RLR_OBJ14_MotionStatus 0 "unknown" 1 "moving " 2 "stopped" 3 "stationary" 4 "crossing" 5 "reserve;";
VAL_ 865 RLR_OBJ13_Convergence 0 "收敛
0x1=不收敛";
VAL_ 865 RLR_OBJ13_MotionStatus 0 "unknown" 1 "moving " 2 "stopped" 3 "stationary" 4 "crossing" 5 "reserve;";
VAL_ 865 RLR_OBJ14_Measured 0 "unknown" 1 "Measured" 2 "Predicted" 3 "Reserved";
VAL_ 865 RLR_OBJ14_Location 0 "unknown" 1 "LeRt Lane" 2 "Right  Lane" 3 "Ego Lane";
VAL_ 865 RLR_OBJ14_Type 0 "Not Detected" 1 "car" 2 "truck" 3 "bicycle/motorbike" 4 "pedestrian" 5 "general" 6 "animal" 7 "uncertain";
VAL_ 865 RLR_OBJ13_Measured 0 "unknown" 1 "Measured" 2 "Predicted" 3 "Reserved";
VAL_ 865 RLR_OBJ13_Location 0 "unknown" 1 "LeRt Lane" 2 "Right  Lane" 3 "Ego Lane";
VAL_ 865 RLR_OBJ13_Type 0 "Not Detected" 1 "car" 2 "truck" 3 "bicycle/motorbike" 4 "pedestrian" 5 "general" 6 "animal" 7 "uncertain";

VAL_ 855 RLR_OBJ16_Convergence 0 "收敛
0x1=不收敛";
VAL_ 855 RLR_OBJ16_MotionStatus 0 "unknown" 1 "moving " 2 "stopped" 3 "stationary" 4 "crossing" 5 "reserve;";
VAL_ 855 RLR_OBJ15_Convergence 0 "收敛
0x1=不收敛";
VAL_ 855 RLR_OBJ15_MotionStatus 0 "unknown" 1 "moving " 2 "stopped" 3 "stationary" 4 "crossing" 5 "reserve;";
VAL_ 855 RLR_OBJ16_Measured 0 "unknown" 1 "Measured" 2 "Predicted" 3 "Reserved";
VAL_ 855 RLR_OBJ16_Location 0 "unknown" 1 "LeRt Lane" 2 "Right  Lane" 3 "Ego Lane";
VAL_ 855 RLR_OBJ16_Type 0 "Not Detected" 1 "car" 2 "truck" 3 "bicycle/motorbike" 4 "pedestrian" 5 "general" 6 "animal" 7 "uncertain";
VAL_ 855 RLR_OBJ15_Measured 0 "unknown" 1 "Measured" 2 "Predicted" 3 "Reserved";
VAL_ 855 RLR_OBJ15_Location 0 "unknown" 1 "LeRt Lane" 2 "Right  Lane" 3 "Ego Lane";
VAL_ 855 RLR_OBJ15_Type 0 "Not Detected" 1 "car" 2 "truck" 3 "bicycle/motorbike" 4 "pedestrian" 5 "general" 6 "animal" 7 "uncertain";

VAL_ 856 RLR_OBJ18_Convergence 0 "收敛
0x1=不收敛";
VAL_ 856 RLR_OBJ18_MotionStatus 0 "unknown" 1 "moving " 2 "stopped" 3 "stationary" 4 "crossing" 5 "reserve;";
VAL_ 856 RLR_OBJ17_Convergence 0 "收敛
0x1=不收敛";
VAL_ 856 RLR_OBJ17_MotionStatus 0 "unknown" 1 "moving " 2 "stopped" 3 "stationary" 4 "crossing" 5 "reserve;";
VAL_ 856 RLR_OBJ18_Measured 0 "unknown" 1 "Measured" 2 "Predicted" 3 "Reserved";
VAL_ 856 RLR_OBJ18_Location 0 "unknown" 1 "LeRt Lane" 2 "Right  Lane" 3 "Ego Lane";
VAL_ 856 RLR_OBJ18_Type 0 "Not Detected" 1 "car" 2 "truck" 3 "bicycle/motorbike" 4 "pedestrian" 5 "general" 6 "animal" 7 "uncertain";
VAL_ 856 RLR_OBJ17_Measured 0 "unknown" 1 "Measured" 2 "Predicted" 3 "Reserved";
VAL_ 856 RLR_OBJ17_Location 0 "unknown" 1 "LeRt Lane" 2 "Right  Lane" 3 "Ego Lane";
VAL_ 856 RLR_OBJ17_Type 0 "Not Detected" 1 "car" 2 "truck" 3 "bicycle/motorbike" 4 "pedestrian" 5 "general" 6 "animal" 7 "uncertain";

VAL_ 857 RLR_OBJ20_Convergence 0 "收敛
0x1=不收敛";
VAL_ 857 RLR_OBJ20_MotionStatus 0 "unknown" 1 "moving " 2 "stopped" 3 "stationary" 4 "crossing" 5 "reserve;";
VAL_ 857 RLR_OBJ19_Convergence 0 "收敛
0x1=不收敛";
VAL_ 857 RLR_OBJ19_MotionStatus 0 "unknown" 1 "moving " 2 "stopped" 3 "stationary" 4 "crossing" 5 "reserve;";
VAL_ 857 RLR_OBJ20_Measured 0 "unknown" 1 "Measured" 2 "Predicted" 3 "Reserved";
VAL_ 857 RLR_OBJ20_Location 0 "unknown" 1 "LeRt Lane" 2 "Right  Lane" 3 "Ego Lane";
VAL_ 857 RLR_OBJ20_Type 0 "Not Detected" 1 "car" 2 "truck" 3 "bicycle/motorbike" 4 "pedestrian" 5 "general" 6 "animal" 7 "uncertain";
VAL_ 857 RLR_OBJ19_Measured 0 "unknown" 1 "Measured" 2 "Predicted" 3 "Reserved";
VAL_ 857 RLR_OBJ19_Location 0 "unknown" 1 "LeRt Lane" 2 "Right  Lane" 3 "Ego Lane";
VAL_ 857 RLR_OBJ19_Type 0 "Not Detected" 1 "car" 2 "truck" 3 "bicycle/motorbike" 4 "pedestrian" 5 "general" 6 "animal" 7 "uncertain";

VAL_ 858 RLR_OBJ22_Convergence 0 "收敛
0x1=不收敛";
VAL_ 858 RLR_OBJ22_MotionStatus 0 "unknown" 1 "moving " 2 "stopped" 3 "stationary" 4 "crossing" 5 "reserve;";
VAL_ 858 RLR_OBJ21_Convergence 0 "收敛
0x1=不收敛";
VAL_ 858 RLR_OBJ21_MotionStatus 0 "unknown" 1 "moving " 2 "stopped" 3 "stationary" 4 "crossing" 5 "reserve;";
VAL_ 858 RLR_OBJ22_Measured 0 "unknown" 1 "Measured" 2 "Predicted" 3 "Reserved";
VAL_ 858 RLR_OBJ22_Location 0 "unknown" 1 "LeRt Lane" 2 "Right  Lane" 3 "Ego Lane";
VAL_ 858 RLR_OBJ22_Type 0 "Not Detected" 1 "car" 2 "truck" 3 "bicycle/motorbike" 4 "pedestrian" 5 "general" 6 "animal" 7 "uncertain";
VAL_ 858 RLR_OBJ21_Measured 0 "unknown" 1 "Measured" 2 "Predicted" 3 "Reserved";
VAL_ 858 RLR_OBJ21_Location 0 "unknown" 1 "LeRt Lane" 2 "Right  Lane" 3 "Ego Lane";
VAL_ 858 RLR_OBJ21_Type 0 "Not Detected" 1 "car" 2 "truck" 3 "bicycle/motorbike" 4 "pedestrian" 5 "general" 6 "animal" 7 "uncertain";
