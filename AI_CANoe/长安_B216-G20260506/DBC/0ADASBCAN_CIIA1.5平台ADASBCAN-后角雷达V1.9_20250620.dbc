VERSION ""

NS_ :

BS_:
BU_: RLR_L RRR_L mADC

BO_ 859 RLR_L_35B: 64 RLR_L
 SG_ RLR_OBJ24_LostCnt : 483|4@0+ (1.0000000000,0.0000000000) [0.0000000000|15.0000000000] ""  RRR_L,mADC
 SG_ RLR_OBJ23_LostCnt : 495|4@0+ (1.0000000000,0.0000000000) [0.0000000000|15.0000000000] ""  RRR_L,mADC
 SG_ RLR_OBJ24_Dx : 230|13@0+ (0.0625000000,-256.0000000000) [-256.0000000000|255.9380000000] "m"  RRR_L,mADC
 SG_ RLR_OBJ24_Dy : 209|11@0+ (0.1250000000,-128.0000000000) [-128.0000000000|127.8750000000] "m"  RRR_L,mADC
 SG_ RLR_OBJ23_Dx : 59|13@0+ (0.0625000000,-256.0000000000) [-256.0000000000|255.9380000000] "m"  RRR_L,mADC
 SG_ RLR_OBJ23_Dy : 54|11@0+ (0.1250000000,-128.0000000000) [-128.0000000000|127.8750000000] "m"  RRR_L,mADC
 SG_ RLR_OBJ24_Vx : 310|12@0+ (0.0625000000,-128.0000000000) [-128.0000000000|127.9380000000] "m/s"  RRR_L,mADC
 SG_ RLR_OBJ24_Vy : 288|10@0+ (0.0625000000,-32.0000000000) [-32.0000000000|31.9375000000] "m/s"  RRR_L,mADC
 SG_ RLR_OBJ24_Convergence : 458|1@0+ (1.0000000000,0.0000000000) [0.0000000000|1.0000000000] ""  RRR_L,mADC
 SG_ RLR_OBJ24_DelayTime : 453|10@0+ (1.0000000000,0.0000000000) [0.0000000000|1023.0000000000] "ms"  RRR_L,mADC
 SG_ RLR_OBJ24_HeightGround : 424|9@0+ (0.1000000000,0.0000000000) [0.0000000000|51.1000000000] "m"  RRR_L,mADC
 SG_ RLR_OBJ24_MotionStatus : 470|3@0+ (1.0000000000,0.0000000000) [0.0000000000|7.0000000000] ""  RRR_L,mADC
 SG_ RLR_OBJ24_RelVx_std : 413|12@0+ (0.0625000000,0.0000000000) [0.0000000000|255.9375000000] "m/s"  RRR_L,mADC
 SG_ RLR_OBJ24_RelVy_std : 407|10@0+ (0.1250000000,0.0000000000) [0.0000000000|127.8750000000] "m/s"  RRR_L,mADC
 SG_ RLR_OBJ24_Dx_Vnce : 389|14@0+ (0.0500000000,0.0000000000) [0.0000000000|50.0000000000] "m2"  RRR_L,mADC
 SG_ RLR_OBJ24_Dy_Vnce : 383|10@0+ (0.0200000000,0.0000000000) [0.0000000000|20.0000000000] "m2"  RRR_L,mADC
 SG_ RLR_OBJ23_Vx : 139|12@0+ (0.0625000000,-128.0000000000) [-128.0000000000|127.9380000000] "m/s"  RRR_L,mADC
 SG_ RLR_OBJ23_Vy : 133|10@0+ (0.0625000000,-32.0000000000) [-32.0000000000|31.9375000000] "m/s"  RRR_L,mADC
 SG_ RLR_OBJ23_Convergence : 459|1@0+ (1.0000000000,0.0000000000) [0.0000000000|1.0000000000] ""  RRR_L,mADC
 SG_ RLR_OBJ23_DelayTime : 447|10@0+ (1.0000000000,0.0000000000) [0.0000000000|1023.0000000000] "ms"  RRR_L,mADC
 SG_ RLR_OBJ23_HeightGround : 417|9@0+ (0.1000000000,0.0000000000) [0.0000000000|51.1000000000] "m"  RRR_L,mADC
 SG_ RLR_OBJ23_MotionStatus : 457|3@0+ (1.0000000000,0.0000000000) [0.0000000000|7.0000000000] ""  RRR_L,mADC
 SG_ RLR_OBJ23_RelVx_std : 363|12@0+ (0.0625000000,0.0000000000) [0.0000000000|255.9375000000] "m/s"  RRR_L,mADC
 SG_ RLR_OBJ23_RelVy_std : 357|10@0+ (0.1250000000,0.0000000000) [0.0000000000|127.8750000000] "m/s"  RRR_L,mADC
 SG_ RLR_OBJ23_Dx_Vnce : 339|14@0+ (0.0500000000,0.0000000000) [0.0000000000|50.0000000000] "m2"  RRR_L,mADC
 SG_ RLR_OBJ23_Dy_Vnce : 333|10@0+ (0.0200000000,0.0000000000) [0.0000000000|20.0000000000] "m2"  RRR_L,mADC
 SG_ RLR_CRCCheck_35B : 503|16@0+ (1.0000000000,0.0000000000) [0.0000000000|65535.0000000000] ""  RRR_L,mADC
 SG_ RLR_RollingCounter_35B : 491|4@0+ (1.0000000000,0.0000000000) [0.0000000000|15.0000000000] ""  RRR_L,mADC
 SG_ RLR_OBJ24_Track_Age : 325|8@0+ (1.0000000000,0.0000000000) [0.0000000000|255.0000000000] ""  RRR_L,mADC
 SG_ RLR_OBJ24_ReRPointLoc : 312|3@0+ (1.0000000000,0.0000000000) [0.0000000000|7.0000000000] ""  RRR_L,mADC
 SG_ RLR_OBJ24_ObstacleProb : 294|6@0+ (2.0000000000,0.0000000000) [0.0000000000|100.0000000000] "%"  RRR_L,mADC
 SG_ RLR_OBJ24_Measured : 280|2@0+ (1.0000000000,0.0000000000) [0.0000000000|3.0000000000] ""  RRR_L,mADC
 SG_ RLR_OBJ24_ExistProb : 286|6@0+ (2.0000000000,0.0000000000) [0.0000000000|100.0000000000] "%"  RRR_L,mADC
 SG_ RLR_OBJ24_Location : 272|2@0+ (1.0000000000,0.0000000000) [0.0000000000|3.0000000000] ""  RRR_L,mADC
 SG_ RLR_OBJ24_RelAx : 265|9@0+ (0.0625000000,-16.0000000000) [-16.0000000000|15.9375000000] "m/s2"  RRR_L,mADC
 SG_ RLR_OBJ24_RelAy : 259|10@0+ (0.0312500000,-16.0000000000) [-16.0000000000|15.9688000000] "m/s2"  RRR_L,mADC
 SG_ RLR_OBJ24_RelVx : 255|12@0+ (0.0625000000,-128.0000000000) [-128.0000000000|127.9380000000] "m/s"  RRR_L,mADC
 SG_ RLR_OBJ24_RelVy : 233|10@0+ (0.0625000000,-32.0000000000) [-32.0000000000|63.8750000000] "m/s"  RRR_L,mADC
 SG_ RLR_OBJ24_HeadingAngle : 203|10@0+ (0.0100000000,-3.1400000000) [-3.1400000000|3.1400000000] "rad"  RRR_L,mADC
 SG_ RLR_OBJ24_Length : 196|9@0+ (0.0500000000,0.0000000000) [0.0000000000|25.5000000000] "m"  RRR_L,mADC
 SG_ RLR_OBJ24_Height : 189|9@0+ (0.0100000000,0.0000000000) [0.0000000000|5.1100000000] "m"  RRR_L,mADC
 SG_ RLR_OBJ24_Width : 168|11@0+ (0.0100000000,0.0000000000) [0.0000000000|12.0000000000] "m"  RRR_L,mADC
 SG_ RLR_OBJ24_Type : 171|3@0+ (1.0000000000,0.0000000000) [0.0000000000|7.0000000000] ""  RRR_L,mADC
 SG_ RLR_OBJ24_Track_ID : 162|7@0+ (1.0000000000,0.0000000000) [0.0000000000|127.0000000000] ""  RRR_L,mADC
 SG_ RLR_OBJ23_Track_Age : 154|8@0+ (1.0000000000,0.0000000000) [0.0000000000|255.0000000000] ""  RRR_L,mADC
 SG_ RLR_OBJ23_ReRPointLoc : 157|3@0+ (1.0000000000,0.0000000000) [0.0000000000|7.0000000000] ""  RRR_L,mADC
 SG_ RLR_OBJ23_ObstacleProb : 123|6@0+ (2.0000000000,0.0000000000) [0.0000000000|100.0000000000] "%"  RRR_L,mADC
 SG_ RLR_OBJ23_Measured : 125|2@0+ (1.0000000000,0.0000000000) [0.0000000000|3.0000000000] ""  RRR_L,mADC
 SG_ RLR_OBJ23_ExistProb : 115|6@0+ (2.0000000000,0.0000000000) [0.0000000000|100.0000000000] "%"  RRR_L,mADC
 SG_ RLR_OBJ23_Location : 117|2@0+ (1.0000000000,0.0000000000) [0.0000000000|3.0000000000] ""  RRR_L,mADC
 SG_ RLR_OBJ23_RelAx : 110|9@0+ (0.0625000000,-16.0000000000) [-16.0000000000|15.9375000000] "m/s2"  RRR_L,mADC
 SG_ RLR_OBJ23_RelAy : 88|10@0+ (0.0312500000,-16.0000000000) [-16.0000000000|15.9688000000] "m/s2"  RRR_L,mADC
 SG_ RLR_OBJ23_RelVx : 84|12@0+ (0.0625000000,-128.0000000000) [-128.0000000000|127.9380000000] "m/s"  RRR_L,mADC
 SG_ RLR_OBJ23_RelVy : 78|10@0+ (0.0625000000,-32.0000000000) [-32.0000000000|63.8750000000] "m/s"  RRR_L,mADC
 SG_ RLR_OBJ23_HeadingAngle : 32|10@0+ (0.0100000000,-3.1400000000) [-3.1400000000|3.1400000000] "rad"  RRR_L,mADC
 SG_ RLR_OBJ23_Length : 25|9@0+ (0.0500000000,0.0000000000) [0.0000000000|25.5000000000] "m"  RRR_L,mADC
 SG_ RLR_OBJ23_Height : 18|9@0+ (0.0100000000,0.0000000000) [0.0000000000|5.1100000000] "m"  RRR_L,mADC
 SG_ RLR_OBJ23_Width : 13|11@0+ (0.0100000000,0.0000000000) [0.0000000000|12.0000000000] "m"  RRR_L,mADC
 SG_ RLR_OBJ23_Type : 0|3@0+ (1.0000000000,0.0000000000) [0.0000000000|7.0000000000] ""  RRR_L,mADC
 SG_ RLR_OBJ23_Track_ID : 7|7@0+ (1.0000000000,0.0000000000) [0.0000000000|127.0000000000] ""  RRR_L,mADC

BO_ 860 RLR_L_35C: 64 RLR_L
 SG_ RLR_OBJ26_LostCnt : 483|4@0+ (1.0000000000,0.0000000000) [0.0000000000|15.0000000000] ""  RRR_L,mADC
 SG_ RLR_OBJ25_LostCnt : 495|4@0+ (1.0000000000,0.0000000000) [0.0000000000|15.0000000000] ""  RRR_L,mADC
 SG_ RLR_OBJ26_Dx : 230|13@0+ (0.0625000000,-256.0000000000) [-256.0000000000|255.9380000000] "m"  RRR_L,mADC
 SG_ RLR_OBJ26_Dy : 209|11@0+ (0.1250000000,-128.0000000000) [-128.0000000000|127.8750000000] "m"  RRR_L,mADC
 SG_ RLR_OBJ25_Dx : 59|13@0+ (0.0625000000,-256.0000000000) [-256.0000000000|255.9380000000] "m"  RRR_L,mADC
 SG_ RLR_OBJ25_Dy : 54|11@0+ (0.1250000000,-128.0000000000) [-128.0000000000|127.8750000000] "m"  RRR_L,mADC
 SG_ RLR_OBJ26_Vx : 310|12@0+ (0.0625000000,-128.0000000000) [-128.0000000000|127.9380000000] "m/s"  RRR_L,mADC
 SG_ RLR_OBJ26_Vy : 288|10@0+ (0.0625000000,-32.0000000000) [-32.0000000000|31.9375000000] "m/s"  RRR_L,mADC
 SG_ RLR_OBJ26_Convergence : 458|1@0+ (1.0000000000,0.0000000000) [0.0000000000|1.0000000000] ""  RRR_L,mADC
 SG_ RLR_OBJ26_DelayTime : 453|10@0+ (1.0000000000,0.0000000000) [0.0000000000|1023.0000000000] "ms"  RRR_L,mADC
 SG_ RLR_OBJ26_HeightGround : 424|9@0+ (0.1000000000,0.0000000000) [0.0000000000|51.1000000000] "m"  RRR_L,mADC
 SG_ RLR_OBJ26_MotionStatus : 470|3@0+ (1.0000000000,0.0000000000) [0.0000000000|7.0000000000] ""  RRR_L,mADC
 SG_ RLR_OBJ26_RelVx_std : 413|12@0+ (0.0625000000,0.0000000000) [0.0000000000|255.9375000000] "m/s"  RRR_L,mADC
 SG_ RLR_OBJ26_RelVy_std : 407|10@0+ (0.1250000000,0.0000000000) [0.0000000000|127.8750000000] "m/s"  RRR_L,mADC
 SG_ RLR_OBJ26_Dx_Vnce : 389|14@0+ (0.0500000000,0.0000000000) [0.0000000000|50.0000000000] "m2"  RRR_L,mADC
 SG_ RLR_OBJ26_Dy_Vnce : 383|10@0+ (0.0200000000,0.0000000000) [0.0000000000|20.0000000000] "m2"  RRR_L,mADC
 SG_ RLR_OBJ25_Vx : 139|12@0+ (0.0625000000,-128.0000000000) [-128.0000000000|127.9380000000] "m/s"  RRR_L,mADC
 SG_ RLR_OBJ25_Vy : 133|10@0+ (0.0625000000,-32.0000000000) [-32.0000000000|31.9375000000] "m/s"  RRR_L,mADC
 SG_ RLR_OBJ25_Convergence : 459|1@0+ (1.0000000000,0.0000000000) [0.0000000000|1.0000000000] ""  RRR_L,mADC
 SG_ RLR_OBJ25_DelayTime : 447|10@0+ (1.0000000000,0.0000000000) [0.0000000000|1023.0000000000] "ms"  RRR_L,mADC
 SG_ RLR_OBJ25_HeightGround : 417|9@0+ (0.1000000000,0.0000000000) [0.0000000000|51.1000000000] "m"  RRR_L,mADC
 SG_ RLR_OBJ25_MotionStatus : 457|3@0+ (1.0000000000,0.0000000000) [0.0000000000|7.0000000000] ""  RRR_L,mADC
 SG_ RLR_OBJ25_RelVx_std : 363|12@0+ (0.0625000000,0.0000000000) [0.0000000000|255.9375000000] "m/s"  RRR_L,mADC
 SG_ RLR_OBJ25_RelVy_std : 357|10@0+ (0.1250000000,0.0000000000) [0.0000000000|127.8750000000] "m/s"  RRR_L,mADC
 SG_ RLR_OBJ25_Dx_Vnce : 339|14@0+ (0.0500000000,0.0000000000) [0.0000000000|50.0000000000] "m2"  RRR_L,mADC
 SG_ RLR_OBJ25_Dy_Vnce : 333|10@0+ (0.0200000000,0.0000000000) [0.0000000000|20.0000000000] "m2"  RRR_L,mADC
 SG_ RLR_CRCCheck_35C : 503|16@0+ (1.0000000000,0.0000000000) [0.0000000000|65535.0000000000] ""  RRR_L,mADC
 SG_ RLR_RollingCounter_35C : 491|4@0+ (1.0000000000,0.0000000000) [0.0000000000|15.0000000000] ""  RRR_L,mADC
 SG_ RLR_OBJ26_Track_Age : 325|8@0+ (1.0000000000,0.0000000000) [0.0000000000|255.0000000000] ""  RRR_L,mADC
 SG_ RLR_OBJ26_ReRPointLoc : 312|3@0+ (1.0000000000,0.0000000000) [0.0000000000|7.0000000000] ""  RRR_L,mADC
 SG_ RLR_OBJ26_ObstacleProb : 294|6@0+ (2.0000000000,0.0000000000) [0.0000000000|100.0000000000] "%"  RRR_L,mADC
 SG_ RLR_OBJ26_Measured : 280|2@0+ (1.0000000000,0.0000000000) [0.0000000000|3.0000000000] ""  RRR_L,mADC
 SG_ RLR_OBJ26_ExistProb : 286|6@0+ (2.0000000000,0.0000000000) [0.0000000000|100.0000000000] "%"  RRR_L,mADC
 SG_ RLR_OBJ26_Location : 272|2@0+ (1.0000000000,0.0000000000) [0.0000000000|3.0000000000] ""  RRR_L,mADC
 SG_ RLR_OBJ26_RelAx : 265|9@0+ (0.0625000000,-16.0000000000) [-16.0000000000|15.9375000000] "m/s2"  RRR_L,mADC
 SG_ RLR_OBJ26_RelAy : 259|10@0+ (0.0312500000,-16.0000000000) [-16.0000000000|15.9688000000] "m/s2"  RRR_L,mADC
 SG_ RLR_OBJ26_RelVx : 255|12@0+ (0.0625000000,-128.0000000000) [-128.0000000000|127.9380000000] "m/s"  RRR_L,mADC
 SG_ RLR_OBJ26_RelVy : 233|10@0+ (0.0625000000,-32.0000000000) [-32.0000000000|63.8750000000] "m/s"  RRR_L,mADC
 SG_ RLR_OBJ26_HeadingAngle : 203|10@0+ (0.0100000000,-3.1400000000) [-3.1400000000|3.1400000000] "rad"  RRR_L,mADC
 SG_ RLR_OBJ26_Length : 196|9@0+ (0.0500000000,0.0000000000) [0.0000000000|25.5000000000] "m"  RRR_L,mADC
 SG_ RLR_OBJ26_Height : 189|9@0+ (0.0100000000,0.0000000000) [0.0000000000|5.1100000000] "m"  RRR_L,mADC
 SG_ RLR_OBJ26_Width : 168|11@0+ (0.0100000000,0.0000000000) [0.0000000000|12.0000000000] "m"  RRR_L,mADC
 SG_ RLR_OBJ26_Type : 171|3@0+ (1.0000000000,0.0000000000) [0.0000000000|7.0000000000] ""  RRR_L,mADC
 SG_ RLR_OBJ26_Track_ID : 162|7@0+ (1.0000000000,0.0000000000) [0.0000000000|127.0000000000] ""  RRR_L,mADC
 SG_ RLR_OBJ25_Track_Age : 154|8@0+ (1.0000000000,0.0000000000) [0.0000000000|255.0000000000] ""  RRR_L,mADC
 SG_ RLR_OBJ25_ReRPointLoc : 157|3@0+ (1.0000000000,0.0000000000) [0.0000000000|7.0000000000] ""  RRR_L,mADC
 SG_ RLR_OBJ25_ObstacleProb : 123|6@0+ (2.0000000000,0.0000000000) [0.0000000000|100.0000000000] "%"  RRR_L,mADC
 SG_ RLR_OBJ25_Measured : 125|2@0+ (1.0000000000,0.0000000000) [0.0000000000|3.0000000000] ""  RRR_L,mADC
 SG_ RLR_OBJ25_ExistProb : 115|6@0+ (2.0000000000,0.0000000000) [0.0000000000|100.0000000000] "%"  RRR_L,mADC
 SG_ RLR_OBJ25_Location : 117|2@0+ (1.0000000000,0.0000000000) [0.0000000000|3.0000000000] ""  RRR_L,mADC
 SG_ RLR_OBJ25_RelAx : 110|9@0+ (0.0625000000,-16.0000000000) [-16.0000000000|15.9375000000] "m/s2"  RRR_L,mADC
 SG_ RLR_OBJ25_RelAy : 88|10@0+ (0.0312500000,-16.0000000000) [-16.0000000000|15.9688000000] "m/s2"  RRR_L,mADC
 SG_ RLR_OBJ25_RelVx : 84|12@0+ (0.0625000000,-128.0000000000) [-128.0000000000|127.9380000000] "m/s"  RRR_L,mADC
 SG_ RLR_OBJ25_RelVy : 78|10@0+ (0.0625000000,-32.0000000000) [-32.0000000000|63.8750000000] "m/s"  RRR_L,mADC
 SG_ RLR_OBJ25_HeadingAngle : 32|10@0+ (0.0100000000,-3.1400000000) [-3.1400000000|3.1400000000] "rad"  RRR_L,mADC
 SG_ RLR_OBJ25_Length : 25|9@0+ (0.0500000000,0.0000000000) [0.0000000000|25.5000000000] "m"  RRR_L,mADC
 SG_ RLR_OBJ25_Height : 18|9@0+ (0.0100000000,0.0000000000) [0.0000000000|5.1100000000] "m"  RRR_L,mADC
 SG_ RLR_OBJ25_Width : 13|11@0+ (0.0100000000,0.0000000000) [0.0000000000|12.0000000000] "m"  RRR_L,mADC
 SG_ RLR_OBJ25_Type : 0|3@0+ (1.0000000000,0.0000000000) [0.0000000000|7.0000000000] ""  RRR_L,mADC
 SG_ RLR_OBJ25_Track_ID : 7|7@0+ (1.0000000000,0.0000000000) [0.0000000000|127.0000000000] ""  RRR_L,mADC

BO_ 861 RLR_L_35D: 64 RLR_L
 SG_ RLR_OBJ28_LostCnt : 483|4@0+ (1.0000000000,0.0000000000) [0.0000000000|15.0000000000] ""  RRR_L,mADC
 SG_ RLR_OBJ27_LostCnt : 495|4@0+ (1.0000000000,0.0000000000) [0.0000000000|15.0000000000] ""  RRR_L,mADC
 SG_ RLR_OBJ28_Dx : 230|13@0+ (0.0625000000,-256.0000000000) [-256.0000000000|255.9380000000] "m"  RRR_L,mADC
 SG_ RLR_OBJ28_Dy : 209|11@0+ (0.1250000000,-128.0000000000) [-128.0000000000|127.8750000000] "m"  RRR_L,mADC
 SG_ RLR_OBJ27_Dx : 59|13@0+ (0.0625000000,-256.0000000000) [-256.0000000000|255.9380000000] "m"  RRR_L,mADC
 SG_ RLR_OBJ27_Dy : 54|11@0+ (0.1250000000,-128.0000000000) [-128.0000000000|127.8750000000] "m"  RRR_L,mADC
 SG_ RLR_OBJ28_Vx : 310|12@0+ (0.0625000000,-128.0000000000) [-128.0000000000|127.9380000000] "m/s"  RRR_L,mADC
 SG_ RLR_OBJ28_Vy : 288|10@0+ (0.0625000000,-32.0000000000) [-32.0000000000|31.9375000000] "m/s"  RRR_L,mADC
 SG_ RLR_OBJ28_Convergence : 458|1@0+ (1.0000000000,0.0000000000) [0.0000000000|1.0000000000] ""  RRR_L,mADC
 SG_ RLR_OBJ28_DelayTime : 453|10@0+ (1.0000000000,0.0000000000) [0.0000000000|1023.0000000000] "ms"  RRR_L,mADC
 SG_ RLR_OBJ28_HeightGround : 424|9@0+ (0.1000000000,0.0000000000) [0.0000000000|51.1000000000] "m"  RRR_L,mADC
 SG_ RLR_OBJ28_MotionStatus : 470|3@0+ (1.0000000000,0.0000000000) [0.0000000000|7.0000000000] ""  RRR_L,mADC
 SG_ RLR_OBJ28_RelVx_std : 413|12@0+ (0.0625000000,0.0000000000) [0.0000000000|255.9375000000] "m/s"  RRR_L,mADC
 SG_ RLR_OBJ28_RelVy_std : 407|10@0+ (0.1250000000,0.0000000000) [0.0000000000|127.8750000000] "m/s"  RRR_L,mADC
 SG_ RLR_OBJ28_Dx_Vnce : 389|14@0+ (0.0500000000,0.0000000000) [0.0000000000|50.0000000000] "m2"  RRR_L,mADC
 SG_ RLR_OBJ28_Dy_Vnce : 383|10@0+ (0.0200000000,0.0000000000) [0.0000000000|20.0000000000] "m2"  RRR_L,mADC
 SG_ RLR_OBJ27_Vx : 139|12@0+ (0.0625000000,-128.0000000000) [-128.0000000000|127.9380000000] "m/s"  RRR_L,mADC
 SG_ RLR_OBJ27_Vy : 133|10@0+ (0.0625000000,-32.0000000000) [-32.0000000000|31.9375000000] "m/s"  RRR_L,mADC
 SG_ RLR_OBJ27_Convergence : 459|1@0+ (1.0000000000,0.0000000000) [0.0000000000|1.0000000000] ""  RRR_L,mADC
 SG_ RLR_OBJ27_DelayTime : 447|10@0+ (1.0000000000,0.0000000000) [0.0000000000|1023.0000000000] "ms"  RRR_L,mADC
 SG_ RLR_OBJ27_HeightGround : 417|9@0+ (0.1000000000,0.0000000000) [0.0000000000|51.1000000000] "m"  RRR_L,mADC
 SG_ RLR_OBJ27_MotionStatus : 457|3@0+ (1.0000000000,0.0000000000) [0.0000000000|7.0000000000] ""  RRR_L,mADC
 SG_ RLR_OBJ27_RelVx_std : 363|12@0+ (0.0625000000,0.0000000000) [0.0000000000|255.9375000000] "m/s"  RRR_L,mADC
 SG_ RLR_OBJ27_RelVy_std : 357|10@0+ (0.1250000000,0.0000000000) [0.0000000000|127.8750000000] "m/s"  RRR_L,mADC
 SG_ RLR_OBJ27_Dx_Vnce : 339|14@0+ (0.0500000000,0.0000000000) [0.0000000000|50.0000000000] "m2"  RRR_L,mADC
 SG_ RLR_OBJ27_Dy_Vnce : 333|10@0+ (0.0200000000,0.0000000000) [0.0000000000|20.0000000000] "m2"  RRR_L,mADC
 SG_ RLR_CRCCheck_35D : 503|16@0+ (1.0000000000,0.0000000000) [0.0000000000|65535.0000000000] ""  RRR_L,mADC
 SG_ RLR_RollingCounter_35D : 491|4@0+ (1.0000000000,0.0000000000) [0.0000000000|15.0000000000] ""  RRR_L,mADC
 SG_ RLR_OBJ28_Track_Age : 325|8@0+ (1.0000000000,0.0000000000) [0.0000000000|255.0000000000] ""  RRR_L,mADC
 SG_ RLR_OBJ28_ReRPointLoc : 312|3@0+ (1.0000000000,0.0000000000) [0.0000000000|7.0000000000] ""  RRR_L,mADC
 SG_ RLR_OBJ28_ObstacleProb : 294|6@0+ (2.0000000000,0.0000000000) [0.0000000000|100.0000000000] "%"  RRR_L,mADC
 SG_ RLR_OBJ28_Measured : 280|2@0+ (1.0000000000,0.0000000000) [0.0000000000|3.0000000000] ""  RRR_L,mADC
 SG_ RLR_OBJ28_ExistProb : 286|6@0+ (2.0000000000,0.0000000000) [0.0000000000|100.0000000000] "%"  RRR_L,mADC
 SG_ RLR_OBJ28_Location : 272|2@0+ (1.0000000000,0.0000000000) [0.0000000000|3.0000000000] ""  RRR_L,mADC
 SG_ RLR_OBJ28_RelAx : 265|9@0+ (0.0625000000,-16.0000000000) [-16.0000000000|15.9375000000] "m/s2"  RRR_L,mADC
 SG_ RLR_OBJ28_RelAy : 259|10@0+ (0.0312500000,-16.0000000000) [-16.0000000000|15.9688000000] "m/s2"  RRR_L,mADC
 SG_ RLR_OBJ28_RelVx : 255|12@0+ (0.0625000000,-128.0000000000) [-128.0000000000|127.9380000000] "m/s"  RRR_L,mADC
 SG_ RLR_OBJ28_RelVy : 233|10@0+ (0.0625000000,-32.0000000000) [-32.0000000000|63.8750000000] "m/s"  RRR_L,mADC
 SG_ RLR_OBJ28_HeadingAngle : 203|10@0+ (0.0100000000,-3.1400000000) [-3.1400000000|3.1400000000] "rad"  RRR_L,mADC
 SG_ RLR_OBJ28_Length : 196|9@0+ (0.0500000000,0.0000000000) [0.0000000000|25.5000000000] "m"  RRR_L,mADC
 SG_ RLR_OBJ28_Height : 189|9@0+ (0.0100000000,0.0000000000) [0.0000000000|5.1100000000] "m"  RRR_L,mADC
 SG_ RLR_OBJ28_Width : 168|11@0+ (0.0100000000,0.0000000000) [0.0000000000|12.0000000000] "m"  RRR_L,mADC
 SG_ RLR_OBJ28_Type : 171|3@0+ (1.0000000000,0.0000000000) [0.0000000000|7.0000000000] ""  RRR_L,mADC
 SG_ RLR_OBJ28_Track_ID : 162|7@0+ (1.0000000000,0.0000000000) [0.0000000000|127.0000000000] ""  RRR_L,mADC
 SG_ RLR_OBJ27_Track_Age : 154|8@0+ (1.0000000000,0.0000000000) [0.0000000000|255.0000000000] ""  RRR_L,mADC
 SG_ RLR_OBJ27_ReRPointLoc : 157|3@0+ (1.0000000000,0.0000000000) [0.0000000000|7.0000000000] ""  RRR_L,mADC
 SG_ RLR_OBJ27_ObstacleProb : 123|6@0+ (2.0000000000,0.0000000000) [0.0000000000|100.0000000000] "%"  RRR_L,mADC
 SG_ RLR_OBJ27_Measured : 125|2@0+ (1.0000000000,0.0000000000) [0.0000000000|3.0000000000] ""  RRR_L,mADC
 SG_ RLR_OBJ27_ExistProb : 115|6@0+ (2.0000000000,0.0000000000) [0.0000000000|100.0000000000] "%"  RRR_L,mADC
 SG_ RLR_OBJ27_Location : 117|2@0+ (1.0000000000,0.0000000000) [0.0000000000|3.0000000000] ""  RRR_L,mADC
 SG_ RLR_OBJ27_RelAx : 110|9@0+ (0.0625000000,-16.0000000000) [-16.0000000000|15.9375000000] "m/s2"  RRR_L,mADC
 SG_ RLR_OBJ27_RelAy : 88|10@0+ (0.0312500000,-16.0000000000) [-16.0000000000|15.9688000000] "m/s2"  RRR_L,mADC
 SG_ RLR_OBJ27_RelVx : 84|12@0+ (0.0625000000,-128.0000000000) [-128.0000000000|127.9380000000] "m/s"  RRR_L,mADC
 SG_ RLR_OBJ27_RelVy : 78|10@0+ (0.0625000000,-32.0000000000) [-32.0000000000|63.8750000000] "m/s"  RRR_L,mADC
 SG_ RLR_OBJ27_HeadingAngle : 32|10@0+ (0.0100000000,-3.1400000000) [-3.1400000000|3.1400000000] "rad"  RRR_L,mADC
 SG_ RLR_OBJ27_Length : 25|9@0+ (0.0500000000,0.0000000000) [0.0000000000|25.5000000000] "m"  RRR_L,mADC
 SG_ RLR_OBJ27_Height : 18|9@0+ (0.0100000000,0.0000000000) [0.0000000000|5.1100000000] "m"  RRR_L,mADC
 SG_ RLR_OBJ27_Width : 13|11@0+ (0.0100000000,0.0000000000) [0.0000000000|12.0000000000] "m"  RRR_L,mADC
 SG_ RLR_OBJ27_Type : 0|3@0+ (1.0000000000,0.0000000000) [0.0000000000|7.0000000000] ""  RRR_L,mADC
 SG_ RLR_OBJ27_Track_ID : 7|7@0+ (1.0000000000,0.0000000000) [0.0000000000|127.0000000000] ""  RRR_L,mADC

BO_ 862 RLR_L_35E: 64 RLR_L
 SG_ RLR_OBJ30_LostCnt : 483|4@0+ (1.0000000000,0.0000000000) [0.0000000000|15.0000000000] ""  RRR_L,mADC
 SG_ RLR_OBJ29_LostCnt : 495|4@0+ (1.0000000000,0.0000000000) [0.0000000000|15.0000000000] ""  RRR_L,mADC
 SG_ RLR_OBJ30_Dx : 230|13@0+ (0.0625000000,-256.0000000000) [-256.0000000000|255.9380000000] "m"  RRR_L,mADC
 SG_ RLR_OBJ30_Dy : 209|11@0+ (0.1250000000,-128.0000000000) [-128.0000000000|127.8750000000] "m"  RRR_L,mADC
 SG_ RLR_OBJ29_Dx : 59|13@0+ (0.0625000000,-256.0000000000) [-256.0000000000|255.9380000000] "m"  RRR_L,mADC
 SG_ RLR_OBJ29_Dy : 54|11@0+ (0.1250000000,-128.0000000000) [-128.0000000000|127.8750000000] "m"  RRR_L,mADC
 SG_ RLR_OBJ30_Vx : 310|12@0+ (0.0625000000,-128.0000000000) [-128.0000000000|127.9380000000] "m/s"  RRR_L,mADC
 SG_ RLR_OBJ30_Vy : 288|10@0+ (0.0625000000,-32.0000000000) [-32.0000000000|31.9375000000] "m/s"  RRR_L,mADC
 SG_ RLR_OBJ30_Convergence : 458|1@0+ (1.0000000000,0.0000000000) [0.0000000000|1.0000000000] ""  RRR_L,mADC
 SG_ RLR_OBJ30_DelayTime : 453|10@0+ (1.0000000000,0.0000000000) [0.0000000000|1023.0000000000] "ms"  RRR_L,mADC
 SG_ RLR_OBJ30_HeightGround : 424|9@0+ (0.1000000000,0.0000000000) [0.0000000000|51.1000000000] "m"  RRR_L,mADC
 SG_ RLR_OBJ30_MotionStatus : 470|3@0+ (1.0000000000,0.0000000000) [0.0000000000|7.0000000000] ""  RRR_L,mADC
 SG_ RLR_OBJ30_RelVx_std : 413|12@0+ (0.0625000000,0.0000000000) [0.0000000000|255.9375000000] "m/s"  RRR_L,mADC
 SG_ RLR_OBJ30_RelVy_std : 407|10@0+ (0.1250000000,0.0000000000) [0.0000000000|127.8750000000] "m/s"  RRR_L,mADC
 SG_ RLR_OBJ30_Dx_Vnce : 389|14@0+ (0.0500000000,0.0000000000) [0.0000000000|50.0000000000] "m2"  RRR_L,mADC
 SG_ RLR_OBJ30_Dy_Vnce : 383|10@0+ (0.0200000000,0.0000000000) [0.0000000000|20.0000000000] "m2"  RRR_L,mADC
 SG_ RLR_OBJ29_Vx : 139|12@0+ (0.0625000000,-128.0000000000) [-128.0000000000|127.9380000000] "m/s"  RRR_L,mADC
 SG_ RLR_OBJ29_Vy : 133|10@0+ (0.0625000000,-32.0000000000) [-32.0000000000|31.9375000000] "m/s"  RRR_L,mADC
 SG_ RLR_OBJ29_Convergence : 459|1@0+ (1.0000000000,0.0000000000) [0.0000000000|1.0000000000] ""  RRR_L,mADC
 SG_ RLR_OBJ29_DelayTime : 447|10@0+ (1.0000000000,0.0000000000) [0.0000000000|1023.0000000000] "ms"  RRR_L,mADC
 SG_ RLR_OBJ29_HeightGround : 417|9@0+ (0.1000000000,0.0000000000) [0.0000000000|51.1000000000] "m"  RRR_L,mADC
 SG_ RLR_OBJ29_MotionStatus : 457|3@0+ (1.0000000000,0.0000000000) [0.0000000000|7.0000000000] ""  RRR_L,mADC
 SG_ RLR_OBJ29_RelVx_std : 363|12@0+ (0.0625000000,0.0000000000) [0.0000000000|255.9375000000] "m/s"  RRR_L,mADC
 SG_ RLR_OBJ29_RelVy_std : 357|10@0+ (0.1250000000,0.0000000000) [0.0000000000|127.8750000000] "m/s"  RRR_L,mADC
 SG_ RLR_OBJ29_Dx_Vnce : 339|14@0+ (0.0500000000,0.0000000000) [0.0000000000|50.0000000000] "m2"  RRR_L,mADC
 SG_ RLR_OBJ29_Dy_Vnce : 333|10@0+ (0.0200000000,0.0000000000) [0.0000000000|20.0000000000] "m2"  RRR_L,mADC
 SG_ RLR_CRCCheck_35E : 503|16@0+ (1.0000000000,0.0000000000) [0.0000000000|65535.0000000000] ""  RRR_L,mADC
 SG_ RLR_RollingCounter_35E : 491|4@0+ (1.0000000000,0.0000000000) [0.0000000000|15.0000000000] ""  RRR_L,mADC
 SG_ RLR_OBJ30_Track_Age : 325|8@0+ (1.0000000000,0.0000000000) [0.0000000000|255.0000000000] ""  RRR_L,mADC
 SG_ RLR_OBJ30_ReRPointLoc : 312|3@0+ (1.0000000000,0.0000000000) [0.0000000000|7.0000000000] ""  RRR_L,mADC
 SG_ RLR_OBJ30_ObstacleProb : 294|6@0+ (2.0000000000,0.0000000000) [0.0000000000|100.0000000000] "%"  RRR_L,mADC
 SG_ RLR_OBJ30_Measured : 280|2@0+ (1.0000000000,0.0000000000) [0.0000000000|3.0000000000] ""  RRR_L,mADC
 SG_ RLR_OBJ30_ExistProb : 286|6@0+ (2.0000000000,0.0000000000) [0.0000000000|100.0000000000] "%"  RRR_L,mADC
 SG_ RLR_OBJ30_Location : 272|2@0+ (1.0000000000,0.0000000000) [0.0000000000|3.0000000000] ""  RRR_L,mADC
 SG_ RLR_OBJ30_RelAx : 265|9@0+ (0.0625000000,-16.0000000000) [-16.0000000000|15.9375000000] "m/s2"  RRR_L,mADC
 SG_ RLR_OBJ30_RelAy : 259|10@0+ (0.0312500000,-16.0000000000) [-16.0000000000|15.9688000000] "m/s2"  RRR_L,mADC
 SG_ RLR_OBJ30_RelVx : 255|12@0+ (0.0625000000,-128.0000000000) [-128.0000000000|127.9380000000] "m/s"  RRR_L,mADC
 SG_ RLR_OBJ30_RelVy : 233|10@0+ (0.0625000000,-32.0000000000) [-32.0000000000|63.8750000000] "m/s"  RRR_L,mADC
 SG_ RLR_OBJ30_HeadingAngle : 203|10@0+ (0.0100000000,-3.1400000000) [-3.1400000000|3.1400000000] "rad"  RRR_L,mADC
 SG_ RLR_OBJ30_Length : 196|9@0+ (0.0500000000,0.0000000000) [0.0000000000|25.5000000000] "m"  RRR_L,mADC
 SG_ RLR_OBJ30_Height : 189|9@0+ (0.0100000000,0.0000000000) [0.0000000000|5.1100000000] "m"  RRR_L,mADC
 SG_ RLR_OBJ30_Width : 168|11@0+ (0.0100000000,0.0000000000) [0.0000000000|12.0000000000] "m"  RRR_L,mADC
 SG_ RLR_OBJ30_Type : 171|3@0+ (1.0000000000,0.0000000000) [0.0000000000|7.0000000000] ""  RRR_L,mADC
 SG_ RLR_OBJ30_Track_ID : 162|7@0+ (1.0000000000,0.0000000000) [0.0000000000|127.0000000000] ""  RRR_L,mADC
 SG_ RLR_OBJ29_Track_Age : 154|8@0+ (1.0000000000,0.0000000000) [0.0000000000|255.0000000000] ""  RRR_L,mADC
 SG_ RLR_OBJ29_ReRPointLoc : 157|3@0+ (1.0000000000,0.0000000000) [0.0000000000|7.0000000000] ""  RRR_L,mADC
 SG_ RLR_OBJ29_ObstacleProb : 123|6@0+ (2.0000000000,0.0000000000) [0.0000000000|100.0000000000] "%"  RRR_L,mADC
 SG_ RLR_OBJ29_Measured : 125|2@0+ (1.0000000000,0.0000000000) [0.0000000000|3.0000000000] ""  RRR_L,mADC
 SG_ RLR_OBJ29_ExistProb : 115|6@0+ (2.0000000000,0.0000000000) [0.0000000000|100.0000000000] "%"  RRR_L,mADC
 SG_ RLR_OBJ29_Location : 117|2@0+ (1.0000000000,0.0000000000) [0.0000000000|3.0000000000] ""  RRR_L,mADC
 SG_ RLR_OBJ29_RelAx : 110|9@0+ (0.0625000000,-16.0000000000) [-16.0000000000|15.9375000000] "m/s2"  RRR_L,mADC
 SG_ RLR_OBJ29_RelAy : 88|10@0+ (0.0312500000,-16.0000000000) [-16.0000000000|15.9688000000] "m/s2"  RRR_L,mADC
 SG_ RLR_OBJ29_RelVx : 84|12@0+ (0.0625000000,-128.0000000000) [-128.0000000000|127.9380000000] "m/s"  RRR_L,mADC
 SG_ RLR_OBJ29_RelVy : 78|10@0+ (0.0625000000,-32.0000000000) [-32.0000000000|63.8750000000] "m/s"  RRR_L,mADC
 SG_ RLR_OBJ29_HeadingAngle : 32|10@0+ (0.0100000000,-3.1400000000) [-3.1400000000|3.1400000000] "rad"  RRR_L,mADC
 SG_ RLR_OBJ29_Length : 25|9@0+ (0.0500000000,0.0000000000) [0.0000000000|25.5000000000] "m"  RRR_L,mADC
 SG_ RLR_OBJ29_Height : 18|9@0+ (0.0100000000,0.0000000000) [0.0000000000|5.1100000000] "m"  RRR_L,mADC
 SG_ RLR_OBJ29_Width : 13|11@0+ (0.0100000000,0.0000000000) [0.0000000000|12.0000000000] "m"  RRR_L,mADC
 SG_ RLR_OBJ29_Type : 0|3@0+ (1.0000000000,0.0000000000) [0.0000000000|7.0000000000] ""  RRR_L,mADC
 SG_ RLR_OBJ29_Track_ID : 7|7@0+ (1.0000000000,0.0000000000) [0.0000000000|127.0000000000] ""  RRR_L,mADC

BO_ 863 RLR_L_35F: 64 RLR_L
 SG_ RLR_OBJ32_LostCnt : 483|4@0+ (1.0000000000,0.0000000000) [0.0000000000|15.0000000000] ""  RRR_L,mADC
 SG_ RLR_OBJ31_LostCnt : 495|4@0+ (1.0000000000,0.0000000000) [0.0000000000|15.0000000000] ""  RRR_L,mADC
 SG_ RLR_OBJ32_Dx : 230|13@0+ (0.0625000000,-256.0000000000) [-256.0000000000|255.9380000000] "m"  RRR_L,mADC
 SG_ RLR_OBJ32_Dy : 209|11@0+ (0.1250000000,-128.0000000000) [-128.0000000000|127.8750000000] "m"  RRR_L,mADC
 SG_ RLR_OBJ31_Dx : 59|13@0+ (0.0625000000,-256.0000000000) [-256.0000000000|255.9380000000] "m"  RRR_L,mADC
 SG_ RLR_OBJ31_Dy : 54|11@0+ (0.1250000000,-128.0000000000) [-128.0000000000|127.8750000000] "m"  RRR_L,mADC
 SG_ RLR_OBJ32_Vx : 310|12@0+ (0.0625000000,-128.0000000000) [-128.0000000000|127.9380000000] "m/s"  RRR_L,mADC
 SG_ RLR_OBJ32_Vy : 288|10@0+ (0.0625000000,-32.0000000000) [-32.0000000000|31.9375000000] "m/s"  RRR_L,mADC
 SG_ RLR_OBJ32_Convergence : 458|1@0+ (1.0000000000,0.0000000000) [0.0000000000|1.0000000000] ""  RRR_L,mADC
 SG_ RLR_OBJ32_DelayTime : 453|10@0+ (1.0000000000,0.0000000000) [0.0000000000|1023.0000000000] "ms"  RRR_L,mADC
 SG_ RLR_OBJ32_HeightGround : 424|9@0+ (0.1000000000,0.0000000000) [0.0000000000|51.1000000000] "m"  RRR_L,mADC
 SG_ RLR_OBJ32_MotionStatus : 470|3@0+ (1.0000000000,0.0000000000) [0.0000000000|7.0000000000] ""  RRR_L,mADC
 SG_ RLR_OBJ32_RelVx_std : 413|12@0+ (0.0625000000,0.0000000000) [0.0000000000|255.9375000000] "m/s"  RRR_L,mADC
 SG_ RLR_OBJ32_RelVy_std : 407|10@0+ (0.1250000000,0.0000000000) [0.0000000000|127.8750000000] "m/s"  RRR_L,mADC
 SG_ RLR_OBJ32_Dx_Vnce : 389|14@0+ (0.0500000000,0.0000000000) [0.0000000000|50.0000000000] "m2"  RRR_L,mADC
 SG_ RLR_OBJ32_Dy_Vnce : 383|10@0+ (0.0200000000,0.0000000000) [0.0000000000|20.0000000000] "m2"  RRR_L,mADC
 SG_ RLR_OBJ31_Vx : 139|12@0+ (0.0625000000,-128.0000000000) [-128.0000000000|127.9380000000] "m/s"  RRR_L,mADC
 SG_ RLR_OBJ31_Vy : 133|10@0+ (0.0625000000,-32.0000000000) [-32.0000000000|31.9375000000] "m/s"  RRR_L,mADC
 SG_ RLR_OBJ31_Convergence : 459|1@0+ (1.0000000000,0.0000000000) [0.0000000000|1.0000000000] ""  RRR_L,mADC
 SG_ RLR_OBJ31_DelayTime : 447|10@0+ (1.0000000000,0.0000000000) [0.0000000000|1023.0000000000] "ms"  RRR_L,mADC
 SG_ RLR_OBJ31_HeightGround : 417|9@0+ (0.1000000000,0.0000000000) [0.0000000000|51.1000000000] "m"  RRR_L,mADC
 SG_ RLR_OBJ31_MotionStatus : 457|3@0+ (1.0000000000,0.0000000000) [0.0000000000|7.0000000000] ""  RRR_L,mADC
 SG_ RLR_OBJ31_RelVx_std : 363|12@0+ (0.0625000000,0.0000000000) [0.0000000000|255.9375000000] "m/s"  RRR_L,mADC
 SG_ RLR_OBJ31_RelVy_std : 357|10@0+ (0.1250000000,0.0000000000) [0.0000000000|127.8750000000] "m/s"  RRR_L,mADC
 SG_ RLR_OBJ31_Dx_Vnce : 339|14@0+ (0.0500000000,0.0000000000) [0.0000000000|50.0000000000] "m2"  RRR_L,mADC
 SG_ RLR_OBJ31_Dy_Vnce : 333|10@0+ (0.0200000000,0.0000000000) [0.0000000000|20.0000000000] "m2"  RRR_L,mADC
 SG_ RLR_CRCCheck_35R : 503|16@0+ (1.0000000000,0.0000000000) [0.0000000000|65535.0000000000] ""  RRR_L,mADC
 SG_ RLR_RollingCounter_35R : 491|4@0+ (1.0000000000,0.0000000000) [0.0000000000|15.0000000000] ""  RRR_L,mADC
 SG_ RLR_OBJ32_Track_Age : 325|8@0+ (1.0000000000,0.0000000000) [0.0000000000|255.0000000000] ""  RRR_L,mADC
 SG_ RLR_OBJ32_ReRPointLoc : 312|3@0+ (1.0000000000,0.0000000000) [0.0000000000|7.0000000000] ""  RRR_L,mADC
 SG_ RLR_OBJ32_ObstacleProb : 294|6@0+ (2.0000000000,0.0000000000) [0.0000000000|100.0000000000] "%"  RRR_L,mADC
 SG_ RLR_OBJ32_Measured : 280|2@0+ (1.0000000000,0.0000000000) [0.0000000000|3.0000000000] ""  RRR_L,mADC
 SG_ RLR_OBJ32_ExistProb : 286|6@0+ (2.0000000000,0.0000000000) [0.0000000000|100.0000000000] "%"  RRR_L,mADC
 SG_ RLR_OBJ32_Location : 272|2@0+ (1.0000000000,0.0000000000) [0.0000000000|3.0000000000] ""  RRR_L,mADC
 SG_ RLR_OBJ32_RelAx : 265|9@0+ (0.0625000000,-16.0000000000) [-16.0000000000|15.9375000000] "m/s2"  RRR_L,mADC
 SG_ RLR_OBJ32_RelAy : 259|10@0+ (0.0312500000,-16.0000000000) [-16.0000000000|15.9688000000] "m/s2"  RRR_L,mADC
 SG_ RLR_OBJ32_RelVx : 255|12@0+ (0.0625000000,-128.0000000000) [-128.0000000000|127.9380000000] "m/s"  RRR_L,mADC
 SG_ RLR_OBJ32_RelVy : 233|10@0+ (0.0625000000,-32.0000000000) [-32.0000000000|63.8750000000] "m/s"  RRR_L,mADC
 SG_ RLR_OBJ32_HeadingAngle : 203|10@0+ (0.0100000000,-3.1400000000) [-3.1400000000|3.1400000000] "rad"  RRR_L,mADC
 SG_ RLR_OBJ32_Length : 196|9@0+ (0.0500000000,0.0000000000) [0.0000000000|25.5000000000] "m"  RRR_L,mADC
 SG_ RLR_OBJ32_Height : 189|9@0+ (0.0100000000,0.0000000000) [0.0000000000|5.1100000000] "m"  RRR_L,mADC
 SG_ RLR_OBJ32_Width : 168|11@0+ (0.0100000000,0.0000000000) [0.0000000000|12.0000000000] "m"  RRR_L,mADC
 SG_ RLR_OBJ32_Type : 171|3@0+ (1.0000000000,0.0000000000) [0.0000000000|7.0000000000] ""  RRR_L,mADC
 SG_ RLR_OBJ32_Track_ID : 162|7@0+ (1.0000000000,0.0000000000) [0.0000000000|127.0000000000] ""  RRR_L,mADC
 SG_ RLR_OBJ31_Track_Age : 154|8@0+ (1.0000000000,0.0000000000) [0.0000000000|255.0000000000] ""  RRR_L,mADC
 SG_ RLR_OBJ31_ReRPointLoc : 157|3@0+ (1.0000000000,0.0000000000) [0.0000000000|7.0000000000] ""  RRR_L,mADC
 SG_ RLR_OBJ31_ObstacleProb : 123|6@0+ (2.0000000000,0.0000000000) [0.0000000000|100.0000000000] "%"  RRR_L,mADC
 SG_ RLR_OBJ31_Measured : 125|2@0+ (1.0000000000,0.0000000000) [0.0000000000|3.0000000000] ""  RRR_L,mADC
 SG_ RLR_OBJ31_ExistProb : 115|6@0+ (2.0000000000,0.0000000000) [0.0000000000|100.0000000000] "%"  RRR_L,mADC
 SG_ RLR_OBJ31_Location : 117|2@0+ (1.0000000000,0.0000000000) [0.0000000000|3.0000000000] ""  RRR_L,mADC
 SG_ RLR_OBJ31_RelAx : 110|9@0+ (0.0625000000,-16.0000000000) [-16.0000000000|15.9375000000] "m/s2"  RRR_L,mADC
 SG_ RLR_OBJ31_RelAy : 88|10@0+ (0.0312500000,-16.0000000000) [-16.0000000000|15.9688000000] "m/s2"  RRR_L,mADC
 SG_ RLR_OBJ31_RelVx : 84|12@0+ (0.0625000000,-128.0000000000) [-128.0000000000|127.9380000000] "m/s"  RRR_L,mADC
 SG_ RLR_OBJ31_RelVy : 78|10@0+ (0.0625000000,-32.0000000000) [-32.0000000000|63.8750000000] "m/s"  RRR_L,mADC
 SG_ RLR_OBJ31_HeadingAngle : 32|10@0+ (0.0100000000,-3.1400000000) [-3.1400000000|3.1400000000] "rad"  RRR_L,mADC
 SG_ RLR_OBJ31_Length : 25|9@0+ (0.0500000000,0.0000000000) [0.0000000000|25.5000000000] "m"  RRR_L,mADC
 SG_ RLR_OBJ31_Height : 18|9@0+ (0.0100000000,0.0000000000) [0.0000000000|5.1100000000] "m"  RRR_L,mADC
 SG_ RLR_OBJ31_Width : 13|11@0+ (0.0100000000,0.0000000000) [0.0000000000|12.0000000000] "m"  RRR_L,mADC
 SG_ RLR_OBJ31_Type : 0|3@0+ (1.0000000000,0.0000000000) [0.0000000000|7.0000000000] ""  RRR_L,mADC
 SG_ RLR_OBJ31_Track_ID : 7|7@0+ (1.0000000000,0.0000000000) [0.0000000000|127.0000000000] ""  RRR_L,mADC

BO_ 917 RLR_L_395: 64 RLR_L
 SG_ RRGuardrailReadyFlag : 333|1@0+ (1.0000000000,0.0000000000) [0.0000000000|1.0000000000] ""  RRR_L,mADC
 SG_ RLGuardrailReadyFlag : 332|1@0+ (1.0000000000,0.0000000000) [0.0000000000|1.0000000000] ""  RRR_L,mADC
 SG_ RRR_CRCCheck_395 : 503|16@0+ (1.0000000000,0.0000000000) [0.0000000000|65535.0000000000] ""  RRR_L,mADC
 SG_ RRR_RollingCounter_395 : 491|4@0+ (1.0000000000,0.0000000000) [0.0000000000|15.0000000000] ""  RRR_L,mADC
 SG_ RRR_LOC_RollingCounter : 155|4@0+ (1.0000000000,0.0000000000) [0.0000000000|15.0000000000] ""  RRR_L,mADC
 SG_ RLR_RearRightGuardrailConRidenc : 473|2@0+ (1.0000000000,0.0000000000) [0.0000000000|3.0000000000] "-"  RRR_L,mADC
 SG_ RLR__RearRightGuardrail_End : 469|12@0+ (0.0250000000,-82.3750000000) [-82.3750000000|20.0000000000] "m"  RRR_L,mADC
 SG_ RLR__RearRightGuardrail_Start : 449|12@0+ (0.0250000000,-82.3750000000) [-82.3750000000|20.0000000000] "m"  RRR_L,mADC
 SG_ RLR_RearRightGuardrailC3 : 445|12@0+ (0.0000004800,-0.0010000000) [-0.0010000000|0.0009760860] "-"  RRR_L,mADC
 SG_ RLR_RearRightGuardrailC2 : 425|12@0+ (0.0000150000,-0.0312000000) [-0.0312000000|0.0312347410] "-"  RRR_L,mADC
 SG_ RLR_RearRightGuardrailC1 : 421|12@0+ (0.0004900000,-1.0000000000) [-1.0000000000|0.9990234380] "-"  RRR_L,mADC
 SG_ RLR_RearRightGuardrailC0 : 401|12@0+ (0.0156300000,-32.0000000000) [-32.0000000000|31.9843750000] "m"  RRR_L,mADC
 SG_ RLR_RearLeftGuardrailConRidence : 403|2@0+ (1.0000000000,0.0000000000) [0.0000000000|3.0000000000] "-"  RRR_L,mADC
 SG_ RLR__RearLeftGuardrail_End : 399|12@0+ (0.0250000000,-82.3750000000) [-82.3750000000|20.0000000000] "m"  RRR_L,mADC
 SG_ RLR__RearLeftGuardrail_Start : 379|12@0+ (0.0250000000,-82.3750000000) [-82.3750000000|20.0000000000] "m"  RRR_L,mADC
 SG_ RLR_RearLeftGuardrailC3 : 375|12@0+ (0.0000004800,-0.0010000000) [-0.0010000000|0.0009760860] "-"  RRR_L,mADC
 SG_ RLR_RearLeftGuardrailC2 : 355|12@0+ (0.0000150000,-0.0312000000) [-0.0312000000|0.0312347410] "-"  RRR_L,mADC
 SG_ RLR_RearLeftGuardrailC1 : 351|12@0+ (0.0004900000,-1.0000000000) [-1.0000000000|0.9990234380] "-"  RRR_L,mADC
 SG_ RLR_RearLeftGuardrailC0 : 331|12@0+ (0.0156300000,-32.0000000000) [-32.0000000000|31.9843750000] "m"  RRR_L,mADC

BO_ 943 RLR_L_3AF: 64 RLR_L
 SG_ RRR_HwVers6 : 255|8@0+ (1.0000000000,0.0000000000) [0.0000000000|255.0000000000] ""  RRR_L,mADC
 SG_ RRR_HwVers5 : 247|8@0+ (1.0000000000,0.0000000000) [0.0000000000|255.0000000000] ""  RRR_L,mADC
 SG_ RRR_HwVers4 : 231|16@0+ (1.0000000000,0.0000000000) [0.0000000000|65535.0000000000] ""  RRR_L,mADC
 SG_ RRR_HwVers3 : 223|8@0+ (1.0000000000,0.0000000000) [0.0000000000|255.0000000000] ""  RRR_L,mADC
 SG_ RRR_HwVers2 : 215|8@0+ (1.0000000000,0.0000000000) [0.0000000000|255.0000000000] ""  RRR_L,mADC
 SG_ RRR_HwVers1 : 207|8@0+ (1.0000000000,0.0000000000) [0.0000000000|255.0000000000] ""  RRR_L,mADC
 SG_ RRR_HwVers0 : 199|8@0+ (1.0000000000,0.0000000000) [0.0000000000|255.0000000000] ""  RRR_L,mADC
 SG_ RRR_SwVers6 : 191|8@0+ (1.0000000000,0.0000000000) [0.0000000000|255.0000000000] ""  RRR_L,mADC
 SG_ RRR_SwVers5 : 183|8@0+ (1.0000000000,0.0000000000) [0.0000000000|255.0000000000] ""  RRR_L,mADC
 SG_ RRR_SwVers4 : 167|16@0+ (1.0000000000,0.0000000000) [0.0000000000|65535.0000000000] ""  RRR_L,mADC
 SG_ RRR_SwVers3 : 159|8@0+ (1.0000000000,0.0000000000) [0.0000000000|255.0000000000] ""  RRR_L,mADC
 SG_ RRR_SwVers2 : 151|8@0+ (1.0000000000,0.0000000000) [0.0000000000|255.0000000000] ""  RRR_L,mADC
 SG_ RRR_SwVers1 : 143|8@0+ (1.0000000000,0.0000000000) [0.0000000000|255.0000000000] ""  RRR_L,mADC
 SG_ RRR_SwVers0 : 135|8@0+ (1.0000000000,0.0000000000) [0.0000000000|255.0000000000] ""  RRR_L,mADC
 SG_ RLR_HwVers6 : 127|8@0+ (1.0000000000,0.0000000000) [0.0000000000|255.0000000000] ""  RRR_L,mADC
 SG_ RLR_HwVers5 : 119|8@0+ (1.0000000000,0.0000000000) [0.0000000000|255.0000000000] ""  RRR_L,mADC
 SG_ RLR_HwVers4 : 103|16@0+ (1.0000000000,0.0000000000) [0.0000000000|65535.0000000000] ""  RRR_L,mADC
 SG_ RLR_HwVers3 : 95|8@0+ (1.0000000000,0.0000000000) [0.0000000000|255.0000000000] ""  RRR_L,mADC
 SG_ RLR_HwVers2 : 87|8@0+ (1.0000000000,0.0000000000) [0.0000000000|255.0000000000] ""  RRR_L,mADC
 SG_ RLR_HwVers1 : 79|8@0+ (1.0000000000,0.0000000000) [0.0000000000|255.0000000000] ""  RRR_L,mADC
 SG_ RLR_HwVers0 : 71|8@0+ (1.0000000000,0.0000000000) [0.0000000000|255.0000000000] ""  RRR_L,mADC
 SG_ RLR_SwVers6 : 63|8@0+ (1.0000000000,0.0000000000) [0.0000000000|255.0000000000] ""  RRR_L,mADC
 SG_ RLR_SwVers5 : 55|8@0+ (1.0000000000,0.0000000000) [0.0000000000|255.0000000000] ""  RRR_L,mADC
 SG_ RLR_SwVers4 : 39|16@0+ (1.0000000000,0.0000000000) [0.0000000000|65535.0000000000] ""  RRR_L,mADC
 SG_ RLR_SwVers3 : 31|8@0+ (1.0000000000,0.0000000000) [0.0000000000|255.0000000000] ""  RRR_L,mADC
 SG_ RLR_SwVers2 : 23|8@0+ (1.0000000000,0.0000000000) [0.0000000000|255.0000000000] ""  RRR_L,mADC
 SG_ RLR_SwVers1 : 15|8@0+ (1.0000000000,0.0000000000) [0.0000000000|255.0000000000] ""  RRR_L,mADC
 SG_ RLR_SwVers0 : 7|8@0+ (1.0000000000,0.0000000000) [0.0000000000|255.0000000000] ""  RRR_L,mADC

BO_ 837 RLR_L_345: 16 RLR_L
 SG_ RLR_BSDLCAMode : 79|2@0+ (1.0000000000,0.0000000000) [0.0000000000|3.0000000000] ""  RRR_L,mADC
 SG_ RLR_AudioWarningEnableStatus : 100|1@0+ (1.0000000000,0.0000000000) [0.0000000000|1.0000000000] ""  RRR_L,mADC
 SG_ RLR_SEAEnableStatus : 99|1@0+ (1.0000000000,0.0000000000) [0.0000000000|1.0000000000] ""  RRR_L,mADC
 SG_ RLR_BSD_LCASoundWar : 98|1@0+ (1.0000000000,0.0000000000) [0.0000000000|1.0000000000] ""  RRR_L,mADC
 SG_ RLR_LDWShakeLevStatus : 97|2@0+ (1.0000000000,0.0000000000) [0.0000000000|3.0000000000] ""  RRR_L,mADC
 SG_ RLR_EmergencyLightingRequest : 77|2@0+ (1.0000000000,0.0000000000) [0.0000000000|3.0000000000] ""  RRR_L,mADC
 SG_ RLR_LDWVibrationWarningReq : 75|2@0+ (1.0000000000,0.0000000000) [0.0000000000|3.0000000000] ""  RRR_L,mADC
 SG_ RLR_RearColliAstType : 73|2@0+ (1.0000000000,0.0000000000) [0.0000000000|3.0000000000] ""  RRR_L,mADC
 SG_ RLR_SEAModeStatus : 70|1@0+ (1.0000000000,0.0000000000) [0.0000000000|1.0000000000] ""  RRR_L,mADC
 SG_ RLR_SEAOnOffSts : 69|1@0+ (1.0000000000,0.0000000000) [0.0000000000|1.0000000000] ""  RRR_L,mADC
 SG_ RLR_BSDLCASetting : 68|2@0+ (1.0000000000,0.0000000000) [0.0000000000|3.0000000000] ""  RRR_L,mADC
 SG_ RLR_BSDLCARemindmode : 66|2@0+ (1.0000000000,0.0000000000) [0.0000000000|3.0000000000] ""  RRR_L,mADC
 SG_ RLR_BSDLCAOnOff : 64|1@0+ (1.0000000000,0.0000000000) [0.0000000000|1.0000000000] ""  RRR_L,mADC
 SG_ RLR_RCWEnableStatus : 61|1@0+ (1.0000000000,0.0000000000) [0.0000000000|1.0000000000] ""  RRR_L,mADC
 SG_ RLR_RCTAEnableStatus : 62|1@0+ (1.0000000000,0.0000000000) [0.0000000000|1.0000000000] ""  RRR_L,mADC
 SG_ RLR_AEBVehilceHoldReq : 63|1@0+ (1.0000000000,0.0000000000) [0.0000000000|1.0000000000] ""  RRR_L,mADC
 SG_ RLR_RCTBTargetDecel : 47|16@0+ (0.0005000000,-16.0000000000) [-16.0000000000|16.0000000000] "m/s2"  RRR_L,mADC
 SG_ RLR_RCTBEnable : 32|1@0+ (1.0000000000,0.0000000000) [0.0000000000|1.0000000000] ""  RRR_L,mADC
 SG_ RLR_BSD_LCAEnableStatus : 34|2@0+ (1.0000000000,0.0000000000) [0.0000000000|3.0000000000] ""  RRR_L,mADC
 SG_ RLR_SEAStatus : 36|2@0+ (1.0000000000,0.0000000000) [0.0000000000|3.0000000000] ""  RRR_L,mADC
 SG_ RLR_RCWStatus : 38|2@0+ (1.0000000000,0.0000000000) [0.0000000000|3.0000000000] ""  RRR_L,mADC
 SG_ RLR_BSD_LCAStatus : 24|2@0+ (1.0000000000,0.0000000000) [0.0000000000|3.0000000000] ""  RRR_L,mADC
 SG_ RLR_RCTBStatus : 26|2@0+ (1.0000000000,0.0000000000) [0.0000000000|3.0000000000] ""  RRR_L,mADC
 SG_ RLR_RCTAStatus : 28|2@0+ (1.0000000000,0.0000000000) [0.0000000000|3.0000000000] ""  RRR_L,mADC
 SG_ RLR_Left_BSD_LCAAlert : 18|2@0+ (1.0000000000,0.0000000000) [0.0000000000|3.0000000000] ""  RRR_L,mADC
 SG_ RLR_SEAAlert : 20|2@0+ (1.0000000000,0.0000000000) [0.0000000000|3.0000000000] ""  RRR_L,mADC
 SG_ RLR_RCWAlert : 23|2@0+ (1.0000000000,0.0000000000) [0.0000000000|3.0000000000] ""  RRR_L,mADC
 SG_ RLR_DOWLeftAlert : 9|2@0+ (1.0000000000,0.0000000000) [0.0000000000|3.0000000000] ""  RRR_L,mADC
 SG_ RLR_BSD_LCAAlert : 11|2@0+ (1.0000000000,0.0000000000) [0.0000000000|3.0000000000] ""  RRR_L,mADC
 SG_ RLR_RCTBActive : 13|2@0+ (1.0000000000,0.0000000000) [0.0000000000|3.0000000000] ""  RRR_L,mADC
 SG_ RLR_Right_SEAAlert : 15|2@0+ (1.0000000000,0.0000000000) [0.0000000000|3.0000000000] ""  RRR_L,mADC
 SG_ RLR_Right_RCWAlert : 1|2@0+ (1.0000000000,0.0000000000) [0.0000000000|3.0000000000] ""  RRR_L,mADC
 SG_ RLR_DOWRightAlert : 3|2@0+ (1.0000000000,0.0000000000) [0.0000000000|3.0000000000] ""  RRR_L,mADC
 SG_ RLR_Left_RCTAAlert : 5|2@0+ (1.0000000000,0.0000000000) [0.0000000000|3.0000000000] ""  RRR_L,mADC
 SG_ RLR_Right_RCTAAlert : 7|2@0+ (1.0000000000,0.0000000000) [0.0000000000|3.0000000000] ""  RRR_L,mADC

BO_ 692 RLR_L_2B4: 64 RLR_L
 SG_ RLR_CRCCheck_2B4 : 503|16@0+ (1.0000000000,0.0000000000) [0.0000000000|65535.0000000000] ""  RRR_L,mADC
 SG_ RLR_RollingCounter_2B4 : 491|4@0+ (1.0000000000,0.0000000000) [0.0000000000|15.0000000000] ""  RRR_L,mADC
 SG_ LCDAL_ResetSts : 250|3@0+ (1.0000000000,0.0000000000) [0.0000000000|7.0000000000] ""  RRR_L,mADC
 SG_ FuncDegradeType_RL : 223|32@0+ (1.0000000000,0.0000000000) [0.0000000000|4294967295.0000000000] ""  RRR_L,mADC
 SG_ FUSION_TimeoutCnt_RL : 215|8@0+ (1.0000000000,0.0000000000) [0.0000000000|255.0000000000] ""  RRR_L,mADC
 SG_ VALIDATION_TimeoutCnt_RL : 207|8@0+ (1.0000000000,0.0000000000) [0.0000000000|255.0000000000] ""  RRR_L,mADC
 SG_ CurFrameCycle_RL : 199|8@0+ (1.0000000000,0.0000000000) [0.0000000000|255.0000000000] ""  RRR_L,mADC
 SG_ ProcessTimeoutCnt_RL : 191|8@0+ (1.0000000000,0.0000000000) [0.0000000000|255.0000000000] ""  RRR_L,mADC
 SG_ RevFrameCnt_RL : 159|32@0+ (1.0000000000,0.0000000000) [0.0000000000|4294967295.0000000000] ""  RRR_L,mADC
 SG_ Local_Pointcloud_Number_RL : 151|8@0+ (1.0000000000,0.0000000000) [0.0000000000|255.0000000000] ""  RRR_L,mADC
 SG_ RealTimeCal_PrcssBar_RL : 142|7@0+ (1.0000000000,0.0000000000) [0.0000000000|100.0000000000] "%"  RRR_L,mADC
 SG_ RealTimeCal_VelErrOutput_RL : 134|7@0+ (0.1000000000,-5.0000000000) [-5.0000000000|5.0000000000] "%"  RRR_L,mADC
 SG_ RealTimeCal_HoriMntErrOutput_RL : 112|9@0+ (0.0200000000,-5.0000000000) [-5.0000000000|5.0000000000] "°"  RRR_L,mADC
 SG_ RealTimeCal_FailReasonCode_RL : 116|3@0+ (1.0000000000,0.0000000000) [0.0000000000|7.0000000000] ""  RRR_L,mADC
 SG_ RealTimeCal_Status_RL : 119|3@0+ (1.0000000000,0.0000000000) [0.0000000000|7.0000000000] ""  RRR_L,mADC
 SG_ DiagCal_PrcssBar_RL : 110|7@0+ (1.0000000000,0.0000000000) [0.0000000000|100.0000000000] "%"  RRR_L,mADC
 SG_ DiagCal_VelErrOutput_RL : 102|7@0+ (0.1000000000,-5.0000000000) [-5.0000000000|5.0000000000] "%"  RRR_L,mADC
 SG_ DiagCal_HoriMntErrOutput_RL : 80|9@0+ (0.0200000000,-5.0000000000) [-5.0000000000|5.0000000000] "°"  RRR_L,mADC
 SG_ DiagCal_FailReasonCode_RL : 84|3@0+ (1.0000000000,0.0000000000) [0.0000000000|7.0000000000] ""  RRR_L,mADC
 SG_ DiagCal_Status_RL : 87|3@0+ (1.0000000000,0.0000000000) [0.0000000000|7.0000000000] ""  RRR_L,mADC
 SG_ EolCal_PrcssBar_RL : 78|7@0+ (1.0000000000,0.0000000000) [0.0000000000|100.0000000000] "%"  RRR_L,mADC
 SG_ EolCal_VelErrOutput_RL : 70|7@0+ (0.1000000000,-5.0000000000) [-5.0000000000|5.0000000000] "%"  RRR_L,mADC
 SG_ EolCal_HoriMntErrOutput_RL : 48|9@0+ (0.0200000000,-5.0000000000) [-5.0000000000|5.0000000000] "°"  RRR_L,mADC
 SG_ EolCal_FailReasonCode_RL : 52|3@0+ (1.0000000000,0.0000000000) [0.0000000000|7.0000000000] ""  RRR_L,mADC
 SG_ EolCal_Status_RL : 55|3@0+ (1.0000000000,0.0000000000) [0.0000000000|7.0000000000] ""  RRR_L,mADC
 SG_ PriCounter_RL : 31|24@0+ (1.0000000000,0.0000000000) [0.0000000000|16777215.0000000000] ""  RRR_L,mADC
 SG_ MsgCounter_RL : 7|24@0+ (1.0000000000,0.0000000000) [0.0000000000|16777215.0000000000] ""  RRR_L,mADC

BO_ 587 RLR_L_24B: 64 RLR_L
 SG_ Transmitcnt6_R : 455|32@0+ (1.0000000000,0.0000000000) [0.0000000000|4294967295.0000000000] ""  RRR_L,mADC
 SG_ Transmitcnt5_R : 423|32@0+ (1.0000000000,0.0000000000) [0.0000000000|4294967295.0000000000] ""  RRR_L,mADC
 SG_ Transmitcnt4_R : 391|32@0+ (1.0000000000,0.0000000000) [0.0000000000|4294967295.0000000000] ""  RRR_L,mADC
 SG_ Transmitcnt3_R : 359|32@0+ (1.0000000000,0.0000000000) [0.0000000000|4294967295.0000000000] ""  RRR_L,mADC
 SG_ Transmitcnt2_R : 327|32@0+ (1.0000000000,0.0000000000) [0.0000000000|4294967295.0000000000] ""  RRR_L,mADC
 SG_ Transmitcnt1_R : 295|32@0+ (1.0000000000,0.0000000000) [0.0000000000|4294967295.0000000000] ""  RRR_L,mADC
 SG_ RLR_Track_ID_R : 270|7@0+ (1.0000000000,0.0000000000) [0.0000000000|127.0000000000] ""  RRR_L,mADC
 SG_ RLR_Measured_R : 273|2@0+ (1.0000000000,0.0000000000) [0.0000000000|3.0000000000] ""  RRR_L,mADC
 SG_ RLR_Location_R : 199|2@0+ (1.0000000000,0.0000000000) [0.0000000000|3.0000000000] ""  RRR_L,mADC
 SG_ RLR_ClassComfrmFlg_R : 271|1@0+ (1.0000000000,0.0000000000) [0.0000000000|1.0000000000] ""  RRR_L,mADC
 SG_ RLR_TrckrType_R : 197|3@0+ (1.0000000000,0.0000000000) [0.0000000000|7.0000000000] ""  RRR_L,mADC
 SG_ RLR_TrckrAge_R : 263|8@0+ (1.0000000000,0.0000000000) [0.0000000000|255.0000000000] ""  RRR_L,mADC
 SG_ RLR_MotionStatus_R : 194|3@0+ (1.0000000000,0.0000000000) [0.0000000000|7.0000000000] ""  RRR_L,mADC
 SG_ RLR_AbsVy_R : 207|12@0+ (0.0625000000,-128.0000000000) [-128.0000000000|127.9380000000] "m/s"  RRR_L,mADC
 SG_ RLR_AbsoVx_R : 211|10@0+ (0.1250000000,-64.0000000000) [-64.0000000000|63.8750000000] "m/s"  RRR_L,mADC
 SG_ RLR_LocDx_R : 217|13@0+ (0.0625000000,-256.0000000000) [-256.0000000000|255.9380000000] "m"  RRR_L,mADC
 SG_ RLR_LocDy_R : 236|11@0+ (0.1250000000,-128.0000000000) [-128.0000000000|127.8750000000] "m"  RRR_L,mADC
 SG_ RLR_HeadingAngle_R : 241|10@0+ (0.0100000000,-3.1400000000) [-3.1400000000|3.1400000000] "rad"  RRR_L,mADC
 SG_ RLR_Length_R : 132|9@0+ (0.0500000000,0.0000000000) [0.0000000000|25.5000000000] "m"  RRR_L,mADC
 SG_ RLR_Width_R : 139|11@0+ (0.0100000000,0.0000000000) [0.0000000000|12.0000000000] "m"  RRR_L,mADC
 SG_ RLR_Track_ID_L : 144|7@0+ (1.0000000000,0.0000000000) [0.0000000000|127.0000000000] ""  RRR_L,mADC
 SG_ RLR_Measured_L : 153|2@0+ (1.0000000000,0.0000000000) [0.0000000000|3.0000000000] ""  RRR_L,mADC
 SG_ RLR_Location_L : 167|2@0+ (1.0000000000,0.0000000000) [0.0000000000|3.0000000000] ""  RRR_L,mADC
 SG_ RLR_ClassComfrmFlg_L : 164|1@0+ (1.0000000000,0.0000000000) [0.0000000000|1.0000000000] ""  RRR_L,mADC
 SG_ RLR_TrckrType_L : 163|3@0+ (1.0000000000,0.0000000000) [0.0000000000|7.0000000000] ""  RRR_L,mADC
 SG_ RLR_TrckrAge_L : 71|8@0+ (1.0000000000,0.0000000000) [0.0000000000|255.0000000000] ""  RRR_L,mADC
 SG_ RLR_MotionStatus_L : 160|3@0+ (1.0000000000,0.0000000000) [0.0000000000|7.0000000000] ""  RRR_L,mADC
 SG_ RLR_AbsVy_L : 173|12@0+ (0.0625000000,-128.0000000000) [-128.0000000000|127.9380000000] "m/s"  RRR_L,mADC
 SG_ RLR_AbsoVx_L : 177|10@0+ (0.1250000000,-64.0000000000) [-64.0000000000|63.8750000000] "m/s"  RRR_L,mADC
 SG_ RLR_LocDx_L : 79|13@0+ (0.0625000000,-256.0000000000) [-256.0000000000|255.9380000000] "m"  RRR_L,mADC
 SG_ RLR_LocDy_L : 82|11@0+ (0.1250000000,-128.0000000000) [-128.0000000000|127.8750000000] "m"  RRR_L,mADC
 SG_ RLR_HeadingAngle_L : 103|10@0+ (0.0100000000,-3.1400000000) [-3.1400000000|3.1400000000] "rad"  RRR_L,mADC
 SG_ RLR_Length_L : 109|9@0+ (0.0500000000,0.0000000000) [0.0000000000|25.5000000000] "m"  RRR_L,mADC
 SG_ RLR_Width_L : 116|11@0+ (0.0100000000,0.0000000000) [0.0000000000|12.0000000000] "m"  RRR_L,mADC
 SG_ RLR_TrckrNum : 121|2@0+ (1.0000000000,0.0000000000) [3.0000000000|3.0000000000] ""  RRR_L,mADC
 SG_ RLR_TrackerTimeStamp : 7|64@0+ (0.0001000000,0.0000000000) [0.0000000000|429496.7295000000] ""  RRR_L,mADC

BO_ 695 RLR_L_2B7: 64 RLR_L
 SG_ RLR_CRCCheck_2B7 : 503|16@0+ (1.0000000000,0.0000000000) [0.0000000000|65535.0000000000] ""  RRR_L,mADC
 SG_ RLR_RollingCounter_2B7 : 491|4@0+ (1.0000000000,0.0000000000) [0.0000000000|15.0000000000] ""  RRR_L,mADC
 SG_ RLR_OBJ32_lAy : 333|10@0+ (0.0312500000,-16.0000000000) [-16.0000000000|15.9688000000] "m/s2"  RRR_L,mADC
 SG_ RLR_OBJ31_lAy : 327|10@0+ (0.0312500000,-16.0000000000) [-16.0000000000|15.9688000000] "m/s2"  RRR_L,mADC
 SG_ RLR_OBJ30_lAy : 309|10@0+ (0.0312500000,-16.0000000000) [-16.0000000000|15.9688000000] "m/s2"  RRR_L,mADC
 SG_ RLR_OBJ29_lAy : 303|10@0+ (0.0312500000,-16.0000000000) [-16.0000000000|15.9688000000] "m/s2"  RRR_L,mADC
 SG_ RLR_OBJ28_lAy : 281|10@0+ (0.0312500000,-16.0000000000) [-16.0000000000|15.9688000000] "m/s2"  RRR_L,mADC
 SG_ RLR_OBJ27_lAy : 275|10@0+ (0.0312500000,-16.0000000000) [-16.0000000000|15.9688000000] "m/s2"  RRR_L,mADC
 SG_ RLR_OBJ26_lAy : 269|10@0+ (0.0312500000,-16.0000000000) [-16.0000000000|15.9688000000] "m/s2"  RRR_L,mADC
 SG_ RLR_OBJ25_lAy : 263|10@0+ (0.0312500000,-16.0000000000) [-16.0000000000|15.9688000000] "m/s2"  RRR_L,mADC
 SG_ RLR_OBJ24_lAy : 245|10@0+ (0.0312500000,-16.0000000000) [-16.0000000000|15.9688000000] "m/s2"  RRR_L,mADC
 SG_ RLR_OBJ23_lAy : 239|10@0+ (0.0312500000,-16.0000000000) [-16.0000000000|15.9688000000] "m/s2"  RRR_L,mADC
 SG_ RLR_OBJ22_lAy : 217|10@0+ (0.0312500000,-16.0000000000) [-16.0000000000|15.9688000000] "m/s2"  RRR_L,mADC
 SG_ RLR_OBJ21_lAy : 211|10@0+ (0.0312500000,-16.0000000000) [-16.0000000000|15.9688000000] "m/s2"  RRR_L,mADC
 SG_ RLR_OBJ20_lAy : 205|10@0+ (0.0312500000,-16.0000000000) [-16.0000000000|15.9688000000] "m/s2"  RRR_L,mADC
 SG_ RLR_OBJ19_lAy : 199|10@0+ (0.0312500000,-16.0000000000) [-16.0000000000|15.9688000000] "m/s2"  RRR_L,mADC
 SG_ RLR_OBJ18_lAy : 181|10@0+ (0.0312500000,-16.0000000000) [-16.0000000000|15.9688000000] "m/s2"  RRR_L,mADC
 SG_ RLR_OBJ17_lAy : 175|10@0+ (0.0312500000,-16.0000000000) [-16.0000000000|15.9688000000] "m/s2"  RRR_L,mADC
 SG_ RLR_OBJ16_lAy : 153|10@0+ (0.0312500000,-16.0000000000) [-16.0000000000|15.9688000000] "m/s2"  RRR_L,mADC
 SG_ RLR_OBJ15_lAy : 147|10@0+ (0.0312500000,-16.0000000000) [-16.0000000000|15.9688000000] "m/s2"  RRR_L,mADC
 SG_ RLR_OBJ14_lAy : 141|10@0+ (0.0312500000,-16.0000000000) [-16.0000000000|15.9688000000] "m/s2"  RRR_L,mADC
 SG_ RLR_OBJ13_lAy : 135|10@0+ (0.0312500000,-16.0000000000) [-16.0000000000|15.9688000000] "m/s2"  RRR_L,mADC
 SG_ RLR_OBJ12_lAy : 117|10@0+ (0.0312500000,-16.0000000000) [-16.0000000000|15.9688000000] "m/s2"  RRR_L,mADC
 SG_ RLR_OBJ11_lAy : 111|10@0+ (0.0312500000,-16.0000000000) [-16.0000000000|15.9688000000] "m/s2"  RRR_L,mADC
 SG_ RLR_OBJ10_lAy : 89|10@0+ (0.0312500000,-16.0000000000) [-16.0000000000|15.9688000000] "m/s2"  RRR_L,mADC
 SG_ RLR_OBJ9_lAy : 83|10@0+ (0.0312500000,-16.0000000000) [-16.0000000000|15.9688000000] "m/s2"  RRR_L,mADC
 SG_ RLR_OBJ8_lAy : 77|10@0+ (0.0312500000,-16.0000000000) [-16.0000000000|15.9688000000] "m/s2"  RRR_L,mADC
 SG_ RLR_OBJ7_lAy : 71|10@0+ (0.0312500000,-16.0000000000) [-16.0000000000|15.9688000000] "m/s2"  RRR_L,mADC
 SG_ RLR_OBJ6_lAy : 53|10@0+ (0.0312500000,-16.0000000000) [-16.0000000000|15.9688000000] "m/s2"  RRR_L,mADC
 SG_ RLR_OBJ5_lAy : 47|10@0+ (0.0312500000,-16.0000000000) [-16.0000000000|15.9688000000] "m/s2"  RRR_L,mADC
 SG_ RLR_OBJ4_lAy : 25|10@0+ (0.0312500000,-16.0000000000) [-16.0000000000|15.9688000000] "m/s2"  RRR_L,mADC
 SG_ RLR_OBJ3_lAy : 19|10@0+ (0.0312500000,-16.0000000000) [-16.0000000000|15.9688000000] "m/s2"  RRR_L,mADC
 SG_ RLR_OBJ2_lAy : 13|10@0+ (0.0312500000,-16.0000000000) [-16.0000000000|15.9688000000] "m/s2"  RRR_L,mADC
 SG_ RLR_OBJ1_lAy : 7|10@0+ (0.0312500000,-16.0000000000) [-16.0000000000|15.9688000000] "m/s2"  RRR_L,mADC

BO_ 841 RRR_L_349: 64 RRR_L
 SG_ RRR_Suppliers : 75|4@0+ (1.0000000000,0.0000000000) [0.0000000000|15.0000000000] ""  RLR_L,mADC
 SG_ RRR_RS_TiOut : 165|1@0+ (1.0000000000,0.0000000000) [0.0000000000|1.0000000000] "-"  RLR_L,mADC
 SG_ RRR_RS_TiLeap : 164|1@0+ (1.0000000000,0.0000000000) [0.0000000000|1.0000000000] "-"  RLR_L,mADC
 SG_ RRR_RS_TiBas : 163|1@0+ (1.0000000000,0.0000000000) [0.0000000000|1.0000000000] "-"  RLR_L,mADC
 SG_ RRR_RS_TiStamp : 199|64@0+ (0.0001000000,0.0000000000) [0.0000000000|1844674407370950.0000000000] "s"  RLR_L,mADC
 SG_ RRR_CRCCheck_349 : 503|16@0+ (1.0000000000,0.0000000000) [0.0000000000|65535.0000000000] ""  RLR_L,mADC
 SG_ RRR_RollingCounter_349 : 491|4@0+ (1.0000000000,0.0000000000) [0.0000000000|15.0000000000] ""  RLR_L,mADC
 SG_ RRR_ECU_TiOut : 147|1@0+ (1.0000000000,0.0000000000) [0.0000000000|1.0000000000] "-"  RLR_L,mADC
 SG_ RRR_ECU_TiLeap : 148|1@0+ (1.0000000000,0.0000000000) [0.0000000000|1.0000000000] "-"  RLR_L,mADC
 SG_ RRR_ECU_TiBas : 149|1@0+ (1.0000000000,0.0000000000) [0.0000000000|1.0000000000] "-"  RLR_L,mADC
 SG_ RRR_ECU_TiStamp : 117|32@0+ (0.0001000000,0.0000000000) [0.0000000000|429496.7295000000] "s"  RLR_L,mADC
 SG_ RRR_MCUTiStamp : 101|16@0+ (1.0000000000,0.0000000000) [0.0000000000|65536.0000000000] "um"  RLR_L,mADC
 SG_ RRR_SyncTiStamp : 12|64@0+ (0.0001000000,0.0000000000) [0.0000000000|1844674407370950.0000000000] "s"  RLR_L,mADC
 SG_ RRR_WorkMode : 162|2@0+ (1.0000000000,0.0000000000) [0.0000000000|3.0000000000] "-"  RLR_L,mADC
 SG_ RRR_ObjDelay : 4|8@0+ (1.0000000000,0.0000000000) [0.0000000000|255.0000000000] "ms"  RLR_L,mADC
 SG_ RRR_SystemStatus : 7|3@0+ (1.0000000000,0.0000000000) [0.0000000000|7.0000000000] ""  RLR_L,mADC

BO_ 922 RRR_L_39A: 64 RRR_L
 SG_ RLR_CRCCheck_39A : 503|16@0+ (1.0000000000,0.0000000000) [0.0000000000|65535.0000000000] ""  RLR_L,mADC
 SG_ RLR_RollingCounter_39A : 491|4@0+ (1.0000000000,0.0000000000) [0.0000000000|15.0000000000] ""  RLR_L,mADC
 SG_ RLR_FreespaceSectorKinestate34 : 477|2@0+ (1.0000000000,0.0000000000) [0.0000000000|3.0000000000] "-"  RLR_L,mADC
 SG_ RLR_FreespaceSectorConRidence34 : 479|2@0+ (1.0000000000,0.0000000000) [0.0000000000|3.0000000000] "-"  RLR_L,mADC
 SG_ RLR_FreespaceSectorDistance34 : 457|10@0+ (0.1000000000,0.0000000000) [0.0000000000|100.0000000000] "-"  RLR_L,mADC
 SG_ RLR_FreespaceSectorKinestate33 : 459|2@0+ (1.0000000000,0.0000000000) [0.0000000000|3.0000000000] "-"  RLR_L,mADC
 SG_ RLR_FreespaceSectorConRidence33 : 461|2@0+ (1.0000000000,0.0000000000) [0.0000000000|3.0000000000] "-"  RLR_L,mADC
 SG_ RLR_FreespaceSectorDistance33 : 455|10@0+ (0.1000000000,0.0000000000) [0.0000000000|100.0000000000] "-"  RLR_L,mADC
 SG_ RLR_FreespaceSectorKinestate32 : 441|2@0+ (1.0000000000,0.0000000000) [0.0000000000|3.0000000000] "-"  RLR_L,mADC
 SG_ RLR_FreespaceSectorConRidence32 : 443|2@0+ (1.0000000000,0.0000000000) [0.0000000000|3.0000000000] "-"  RLR_L,mADC
 SG_ RLR_FreespaceSectorDistance32 : 437|10@0+ (0.1000000000,0.0000000000) [0.0000000000|100.0000000000] "-"  RLR_L,mADC
 SG_ RLR_FreespaceSectorKinestate31 : 439|2@0+ (1.0000000000,0.0000000000) [0.0000000000|3.0000000000] "-"  RLR_L,mADC
 SG_ RLR_FreespaceSectorConRidence31 : 425|2@0+ (1.0000000000,0.0000000000) [0.0000000000|3.0000000000] "-"  RLR_L,mADC
 SG_ RLR_FreespaceSectorDistance31 : 419|10@0+ (0.1000000000,0.0000000000) [0.0000000000|100.0000000000] "-"  RLR_L,mADC
 SG_ RLR_FreespaceSectorKinestate30 : 421|2@0+ (1.0000000000,0.0000000000) [0.0000000000|3.0000000000] "-"  RLR_L,mADC
 SG_ RLR_FreespaceSectorConRidence30 : 423|2@0+ (1.0000000000,0.0000000000) [0.0000000000|3.0000000000] "-"  RLR_L,mADC
 SG_ RLR_FreespaceSectorDistance30 : 401|10@0+ (0.1000000000,0.0000000000) [0.0000000000|100.0000000000] "-"  RLR_L,mADC
 SG_ RLR_FreespaceSectorKinestate29 : 403|2@0+ (1.0000000000,0.0000000000) [0.0000000000|3.0000000000] "-"  RLR_L,mADC
 SG_ RLR_FreespaceSectorConRidence29 : 405|2@0+ (1.0000000000,0.0000000000) [0.0000000000|3.0000000000] "-"  RLR_L,mADC
 SG_ RLR_FreespaceSectorDistance29 : 399|10@0+ (0.1000000000,0.0000000000) [0.0000000000|100.0000000000] "-"  RLR_L,mADC
 SG_ RLR_FreespaceSectorKinestate28 : 385|2@0+ (1.0000000000,0.0000000000) [0.0000000000|3.0000000000] "-"  RLR_L,mADC
 SG_ RLR_FreespaceSectorConRidence28 : 387|2@0+ (1.0000000000,0.0000000000) [0.0000000000|3.0000000000] "-"  RLR_L,mADC
 SG_ RLR_FreespaceSectorDistance28 : 381|10@0+ (0.1000000000,0.0000000000) [0.0000000000|100.0000000000] "-"  RLR_L,mADC
 SG_ RLR_FreespaceSectorKinestate27 : 383|2@0+ (1.0000000000,0.0000000000) [0.0000000000|3.0000000000] "-"  RLR_L,mADC
 SG_ RLR_FreespaceSectorConRidence27 : 369|2@0+ (1.0000000000,0.0000000000) [0.0000000000|3.0000000000] "-"  RLR_L,mADC
 SG_ RLR_FreespaceSectorDistance27 : 363|10@0+ (0.1000000000,0.0000000000) [0.0000000000|100.0000000000] "-"  RLR_L,mADC
 SG_ RLR_FreespaceSectorKinestate26 : 365|2@0+ (1.0000000000,0.0000000000) [0.0000000000|3.0000000000] "-"  RLR_L,mADC
 SG_ RLR_FreespaceSectorConRidence26 : 367|2@0+ (1.0000000000,0.0000000000) [0.0000000000|3.0000000000] "-"  RLR_L,mADC
 SG_ RLR_FreespaceSectorDistance26 : 345|10@0+ (0.1000000000,0.0000000000) [0.0000000000|100.0000000000] "-"  RLR_L,mADC
 SG_ RLR_FreespaceSectorKinestate25 : 347|2@0+ (1.0000000000,0.0000000000) [0.0000000000|3.0000000000] "-"  RLR_L,mADC
 SG_ RLR_FreespaceSectorConRidence25 : 349|2@0+ (1.0000000000,0.0000000000) [0.0000000000|3.0000000000] "-"  RLR_L,mADC
 SG_ RLR_FreespaceSectorDistance25 : 343|10@0+ (0.1000000000,0.0000000000) [0.0000000000|100.0000000000] "-"  RLR_L,mADC
 SG_ RLR_FreespaceSectorKinestate24 : 329|2@0+ (1.0000000000,0.0000000000) [0.0000000000|3.0000000000] "-"  RLR_L,mADC
 SG_ RLR_FreespaceSectorConRidence24 : 331|2@0+ (1.0000000000,0.0000000000) [0.0000000000|3.0000000000] "-"  RLR_L,mADC
 SG_ RLR_FreespaceSectorDistance24 : 325|10@0+ (0.1000000000,0.0000000000) [0.0000000000|100.0000000000] "-"  RLR_L,mADC
 SG_ RLR_FreespaceSectorKinestate23 : 327|2@0+ (1.0000000000,0.0000000000) [0.0000000000|3.0000000000] "-"  RLR_L,mADC
 SG_ RLR_FreespaceSectorConRidence23 : 313|2@0+ (1.0000000000,0.0000000000) [0.0000000000|3.0000000000] "-"  RLR_L,mADC
 SG_ RLR_FreespaceSectorDistance23 : 307|10@0+ (0.1000000000,0.0000000000) [0.0000000000|100.0000000000] "-"  RLR_L,mADC
 SG_ RLR_FreespaceSectorKinestate22 : 309|2@0+ (1.0000000000,0.0000000000) [0.0000000000|3.0000000000] "-"  RLR_L,mADC
 SG_ RLR_FreespaceSectorConRidence22 : 311|2@0+ (1.0000000000,0.0000000000) [0.0000000000|3.0000000000] "-"  RLR_L,mADC
 SG_ RLR_FreespaceSectorDistance22 : 289|10@0+ (0.1000000000,0.0000000000) [0.0000000000|100.0000000000] "-"  RLR_L,mADC
 SG_ RLR_FreespaceSectorKinestate21 : 291|2@0+ (1.0000000000,0.0000000000) [0.0000000000|3.0000000000] "-"  RLR_L,mADC
 SG_ RLR_FreespaceSectorConRidence21 : 293|2@0+ (1.0000000000,0.0000000000) [0.0000000000|3.0000000000] "-"  RLR_L,mADC
 SG_ RLR_FreespaceSectorDistance21 : 287|10@0+ (0.1000000000,0.0000000000) [0.0000000000|100.0000000000] "-"  RLR_L,mADC
 SG_ RLR_FreespaceSectorKinestate20 : 273|2@0+ (1.0000000000,0.0000000000) [0.0000000000|3.0000000000] "-"  RLR_L,mADC
 SG_ RLR_FreespaceSectorConRidence20 : 275|2@0+ (1.0000000000,0.0000000000) [0.0000000000|3.0000000000] "-"  RLR_L,mADC
 SG_ RLR_FreespaceSectorDistance20 : 269|10@0+ (0.1000000000,0.0000000000) [0.0000000000|100.0000000000] "-"  RLR_L,mADC
 SG_ RLR_FreespaceSectorKinestate19 : 271|2@0+ (1.0000000000,0.0000000000) [0.0000000000|3.0000000000] "-"  RLR_L,mADC
 SG_ RLR_FreespaceSectorConRidence19 : 257|2@0+ (1.0000000000,0.0000000000) [0.0000000000|3.0000000000] "-"  RLR_L,mADC
 SG_ RLR_FreespaceSectorDistance19 : 251|10@0+ (0.1000000000,0.0000000000) [0.0000000000|100.0000000000] "-"  RLR_L,mADC
 SG_ RLR_FreespaceSectorKinestate18 : 253|2@0+ (1.0000000000,0.0000000000) [0.0000000000|3.0000000000] "-"  RLR_L,mADC
 SG_ RLR_FreespaceSectorConRidence18 : 255|2@0+ (1.0000000000,0.0000000000) [0.0000000000|3.0000000000] "-"  RLR_L,mADC
 SG_ RLR_FreespaceSectorDistance18 : 233|10@0+ (0.1000000000,0.0000000000) [0.0000000000|100.0000000000] "-"  RLR_L,mADC
 SG_ RLR_FreespaceSectorKinestate17 : 235|2@0+ (1.0000000000,0.0000000000) [0.0000000000|3.0000000000] "-"  RLR_L,mADC
 SG_ RLR_FreespaceSectorConRidence17 : 237|2@0+ (1.0000000000,0.0000000000) [0.0000000000|3.0000000000] "-"  RLR_L,mADC
 SG_ RLR_FreespaceSectorDistance17 : 231|10@0+ (0.1000000000,0.0000000000) [0.0000000000|100.0000000000] "-"  RLR_L,mADC
 SG_ RLR_FreespaceSectorKinestate16 : 217|2@0+ (1.0000000000,0.0000000000) [0.0000000000|3.0000000000] "-"  RLR_L,mADC
 SG_ RLR_FreespaceSectorConRidence16 : 219|2@0+ (1.0000000000,0.0000000000) [0.0000000000|3.0000000000] "-"  RLR_L,mADC
 SG_ RLR_FreespaceSectorDistance16 : 213|10@0+ (0.1000000000,0.0000000000) [0.0000000000|100.0000000000] "-"  RLR_L,mADC
 SG_ RLR_FreespaceSectorKinestate15 : 215|2@0+ (1.0000000000,0.0000000000) [0.0000000000|3.0000000000] "-"  RLR_L,mADC
 SG_ RLR_FreespaceSectorConRidence15 : 201|2@0+ (1.0000000000,0.0000000000) [0.0000000000|3.0000000000] "-"  RLR_L,mADC
 SG_ RLR_FreespaceSectorDistance15 : 195|10@0+ (0.1000000000,0.0000000000) [0.0000000000|100.0000000000] "-"  RLR_L,mADC
 SG_ RLR_FreespaceSectorKinestate14 : 197|2@0+ (1.0000000000,0.0000000000) [0.0000000000|3.0000000000] "-"  RLR_L,mADC
 SG_ RLR_FreespaceSectorConRidence14 : 199|2@0+ (1.0000000000,0.0000000000) [0.0000000000|3.0000000000] "-"  RLR_L,mADC
 SG_ RLR_FreespaceSectorDistance14 : 177|10@0+ (0.1000000000,0.0000000000) [0.0000000000|100.0000000000] "-"  RLR_L,mADC
 SG_ RLR_FreespaceSectorKinestate13 : 179|2@0+ (1.0000000000,0.0000000000) [0.0000000000|3.0000000000] "-"  RLR_L,mADC
 SG_ RLR_FreespaceSectorConRidence13 : 181|2@0+ (1.0000000000,0.0000000000) [0.0000000000|3.0000000000] "-"  RLR_L,mADC
 SG_ RLR_FreespaceSectorDistance13 : 175|10@0+ (0.1000000000,0.0000000000) [0.0000000000|100.0000000000] "-"  RLR_L,mADC
 SG_ RLR_FreespaceSectorKinestate12 : 161|2@0+ (1.0000000000,0.0000000000) [0.0000000000|3.0000000000] "-"  RLR_L,mADC
 SG_ RLR_FreespaceSectorConRidence12 : 163|2@0+ (1.0000000000,0.0000000000) [0.0000000000|3.0000000000] "-"  RLR_L,mADC
 SG_ RLR_FreespaceSectorDistance12 : 157|10@0+ (0.1000000000,0.0000000000) [0.0000000000|100.0000000000] "-"  RLR_L,mADC
 SG_ RLR_FreespaceSectorKinestate11 : 159|2@0+ (1.0000000000,0.0000000000) [0.0000000000|3.0000000000] "-"  RLR_L,mADC
 SG_ RLR_FreespaceSectorConRidence11 : 145|2@0+ (1.0000000000,0.0000000000) [0.0000000000|3.0000000000] "-"  RLR_L,mADC
 SG_ RLR_FreespaceSectorDistance11 : 139|10@0+ (0.1000000000,0.0000000000) [0.0000000000|100.0000000000] "-"  RLR_L,mADC
 SG_ RLR_FreespaceSectorKinestate10 : 141|2@0+ (1.0000000000,0.0000000000) [0.0000000000|3.0000000000] "-"  RLR_L,mADC
 SG_ RLR_FreespaceSectorConRidence10 : 143|2@0+ (1.0000000000,0.0000000000) [0.0000000000|3.0000000000] "-"  RLR_L,mADC
 SG_ RLR_FreespaceSectorDistance10 : 121|10@0+ (0.1000000000,0.0000000000) [0.0000000000|100.0000000000] "-"  RLR_L,mADC
 SG_ RLR_FreespaceSectorKinestate9 : 123|2@0+ (1.0000000000,0.0000000000) [0.0000000000|3.0000000000] "-"  RLR_L,mADC
 SG_ RLR_FreespaceSectorConRidence9 : 125|2@0+ (1.0000000000,0.0000000000) [0.0000000000|3.0000000000] "-"  RLR_L,mADC
 SG_ RLR_FreespaceSectorDistance9 : 119|10@0+ (0.1000000000,0.0000000000) [0.0000000000|100.0000000000] "-"  RLR_L,mADC
 SG_ RLR_FreespaceSectorKinestate8 : 105|2@0+ (1.0000000000,0.0000000000) [0.0000000000|3.0000000000] "-"  RLR_L,mADC
 SG_ RLR_FreespaceSectorConRidence8 : 107|2@0+ (1.0000000000,0.0000000000) [0.0000000000|3.0000000000] "-"  RLR_L,mADC
 SG_ RLR_FreespaceSectorDistance8 : 101|10@0+ (0.1000000000,0.0000000000) [0.0000000000|100.0000000000] "-"  RLR_L,mADC
 SG_ RLR_FreespaceSectorKinestate7 : 103|2@0+ (1.0000000000,0.0000000000) [0.0000000000|3.0000000000] "-"  RLR_L,mADC
 SG_ RLR_FreespaceSectorConRidence7 : 89|2@0+ (1.0000000000,0.0000000000) [0.0000000000|3.0000000000] "-"  RLR_L,mADC
 SG_ RLR_FreespaceSectorDistance7 : 83|10@0+ (0.1000000000,0.0000000000) [0.0000000000|100.0000000000] "-"  RLR_L,mADC
 SG_ RLR_FreespaceSectorKinestate6 : 85|2@0+ (1.0000000000,0.0000000000) [0.0000000000|3.0000000000] "-"  RLR_L,mADC
 SG_ RLR_FreespaceSectorConRidence6 : 87|2@0+ (1.0000000000,0.0000000000) [0.0000000000|3.0000000000] "-"  RLR_L,mADC
 SG_ RLR_FreespaceSectorDistance6 : 65|10@0+ (0.1000000000,0.0000000000) [0.0000000000|100.0000000000] "-"  RLR_L,mADC
 SG_ RLR_FreespaceSectorKinestate5 : 67|2@0+ (1.0000000000,0.0000000000) [0.0000000000|3.0000000000] "-"  RLR_L,mADC
 SG_ RLR_FreespaceSectorConRidence5 : 69|2@0+ (1.0000000000,0.0000000000) [0.0000000000|3.0000000000] "-"  RLR_L,mADC
 SG_ RLR_FreespaceSectorDistance5 : 63|10@0+ (0.1000000000,0.0000000000) [0.0000000000|100.0000000000] "-"  RLR_L,mADC
 SG_ RLR_FreespaceSectorKinestate4 : 49|2@0+ (1.0000000000,0.0000000000) [0.0000000000|3.0000000000] "-"  RLR_L,mADC
 SG_ RLR_FreespaceSectorConRidence4 : 51|2@0+ (1.0000000000,0.0000000000) [0.0000000000|3.0000000000] "-"  RLR_L,mADC
 SG_ RLR_FreespaceSectorDistance4 : 45|10@0+ (0.1000000000,0.0000000000) [0.0000000000|100.0000000000] "-"  RLR_L,mADC
 SG_ RLR_FreespaceSectorKinestate3 : 47|2@0+ (1.0000000000,0.0000000000) [0.0000000000|3.0000000000] "-"  RLR_L,mADC
 SG_ RLR_FreespaceSectorConRidence3 : 33|2@0+ (1.0000000000,0.0000000000) [0.0000000000|3.0000000000] "-"  RLR_L,mADC
 SG_ RLR_FreespaceSectorDistance3 : 27|10@0+ (0.1000000000,0.0000000000) [0.0000000000|100.0000000000] "-"  RLR_L,mADC
 SG_ RLR_FreespaceSectorKinestate2 : 29|2@0+ (1.0000000000,0.0000000000) [0.0000000000|3.0000000000] "-"  RLR_L,mADC
 SG_ RLR_FreespaceSectorConRidence2 : 31|2@0+ (1.0000000000,0.0000000000) [0.0000000000|3.0000000000] "-"  RLR_L,mADC
 SG_ RLR_FreespaceSectorDistance2 : 9|10@0+ (0.1000000000,0.0000000000) [0.0000000000|100.0000000000] "-"  RLR_L,mADC
 SG_ RLR_FreespaceSectorKinestate1 : 11|2@0+ (1.0000000000,0.0000000000) [0.0000000000|3.0000000000] "-"  RLR_L,mADC
 SG_ RLR_FreespaceSectorConRidence1 : 13|2@0+ (1.0000000000,0.0000000000) [0.0000000000|3.0000000000] "-"  RLR_L,mADC
 SG_ RLR_FreespaceSectorDistance1 : 7|10@0+ (0.1000000000,0.0000000000) [0.0000000000|100.0000000000] "-"  RLR_L,mADC

BO_ 923 RRR_L_39B: 64 RRR_L
 SG_ RLR_CRCCheck_39B : 503|16@0+ (1.0000000000,0.0000000000) [0.0000000000|65535.0000000000] ""  RLR_L,mADC
 SG_ RLR_RollingCounter_39B : 491|4@0+ (1.0000000000,0.0000000000) [0.0000000000|15.0000000000] ""  RLR_L,mADC
 SG_ RLR_FreespaceSectorKinestate68 : 477|2@0+ (1.0000000000,0.0000000000) [0.0000000000|3.0000000000] "-"  RLR_L,mADC
 SG_ RLR_FreespaceSectorConRidence68 : 479|2@0+ (1.0000000000,0.0000000000) [0.0000000000|3.0000000000] "-"  RLR_L,mADC
 SG_ RLR_FreespaceSectorDistance68 : 457|10@0+ (0.1000000000,0.0000000000) [0.0000000000|100.0000000000] "-"  RLR_L,mADC
 SG_ RLR_FreespaceSectorKinestate67 : 459|2@0+ (1.0000000000,0.0000000000) [0.0000000000|3.0000000000] "-"  RLR_L,mADC
 SG_ RLR_FreespaceSectorConRidence67 : 461|2@0+ (1.0000000000,0.0000000000) [0.0000000000|3.0000000000] "-"  RLR_L,mADC
 SG_ RLR_FreespaceSectorDistance67 : 455|10@0+ (0.1000000000,0.0000000000) [0.0000000000|100.0000000000] "-"  RLR_L,mADC
 SG_ RLR_FreespaceSectorKinestate66 : 441|2@0+ (1.0000000000,0.0000000000) [0.0000000000|3.0000000000] "-"  RLR_L,mADC
 SG_ RLR_FreespaceSectorConRidence66 : 443|2@0+ (1.0000000000,0.0000000000) [0.0000000000|3.0000000000] "-"  RLR_L,mADC
 SG_ RLR_FreespaceSectorDistance66 : 437|10@0+ (0.1000000000,0.0000000000) [0.0000000000|100.0000000000] "-"  RLR_L,mADC
 SG_ RLR_FreespaceSectorKinestate65 : 439|2@0+ (1.0000000000,0.0000000000) [0.0000000000|3.0000000000] "-"  RLR_L,mADC
 SG_ RLR_FreespaceSectorConRidence65 : 425|2@0+ (1.0000000000,0.0000000000) [0.0000000000|3.0000000000] "-"  RLR_L,mADC
 SG_ RLR_FreespaceSectorDistance65 : 419|10@0+ (0.1000000000,0.0000000000) [0.0000000000|100.0000000000] "-"  RLR_L,mADC
 SG_ RLR_FreespaceSectorKinestate64 : 421|2@0+ (1.0000000000,0.0000000000) [0.0000000000|3.0000000000] "-"  RLR_L,mADC
 SG_ RLR_FreespaceSectorConRidence64 : 423|2@0+ (1.0000000000,0.0000000000) [0.0000000000|3.0000000000] "-"  RLR_L,mADC
 SG_ RLR_FreespaceSectorDistance64 : 401|10@0+ (0.1000000000,0.0000000000) [0.0000000000|100.0000000000] "-"  RLR_L,mADC
 SG_ RLR_FreespaceSectorKinestate63 : 403|2@0+ (1.0000000000,0.0000000000) [0.0000000000|3.0000000000] "-"  RLR_L,mADC
 SG_ RLR_FreespaceSectorConRidence63 : 405|2@0+ (1.0000000000,0.0000000000) [0.0000000000|3.0000000000] "-"  RLR_L,mADC
 SG_ RLR_FreespaceSectorDistance63 : 399|10@0+ (0.1000000000,0.0000000000) [0.0000000000|100.0000000000] "-"  RLR_L,mADC
 SG_ RLR_FreespaceSectorKinestate62 : 385|2@0+ (1.0000000000,0.0000000000) [0.0000000000|3.0000000000] "-"  RLR_L,mADC
 SG_ RLR_FreespaceSectorConRidence62 : 387|2@0+ (1.0000000000,0.0000000000) [0.0000000000|3.0000000000] "-"  RLR_L,mADC
 SG_ RLR_FreespaceSectorDistance62 : 381|10@0+ (0.1000000000,0.0000000000) [0.0000000000|100.0000000000] "-"  RLR_L,mADC
 SG_ RLR_FreespaceSectorKinestate61 : 383|2@0+ (1.0000000000,0.0000000000) [0.0000000000|3.0000000000] "-"  RLR_L,mADC
 SG_ RLR_FreespaceSectorConRidence61 : 369|2@0+ (1.0000000000,0.0000000000) [0.0000000000|3.0000000000] "-"  RLR_L,mADC
 SG_ RLR_FreespaceSectorDistance61 : 363|10@0+ (0.1000000000,0.0000000000) [0.0000000000|100.0000000000] "-"  RLR_L,mADC
 SG_ RLR_FreespaceSectorKinestate60 : 365|2@0+ (1.0000000000,0.0000000000) [0.0000000000|3.0000000000] "-"  RLR_L,mADC
 SG_ RLR_FreespaceSectorConRidence60 : 367|2@0+ (1.0000000000,0.0000000000) [0.0000000000|3.0000000000] "-"  RLR_L,mADC
 SG_ RLR_FreespaceSectorDistance60 : 345|10@0+ (0.1000000000,0.0000000000) [0.0000000000|100.0000000000] "-"  RLR_L,mADC
 SG_ RLR_FreespaceSectorKinestate59 : 347|2@0+ (1.0000000000,0.0000000000) [0.0000000000|3.0000000000] "-"  RLR_L,mADC
 SG_ RLR_FreespaceSectorConRidence59 : 349|2@0+ (1.0000000000,0.0000000000) [0.0000000000|3.0000000000] "-"  RLR_L,mADC
 SG_ RLR_FreespaceSectorDistance59 : 343|10@0+ (0.1000000000,0.0000000000) [0.0000000000|100.0000000000] "-"  RLR_L,mADC
 SG_ RLR_FreespaceSectorKinestate58 : 329|2@0+ (1.0000000000,0.0000000000) [0.0000000000|3.0000000000] "-"  RLR_L,mADC
 SG_ RLR_FreespaceSectorConRidence58 : 331|2@0+ (1.0000000000,0.0000000000) [0.0000000000|3.0000000000] "-"  RLR_L,mADC
 SG_ RLR_FreespaceSectorDistance58 : 325|10@0+ (0.1000000000,0.0000000000) [0.0000000000|100.0000000000] "-"  RLR_L,mADC
 SG_ RLR_FreespaceSectorKinestate57 : 327|2@0+ (1.0000000000,0.0000000000) [0.0000000000|3.0000000000] "-"  RLR_L,mADC
 SG_ RLR_FreespaceSectorConRidence57 : 313|2@0+ (1.0000000000,0.0000000000) [0.0000000000|3.0000000000] "-"  RLR_L,mADC
 SG_ RLR_FreespaceSectorDistance57 : 307|10@0+ (0.1000000000,0.0000000000) [0.0000000000|100.0000000000] "-"  RLR_L,mADC
 SG_ RLR_FreespaceSectorKinestate56 : 309|2@0+ (1.0000000000,0.0000000000) [0.0000000000|3.0000000000] "-"  RLR_L,mADC
 SG_ RLR_FreespaceSectorConRidence56 : 311|2@0+ (1.0000000000,0.0000000000) [0.0000000000|3.0000000000] "-"  RLR_L,mADC
 SG_ RLR_FreespaceSectorDistance56 : 289|10@0+ (0.1000000000,0.0000000000) [0.0000000000|100.0000000000] "-"  RLR_L,mADC
 SG_ RLR_FreespaceSectorKinestate55 : 291|2@0+ (1.0000000000,0.0000000000) [0.0000000000|3.0000000000] "-"  RLR_L,mADC
 SG_ RLR_FreespaceSectorConRidence55 : 293|2@0+ (1.0000000000,0.0000000000) [0.0000000000|3.0000000000] "-"  RLR_L,mADC
 SG_ RLR_FreespaceSectorDistance55 : 287|10@0+ (0.1000000000,0.0000000000) [0.0000000000|100.0000000000] "-"  RLR_L,mADC
 SG_ RLR_FreespaceSectorKinestate54 : 273|2@0+ (1.0000000000,0.0000000000) [0.0000000000|3.0000000000] "-"  RLR_L,mADC
 SG_ RLR_FreespaceSectorConRidence54 : 275|2@0+ (1.0000000000,0.0000000000) [0.0000000000|3.0000000000] "-"  RLR_L,mADC
 SG_ RLR_FreespaceSectorDistance54 : 269|10@0+ (0.1000000000,0.0000000000) [0.0000000000|100.0000000000] "-"  RLR_L,mADC
 SG_ RLR_FreespaceSectorKinestate53 : 271|2@0+ (1.0000000000,0.0000000000) [0.0000000000|3.0000000000] "-"  RLR_L,mADC
 SG_ RLR_FreespaceSectorConRidence53 : 257|2@0+ (1.0000000000,0.0000000000) [0.0000000000|3.0000000000] "-"  RLR_L,mADC
 SG_ RLR_FreespaceSectorDistance53 : 251|10@0+ (0.1000000000,0.0000000000) [0.0000000000|100.0000000000] "-"  RLR_L,mADC
 SG_ RLR_FreespaceSectorKinestate52 : 253|2@0+ (1.0000000000,0.0000000000) [0.0000000000|3.0000000000] "-"  RLR_L,mADC
 SG_ RLR_FreespaceSectorConRidence52 : 255|2@0+ (1.0000000000,0.0000000000) [0.0000000000|3.0000000000] "-"  RLR_L,mADC
 SG_ RLR_FreespaceSectorDistance52 : 233|10@0+ (0.1000000000,0.0000000000) [0.0000000000|100.0000000000] "-"  RLR_L,mADC
 SG_ RLR_FreespaceSectorKinestate51 : 235|2@0+ (1.0000000000,0.0000000000) [0.0000000000|3.0000000000] "-"  RLR_L,mADC
 SG_ RLR_FreespaceSectorConRidence51 : 237|2@0+ (1.0000000000,0.0000000000) [0.0000000000|3.0000000000] "-"  RLR_L,mADC
 SG_ RLR_FreespaceSectorDistance51 : 231|10@0+ (0.1000000000,0.0000000000) [0.0000000000|100.0000000000] "-"  RLR_L,mADC
 SG_ RLR_FreespaceSectorKinestate50 : 217|2@0+ (1.0000000000,0.0000000000) [0.0000000000|3.0000000000] "-"  RLR_L,mADC
 SG_ RLR_FreespaceSectorConRidence50 : 219|2@0+ (1.0000000000,0.0000000000) [0.0000000000|3.0000000000] "-"  RLR_L,mADC
 SG_ RLR_FreespaceSectorDistance50 : 213|10@0+ (0.1000000000,0.0000000000) [0.0000000000|100.0000000000] "-"  RLR_L,mADC
 SG_ RLR_FreespaceSectorKinestate49 : 215|2@0+ (1.0000000000,0.0000000000) [0.0000000000|3.0000000000] "-"  RLR_L,mADC
 SG_ RLR_FreespaceSectorConRidence49 : 201|2@0+ (1.0000000000,0.0000000000) [0.0000000000|3.0000000000] "-"  RLR_L,mADC
 SG_ RLR_FreespaceSectorDistance49 : 195|10@0+ (0.1000000000,0.0000000000) [0.0000000000|100.0000000000] "-"  RLR_L,mADC
 SG_ RLR_FreespaceSectorKinestate48 : 197|2@0+ (1.0000000000,0.0000000000) [0.0000000000|3.0000000000] "-"  RLR_L,mADC
 SG_ RLR_FreespaceSectorConRidence48 : 199|2@0+ (1.0000000000,0.0000000000) [0.0000000000|3.0000000000] "-"  RLR_L,mADC
 SG_ RLR_FreespaceSectorDistance48 : 177|10@0+ (0.1000000000,0.0000000000) [0.0000000000|100.0000000000] "-"  RLR_L,mADC
 SG_ RLR_FreespaceSectorKinestate47 : 179|2@0+ (1.0000000000,0.0000000000) [0.0000000000|3.0000000000] "-"  RLR_L,mADC
 SG_ RLR_FreespaceSectorConRidence47 : 181|2@0+ (1.0000000000,0.0000000000) [0.0000000000|3.0000000000] "-"  RLR_L,mADC
 SG_ RLR_FreespaceSectorDistance47 : 175|10@0+ (0.1000000000,0.0000000000) [0.0000000000|100.0000000000] "-"  RLR_L,mADC
 SG_ RLR_FreespaceSectorKinestate46 : 161|2@0+ (1.0000000000,0.0000000000) [0.0000000000|3.0000000000] "-"  RLR_L,mADC
 SG_ RLR_FreespaceSectorConRidence46 : 163|2@0+ (1.0000000000,0.0000000000) [0.0000000000|3.0000000000] "-"  RLR_L,mADC
 SG_ RLR_FreespaceSectorDistance46 : 157|10@0+ (0.1000000000,0.0000000000) [0.0000000000|100.0000000000] "-"  RLR_L,mADC
 SG_ RLR_FreespaceSectorKinestate45 : 159|2@0+ (1.0000000000,0.0000000000) [0.0000000000|3.0000000000] "-"  RLR_L,mADC
 SG_ RLR_FreespaceSectorConRidence45 : 145|2@0+ (1.0000000000,0.0000000000) [0.0000000000|3.0000000000] "-"  RLR_L,mADC
 SG_ RLR_FreespaceSectorDistance45 : 139|10@0+ (0.1000000000,0.0000000000) [0.0000000000|100.0000000000] "-"  RLR_L,mADC
 SG_ RLR_FreespaceSectorKinestate44 : 141|2@0+ (1.0000000000,0.0000000000) [0.0000000000|3.0000000000] "-"  RLR_L,mADC
 SG_ RLR_FreespaceSectorConRidence44 : 143|2@0+ (1.0000000000,0.0000000000) [0.0000000000|3.0000000000] "-"  RLR_L,mADC
 SG_ RLR_FreespaceSectorDistance44 : 121|10@0+ (0.1000000000,0.0000000000) [0.0000000000|100.0000000000] "-"  RLR_L,mADC
 SG_ RLR_FreespaceSectorKinestate43 : 123|2@0+ (1.0000000000,0.0000000000) [0.0000000000|3.0000000000] "-"  RLR_L,mADC
 SG_ RLR_FreespaceSectorConRidence43 : 125|2@0+ (1.0000000000,0.0000000000) [0.0000000000|3.0000000000] "-"  RLR_L,mADC
 SG_ RLR_FreespaceSectorDistance43 : 119|10@0+ (0.1000000000,0.0000000000) [0.0000000000|100.0000000000] "-"  RLR_L,mADC
 SG_ RLR_FreespaceSectorKinestate42 : 105|2@0+ (1.0000000000,0.0000000000) [0.0000000000|3.0000000000] "-"  RLR_L,mADC
 SG_ RLR_FreespaceSectorConRidence42 : 107|2@0+ (1.0000000000,0.0000000000) [0.0000000000|3.0000000000] "-"  RLR_L,mADC
 SG_ RLR_FreespaceSectorDistance42 : 101|10@0+ (0.1000000000,0.0000000000) [0.0000000000|100.0000000000] "-"  RLR_L,mADC
 SG_ RLR_FreespaceSectorKinestate41 : 103|2@0+ (1.0000000000,0.0000000000) [0.0000000000|3.0000000000] "-"  RLR_L,mADC
 SG_ RLR_FreespaceSectorConRidence41 : 89|2@0+ (1.0000000000,0.0000000000) [0.0000000000|3.0000000000] "-"  RLR_L,mADC
 SG_ RLR_FreespaceSectorDistance41 : 83|10@0+ (0.1000000000,0.0000000000) [0.0000000000|100.0000000000] "-"  RLR_L,mADC
 SG_ RLR_FreespaceSectorKinestate40 : 85|2@0+ (1.0000000000,0.0000000000) [0.0000000000|3.0000000000] "-"  RLR_L,mADC
 SG_ RLR_FreespaceSectorConRidence40 : 87|2@0+ (1.0000000000,0.0000000000) [0.0000000000|3.0000000000] "-"  RLR_L,mADC
 SG_ RLR_FreespaceSectorDistance40 : 65|10@0+ (0.1000000000,0.0000000000) [0.0000000000|100.0000000000] "-"  RLR_L,mADC
 SG_ RLR_FreespaceSectorKinestate39 : 67|2@0+ (1.0000000000,0.0000000000) [0.0000000000|3.0000000000] "-"  RLR_L,mADC
 SG_ RLR_FreespaceSectorConRidence39 : 69|2@0+ (1.0000000000,0.0000000000) [0.0000000000|3.0000000000] "-"  RLR_L,mADC
 SG_ RLR_FreespaceSectorDistance39 : 63|10@0+ (0.1000000000,0.0000000000) [0.0000000000|100.0000000000] "-"  RLR_L,mADC
 SG_ RLR_FreespaceSectorKinestate38 : 49|2@0+ (1.0000000000,0.0000000000) [0.0000000000|3.0000000000] "-"  RLR_L,mADC
 SG_ RLR_FreespaceSectorConRidence38 : 51|2@0+ (1.0000000000,0.0000000000) [0.0000000000|3.0000000000] "-"  RLR_L,mADC
 SG_ RLR_FreespaceSectorDistance38 : 45|10@0+ (0.1000000000,0.0000000000) [0.0000000000|100.0000000000] "-"  RLR_L,mADC
 SG_ RLR_FreespaceSectorKinestate37 : 47|2@0+ (1.0000000000,0.0000000000) [0.0000000000|3.0000000000] "-"  RLR_L,mADC
 SG_ RLR_FreespaceSectorConRidence37 : 33|2@0+ (1.0000000000,0.0000000000) [0.0000000000|3.0000000000] "-"  RLR_L,mADC
 SG_ RLR_FreespaceSectorDistance37 : 27|10@0+ (0.1000000000,0.0000000000) [0.0000000000|100.0000000000] "-"  RLR_L,mADC
 SG_ RLR_FreespaceSectorKinestate36 : 29|2@0+ (1.0000000000,0.0000000000) [0.0000000000|3.0000000000] "-"  RLR_L,mADC
 SG_ RLR_FreespaceSectorConRidence36 : 31|2@0+ (1.0000000000,0.0000000000) [0.0000000000|3.0000000000] "-"  RLR_L,mADC
 SG_ RLR_FreespaceSectorDistance36 : 9|10@0+ (0.1000000000,0.0000000000) [0.0000000000|100.0000000000] "-"  RLR_L,mADC
 SG_ RLR_FreespaceSectorKinestate35 : 11|2@0+ (1.0000000000,0.0000000000) [0.0000000000|3.0000000000] "-"  RLR_L,mADC
 SG_ RLR_FreespaceSectorConRidence35 : 13|2@0+ (1.0000000000,0.0000000000) [0.0000000000|3.0000000000] "-"  RLR_L,mADC
 SG_ RLR_FreespaceSectorDistance35 : 7|10@0+ (0.1000000000,0.0000000000) [0.0000000000|100.0000000000] "-"  RLR_L,mADC

CM_ BO_ 859  " ";
CM_ SG_ 859 RLR_OBJ24_LostCnt  " ";
CM_ SG_ 859 RLR_OBJ23_LostCnt  " ";
CM_ SG_ 859 RLR_OBJ24_Dx  " ";
CM_ SG_ 859 RLR_OBJ24_Dy  " ";
CM_ SG_ 859 RLR_OBJ23_Dx  " ";
CM_ SG_ 859 RLR_OBJ23_Dy  " ";
CM_ SG_ 859 RLR_OBJ24_Vx  " ";
CM_ SG_ 859 RLR_OBJ24_Vy  " ";
CM_ SG_ 859 RLR_OBJ24_Convergence  " ";
CM_ SG_ 859 RLR_OBJ24_DelayTime  " ";
CM_ SG_ 859 RLR_OBJ24_HeightGround  " ";
CM_ SG_ 859 RLR_OBJ24_MotionStatus  " ";
CM_ SG_ 859 RLR_OBJ24_RelVx_std  " ";
CM_ SG_ 859 RLR_OBJ24_RelVy_std  " ";
CM_ SG_ 859 RLR_OBJ24_Dx_Vnce  " ";
CM_ SG_ 859 RLR_OBJ24_Dy_Vnce  " ";
CM_ SG_ 859 RLR_OBJ23_Vx  " ";
CM_ SG_ 859 RLR_OBJ23_Vy  " ";
CM_ SG_ 859 RLR_OBJ23_Convergence  " ";
CM_ SG_ 859 RLR_OBJ23_DelayTime  " ";
CM_ SG_ 859 RLR_OBJ23_HeightGround  " ";
CM_ SG_ 859 RLR_OBJ23_MotionStatus  " ";
CM_ SG_ 859 RLR_OBJ23_RelVx_std  " ";
CM_ SG_ 859 RLR_OBJ23_RelVy_std  " ";
CM_ SG_ 859 RLR_OBJ23_Dx_Vnce  " ";
CM_ SG_ 859 RLR_OBJ23_Dy_Vnce  " ";
CM_ SG_ 859 RLR_CRCCheck_35B  " ";
CM_ SG_ 859 RLR_RollingCounter_35B  " ";
CM_ SG_ 859 RLR_OBJ24_Track_Age  " ";
CM_ SG_ 859 RLR_OBJ24_ReRPointLoc  " ";
CM_ SG_ 859 RLR_OBJ24_ObstacleProb  " ";
CM_ SG_ 859 RLR_OBJ24_Measured  " ";
CM_ SG_ 859 RLR_OBJ24_ExistProb  " ";
CM_ SG_ 859 RLR_OBJ24_Location  " ";
CM_ SG_ 859 RLR_OBJ24_RelAx  " ";
CM_ SG_ 859 RLR_OBJ24_RelAy  " ";
CM_ SG_ 859 RLR_OBJ24_RelVx  " ";
CM_ SG_ 859 RLR_OBJ24_RelVy  " ";
CM_ SG_ 859 RLR_OBJ24_HeadingAngle  " ";
CM_ SG_ 859 RLR_OBJ24_Length  " ";
CM_ SG_ 859 RLR_OBJ24_Height  " ";
CM_ SG_ 859 RLR_OBJ24_Width  " ";
CM_ SG_ 859 RLR_OBJ24_Type  " ";
CM_ SG_ 859 RLR_OBJ24_Track_ID  " ";
CM_ SG_ 859 RLR_OBJ23_Track_Age  " ";
CM_ SG_ 859 RLR_OBJ23_ReRPointLoc  " ";
CM_ SG_ 859 RLR_OBJ23_ObstacleProb  " ";
CM_ SG_ 859 RLR_OBJ23_Measured  " ";
CM_ SG_ 859 RLR_OBJ23_ExistProb  " ";
CM_ SG_ 859 RLR_OBJ23_Location  " ";
CM_ SG_ 859 RLR_OBJ23_RelAx  " ";
CM_ SG_ 859 RLR_OBJ23_RelAy  " ";
CM_ SG_ 859 RLR_OBJ23_RelVx  " ";
CM_ SG_ 859 RLR_OBJ23_RelVy  " ";
CM_ SG_ 859 RLR_OBJ23_HeadingAngle  " ";
CM_ SG_ 859 RLR_OBJ23_Length  " ";
CM_ SG_ 859 RLR_OBJ23_Height  " ";
CM_ SG_ 859 RLR_OBJ23_Width  " ";
CM_ SG_ 859 RLR_OBJ23_Type  " ";
CM_ SG_ 859 RLR_OBJ23_Track_ID  " ";

CM_ BO_ 860  " ";
CM_ SG_ 860 RLR_OBJ26_LostCnt  " ";
CM_ SG_ 860 RLR_OBJ25_LostCnt  " ";
CM_ SG_ 860 RLR_OBJ26_Dx  " ";
CM_ SG_ 860 RLR_OBJ26_Dy  " ";
CM_ SG_ 860 RLR_OBJ25_Dx  " ";
CM_ SG_ 860 RLR_OBJ25_Dy  " ";
CM_ SG_ 860 RLR_OBJ26_Vx  " ";
CM_ SG_ 860 RLR_OBJ26_Vy  " ";
CM_ SG_ 860 RLR_OBJ26_Convergence  " ";
CM_ SG_ 860 RLR_OBJ26_DelayTime  " ";
CM_ SG_ 860 RLR_OBJ26_HeightGround  " ";
CM_ SG_ 860 RLR_OBJ26_MotionStatus  " ";
CM_ SG_ 860 RLR_OBJ26_RelVx_std  " ";
CM_ SG_ 860 RLR_OBJ26_RelVy_std  " ";
CM_ SG_ 860 RLR_OBJ26_Dx_Vnce  " ";
CM_ SG_ 860 RLR_OBJ26_Dy_Vnce  " ";
CM_ SG_ 860 RLR_OBJ25_Vx  " ";
CM_ SG_ 860 RLR_OBJ25_Vy  " ";
CM_ SG_ 860 RLR_OBJ25_Convergence  " ";
CM_ SG_ 860 RLR_OBJ25_DelayTime  " ";
CM_ SG_ 860 RLR_OBJ25_HeightGround  " ";
CM_ SG_ 860 RLR_OBJ25_MotionStatus  " ";
CM_ SG_ 860 RLR_OBJ25_RelVx_std  " ";
CM_ SG_ 860 RLR_OBJ25_RelVy_std  " ";
CM_ SG_ 860 RLR_OBJ25_Dx_Vnce  " ";
CM_ SG_ 860 RLR_OBJ25_Dy_Vnce  " ";
CM_ SG_ 860 RLR_CRCCheck_35C  " ";
CM_ SG_ 860 RLR_RollingCounter_35C  " ";
CM_ SG_ 860 RLR_OBJ26_Track_Age  " ";
CM_ SG_ 860 RLR_OBJ26_ReRPointLoc  " ";
CM_ SG_ 860 RLR_OBJ26_ObstacleProb  " ";
CM_ SG_ 860 RLR_OBJ26_Measured  " ";
CM_ SG_ 860 RLR_OBJ26_ExistProb  " ";
CM_ SG_ 860 RLR_OBJ26_Location  " ";
CM_ SG_ 860 RLR_OBJ26_RelAx  " ";
CM_ SG_ 860 RLR_OBJ26_RelAy  " ";
CM_ SG_ 860 RLR_OBJ26_RelVx  " ";
CM_ SG_ 860 RLR_OBJ26_RelVy  " ";
CM_ SG_ 860 RLR_OBJ26_HeadingAngle  " ";
CM_ SG_ 860 RLR_OBJ26_Length  " ";
CM_ SG_ 860 RLR_OBJ26_Height  " ";
CM_ SG_ 860 RLR_OBJ26_Width  " ";
CM_ SG_ 860 RLR_OBJ26_Type  " ";
CM_ SG_ 860 RLR_OBJ26_Track_ID  " ";
CM_ SG_ 860 RLR_OBJ25_Track_Age  " ";
CM_ SG_ 860 RLR_OBJ25_ReRPointLoc  " ";
CM_ SG_ 860 RLR_OBJ25_ObstacleProb  " ";
CM_ SG_ 860 RLR_OBJ25_Measured  " ";
CM_ SG_ 860 RLR_OBJ25_ExistProb  " ";
CM_ SG_ 860 RLR_OBJ25_Location  " ";
CM_ SG_ 860 RLR_OBJ25_RelAx  " ";
CM_ SG_ 860 RLR_OBJ25_RelAy  " ";
CM_ SG_ 860 RLR_OBJ25_RelVx  " ";
CM_ SG_ 860 RLR_OBJ25_RelVy  " ";
CM_ SG_ 860 RLR_OBJ25_HeadingAngle  " ";
CM_ SG_ 860 RLR_OBJ25_Length  " ";
CM_ SG_ 860 RLR_OBJ25_Height  " ";
CM_ SG_ 860 RLR_OBJ25_Width  " ";
CM_ SG_ 860 RLR_OBJ25_Type  " ";
CM_ SG_ 860 RLR_OBJ25_Track_ID  " ";

CM_ BO_ 861  " ";
CM_ SG_ 861 RLR_OBJ28_LostCnt  " ";
CM_ SG_ 861 RLR_OBJ27_LostCnt  " ";
CM_ SG_ 861 RLR_OBJ28_Dx  " ";
CM_ SG_ 861 RLR_OBJ28_Dy  " ";
CM_ SG_ 861 RLR_OBJ27_Dx  " ";
CM_ SG_ 861 RLR_OBJ27_Dy  " ";
CM_ SG_ 861 RLR_OBJ28_Vx  " ";
CM_ SG_ 861 RLR_OBJ28_Vy  " ";
CM_ SG_ 861 RLR_OBJ28_Convergence  " ";
CM_ SG_ 861 RLR_OBJ28_DelayTime  " ";
CM_ SG_ 861 RLR_OBJ28_HeightGround  " ";
CM_ SG_ 861 RLR_OBJ28_MotionStatus  " ";
CM_ SG_ 861 RLR_OBJ28_RelVx_std  " ";
CM_ SG_ 861 RLR_OBJ28_RelVy_std  " ";
CM_ SG_ 861 RLR_OBJ28_Dx_Vnce  " ";
CM_ SG_ 861 RLR_OBJ28_Dy_Vnce  " ";
CM_ SG_ 861 RLR_OBJ27_Vx  " ";
CM_ SG_ 861 RLR_OBJ27_Vy  " ";
CM_ SG_ 861 RLR_OBJ27_Convergence  " ";
CM_ SG_ 861 RLR_OBJ27_DelayTime  " ";
CM_ SG_ 861 RLR_OBJ27_HeightGround  " ";
CM_ SG_ 861 RLR_OBJ27_MotionStatus  " ";
CM_ SG_ 861 RLR_OBJ27_RelVx_std  " ";
CM_ SG_ 861 RLR_OBJ27_RelVy_std  " ";
CM_ SG_ 861 RLR_OBJ27_Dx_Vnce  " ";
CM_ SG_ 861 RLR_OBJ27_Dy_Vnce  " ";
CM_ SG_ 861 RLR_CRCCheck_35D  " ";
CM_ SG_ 861 RLR_RollingCounter_35D  " ";
CM_ SG_ 861 RLR_OBJ28_Track_Age  " ";
CM_ SG_ 861 RLR_OBJ28_ReRPointLoc  " ";
CM_ SG_ 861 RLR_OBJ28_ObstacleProb  " ";
CM_ SG_ 861 RLR_OBJ28_Measured  " ";
CM_ SG_ 861 RLR_OBJ28_ExistProb  " ";
CM_ SG_ 861 RLR_OBJ28_Location  " ";
CM_ SG_ 861 RLR_OBJ28_RelAx  " ";
CM_ SG_ 861 RLR_OBJ28_RelAy  " ";
CM_ SG_ 861 RLR_OBJ28_RelVx  " ";
CM_ SG_ 861 RLR_OBJ28_RelVy  " ";
CM_ SG_ 861 RLR_OBJ28_HeadingAngle  " ";
CM_ SG_ 861 RLR_OBJ28_Length  " ";
CM_ SG_ 861 RLR_OBJ28_Height  " ";
CM_ SG_ 861 RLR_OBJ28_Width  " ";
CM_ SG_ 861 RLR_OBJ28_Type  " ";
CM_ SG_ 861 RLR_OBJ28_Track_ID  " ";
CM_ SG_ 861 RLR_OBJ27_Track_Age  " ";
CM_ SG_ 861 RLR_OBJ27_ReRPointLoc  " ";
CM_ SG_ 861 RLR_OBJ27_ObstacleProb  " ";
CM_ SG_ 861 RLR_OBJ27_Measured  " ";
CM_ SG_ 861 RLR_OBJ27_ExistProb  " ";
CM_ SG_ 861 RLR_OBJ27_Location  " ";
CM_ SG_ 861 RLR_OBJ27_RelAx  " ";
CM_ SG_ 861 RLR_OBJ27_RelAy  " ";
CM_ SG_ 861 RLR_OBJ27_RelVx  " ";
CM_ SG_ 861 RLR_OBJ27_RelVy  " ";
CM_ SG_ 861 RLR_OBJ27_HeadingAngle  " ";
CM_ SG_ 861 RLR_OBJ27_Length  " ";
CM_ SG_ 861 RLR_OBJ27_Height  " ";
CM_ SG_ 861 RLR_OBJ27_Width  " ";
CM_ SG_ 861 RLR_OBJ27_Type  " ";
CM_ SG_ 861 RLR_OBJ27_Track_ID  " ";

CM_ BO_ 862  " ";
CM_ SG_ 862 RLR_OBJ30_LostCnt  " ";
CM_ SG_ 862 RLR_OBJ29_LostCnt  " ";
CM_ SG_ 862 RLR_OBJ30_Dx  " ";
CM_ SG_ 862 RLR_OBJ30_Dy  " ";
CM_ SG_ 862 RLR_OBJ29_Dx  " ";
CM_ SG_ 862 RLR_OBJ29_Dy  " ";
CM_ SG_ 862 RLR_OBJ30_Vx  " ";
CM_ SG_ 862 RLR_OBJ30_Vy  " ";
CM_ SG_ 862 RLR_OBJ30_Convergence  " ";
CM_ SG_ 862 RLR_OBJ30_DelayTime  " ";
CM_ SG_ 862 RLR_OBJ30_HeightGround  " ";
CM_ SG_ 862 RLR_OBJ30_MotionStatus  " ";
CM_ SG_ 862 RLR_OBJ30_RelVx_std  " ";
CM_ SG_ 862 RLR_OBJ30_RelVy_std  " ";
CM_ SG_ 862 RLR_OBJ30_Dx_Vnce  " ";
CM_ SG_ 862 RLR_OBJ30_Dy_Vnce  " ";
CM_ SG_ 862 RLR_OBJ29_Vx  " ";
CM_ SG_ 862 RLR_OBJ29_Vy  " ";
CM_ SG_ 862 RLR_OBJ29_Convergence  " ";
CM_ SG_ 862 RLR_OBJ29_DelayTime  " ";
CM_ SG_ 862 RLR_OBJ29_HeightGround  " ";
CM_ SG_ 862 RLR_OBJ29_MotionStatus  " ";
CM_ SG_ 862 RLR_OBJ29_RelVx_std  " ";
CM_ SG_ 862 RLR_OBJ29_RelVy_std  " ";
CM_ SG_ 862 RLR_OBJ29_Dx_Vnce  " ";
CM_ SG_ 862 RLR_OBJ29_Dy_Vnce  " ";
CM_ SG_ 862 RLR_CRCCheck_35E  " ";
CM_ SG_ 862 RLR_RollingCounter_35E  " ";
CM_ SG_ 862 RLR_OBJ30_Track_Age  " ";
CM_ SG_ 862 RLR_OBJ30_ReRPointLoc  " ";
CM_ SG_ 862 RLR_OBJ30_ObstacleProb  " ";
CM_ SG_ 862 RLR_OBJ30_Measured  " ";
CM_ SG_ 862 RLR_OBJ30_ExistProb  " ";
CM_ SG_ 862 RLR_OBJ30_Location  " ";
CM_ SG_ 862 RLR_OBJ30_RelAx  " ";
CM_ SG_ 862 RLR_OBJ30_RelAy  " ";
CM_ SG_ 862 RLR_OBJ30_RelVx  " ";
CM_ SG_ 862 RLR_OBJ30_RelVy  " ";
CM_ SG_ 862 RLR_OBJ30_HeadingAngle  " ";
CM_ SG_ 862 RLR_OBJ30_Length  " ";
CM_ SG_ 862 RLR_OBJ30_Height  " ";
CM_ SG_ 862 RLR_OBJ30_Width  " ";
CM_ SG_ 862 RLR_OBJ30_Type  " ";
CM_ SG_ 862 RLR_OBJ30_Track_ID  " ";
CM_ SG_ 862 RLR_OBJ29_Track_Age  " ";
CM_ SG_ 862 RLR_OBJ29_ReRPointLoc  " ";
CM_ SG_ 862 RLR_OBJ29_ObstacleProb  " ";
CM_ SG_ 862 RLR_OBJ29_Measured  " ";
CM_ SG_ 862 RLR_OBJ29_ExistProb  " ";
CM_ SG_ 862 RLR_OBJ29_Location  " ";
CM_ SG_ 862 RLR_OBJ29_RelAx  " ";
CM_ SG_ 862 RLR_OBJ29_RelAy  " ";
CM_ SG_ 862 RLR_OBJ29_RelVx  " ";
CM_ SG_ 862 RLR_OBJ29_RelVy  " ";
CM_ SG_ 862 RLR_OBJ29_HeadingAngle  " ";
CM_ SG_ 862 RLR_OBJ29_Length  " ";
CM_ SG_ 862 RLR_OBJ29_Height  " ";
CM_ SG_ 862 RLR_OBJ29_Width  " ";
CM_ SG_ 862 RLR_OBJ29_Type  " ";
CM_ SG_ 862 RLR_OBJ29_Track_ID  " ";

CM_ BO_ 863  " ";
CM_ SG_ 863 RLR_OBJ32_LostCnt  " ";
CM_ SG_ 863 RLR_OBJ31_LostCnt  " ";
CM_ SG_ 863 RLR_OBJ32_Dx  " ";
CM_ SG_ 863 RLR_OBJ32_Dy  " ";
CM_ SG_ 863 RLR_OBJ31_Dx  " ";
CM_ SG_ 863 RLR_OBJ31_Dy  " ";
CM_ SG_ 863 RLR_OBJ32_Vx  " ";
CM_ SG_ 863 RLR_OBJ32_Vy  " ";
CM_ SG_ 863 RLR_OBJ32_Convergence  " ";
CM_ SG_ 863 RLR_OBJ32_DelayTime  " ";
CM_ SG_ 863 RLR_OBJ32_HeightGround  " ";
CM_ SG_ 863 RLR_OBJ32_MotionStatus  " ";
CM_ SG_ 863 RLR_OBJ32_RelVx_std  " ";
CM_ SG_ 863 RLR_OBJ32_RelVy_std  " ";
CM_ SG_ 863 RLR_OBJ32_Dx_Vnce  " ";
CM_ SG_ 863 RLR_OBJ32_Dy_Vnce  " ";
CM_ SG_ 863 RLR_OBJ31_Vx  " ";
CM_ SG_ 863 RLR_OBJ31_Vy  " ";
CM_ SG_ 863 RLR_OBJ31_Convergence  " ";
CM_ SG_ 863 RLR_OBJ31_DelayTime  " ";
CM_ SG_ 863 RLR_OBJ31_HeightGround  " ";
CM_ SG_ 863 RLR_OBJ31_MotionStatus  " ";
CM_ SG_ 863 RLR_OBJ31_RelVx_std  " ";
CM_ SG_ 863 RLR_OBJ31_RelVy_std  " ";
CM_ SG_ 863 RLR_OBJ31_Dx_Vnce  " ";
CM_ SG_ 863 RLR_OBJ31_Dy_Vnce  " ";
CM_ SG_ 863 RLR_CRCCheck_35R  " ";
CM_ SG_ 863 RLR_RollingCounter_35R  " ";
CM_ SG_ 863 RLR_OBJ32_Track_Age  " ";
CM_ SG_ 863 RLR_OBJ32_ReRPointLoc  " ";
CM_ SG_ 863 RLR_OBJ32_ObstacleProb  " ";
CM_ SG_ 863 RLR_OBJ32_Measured  " ";
CM_ SG_ 863 RLR_OBJ32_ExistProb  " ";
CM_ SG_ 863 RLR_OBJ32_Location  " ";
CM_ SG_ 863 RLR_OBJ32_RelAx  " ";
CM_ SG_ 863 RLR_OBJ32_RelAy  " ";
CM_ SG_ 863 RLR_OBJ32_RelVx  " ";
CM_ SG_ 863 RLR_OBJ32_RelVy  " ";
CM_ SG_ 863 RLR_OBJ32_HeadingAngle  " ";
CM_ SG_ 863 RLR_OBJ32_Length  " ";
CM_ SG_ 863 RLR_OBJ32_Height  " ";
CM_ SG_ 863 RLR_OBJ32_Width  " ";
CM_ SG_ 863 RLR_OBJ32_Type  " ";
CM_ SG_ 863 RLR_OBJ32_Track_ID  " ";
CM_ SG_ 863 RLR_OBJ31_Track_Age  " ";
CM_ SG_ 863 RLR_OBJ31_ReRPointLoc  " ";
CM_ SG_ 863 RLR_OBJ31_ObstacleProb  " ";
CM_ SG_ 863 RLR_OBJ31_Measured  " ";
CM_ SG_ 863 RLR_OBJ31_ExistProb  " ";
CM_ SG_ 863 RLR_OBJ31_Location  " ";
CM_ SG_ 863 RLR_OBJ31_RelAx  " ";
CM_ SG_ 863 RLR_OBJ31_RelAy  " ";
CM_ SG_ 863 RLR_OBJ31_RelVx  " ";
CM_ SG_ 863 RLR_OBJ31_RelVy  " ";
CM_ SG_ 863 RLR_OBJ31_HeadingAngle  " ";
CM_ SG_ 863 RLR_OBJ31_Length  " ";
CM_ SG_ 863 RLR_OBJ31_Height  " ";
CM_ SG_ 863 RLR_OBJ31_Width  " ";
CM_ SG_ 863 RLR_OBJ31_Type  " ";
CM_ SG_ 863 RLR_OBJ31_Track_ID  " ";

CM_ BO_ 917  " ";
CM_ SG_ 917 RRGuardrailReadyFlag  " ";
CM_ SG_ 917 RLGuardrailReadyFlag  " ";
CM_ SG_ 917 RRR_CRCCheck_395  " ";
CM_ SG_ 917 RRR_RollingCounter_395  " ";
CM_ SG_ 917 RRR_LOC_RollingCounter  " ";
CM_ SG_ 917 RLR_RearRightGuardrailConRidenc  " ";
CM_ SG_ 917 RLR__RearRightGuardrail_End  " ";
CM_ SG_ 917 RLR__RearRightGuardrail_Start  " ";
CM_ SG_ 917 RLR_RearRightGuardrailC3  " ";
CM_ SG_ 917 RLR_RearRightGuardrailC2  " ";
CM_ SG_ 917 RLR_RearRightGuardrailC1  " ";
CM_ SG_ 917 RLR_RearRightGuardrailC0  " ";
CM_ SG_ 917 RLR_RearLeftGuardrailConRidence  " ";
CM_ SG_ 917 RLR__RearLeftGuardrail_End  " ";
CM_ SG_ 917 RLR__RearLeftGuardrail_Start  " ";
CM_ SG_ 917 RLR_RearLeftGuardrailC3  " ";
CM_ SG_ 917 RLR_RearLeftGuardrailC2  " ";
CM_ SG_ 917 RLR_RearLeftGuardrailC1  " ";
CM_ SG_ 917 RLR_RearLeftGuardrailC0  " ";

CM_ BO_ 943  " ";
CM_ SG_ 943 RRR_HwVers6  "ASCII码，命名规则按照《QJDT037-2019汽车产品零部件件号和名称编制规范》 ";
CM_ SG_ 943 RRR_HwVers5  "ASCII码，命名规则按照《QJDT037-2019汽车产品零部件件号和名称编制规范》 ";
CM_ SG_ 943 RRR_HwVers4  "ASCII码，命名规则按照《QJDT037-2019汽车产品零部件件号和名称编制规范》 ";
CM_ SG_ 943 RRR_HwVers3  "ASCII码，命名规则按照《QJDT037-2019汽车产品零部件件号和名称编制规范》 ";
CM_ SG_ 943 RRR_HwVers2  "ASCII码，命名规则按照《QJDT037-2019汽车产品零部件件号和名称编制规范》 ";
CM_ SG_ 943 RRR_HwVers1  "ASCII码，命名规则按照《QJDT037-2019汽车产品零部件件号和名称编制规范》 ";
CM_ SG_ 943 RRR_HwVers0  "ASCII码，命名规则按照《QJDT037-2019汽车产品零部件件号和名称编制规范》 ";
CM_ SG_ 943 RRR_SwVers6  "ASCII码，命名规则按照《QJDT037-2019汽车产品零部件件号和名称编制规范》 ";
CM_ SG_ 943 RRR_SwVers5  "ASCII码，命名规则按照《QJDT037-2019汽车产品零部件件号和名称编制规范》 ";
CM_ SG_ 943 RRR_SwVers4  "ASCII码，命名规则按照《QJDT037-2019汽车产品零部件件号和名称编制规范》 ";
CM_ SG_ 943 RRR_SwVers3  "ASCII码，命名规则按照《QJDT037-2019汽车产品零部件件号和名称编制规范》 ";
CM_ SG_ 943 RRR_SwVers2  "ASCII码，命名规则按照《QJDT037-2019汽车产品零部件件号和名称编制规范》 ";
CM_ SG_ 943 RRR_SwVers1  "ASCII码，命名规则按照《QJDT037-2019汽车产品零部件件号和名称编制规范》 ";
CM_ SG_ 943 RRR_SwVers0  "ASCII码，命名规则按照《QJDT037-2019汽车产品零部件件号和名称编制规范》 ";
CM_ SG_ 943 RLR_HwVers6  "ASCII码，命名规则按照《QJDT037-2019汽车产品零部件件号和名称编制规范》 ";
CM_ SG_ 943 RLR_HwVers5  "ASCII码，命名规则按照《QJDT037-2019汽车产品零部件件号和名称编制规范》 ";
CM_ SG_ 943 RLR_HwVers4  "ASCII码，命名规则按照《QJDT037-2019汽车产品零部件件号和名称编制规范》 ";
CM_ SG_ 943 RLR_HwVers3  "ASCII码，命名规则按照《QJDT037-2019汽车产品零部件件号和名称编制规范》 ";
CM_ SG_ 943 RLR_HwVers2  "ASCII码，命名规则按照《QJDT037-2019汽车产品零部件件号和名称编制规范》 ";
CM_ SG_ 943 RLR_HwVers1  "ASCII码，命名规则按照《QJDT037-2019汽车产品零部件件号和名称编制规范》 ";
CM_ SG_ 943 RLR_HwVers0  "ASCII码，命名规则按照《QJDT037-2019汽车产品零部件件号和名称编制规范》 ";
CM_ SG_ 943 RLR_SwVers6  "ASCII码，命名规则按照《QJDT037-2019汽车产品零部件件号和名称编制规范》 ";
CM_ SG_ 943 RLR_SwVers5  "ASCII码，命名规则按照《QJDT037-2019汽车产品零部件件号和名称编制规范》 ";
CM_ SG_ 943 RLR_SwVers4  "ASCII码，命名规则按照《QJDT037-2019汽车产品零部件件号和名称编制规范》 ";
CM_ SG_ 943 RLR_SwVers3  "ASCII码，命名规则按照《QJDT037-2019汽车产品零部件件号和名称编制规范》 ";
CM_ SG_ 943 RLR_SwVers2  "ASCII码，命名规则按照《QJDT037-2019汽车产品零部件件号和名称编制规范》 ";
CM_ SG_ 943 RLR_SwVers1  "ASCII码，命名规则按照《QJDT037-2019汽车产品零部件件号和名称编制规范》 ";
CM_ SG_ 943 RLR_SwVers0  "ASCII码，命名规则按照《QJDT037-2019汽车产品零部件件号和名称编制规范》 ";

CM_ BO_ 837  " ";
CM_ SG_ 837 RLR_BSDLCAMode  " ";
CM_ SG_ 837 RLR_AudioWarningEnableStatus  "非SDA小域控专用 ";
CM_ SG_ 837 RLR_SEAEnableStatus  "非SDA小域控专用 ";
CM_ SG_ 837 RLR_BSD_LCASoundWar  " ";
CM_ SG_ 837 RLR_LDWShakeLevStatus  " ";
CM_ SG_ 837 RLR_EmergencyLightingRequest  "低配独有 ";
CM_ SG_ 837 RLR_LDWVibrationWarningReq  "低配独有 ";
CM_ SG_ 837 RLR_RearColliAstType  "低配独有 ";
CM_ SG_ 837 RLR_SEAModeStatus  "低配独有 ";
CM_ SG_ 837 RLR_SEAOnOffSts  "低配独有 ";
CM_ SG_ 837 RLR_BSDLCASetting  "低配独有 ";
CM_ SG_ 837 RLR_BSDLCARemindmode  "低配独有 ";
CM_ SG_ 837 RLR_BSDLCAOnOff  "低配独有 ";
CM_ SG_ 837 RLR_RCWEnableStatus  "低配独有 ";
CM_ SG_ 837 RLR_RCTAEnableStatus  "低配独有 ";
CM_ SG_ 837 RLR_AEBVehilceHoldReq  "低配独有 ";
CM_ SG_ 837 RLR_RCTBTargetDecel  "低配独有 ";
CM_ SG_ 837 RLR_RCTBEnable  "低配独有 ";
CM_ SG_ 837 RLR_BSD_LCAEnableStatus  "低配独有 ";
CM_ SG_ 837 RLR_SEAStatus  "低配独有 ";
CM_ SG_ 837 RLR_RCWStatus  "低配独有 ";
CM_ SG_ 837 RLR_BSD_LCAStatus  "低配独有 ";
CM_ SG_ 837 RLR_RCTBStatus  "低配独有 ";
CM_ SG_ 837 RLR_RCTAStatus  "低配独有 ";
CM_ SG_ 837 RLR_Left_BSD_LCAAlert  "低配独有 ";
CM_ SG_ 837 RLR_SEAAlert  "低配独有 ";
CM_ SG_ 837 RLR_RCWAlert  "低配独有 ";
CM_ SG_ 837 RLR_DOWLeftAlert  "低配独有 ";
CM_ SG_ 837 RLR_BSD_LCAAlert  "低配独有 ";
CM_ SG_ 837 RLR_RCTBActive  "低配独有 ";
CM_ SG_ 837 RLR_Right_SEAAlert  "低配独有 ";
CM_ SG_ 837 RLR_Right_RCWAlert  "低配独有 ";
CM_ SG_ 837 RLR_DOWRightAlert  "低配独有 ";
CM_ SG_ 837 RLR_Left_RCTAAlert  "低配独有 ";
CM_ SG_ 837 RLR_Right_RCTAAlert  "低配独有 ";

CM_ BO_ 692  " ";
CM_ SG_ 692 RLR_CRCCheck_2B4  " ";
CM_ SG_ 692 RLR_RollingCounter_2B4  " ";
CM_ SG_ 692 FuncDegradeType_RL  " ";
CM_ SG_ 692 FUSION_TimeoutCnt_RL  " ";
CM_ SG_ 692 VALIDATION_TimeoutCnt_RL  " ";
CM_ SG_ 692 CurFrameCycle_RL  " ";
CM_ SG_ 692 ProcessTimeoutCnt_RL  " ";
CM_ SG_ 692 RevFrameCnt_RL  " ";
CM_ SG_ 692 Local_Pointcloud_Number_RL  " ";
CM_ SG_ 692 RealTimeCal_PrcssBar_RL  " ";
CM_ SG_ 692 RealTimeCal_VelErrOutput_RL  " ";
CM_ SG_ 692 RealTimeCal_HoriMntErrOutput_RL  " ";
CM_ SG_ 692 RealTimeCal_FailReasonCode_RL  " ";
CM_ SG_ 692 RealTimeCal_Status_RL  " ";
CM_ SG_ 692 DiagCal_PrcssBar_RL  " ";
CM_ SG_ 692 DiagCal_VelErrOutput_RL  " ";
CM_ SG_ 692 DiagCal_HoriMntErrOutput_RL  " ";
CM_ SG_ 692 DiagCal_FailReasonCode_RL  " ";
CM_ SG_ 692 DiagCal_Status_RL  " ";
CM_ SG_ 692 EolCal_PrcssBar_RL  " ";
CM_ SG_ 692 EolCal_VelErrOutput_RL  " ";
CM_ SG_ 692 EolCal_HoriMntErrOutput_RL  " ";
CM_ SG_ 692 EolCal_FailReasonCode_RL  " ";
CM_ SG_ 692 EolCal_Status_RL  " ";
CM_ SG_ 692 PriCounter_RL  " ";
CM_ SG_ 692 MsgCounter_RL  " ";

CM_ BO_ 587  " ";
CM_ SG_ 587 Transmitcnt6_R  " ";
CM_ SG_ 587 Transmitcnt5_R  " ";
CM_ SG_ 587 Transmitcnt4_R  " ";
CM_ SG_ 587 Transmitcnt3_R  " ";
CM_ SG_ 587 Transmitcnt2_R  " ";
CM_ SG_ 587 Transmitcnt1_R  " ";
CM_ SG_ 587 RLR_Track_ID_R  " ";
CM_ SG_ 587 RLR_Measured_R  " ";
CM_ SG_ 587 RLR_Location_R  " ";
CM_ SG_ 587 RLR_ClassComfrmFlg_R  " ";
CM_ SG_ 587 RLR_TrckrType_R  " ";
CM_ SG_ 587 RLR_TrckrAge_R  " ";
CM_ SG_ 587 RLR_MotionStatus_R  " ";
CM_ SG_ 587 RLR_AbsVy_R  " ";
CM_ SG_ 587 RLR_AbsoVx_R  " ";
CM_ SG_ 587 RLR_LocDx_R  " ";
CM_ SG_ 587 RLR_LocDy_R  " ";
CM_ SG_ 587 RLR_HeadingAngle_R  " ";
CM_ SG_ 587 RLR_Length_R  " ";
CM_ SG_ 587 RLR_Width_R  " ";
CM_ SG_ 587 RLR_Track_ID_L  " ";
CM_ SG_ 587 RLR_Measured_L  " ";
CM_ SG_ 587 RLR_Location_L  " ";
CM_ SG_ 587 RLR_ClassComfrmFlg_L  " ";
CM_ SG_ 587 RLR_TrckrType_L  " ";
CM_ SG_ 587 RLR_TrckrAge_L  " ";
CM_ SG_ 587 RLR_MotionStatus_L  " ";
CM_ SG_ 587 RLR_AbsVy_L  " ";
CM_ SG_ 587 RLR_AbsoVx_L  " ";
CM_ SG_ 587 RLR_LocDx_L  " ";
CM_ SG_ 587 RLR_LocDy_L  " ";
CM_ SG_ 587 RLR_HeadingAngle_L  " ";
CM_ SG_ 587 RLR_Length_L  " ";
CM_ SG_ 587 RLR_Width_L  " ";
CM_ SG_ 587 RLR_TrckrNum  " ";
CM_ SG_ 587 RLR_TrackerTimeStamp  " ";

CM_ BO_ 695  " ";
CM_ SG_ 695 RLR_CRCCheck_2B7  " ";
CM_ SG_ 695 RLR_RollingCounter_2B7  " ";
CM_ SG_ 695 RLR_OBJ32_lAy  " ";
CM_ SG_ 695 RLR_OBJ31_lAy  " ";
CM_ SG_ 695 RLR_OBJ30_lAy  " ";
CM_ SG_ 695 RLR_OBJ29_lAy  " ";
CM_ SG_ 695 RLR_OBJ28_lAy  " ";
CM_ SG_ 695 RLR_OBJ27_lAy  " ";
CM_ SG_ 695 RLR_OBJ26_lAy  " ";
CM_ SG_ 695 RLR_OBJ25_lAy  " ";
CM_ SG_ 695 RLR_OBJ24_lAy  " ";
CM_ SG_ 695 RLR_OBJ23_lAy  " ";
CM_ SG_ 695 RLR_OBJ22_lAy  " ";
CM_ SG_ 695 RLR_OBJ21_lAy  " ";
CM_ SG_ 695 RLR_OBJ20_lAy  " ";
CM_ SG_ 695 RLR_OBJ19_lAy  " ";
CM_ SG_ 695 RLR_OBJ18_lAy  " ";
CM_ SG_ 695 RLR_OBJ17_lAy  " ";
CM_ SG_ 695 RLR_OBJ16_lAy  " ";
CM_ SG_ 695 RLR_OBJ15_lAy  " ";
CM_ SG_ 695 RLR_OBJ14_lAy  " ";
CM_ SG_ 695 RLR_OBJ13_lAy  " ";
CM_ SG_ 695 RLR_OBJ12_lAy  " ";
CM_ SG_ 695 RLR_OBJ11_lAy  " ";
CM_ SG_ 695 RLR_OBJ10_lAy  " ";
CM_ SG_ 695 RLR_OBJ9_lAy  " ";
CM_ SG_ 695 RLR_OBJ8_lAy  " ";
CM_ SG_ 695 RLR_OBJ7_lAy  " ";
CM_ SG_ 695 RLR_OBJ6_lAy  " ";
CM_ SG_ 695 RLR_OBJ5_lAy  " ";
CM_ SG_ 695 RLR_OBJ4_lAy  " ";
CM_ SG_ 695 RLR_OBJ3_lAy  " ";
CM_ SG_ 695 RLR_OBJ2_lAy  " ";
CM_ SG_ 695 RLR_OBJ1_lAy  " ";

CM_ BO_ 841  "右后雷达的点云/FS的时钟同步 ";
CM_ SG_ 841 RRR_Suppliers  " ";
CM_ SG_ 841 RRR_RS_TiOut  " ";
CM_ SG_ 841 RRR_RS_TiLeap  " ";
CM_ SG_ 841 RRR_RS_TiBas  " ";
CM_ SG_ 841 RRR_RS_TiStamp  " ";
CM_ SG_ 841 RRR_CRCCheck_349  " ";
CM_ SG_ 841 RRR_RollingCounter_349  " ";
CM_ SG_ 841 RRR_ECU_TiOut  " ";
CM_ SG_ 841 RRR_ECU_TiLeap  " ";
CM_ SG_ 841 RRR_ECU_TiBas  " ";
CM_ SG_ 841 RRR_ECU_TiStamp  " ";
CM_ SG_ 841 RRR_MCUTiStamp  " ";
CM_ SG_ 841 RRR_SyncTiStamp  " ";
CM_ SG_ 841 RRR_WorkMode  " ";
CM_ SG_ 841 RRR_ObjDelay  " ";
CM_ SG_ 841 RRR_SystemStatus  " ";

CM_ BO_ 922  " ";
CM_ SG_ 922 RLR_CRCCheck_39A  " ";
CM_ SG_ 922 RLR_RollingCounter_39A  " ";
CM_ SG_ 922 RLR_FreespaceSectorKinestate34  " ";
CM_ SG_ 922 RLR_FreespaceSectorConRidence34  " ";
CM_ SG_ 922 RLR_FreespaceSectorDistance34  " ";
CM_ SG_ 922 RLR_FreespaceSectorKinestate33  " ";
CM_ SG_ 922 RLR_FreespaceSectorConRidence33  " ";
CM_ SG_ 922 RLR_FreespaceSectorDistance33  " ";
CM_ SG_ 922 RLR_FreespaceSectorKinestate32  " ";
CM_ SG_ 922 RLR_FreespaceSectorConRidence32  " ";
CM_ SG_ 922 RLR_FreespaceSectorDistance32  " ";
CM_ SG_ 922 RLR_FreespaceSectorKinestate31  " ";
CM_ SG_ 922 RLR_FreespaceSectorConRidence31  " ";
CM_ SG_ 922 RLR_FreespaceSectorDistance31  " ";
CM_ SG_ 922 RLR_FreespaceSectorKinestate30  " ";
CM_ SG_ 922 RLR_FreespaceSectorConRidence30  " ";
CM_ SG_ 922 RLR_FreespaceSectorDistance30  " ";
CM_ SG_ 922 RLR_FreespaceSectorKinestate29  " ";
CM_ SG_ 922 RLR_FreespaceSectorConRidence29  " ";
CM_ SG_ 922 RLR_FreespaceSectorDistance29  " ";
CM_ SG_ 922 RLR_FreespaceSectorKinestate28  " ";
CM_ SG_ 922 RLR_FreespaceSectorConRidence28  " ";
CM_ SG_ 922 RLR_FreespaceSectorDistance28  " ";
CM_ SG_ 922 RLR_FreespaceSectorKinestate27  " ";
CM_ SG_ 922 RLR_FreespaceSectorConRidence27  " ";
CM_ SG_ 922 RLR_FreespaceSectorDistance27  " ";
CM_ SG_ 922 RLR_FreespaceSectorKinestate26  " ";
CM_ SG_ 922 RLR_FreespaceSectorConRidence26  " ";
CM_ SG_ 922 RLR_FreespaceSectorDistance26  " ";
CM_ SG_ 922 RLR_FreespaceSectorKinestate25  " ";
CM_ SG_ 922 RLR_FreespaceSectorConRidence25  " ";
CM_ SG_ 922 RLR_FreespaceSectorDistance25  " ";
CM_ SG_ 922 RLR_FreespaceSectorKinestate24  " ";
CM_ SG_ 922 RLR_FreespaceSectorConRidence24  " ";
CM_ SG_ 922 RLR_FreespaceSectorDistance24  " ";
CM_ SG_ 922 RLR_FreespaceSectorKinestate23  " ";
CM_ SG_ 922 RLR_FreespaceSectorConRidence23  " ";
CM_ SG_ 922 RLR_FreespaceSectorDistance23  " ";
CM_ SG_ 922 RLR_FreespaceSectorKinestate22  " ";
CM_ SG_ 922 RLR_FreespaceSectorConRidence22  " ";
CM_ SG_ 922 RLR_FreespaceSectorDistance22  " ";
CM_ SG_ 922 RLR_FreespaceSectorKinestate21  " ";
CM_ SG_ 922 RLR_FreespaceSectorConRidence21  " ";
CM_ SG_ 922 RLR_FreespaceSectorDistance21  " ";
CM_ SG_ 922 RLR_FreespaceSectorKinestate20  " ";
CM_ SG_ 922 RLR_FreespaceSectorConRidence20  " ";
CM_ SG_ 922 RLR_FreespaceSectorDistance20  " ";
CM_ SG_ 922 RLR_FreespaceSectorKinestate19  " ";
CM_ SG_ 922 RLR_FreespaceSectorConRidence19  " ";
CM_ SG_ 922 RLR_FreespaceSectorDistance19  " ";
CM_ SG_ 922 RLR_FreespaceSectorKinestate18  " ";
CM_ SG_ 922 RLR_FreespaceSectorConRidence18  " ";
CM_ SG_ 922 RLR_FreespaceSectorDistance18  " ";
CM_ SG_ 922 RLR_FreespaceSectorKinestate17  " ";
CM_ SG_ 922 RLR_FreespaceSectorConRidence17  " ";
CM_ SG_ 922 RLR_FreespaceSectorDistance17  " ";
CM_ SG_ 922 RLR_FreespaceSectorKinestate16  " ";
CM_ SG_ 922 RLR_FreespaceSectorConRidence16  " ";
CM_ SG_ 922 RLR_FreespaceSectorDistance16  " ";
CM_ SG_ 922 RLR_FreespaceSectorKinestate15  " ";
CM_ SG_ 922 RLR_FreespaceSectorConRidence15  " ";
CM_ SG_ 922 RLR_FreespaceSectorDistance15  " ";
CM_ SG_ 922 RLR_FreespaceSectorKinestate14  " ";
CM_ SG_ 922 RLR_FreespaceSectorConRidence14  " ";
CM_ SG_ 922 RLR_FreespaceSectorDistance14  " ";
CM_ SG_ 922 RLR_FreespaceSectorKinestate13  " ";
CM_ SG_ 922 RLR_FreespaceSectorConRidence13  " ";
CM_ SG_ 922 RLR_FreespaceSectorDistance13  " ";
CM_ SG_ 922 RLR_FreespaceSectorKinestate12  " ";
CM_ SG_ 922 RLR_FreespaceSectorConRidence12  " ";
CM_ SG_ 922 RLR_FreespaceSectorDistance12  " ";
CM_ SG_ 922 RLR_FreespaceSectorKinestate11  " ";
CM_ SG_ 922 RLR_FreespaceSectorConRidence11  " ";
CM_ SG_ 922 RLR_FreespaceSectorDistance11  " ";
CM_ SG_ 922 RLR_FreespaceSectorKinestate10  " ";
CM_ SG_ 922 RLR_FreespaceSectorConRidence10  " ";
CM_ SG_ 922 RLR_FreespaceSectorDistance10  " ";
CM_ SG_ 922 RLR_FreespaceSectorKinestate9  " ";
CM_ SG_ 922 RLR_FreespaceSectorConRidence9  " ";
CM_ SG_ 922 RLR_FreespaceSectorDistance9  " ";
CM_ SG_ 922 RLR_FreespaceSectorKinestate8  " ";
CM_ SG_ 922 RLR_FreespaceSectorConRidence8  " ";
CM_ SG_ 922 RLR_FreespaceSectorDistance8  " ";
CM_ SG_ 922 RLR_FreespaceSectorKinestate7  " ";
CM_ SG_ 922 RLR_FreespaceSectorConRidence7  " ";
CM_ SG_ 922 RLR_FreespaceSectorDistance7  " ";
CM_ SG_ 922 RLR_FreespaceSectorKinestate6  " ";
CM_ SG_ 922 RLR_FreespaceSectorConRidence6  " ";
CM_ SG_ 922 RLR_FreespaceSectorDistance6  " ";
CM_ SG_ 922 RLR_FreespaceSectorKinestate5  " ";
CM_ SG_ 922 RLR_FreespaceSectorConRidence5  " ";
CM_ SG_ 922 RLR_FreespaceSectorDistance5  " ";
CM_ SG_ 922 RLR_FreespaceSectorKinestate4  " ";
CM_ SG_ 922 RLR_FreespaceSectorConRidence4  " ";
CM_ SG_ 922 RLR_FreespaceSectorDistance4  " ";
CM_ SG_ 922 RLR_FreespaceSectorKinestate3  " ";
CM_ SG_ 922 RLR_FreespaceSectorConRidence3  " ";
CM_ SG_ 922 RLR_FreespaceSectorDistance3  " ";
CM_ SG_ 922 RLR_FreespaceSectorKinestate2  " ";
CM_ SG_ 922 RLR_FreespaceSectorConRidence2  " ";
CM_ SG_ 922 RLR_FreespaceSectorDistance2  " ";
CM_ SG_ 922 RLR_FreespaceSectorKinestate1  " ";
CM_ SG_ 922 RLR_FreespaceSectorConRidence1  " ";
CM_ SG_ 922 RLR_FreespaceSectorDistance1  " ";

CM_ BO_ 923  " ";
CM_ SG_ 923 RLR_CRCCheck_39B  " ";
CM_ SG_ 923 RLR_RollingCounter_39B  " ";
CM_ SG_ 923 RLR_FreespaceSectorKinestate68  " ";
CM_ SG_ 923 RLR_FreespaceSectorConRidence68  " ";
CM_ SG_ 923 RLR_FreespaceSectorDistance68  " ";
CM_ SG_ 923 RLR_FreespaceSectorKinestate67  " ";
CM_ SG_ 923 RLR_FreespaceSectorConRidence67  " ";
CM_ SG_ 923 RLR_FreespaceSectorDistance67  " ";
CM_ SG_ 923 RLR_FreespaceSectorKinestate66  " ";
CM_ SG_ 923 RLR_FreespaceSectorConRidence66  " ";
CM_ SG_ 923 RLR_FreespaceSectorDistance66  " ";
CM_ SG_ 923 RLR_FreespaceSectorKinestate65  " ";
CM_ SG_ 923 RLR_FreespaceSectorConRidence65  " ";
CM_ SG_ 923 RLR_FreespaceSectorDistance65  " ";
CM_ SG_ 923 RLR_FreespaceSectorKinestate64  " ";
CM_ SG_ 923 RLR_FreespaceSectorConRidence64  " ";
CM_ SG_ 923 RLR_FreespaceSectorDistance64  " ";
CM_ SG_ 923 RLR_FreespaceSectorKinestate63  " ";
CM_ SG_ 923 RLR_FreespaceSectorConRidence63  " ";
CM_ SG_ 923 RLR_FreespaceSectorDistance63  " ";
CM_ SG_ 923 RLR_FreespaceSectorKinestate62  " ";
CM_ SG_ 923 RLR_FreespaceSectorConRidence62  " ";
CM_ SG_ 923 RLR_FreespaceSectorDistance62  " ";
CM_ SG_ 923 RLR_FreespaceSectorKinestate61  " ";
CM_ SG_ 923 RLR_FreespaceSectorConRidence61  " ";
CM_ SG_ 923 RLR_FreespaceSectorDistance61  " ";
CM_ SG_ 923 RLR_FreespaceSectorKinestate60  " ";
CM_ SG_ 923 RLR_FreespaceSectorConRidence60  " ";
CM_ SG_ 923 RLR_FreespaceSectorDistance60  " ";
CM_ SG_ 923 RLR_FreespaceSectorKinestate59  " ";
CM_ SG_ 923 RLR_FreespaceSectorConRidence59  " ";
CM_ SG_ 923 RLR_FreespaceSectorDistance59  " ";
CM_ SG_ 923 RLR_FreespaceSectorKinestate58  " ";
CM_ SG_ 923 RLR_FreespaceSectorConRidence58  " ";
CM_ SG_ 923 RLR_FreespaceSectorDistance58  " ";
CM_ SG_ 923 RLR_FreespaceSectorKinestate57  " ";
CM_ SG_ 923 RLR_FreespaceSectorConRidence57  " ";
CM_ SG_ 923 RLR_FreespaceSectorDistance57  " ";
CM_ SG_ 923 RLR_FreespaceSectorKinestate56  " ";
CM_ SG_ 923 RLR_FreespaceSectorConRidence56  " ";
CM_ SG_ 923 RLR_FreespaceSectorDistance56  " ";
CM_ SG_ 923 RLR_FreespaceSectorKinestate55  " ";
CM_ SG_ 923 RLR_FreespaceSectorConRidence55  " ";
CM_ SG_ 923 RLR_FreespaceSectorDistance55  " ";
CM_ SG_ 923 RLR_FreespaceSectorKinestate54  " ";
CM_ SG_ 923 RLR_FreespaceSectorConRidence54  " ";
CM_ SG_ 923 RLR_FreespaceSectorDistance54  " ";
CM_ SG_ 923 RLR_FreespaceSectorKinestate53  " ";
CM_ SG_ 923 RLR_FreespaceSectorConRidence53  " ";
CM_ SG_ 923 RLR_FreespaceSectorDistance53  " ";
CM_ SG_ 923 RLR_FreespaceSectorKinestate52  " ";
CM_ SG_ 923 RLR_FreespaceSectorConRidence52  " ";
CM_ SG_ 923 RLR_FreespaceSectorDistance52  " ";
CM_ SG_ 923 RLR_FreespaceSectorKinestate51  " ";
CM_ SG_ 923 RLR_FreespaceSectorConRidence51  " ";
CM_ SG_ 923 RLR_FreespaceSectorDistance51  " ";
CM_ SG_ 923 RLR_FreespaceSectorKinestate50  " ";
CM_ SG_ 923 RLR_FreespaceSectorConRidence50  " ";
CM_ SG_ 923 RLR_FreespaceSectorDistance50  " ";
CM_ SG_ 923 RLR_FreespaceSectorKinestate49  " ";
CM_ SG_ 923 RLR_FreespaceSectorConRidence49  " ";
CM_ SG_ 923 RLR_FreespaceSectorDistance49  " ";
CM_ SG_ 923 RLR_FreespaceSectorKinestate48  " ";
CM_ SG_ 923 RLR_FreespaceSectorConRidence48  " ";
CM_ SG_ 923 RLR_FreespaceSectorDistance48  " ";
CM_ SG_ 923 RLR_FreespaceSectorKinestate47  " ";
CM_ SG_ 923 RLR_FreespaceSectorConRidence47  " ";
CM_ SG_ 923 RLR_FreespaceSectorDistance47  " ";
CM_ SG_ 923 RLR_FreespaceSectorKinestate46  " ";
CM_ SG_ 923 RLR_FreespaceSectorConRidence46  " ";
CM_ SG_ 923 RLR_FreespaceSectorDistance46  " ";
CM_ SG_ 923 RLR_FreespaceSectorKinestate45  " ";
CM_ SG_ 923 RLR_FreespaceSectorConRidence45  " ";
CM_ SG_ 923 RLR_FreespaceSectorDistance45  " ";
CM_ SG_ 923 RLR_FreespaceSectorKinestate44  " ";
CM_ SG_ 923 RLR_FreespaceSectorConRidence44  " ";
CM_ SG_ 923 RLR_FreespaceSectorDistance44  " ";
CM_ SG_ 923 RLR_FreespaceSectorKinestate43  " ";
CM_ SG_ 923 RLR_FreespaceSectorConRidence43  " ";
CM_ SG_ 923 RLR_FreespaceSectorDistance43  " ";
CM_ SG_ 923 RLR_FreespaceSectorKinestate42  " ";
CM_ SG_ 923 RLR_FreespaceSectorConRidence42  " ";
CM_ SG_ 923 RLR_FreespaceSectorDistance42  " ";
CM_ SG_ 923 RLR_FreespaceSectorKinestate41  " ";
CM_ SG_ 923 RLR_FreespaceSectorConRidence41  " ";
CM_ SG_ 923 RLR_FreespaceSectorDistance41  " ";
CM_ SG_ 923 RLR_FreespaceSectorKinestate40  " ";
CM_ SG_ 923 RLR_FreespaceSectorConRidence40  " ";
CM_ SG_ 923 RLR_FreespaceSectorDistance40  " ";
CM_ SG_ 923 RLR_FreespaceSectorKinestate39  " ";
CM_ SG_ 923 RLR_FreespaceSectorConRidence39  " ";
CM_ SG_ 923 RLR_FreespaceSectorDistance39  " ";
CM_ SG_ 923 RLR_FreespaceSectorKinestate38  " ";
CM_ SG_ 923 RLR_FreespaceSectorConRidence38  " ";
CM_ SG_ 923 RLR_FreespaceSectorDistance38  " ";
CM_ SG_ 923 RLR_FreespaceSectorKinestate37  " ";
CM_ SG_ 923 RLR_FreespaceSectorConRidence37  " ";
CM_ SG_ 923 RLR_FreespaceSectorDistance37  " ";
CM_ SG_ 923 RLR_FreespaceSectorKinestate36  " ";
CM_ SG_ 923 RLR_FreespaceSectorConRidence36  " ";
CM_ SG_ 923 RLR_FreespaceSectorDistance36  " ";
CM_ SG_ 923 RLR_FreespaceSectorKinestate35  " ";
CM_ SG_ 923 RLR_FreespaceSectorConRidence35  " ";
CM_ SG_ 923 RLR_FreespaceSectorDistance35  " ";

BA_DEF_ SG_  "GenSigStartValue" INT 0 0;
BA_DEF_ SG_  "GenSigInvalidValue" STRING  ;
BA_DEF_ SG_  "GenSigCycleTime" INT 0 0;
BA_DEF_ SG_  "GenSigSendType" ENUM  "Cyclic","OnWrite","OnWriteWithRepetition","OnChange","OnChangeWithRepetition","IfActive","IfActiveWithRepetition","NoSigSendType","NotUsed","NotUsed","NotUsed","NotUsed","NotUsed";
BA_DEF_ BO_  "GenMsgSendType" ENUM  "Cyclic","Event","Direct","NotUsed","NotUsed","Cyclic","NotUsed","IfActive","NoMsgSendType","NotUsed";
BA_DEF_ BO_  "GenMsgILSupport" ENUM  "No","Yes";
BA_DEF_ BO_  "GenMsgCycleTime" INT 0 65535;
BA_DEF_ BO_  "CANFD_BRS" ENUM  "0","1";
BA_DEF_ BO_  "VFrameFormat" ENUM  "StandardCAN","ExtendedCAN","reserved","reserved","reserved","reserved","reserved","reserved","reserved","reserved","reserved","reserved","reserved","reserved","StandardCAN_FD","ExtendedCAN_FD";
BA_DEF_DEF_  "GenSigStartValue" 0;
BA_DEF_DEF_  "GenSigInvalidValue" "/";
BA_DEF_DEF_  "GenSigCycleTime" 0;
BA_DEF_DEF_  "GenSigSendType" "Cyclic";
BA_DEF_DEF_  "GenMsgSendType" "NoMsgSendType";
BA_DEF_DEF_  "GenMsgILSupport" "Yes";
BA_DEF_DEF_  "GenMsgCycleTime" 0;
BA_DEF_DEF_  "CANFD_BRS" "1";
BA_DEF_DEF_  "VFrameFormat" "StandardCAN";
BA_ "GenMsgCycleTime" BO_ 859 50;
BA_ "GenMsgSendType" BO_ 859 0;
BA_ "VFrameFormat" BO_ 859 14;
BA_ "GenMsgCycleTime" BO_ 860 50;
BA_ "GenMsgSendType" BO_ 860 0;
BA_ "VFrameFormat" BO_ 860 14;
BA_ "GenMsgCycleTime" BO_ 861 50;
BA_ "GenMsgSendType" BO_ 861 0;
BA_ "VFrameFormat" BO_ 861 14;
BA_ "GenMsgCycleTime" BO_ 862 50;
BA_ "GenMsgSendType" BO_ 862 0;
BA_ "VFrameFormat" BO_ 862 14;
BA_ "GenMsgCycleTime" BO_ 863 50;
BA_ "GenMsgSendType" BO_ 863 0;
BA_ "VFrameFormat" BO_ 863 14;
BA_ "GenMsgCycleTime" BO_ 917 50;
BA_ "GenMsgSendType" BO_ 917 0;
BA_ "VFrameFormat" BO_ 917 14;
BA_ "GenMsgCycleTime" BO_ 943 1000;
BA_ "GenMsgSendType" BO_ 943 0;
BA_ "VFrameFormat" BO_ 943 14;
BA_ "GenMsgCycleTime" BO_ 837 50;
BA_ "GenMsgSendType" BO_ 837 0;
BA_ "VFrameFormat" BO_ 837 14;
BA_ "GenMsgCycleTime" BO_ 692 50;
BA_ "GenMsgSendType" BO_ 692 0;
BA_ "VFrameFormat" BO_ 692 14;
BA_ "GenMsgCycleTime" BO_ 587 50;
BA_ "GenMsgSendType" BO_ 587 0;
BA_ "VFrameFormat" BO_ 587 14;
BA_ "GenMsgCycleTime" BO_ 695 50;
BA_ "GenMsgSendType" BO_ 695 0;
BA_ "VFrameFormat" BO_ 695 14;
BA_ "GenMsgCycleTime" BO_ 841 50;
BA_ "GenMsgSendType" BO_ 841 0;
BA_ "VFrameFormat" BO_ 841 14;
BA_ "GenMsgCycleTime" BO_ 922 50;
BA_ "GenMsgSendType" BO_ 922 0;
BA_ "VFrameFormat" BO_ 922 14;
BA_ "GenMsgCycleTime" BO_ 923 50;
BA_ "GenMsgSendType" BO_ 923 0;
BA_ "VFrameFormat" BO_ 923 14;

BA_ "GenSigCycleTime" SG_ 859 RLR_OBJ24_LostCnt 50;
BA_ "GenSigCycleTime" SG_ 859 RLR_OBJ23_LostCnt 50;
BA_ "GenSigCycleTime" SG_ 859 RLR_OBJ24_Dx 50;
BA_ "GenSigCycleTime" SG_ 859 RLR_OBJ24_Dy 50;
BA_ "GenSigCycleTime" SG_ 859 RLR_OBJ23_Dx 50;
BA_ "GenSigCycleTime" SG_ 859 RLR_OBJ23_Dy 50;
BA_ "GenSigCycleTime" SG_ 859 RLR_OBJ24_Vx 50;
BA_ "GenSigCycleTime" SG_ 859 RLR_OBJ24_Vy 50;
BA_ "GenSigCycleTime" SG_ 859 RLR_OBJ24_Convergence 50;
BA_ "GenSigCycleTime" SG_ 859 RLR_OBJ24_DelayTime 50;
BA_ "GenSigCycleTime" SG_ 859 RLR_OBJ24_HeightGround 50;
BA_ "GenSigCycleTime" SG_ 859 RLR_OBJ24_MotionStatus 50;
BA_ "GenSigCycleTime" SG_ 859 RLR_OBJ24_RelVx_std 50;
BA_ "GenSigInvalidValue" SG_ 859 RLR_OBJ24_RelVx_std "4095";
BA_ "GenSigCycleTime" SG_ 859 RLR_OBJ24_RelVy_std 50;
BA_ "GenSigInvalidValue" SG_ 859 RLR_OBJ24_RelVy_std "1023";
BA_ "GenSigCycleTime" SG_ 859 RLR_OBJ24_Dx_Vnce 50;
BA_ "GenSigInvalidValue" SG_ 859 RLR_OBJ24_Dx_Vnce "16383";
BA_ "GenSigCycleTime" SG_ 859 RLR_OBJ24_Dy_Vnce 50;
BA_ "GenSigInvalidValue" SG_ 859 RLR_OBJ24_Dy_Vnce "1023";
BA_ "GenSigCycleTime" SG_ 859 RLR_OBJ23_Vx 50;
BA_ "GenSigCycleTime" SG_ 859 RLR_OBJ23_Vy 50;
BA_ "GenSigCycleTime" SG_ 859 RLR_OBJ23_Convergence 50;
BA_ "GenSigCycleTime" SG_ 859 RLR_OBJ23_DelayTime 50;
BA_ "GenSigCycleTime" SG_ 859 RLR_OBJ23_HeightGround 50;
BA_ "GenSigCycleTime" SG_ 859 RLR_OBJ23_MotionStatus 50;
BA_ "GenSigCycleTime" SG_ 859 RLR_OBJ23_RelVx_std 50;
BA_ "GenSigInvalidValue" SG_ 859 RLR_OBJ23_RelVx_std "4095";
BA_ "GenSigCycleTime" SG_ 859 RLR_OBJ23_RelVy_std 50;
BA_ "GenSigInvalidValue" SG_ 859 RLR_OBJ23_RelVy_std "1023";
BA_ "GenSigCycleTime" SG_ 859 RLR_OBJ23_Dx_Vnce 50;
BA_ "GenSigInvalidValue" SG_ 859 RLR_OBJ23_Dx_Vnce "16383";
BA_ "GenSigCycleTime" SG_ 859 RLR_OBJ23_Dy_Vnce 50;
BA_ "GenSigInvalidValue" SG_ 859 RLR_OBJ23_Dy_Vnce "1023";
BA_ "GenSigCycleTime" SG_ 859 RLR_CRCCheck_35B 50;
BA_ "GenSigCycleTime" SG_ 859 RLR_RollingCounter_35B 50;
BA_ "GenSigCycleTime" SG_ 859 RLR_OBJ24_Track_Age 50;
BA_ "GenSigCycleTime" SG_ 859 RLR_OBJ24_ReRPointLoc 50;
BA_ "GenSigCycleTime" SG_ 859 RLR_OBJ24_ObstacleProb 50;
BA_ "GenSigCycleTime" SG_ 859 RLR_OBJ24_Measured 50;
BA_ "GenSigInvalidValue" SG_ 859 RLR_OBJ24_Measured "0";
BA_ "GenSigCycleTime" SG_ 859 RLR_OBJ24_ExistProb 50;
BA_ "GenSigInvalidValue" SG_ 859 RLR_OBJ24_ExistProb "0";
BA_ "GenSigCycleTime" SG_ 859 RLR_OBJ24_Location 50;
BA_ "GenSigInvalidValue" SG_ 859 RLR_OBJ24_Location "0";
BA_ "GenSigCycleTime" SG_ 859 RLR_OBJ24_RelAx 50;
BA_ "GenSigCycleTime" SG_ 859 RLR_OBJ24_RelAy 50;
BA_ "GenSigCycleTime" SG_ 859 RLR_OBJ24_RelVx 50;
BA_ "GenSigCycleTime" SG_ 859 RLR_OBJ24_RelVy 50;
BA_ "GenSigCycleTime" SG_ 859 RLR_OBJ24_HeadingAngle 50;
BA_ "GenSigCycleTime" SG_ 859 RLR_OBJ24_Length 50;
BA_ "GenSigCycleTime" SG_ 859 RLR_OBJ24_Height 50;
BA_ "GenSigCycleTime" SG_ 859 RLR_OBJ24_Width 50;
BA_ "GenSigCycleTime" SG_ 859 RLR_OBJ24_Type 50;
BA_ "GenSigInvalidValue" SG_ 859 RLR_OBJ24_Type "0";
BA_ "GenSigCycleTime" SG_ 859 RLR_OBJ24_Track_ID 50;
BA_ "GenSigCycleTime" SG_ 859 RLR_OBJ23_Track_Age 50;
BA_ "GenSigCycleTime" SG_ 859 RLR_OBJ23_ReRPointLoc 50;
BA_ "GenSigCycleTime" SG_ 859 RLR_OBJ23_ObstacleProb 50;
BA_ "GenSigCycleTime" SG_ 859 RLR_OBJ23_Measured 50;
BA_ "GenSigInvalidValue" SG_ 859 RLR_OBJ23_Measured "0";
BA_ "GenSigCycleTime" SG_ 859 RLR_OBJ23_ExistProb 50;
BA_ "GenSigInvalidValue" SG_ 859 RLR_OBJ23_ExistProb "0";
BA_ "GenSigCycleTime" SG_ 859 RLR_OBJ23_Location 50;
BA_ "GenSigInvalidValue" SG_ 859 RLR_OBJ23_Location "0";
BA_ "GenSigCycleTime" SG_ 859 RLR_OBJ23_RelAx 50;
BA_ "GenSigCycleTime" SG_ 859 RLR_OBJ23_RelAy 50;
BA_ "GenSigCycleTime" SG_ 859 RLR_OBJ23_RelVx 50;
BA_ "GenSigCycleTime" SG_ 859 RLR_OBJ23_RelVy 50;
BA_ "GenSigCycleTime" SG_ 859 RLR_OBJ23_HeadingAngle 50;
BA_ "GenSigCycleTime" SG_ 859 RLR_OBJ23_Length 50;
BA_ "GenSigCycleTime" SG_ 859 RLR_OBJ23_Height 50;
BA_ "GenSigCycleTime" SG_ 859 RLR_OBJ23_Width 50;
BA_ "GenSigCycleTime" SG_ 859 RLR_OBJ23_Type 50;
BA_ "GenSigInvalidValue" SG_ 859 RLR_OBJ23_Type "0";
BA_ "GenSigCycleTime" SG_ 859 RLR_OBJ23_Track_ID 50;

BA_ "GenSigCycleTime" SG_ 860 RLR_OBJ26_LostCnt 50;
BA_ "GenSigCycleTime" SG_ 860 RLR_OBJ25_LostCnt 50;
BA_ "GenSigCycleTime" SG_ 860 RLR_OBJ26_Dx 50;
BA_ "GenSigCycleTime" SG_ 860 RLR_OBJ26_Dy 50;
BA_ "GenSigCycleTime" SG_ 860 RLR_OBJ25_Dx 50;
BA_ "GenSigCycleTime" SG_ 860 RLR_OBJ25_Dy 50;
BA_ "GenSigCycleTime" SG_ 860 RLR_OBJ26_Vx 50;
BA_ "GenSigCycleTime" SG_ 860 RLR_OBJ26_Vy 50;
BA_ "GenSigCycleTime" SG_ 860 RLR_OBJ26_Convergence 50;
BA_ "GenSigCycleTime" SG_ 860 RLR_OBJ26_DelayTime 50;
BA_ "GenSigCycleTime" SG_ 860 RLR_OBJ26_HeightGround 50;
BA_ "GenSigCycleTime" SG_ 860 RLR_OBJ26_MotionStatus 50;
BA_ "GenSigCycleTime" SG_ 860 RLR_OBJ26_RelVx_std 50;
BA_ "GenSigInvalidValue" SG_ 860 RLR_OBJ26_RelVx_std "4095";
BA_ "GenSigCycleTime" SG_ 860 RLR_OBJ26_RelVy_std 50;
BA_ "GenSigInvalidValue" SG_ 860 RLR_OBJ26_RelVy_std "1023";
BA_ "GenSigCycleTime" SG_ 860 RLR_OBJ26_Dx_Vnce 50;
BA_ "GenSigInvalidValue" SG_ 860 RLR_OBJ26_Dx_Vnce "16383";
BA_ "GenSigCycleTime" SG_ 860 RLR_OBJ26_Dy_Vnce 50;
BA_ "GenSigInvalidValue" SG_ 860 RLR_OBJ26_Dy_Vnce "1023";
BA_ "GenSigCycleTime" SG_ 860 RLR_OBJ25_Vx 50;
BA_ "GenSigCycleTime" SG_ 860 RLR_OBJ25_Vy 50;
BA_ "GenSigCycleTime" SG_ 860 RLR_OBJ25_Convergence 50;
BA_ "GenSigCycleTime" SG_ 860 RLR_OBJ25_DelayTime 50;
BA_ "GenSigCycleTime" SG_ 860 RLR_OBJ25_HeightGround 50;
BA_ "GenSigCycleTime" SG_ 860 RLR_OBJ25_MotionStatus 50;
BA_ "GenSigCycleTime" SG_ 860 RLR_OBJ25_RelVx_std 50;
BA_ "GenSigInvalidValue" SG_ 860 RLR_OBJ25_RelVx_std "4095";
BA_ "GenSigCycleTime" SG_ 860 RLR_OBJ25_RelVy_std 50;
BA_ "GenSigInvalidValue" SG_ 860 RLR_OBJ25_RelVy_std "1023";
BA_ "GenSigCycleTime" SG_ 860 RLR_OBJ25_Dx_Vnce 50;
BA_ "GenSigInvalidValue" SG_ 860 RLR_OBJ25_Dx_Vnce "16383";
BA_ "GenSigCycleTime" SG_ 860 RLR_OBJ25_Dy_Vnce 50;
BA_ "GenSigInvalidValue" SG_ 860 RLR_OBJ25_Dy_Vnce "1023";
BA_ "GenSigCycleTime" SG_ 860 RLR_CRCCheck_35C 50;
BA_ "GenSigCycleTime" SG_ 860 RLR_RollingCounter_35C 50;
BA_ "GenSigCycleTime" SG_ 860 RLR_OBJ26_Track_Age 50;
BA_ "GenSigCycleTime" SG_ 860 RLR_OBJ26_ReRPointLoc 50;
BA_ "GenSigCycleTime" SG_ 860 RLR_OBJ26_ObstacleProb 50;
BA_ "GenSigCycleTime" SG_ 860 RLR_OBJ26_Measured 50;
BA_ "GenSigInvalidValue" SG_ 860 RLR_OBJ26_Measured "0";
BA_ "GenSigCycleTime" SG_ 860 RLR_OBJ26_ExistProb 50;
BA_ "GenSigInvalidValue" SG_ 860 RLR_OBJ26_ExistProb "0";
BA_ "GenSigCycleTime" SG_ 860 RLR_OBJ26_Location 50;
BA_ "GenSigInvalidValue" SG_ 860 RLR_OBJ26_Location "0";
BA_ "GenSigCycleTime" SG_ 860 RLR_OBJ26_RelAx 50;
BA_ "GenSigCycleTime" SG_ 860 RLR_OBJ26_RelAy 50;
BA_ "GenSigCycleTime" SG_ 860 RLR_OBJ26_RelVx 50;
BA_ "GenSigCycleTime" SG_ 860 RLR_OBJ26_RelVy 50;
BA_ "GenSigCycleTime" SG_ 860 RLR_OBJ26_HeadingAngle 50;
BA_ "GenSigCycleTime" SG_ 860 RLR_OBJ26_Length 50;
BA_ "GenSigCycleTime" SG_ 860 RLR_OBJ26_Height 50;
BA_ "GenSigCycleTime" SG_ 860 RLR_OBJ26_Width 50;
BA_ "GenSigCycleTime" SG_ 860 RLR_OBJ26_Type 50;
BA_ "GenSigInvalidValue" SG_ 860 RLR_OBJ26_Type "0";
BA_ "GenSigCycleTime" SG_ 860 RLR_OBJ26_Track_ID 50;
BA_ "GenSigCycleTime" SG_ 860 RLR_OBJ25_Track_Age 50;
BA_ "GenSigCycleTime" SG_ 860 RLR_OBJ25_ReRPointLoc 50;
BA_ "GenSigCycleTime" SG_ 860 RLR_OBJ25_ObstacleProb 50;
BA_ "GenSigCycleTime" SG_ 860 RLR_OBJ25_Measured 50;
BA_ "GenSigInvalidValue" SG_ 860 RLR_OBJ25_Measured "0";
BA_ "GenSigCycleTime" SG_ 860 RLR_OBJ25_ExistProb 50;
BA_ "GenSigInvalidValue" SG_ 860 RLR_OBJ25_ExistProb "0";
BA_ "GenSigCycleTime" SG_ 860 RLR_OBJ25_Location 50;
BA_ "GenSigInvalidValue" SG_ 860 RLR_OBJ25_Location "0";
BA_ "GenSigCycleTime" SG_ 860 RLR_OBJ25_RelAx 50;
BA_ "GenSigCycleTime" SG_ 860 RLR_OBJ25_RelAy 50;
BA_ "GenSigCycleTime" SG_ 860 RLR_OBJ25_RelVx 50;
BA_ "GenSigCycleTime" SG_ 860 RLR_OBJ25_RelVy 50;
BA_ "GenSigCycleTime" SG_ 860 RLR_OBJ25_HeadingAngle 50;
BA_ "GenSigCycleTime" SG_ 860 RLR_OBJ25_Length 50;
BA_ "GenSigCycleTime" SG_ 860 RLR_OBJ25_Height 50;
BA_ "GenSigCycleTime" SG_ 860 RLR_OBJ25_Width 50;
BA_ "GenSigCycleTime" SG_ 860 RLR_OBJ25_Type 50;
BA_ "GenSigInvalidValue" SG_ 860 RLR_OBJ25_Type "0";
BA_ "GenSigCycleTime" SG_ 860 RLR_OBJ25_Track_ID 50;

BA_ "GenSigCycleTime" SG_ 861 RLR_OBJ28_LostCnt 50;
BA_ "GenSigCycleTime" SG_ 861 RLR_OBJ27_LostCnt 50;
BA_ "GenSigCycleTime" SG_ 861 RLR_OBJ28_Dx 50;
BA_ "GenSigCycleTime" SG_ 861 RLR_OBJ28_Dy 50;
BA_ "GenSigCycleTime" SG_ 861 RLR_OBJ27_Dx 50;
BA_ "GenSigCycleTime" SG_ 861 RLR_OBJ27_Dy 50;
BA_ "GenSigCycleTime" SG_ 861 RLR_OBJ28_Vx 50;
BA_ "GenSigCycleTime" SG_ 861 RLR_OBJ28_Vy 50;
BA_ "GenSigCycleTime" SG_ 861 RLR_OBJ28_Convergence 50;
BA_ "GenSigCycleTime" SG_ 861 RLR_OBJ28_DelayTime 50;
BA_ "GenSigCycleTime" SG_ 861 RLR_OBJ28_HeightGround 50;
BA_ "GenSigCycleTime" SG_ 861 RLR_OBJ28_MotionStatus 50;
BA_ "GenSigCycleTime" SG_ 861 RLR_OBJ28_RelVx_std 50;
BA_ "GenSigInvalidValue" SG_ 861 RLR_OBJ28_RelVx_std "4095";
BA_ "GenSigCycleTime" SG_ 861 RLR_OBJ28_RelVy_std 50;
BA_ "GenSigInvalidValue" SG_ 861 RLR_OBJ28_RelVy_std "1023";
BA_ "GenSigCycleTime" SG_ 861 RLR_OBJ28_Dx_Vnce 50;
BA_ "GenSigInvalidValue" SG_ 861 RLR_OBJ28_Dx_Vnce "16383";
BA_ "GenSigCycleTime" SG_ 861 RLR_OBJ28_Dy_Vnce 50;
BA_ "GenSigInvalidValue" SG_ 861 RLR_OBJ28_Dy_Vnce "1023";
BA_ "GenSigCycleTime" SG_ 861 RLR_OBJ27_Vx 50;
BA_ "GenSigCycleTime" SG_ 861 RLR_OBJ27_Vy 50;
BA_ "GenSigCycleTime" SG_ 861 RLR_OBJ27_Convergence 50;
BA_ "GenSigCycleTime" SG_ 861 RLR_OBJ27_DelayTime 50;
BA_ "GenSigCycleTime" SG_ 861 RLR_OBJ27_HeightGround 50;
BA_ "GenSigCycleTime" SG_ 861 RLR_OBJ27_MotionStatus 50;
BA_ "GenSigCycleTime" SG_ 861 RLR_OBJ27_RelVx_std 50;
BA_ "GenSigInvalidValue" SG_ 861 RLR_OBJ27_RelVx_std "4095";
BA_ "GenSigCycleTime" SG_ 861 RLR_OBJ27_RelVy_std 50;
BA_ "GenSigInvalidValue" SG_ 861 RLR_OBJ27_RelVy_std "1023";
BA_ "GenSigCycleTime" SG_ 861 RLR_OBJ27_Dx_Vnce 50;
BA_ "GenSigInvalidValue" SG_ 861 RLR_OBJ27_Dx_Vnce "16383";
BA_ "GenSigCycleTime" SG_ 861 RLR_OBJ27_Dy_Vnce 50;
BA_ "GenSigInvalidValue" SG_ 861 RLR_OBJ27_Dy_Vnce "1023";
BA_ "GenSigCycleTime" SG_ 861 RLR_CRCCheck_35D 50;
BA_ "GenSigCycleTime" SG_ 861 RLR_RollingCounter_35D 50;
BA_ "GenSigCycleTime" SG_ 861 RLR_OBJ28_Track_Age 50;
BA_ "GenSigCycleTime" SG_ 861 RLR_OBJ28_ReRPointLoc 50;
BA_ "GenSigCycleTime" SG_ 861 RLR_OBJ28_ObstacleProb 50;
BA_ "GenSigCycleTime" SG_ 861 RLR_OBJ28_Measured 50;
BA_ "GenSigInvalidValue" SG_ 861 RLR_OBJ28_Measured "0";
BA_ "GenSigCycleTime" SG_ 861 RLR_OBJ28_ExistProb 50;
BA_ "GenSigInvalidValue" SG_ 861 RLR_OBJ28_ExistProb "0";
BA_ "GenSigCycleTime" SG_ 861 RLR_OBJ28_Location 50;
BA_ "GenSigInvalidValue" SG_ 861 RLR_OBJ28_Location "0";
BA_ "GenSigCycleTime" SG_ 861 RLR_OBJ28_RelAx 50;
BA_ "GenSigCycleTime" SG_ 861 RLR_OBJ28_RelAy 50;
BA_ "GenSigCycleTime" SG_ 861 RLR_OBJ28_RelVx 50;
BA_ "GenSigCycleTime" SG_ 861 RLR_OBJ28_RelVy 50;
BA_ "GenSigCycleTime" SG_ 861 RLR_OBJ28_HeadingAngle 50;
BA_ "GenSigCycleTime" SG_ 861 RLR_OBJ28_Length 50;
BA_ "GenSigCycleTime" SG_ 861 RLR_OBJ28_Height 50;
BA_ "GenSigCycleTime" SG_ 861 RLR_OBJ28_Width 50;
BA_ "GenSigCycleTime" SG_ 861 RLR_OBJ28_Type 50;
BA_ "GenSigInvalidValue" SG_ 861 RLR_OBJ28_Type "0";
BA_ "GenSigCycleTime" SG_ 861 RLR_OBJ28_Track_ID 50;
BA_ "GenSigCycleTime" SG_ 861 RLR_OBJ27_Track_Age 50;
BA_ "GenSigCycleTime" SG_ 861 RLR_OBJ27_ReRPointLoc 50;
BA_ "GenSigCycleTime" SG_ 861 RLR_OBJ27_ObstacleProb 50;
BA_ "GenSigCycleTime" SG_ 861 RLR_OBJ27_Measured 50;
BA_ "GenSigInvalidValue" SG_ 861 RLR_OBJ27_Measured "0";
BA_ "GenSigCycleTime" SG_ 861 RLR_OBJ27_ExistProb 50;
BA_ "GenSigInvalidValue" SG_ 861 RLR_OBJ27_ExistProb "0";
BA_ "GenSigCycleTime" SG_ 861 RLR_OBJ27_Location 50;
BA_ "GenSigInvalidValue" SG_ 861 RLR_OBJ27_Location "0";
BA_ "GenSigCycleTime" SG_ 861 RLR_OBJ27_RelAx 50;
BA_ "GenSigCycleTime" SG_ 861 RLR_OBJ27_RelAy 50;
BA_ "GenSigCycleTime" SG_ 861 RLR_OBJ27_RelVx 50;
BA_ "GenSigCycleTime" SG_ 861 RLR_OBJ27_RelVy 50;
BA_ "GenSigCycleTime" SG_ 861 RLR_OBJ27_HeadingAngle 50;
BA_ "GenSigCycleTime" SG_ 861 RLR_OBJ27_Length 50;
BA_ "GenSigCycleTime" SG_ 861 RLR_OBJ27_Height 50;
BA_ "GenSigCycleTime" SG_ 861 RLR_OBJ27_Width 50;
BA_ "GenSigCycleTime" SG_ 861 RLR_OBJ27_Type 50;
BA_ "GenSigInvalidValue" SG_ 861 RLR_OBJ27_Type "0";
BA_ "GenSigCycleTime" SG_ 861 RLR_OBJ27_Track_ID 50;

BA_ "GenSigCycleTime" SG_ 862 RLR_OBJ30_LostCnt 50;
BA_ "GenSigCycleTime" SG_ 862 RLR_OBJ29_LostCnt 50;
BA_ "GenSigCycleTime" SG_ 862 RLR_OBJ30_Dx 50;
BA_ "GenSigCycleTime" SG_ 862 RLR_OBJ30_Dy 50;
BA_ "GenSigCycleTime" SG_ 862 RLR_OBJ29_Dx 50;
BA_ "GenSigCycleTime" SG_ 862 RLR_OBJ29_Dy 50;
BA_ "GenSigCycleTime" SG_ 862 RLR_OBJ30_Vx 50;
BA_ "GenSigCycleTime" SG_ 862 RLR_OBJ30_Vy 50;
BA_ "GenSigCycleTime" SG_ 862 RLR_OBJ30_Convergence 50;
BA_ "GenSigCycleTime" SG_ 862 RLR_OBJ30_DelayTime 50;
BA_ "GenSigCycleTime" SG_ 862 RLR_OBJ30_HeightGround 50;
BA_ "GenSigCycleTime" SG_ 862 RLR_OBJ30_MotionStatus 50;
BA_ "GenSigCycleTime" SG_ 862 RLR_OBJ30_RelVx_std 50;
BA_ "GenSigInvalidValue" SG_ 862 RLR_OBJ30_RelVx_std "4095";
BA_ "GenSigCycleTime" SG_ 862 RLR_OBJ30_RelVy_std 50;
BA_ "GenSigInvalidValue" SG_ 862 RLR_OBJ30_RelVy_std "1023";
BA_ "GenSigCycleTime" SG_ 862 RLR_OBJ30_Dx_Vnce 50;
BA_ "GenSigInvalidValue" SG_ 862 RLR_OBJ30_Dx_Vnce "16383";
BA_ "GenSigCycleTime" SG_ 862 RLR_OBJ30_Dy_Vnce 50;
BA_ "GenSigInvalidValue" SG_ 862 RLR_OBJ30_Dy_Vnce "1023";
BA_ "GenSigCycleTime" SG_ 862 RLR_OBJ29_Vx 50;
BA_ "GenSigCycleTime" SG_ 862 RLR_OBJ29_Vy 50;
BA_ "GenSigCycleTime" SG_ 862 RLR_OBJ29_Convergence 50;
BA_ "GenSigCycleTime" SG_ 862 RLR_OBJ29_DelayTime 50;
BA_ "GenSigCycleTime" SG_ 862 RLR_OBJ29_HeightGround 50;
BA_ "GenSigCycleTime" SG_ 862 RLR_OBJ29_MotionStatus 50;
BA_ "GenSigCycleTime" SG_ 862 RLR_OBJ29_RelVx_std 50;
BA_ "GenSigInvalidValue" SG_ 862 RLR_OBJ29_RelVx_std "4095";
BA_ "GenSigCycleTime" SG_ 862 RLR_OBJ29_RelVy_std 50;
BA_ "GenSigInvalidValue" SG_ 862 RLR_OBJ29_RelVy_std "1023";
BA_ "GenSigCycleTime" SG_ 862 RLR_OBJ29_Dx_Vnce 50;
BA_ "GenSigInvalidValue" SG_ 862 RLR_OBJ29_Dx_Vnce "16383";
BA_ "GenSigCycleTime" SG_ 862 RLR_OBJ29_Dy_Vnce 50;
BA_ "GenSigInvalidValue" SG_ 862 RLR_OBJ29_Dy_Vnce "1023";
BA_ "GenSigCycleTime" SG_ 862 RLR_CRCCheck_35E 50;
BA_ "GenSigCycleTime" SG_ 862 RLR_RollingCounter_35E 50;
BA_ "GenSigCycleTime" SG_ 862 RLR_OBJ30_Track_Age 50;
BA_ "GenSigCycleTime" SG_ 862 RLR_OBJ30_ReRPointLoc 50;
BA_ "GenSigCycleTime" SG_ 862 RLR_OBJ30_ObstacleProb 50;
BA_ "GenSigCycleTime" SG_ 862 RLR_OBJ30_Measured 50;
BA_ "GenSigInvalidValue" SG_ 862 RLR_OBJ30_Measured "0";
BA_ "GenSigCycleTime" SG_ 862 RLR_OBJ30_ExistProb 50;
BA_ "GenSigInvalidValue" SG_ 862 RLR_OBJ30_ExistProb "0";
BA_ "GenSigCycleTime" SG_ 862 RLR_OBJ30_Location 50;
BA_ "GenSigInvalidValue" SG_ 862 RLR_OBJ30_Location "0";
BA_ "GenSigCycleTime" SG_ 862 RLR_OBJ30_RelAx 50;
BA_ "GenSigCycleTime" SG_ 862 RLR_OBJ30_RelAy 50;
BA_ "GenSigCycleTime" SG_ 862 RLR_OBJ30_RelVx 50;
BA_ "GenSigCycleTime" SG_ 862 RLR_OBJ30_RelVy 50;
BA_ "GenSigCycleTime" SG_ 862 RLR_OBJ30_HeadingAngle 50;
BA_ "GenSigCycleTime" SG_ 862 RLR_OBJ30_Length 50;
BA_ "GenSigCycleTime" SG_ 862 RLR_OBJ30_Height 50;
BA_ "GenSigCycleTime" SG_ 862 RLR_OBJ30_Width 50;
BA_ "GenSigCycleTime" SG_ 862 RLR_OBJ30_Type 50;
BA_ "GenSigInvalidValue" SG_ 862 RLR_OBJ30_Type "0";
BA_ "GenSigCycleTime" SG_ 862 RLR_OBJ30_Track_ID 50;
BA_ "GenSigCycleTime" SG_ 862 RLR_OBJ29_Track_Age 50;
BA_ "GenSigCycleTime" SG_ 862 RLR_OBJ29_ReRPointLoc 50;
BA_ "GenSigCycleTime" SG_ 862 RLR_OBJ29_ObstacleProb 50;
BA_ "GenSigCycleTime" SG_ 862 RLR_OBJ29_Measured 50;
BA_ "GenSigInvalidValue" SG_ 862 RLR_OBJ29_Measured "0";
BA_ "GenSigCycleTime" SG_ 862 RLR_OBJ29_ExistProb 50;
BA_ "GenSigInvalidValue" SG_ 862 RLR_OBJ29_ExistProb "0";
BA_ "GenSigCycleTime" SG_ 862 RLR_OBJ29_Location 50;
BA_ "GenSigInvalidValue" SG_ 862 RLR_OBJ29_Location "0";
BA_ "GenSigCycleTime" SG_ 862 RLR_OBJ29_RelAx 50;
BA_ "GenSigCycleTime" SG_ 862 RLR_OBJ29_RelAy 50;
BA_ "GenSigCycleTime" SG_ 862 RLR_OBJ29_RelVx 50;
BA_ "GenSigCycleTime" SG_ 862 RLR_OBJ29_RelVy 50;
BA_ "GenSigCycleTime" SG_ 862 RLR_OBJ29_HeadingAngle 50;
BA_ "GenSigCycleTime" SG_ 862 RLR_OBJ29_Length 50;
BA_ "GenSigCycleTime" SG_ 862 RLR_OBJ29_Height 50;
BA_ "GenSigCycleTime" SG_ 862 RLR_OBJ29_Width 50;
BA_ "GenSigCycleTime" SG_ 862 RLR_OBJ29_Type 50;
BA_ "GenSigInvalidValue" SG_ 862 RLR_OBJ29_Type "0";
BA_ "GenSigCycleTime" SG_ 862 RLR_OBJ29_Track_ID 50;

BA_ "GenSigCycleTime" SG_ 863 RLR_OBJ32_LostCnt 50;
BA_ "GenSigCycleTime" SG_ 863 RLR_OBJ31_LostCnt 50;
BA_ "GenSigCycleTime" SG_ 863 RLR_OBJ32_Dx 50;
BA_ "GenSigCycleTime" SG_ 863 RLR_OBJ32_Dy 50;
BA_ "GenSigCycleTime" SG_ 863 RLR_OBJ31_Dx 50;
BA_ "GenSigCycleTime" SG_ 863 RLR_OBJ31_Dy 50;
BA_ "GenSigCycleTime" SG_ 863 RLR_OBJ32_Vx 50;
BA_ "GenSigCycleTime" SG_ 863 RLR_OBJ32_Vy 50;
BA_ "GenSigCycleTime" SG_ 863 RLR_OBJ32_Convergence 50;
BA_ "GenSigCycleTime" SG_ 863 RLR_OBJ32_DelayTime 50;
BA_ "GenSigCycleTime" SG_ 863 RLR_OBJ32_HeightGround 50;
BA_ "GenSigCycleTime" SG_ 863 RLR_OBJ32_MotionStatus 50;
BA_ "GenSigCycleTime" SG_ 863 RLR_OBJ32_RelVx_std 50;
BA_ "GenSigInvalidValue" SG_ 863 RLR_OBJ32_RelVx_std "4095";
BA_ "GenSigCycleTime" SG_ 863 RLR_OBJ32_RelVy_std 50;
BA_ "GenSigInvalidValue" SG_ 863 RLR_OBJ32_RelVy_std "1023";
BA_ "GenSigCycleTime" SG_ 863 RLR_OBJ32_Dx_Vnce 50;
BA_ "GenSigInvalidValue" SG_ 863 RLR_OBJ32_Dx_Vnce "16383";
BA_ "GenSigCycleTime" SG_ 863 RLR_OBJ32_Dy_Vnce 50;
BA_ "GenSigInvalidValue" SG_ 863 RLR_OBJ32_Dy_Vnce "1023";
BA_ "GenSigCycleTime" SG_ 863 RLR_OBJ31_Vx 50;
BA_ "GenSigCycleTime" SG_ 863 RLR_OBJ31_Vy 50;
BA_ "GenSigCycleTime" SG_ 863 RLR_OBJ31_Convergence 50;
BA_ "GenSigCycleTime" SG_ 863 RLR_OBJ31_DelayTime 50;
BA_ "GenSigCycleTime" SG_ 863 RLR_OBJ31_HeightGround 50;
BA_ "GenSigCycleTime" SG_ 863 RLR_OBJ31_MotionStatus 50;
BA_ "GenSigCycleTime" SG_ 863 RLR_OBJ31_RelVx_std 50;
BA_ "GenSigInvalidValue" SG_ 863 RLR_OBJ31_RelVx_std "4095";
BA_ "GenSigCycleTime" SG_ 863 RLR_OBJ31_RelVy_std 50;
BA_ "GenSigInvalidValue" SG_ 863 RLR_OBJ31_RelVy_std "1023";
BA_ "GenSigCycleTime" SG_ 863 RLR_OBJ31_Dx_Vnce 50;
BA_ "GenSigInvalidValue" SG_ 863 RLR_OBJ31_Dx_Vnce "16383";
BA_ "GenSigCycleTime" SG_ 863 RLR_OBJ31_Dy_Vnce 50;
BA_ "GenSigInvalidValue" SG_ 863 RLR_OBJ31_Dy_Vnce "1023";
BA_ "GenSigCycleTime" SG_ 863 RLR_CRCCheck_35R 50;
BA_ "GenSigCycleTime" SG_ 863 RLR_RollingCounter_35R 50;
BA_ "GenSigCycleTime" SG_ 863 RLR_OBJ32_Track_Age 50;
BA_ "GenSigCycleTime" SG_ 863 RLR_OBJ32_ReRPointLoc 50;
BA_ "GenSigCycleTime" SG_ 863 RLR_OBJ32_ObstacleProb 50;
BA_ "GenSigCycleTime" SG_ 863 RLR_OBJ32_Measured 50;
BA_ "GenSigInvalidValue" SG_ 863 RLR_OBJ32_Measured "0";
BA_ "GenSigCycleTime" SG_ 863 RLR_OBJ32_ExistProb 50;
BA_ "GenSigInvalidValue" SG_ 863 RLR_OBJ32_ExistProb "0";
BA_ "GenSigCycleTime" SG_ 863 RLR_OBJ32_Location 50;
BA_ "GenSigInvalidValue" SG_ 863 RLR_OBJ32_Location "0";
BA_ "GenSigCycleTime" SG_ 863 RLR_OBJ32_RelAx 50;
BA_ "GenSigCycleTime" SG_ 863 RLR_OBJ32_RelAy 50;
BA_ "GenSigCycleTime" SG_ 863 RLR_OBJ32_RelVx 50;
BA_ "GenSigCycleTime" SG_ 863 RLR_OBJ32_RelVy 50;
BA_ "GenSigCycleTime" SG_ 863 RLR_OBJ32_HeadingAngle 50;
BA_ "GenSigCycleTime" SG_ 863 RLR_OBJ32_Length 50;
BA_ "GenSigCycleTime" SG_ 863 RLR_OBJ32_Height 50;
BA_ "GenSigCycleTime" SG_ 863 RLR_OBJ32_Width 50;
BA_ "GenSigCycleTime" SG_ 863 RLR_OBJ32_Type 50;
BA_ "GenSigInvalidValue" SG_ 863 RLR_OBJ32_Type "0";
BA_ "GenSigCycleTime" SG_ 863 RLR_OBJ32_Track_ID 50;
BA_ "GenSigCycleTime" SG_ 863 RLR_OBJ31_Track_Age 50;
BA_ "GenSigCycleTime" SG_ 863 RLR_OBJ31_ReRPointLoc 50;
BA_ "GenSigCycleTime" SG_ 863 RLR_OBJ31_ObstacleProb 50;
BA_ "GenSigCycleTime" SG_ 863 RLR_OBJ31_Measured 50;
BA_ "GenSigInvalidValue" SG_ 863 RLR_OBJ31_Measured "0";
BA_ "GenSigCycleTime" SG_ 863 RLR_OBJ31_ExistProb 50;
BA_ "GenSigInvalidValue" SG_ 863 RLR_OBJ31_ExistProb "0";
BA_ "GenSigCycleTime" SG_ 863 RLR_OBJ31_Location 50;
BA_ "GenSigInvalidValue" SG_ 863 RLR_OBJ31_Location "0";
BA_ "GenSigCycleTime" SG_ 863 RLR_OBJ31_RelAx 50;
BA_ "GenSigCycleTime" SG_ 863 RLR_OBJ31_RelAy 50;
BA_ "GenSigCycleTime" SG_ 863 RLR_OBJ31_RelVx 50;
BA_ "GenSigCycleTime" SG_ 863 RLR_OBJ31_RelVy 50;
BA_ "GenSigCycleTime" SG_ 863 RLR_OBJ31_HeadingAngle 50;
BA_ "GenSigCycleTime" SG_ 863 RLR_OBJ31_Length 50;
BA_ "GenSigCycleTime" SG_ 863 RLR_OBJ31_Height 50;
BA_ "GenSigCycleTime" SG_ 863 RLR_OBJ31_Width 50;
BA_ "GenSigCycleTime" SG_ 863 RLR_OBJ31_Type 50;
BA_ "GenSigInvalidValue" SG_ 863 RLR_OBJ31_Type "0";
BA_ "GenSigCycleTime" SG_ 863 RLR_OBJ31_Track_ID 50;

BA_ "GenSigCycleTime" SG_ 917 RRGuardrailReadyFlag 50;
BA_ "GenSigCycleTime" SG_ 917 RLGuardrailReadyFlag 50;
BA_ "GenSigCycleTime" SG_ 917 RRR_CRCCheck_395 50;
BA_ "GenSigCycleTime" SG_ 917 RRR_RollingCounter_395 50;
BA_ "GenSigCycleTime" SG_ 917 RRR_LOC_RollingCounter 50;
BA_ "GenSigCycleTime" SG_ 917 RLR_RearRightGuardrailConRidenc 50;
BA_ "GenSigCycleTime" SG_ 917 RLR__RearRightGuardrail_End 50;
BA_ "GenSigCycleTime" SG_ 917 RLR__RearRightGuardrail_Start 50;
BA_ "GenSigCycleTime" SG_ 917 RLR_RearRightGuardrailC3 50;
BA_ "GenSigStartValue" SG_ 917 RLR_RearRightGuardrailC3 2047.000000;
BA_ "GenSigCycleTime" SG_ 917 RLR_RearRightGuardrailC2 50;
BA_ "GenSigStartValue" SG_ 917 RLR_RearRightGuardrailC2 2047.000000;
BA_ "GenSigCycleTime" SG_ 917 RLR_RearRightGuardrailC1 50;
BA_ "GenSigStartValue" SG_ 917 RLR_RearRightGuardrailC1 2047.000000;
BA_ "GenSigCycleTime" SG_ 917 RLR_RearRightGuardrailC0 50;
BA_ "GenSigCycleTime" SG_ 917 RLR_RearLeftGuardrailConRidence 50;
BA_ "GenSigCycleTime" SG_ 917 RLR__RearLeftGuardrail_End 50;
BA_ "GenSigCycleTime" SG_ 917 RLR__RearLeftGuardrail_Start 50;
BA_ "GenSigCycleTime" SG_ 917 RLR_RearLeftGuardrailC3 50;
BA_ "GenSigStartValue" SG_ 917 RLR_RearLeftGuardrailC3 2047.000000;
BA_ "GenSigCycleTime" SG_ 917 RLR_RearLeftGuardrailC2 50;
BA_ "GenSigStartValue" SG_ 917 RLR_RearLeftGuardrailC2 2047.000000;
BA_ "GenSigCycleTime" SG_ 917 RLR_RearLeftGuardrailC1 50;
BA_ "GenSigStartValue" SG_ 917 RLR_RearLeftGuardrailC1 2047.000000;
BA_ "GenSigCycleTime" SG_ 917 RLR_RearLeftGuardrailC0 50;

BA_ "GenSigCycleTime" SG_ 943 RRR_HwVers6 1000;
BA_ "GenSigCycleTime" SG_ 943 RRR_HwVers5 1000;
BA_ "GenSigCycleTime" SG_ 943 RRR_HwVers4 1000;
BA_ "GenSigCycleTime" SG_ 943 RRR_HwVers3 1000;
BA_ "GenSigCycleTime" SG_ 943 RRR_HwVers2 1000;
BA_ "GenSigCycleTime" SG_ 943 RRR_HwVers1 1000;
BA_ "GenSigCycleTime" SG_ 943 RRR_HwVers0 1000;
BA_ "GenSigCycleTime" SG_ 943 RRR_SwVers6 1000;
BA_ "GenSigCycleTime" SG_ 943 RRR_SwVers5 1000;
BA_ "GenSigCycleTime" SG_ 943 RRR_SwVers4 1000;
BA_ "GenSigCycleTime" SG_ 943 RRR_SwVers3 1000;
BA_ "GenSigCycleTime" SG_ 943 RRR_SwVers2 1000;
BA_ "GenSigCycleTime" SG_ 943 RRR_SwVers1 1000;
BA_ "GenSigCycleTime" SG_ 943 RRR_SwVers0 1000;
BA_ "GenSigCycleTime" SG_ 943 RLR_HwVers6 1000;
BA_ "GenSigCycleTime" SG_ 943 RLR_HwVers5 1000;
BA_ "GenSigCycleTime" SG_ 943 RLR_HwVers4 1000;
BA_ "GenSigCycleTime" SG_ 943 RLR_HwVers3 1000;
BA_ "GenSigCycleTime" SG_ 943 RLR_HwVers2 1000;
BA_ "GenSigCycleTime" SG_ 943 RLR_HwVers1 1000;
BA_ "GenSigCycleTime" SG_ 943 RLR_HwVers0 1000;
BA_ "GenSigCycleTime" SG_ 943 RLR_SwVers6 1000;
BA_ "GenSigCycleTime" SG_ 943 RLR_SwVers5 1000;
BA_ "GenSigCycleTime" SG_ 943 RLR_SwVers4 1000;
BA_ "GenSigCycleTime" SG_ 943 RLR_SwVers3 1000;
BA_ "GenSigCycleTime" SG_ 943 RLR_SwVers2 1000;
BA_ "GenSigCycleTime" SG_ 943 RLR_SwVers1 1000;
BA_ "GenSigCycleTime" SG_ 943 RLR_SwVers0 1000;

BA_ "GenSigCycleTime" SG_ 837 RLR_BSDLCAMode 50;
BA_ "GenSigStartValue" SG_ 837 RLR_BSDLCAMode 1.000000;
BA_ "GenSigCycleTime" SG_ 837 RLR_AudioWarningEnableStatus 50;
BA_ "GenSigCycleTime" SG_ 837 RLR_SEAEnableStatus 50;
BA_ "GenSigCycleTime" SG_ 837 RLR_BSD_LCASoundWar 50;
BA_ "GenSigCycleTime" SG_ 837 RLR_LDWShakeLevStatus 50;
BA_ "GenSigStartValue" SG_ 837 RLR_LDWShakeLevStatus 2.000000;
BA_ "GenSigCycleTime" SG_ 837 RLR_EmergencyLightingRequest 50;
BA_ "GenSigCycleTime" SG_ 837 RLR_LDWVibrationWarningReq 50;
BA_ "GenSigCycleTime" SG_ 837 RLR_RearColliAstType 50;
BA_ "GenSigCycleTime" SG_ 837 RLR_SEAModeStatus 50;
BA_ "GenSigCycleTime" SG_ 837 RLR_SEAOnOffSts 50;
BA_ "GenSigCycleTime" SG_ 837 RLR_BSDLCASetting 50;
BA_ "GenSigCycleTime" SG_ 837 RLR_BSDLCARemindmode 50;
BA_ "GenSigCycleTime" SG_ 837 RLR_BSDLCAOnOff 50;
BA_ "GenSigCycleTime" SG_ 837 RLR_RCWEnableStatus 50;
BA_ "GenSigCycleTime" SG_ 837 RLR_RCTAEnableStatus 50;
BA_ "GenSigCycleTime" SG_ 837 RLR_AEBVehilceHoldReq 50;
BA_ "GenSigCycleTime" SG_ 837 RLR_RCTBTargetDecel 50;
BA_ "GenSigStartValue" SG_ 837 RLR_RCTBTargetDecel 32000.000000;
BA_ "GenSigCycleTime" SG_ 837 RLR_RCTBEnable 50;
BA_ "GenSigStartValue" SG_ 837 RLR_RCTBEnable 1.000000;
BA_ "GenSigInvalidValue" SG_ 837 RLR_RCTBEnable "0";
BA_ "GenSigCycleTime" SG_ 837 RLR_BSD_LCAEnableStatus 50;
BA_ "GenSigStartValue" SG_ 837 RLR_BSD_LCAEnableStatus 1.000000;
BA_ "GenSigCycleTime" SG_ 837 RLR_SEAStatus 50;
BA_ "GenSigInvalidValue" SG_ 837 RLR_SEAStatus "3";
BA_ "GenSigCycleTime" SG_ 837 RLR_RCWStatus 50;
BA_ "GenSigInvalidValue" SG_ 837 RLR_RCWStatus "3";
BA_ "GenSigCycleTime" SG_ 837 RLR_BSD_LCAStatus 50;
BA_ "GenSigInvalidValue" SG_ 837 RLR_BSD_LCAStatus "3";
BA_ "GenSigCycleTime" SG_ 837 RLR_RCTBStatus 50;
BA_ "GenSigInvalidValue" SG_ 837 RLR_RCTBStatus "3";
BA_ "GenSigCycleTime" SG_ 837 RLR_RCTAStatus 50;
BA_ "GenSigInvalidValue" SG_ 837 RLR_RCTAStatus "3";
BA_ "GenSigCycleTime" SG_ 837 RLR_Left_BSD_LCAAlert 50;
BA_ "GenSigCycleTime" SG_ 837 RLR_SEAAlert 50;
BA_ "GenSigCycleTime" SG_ 837 RLR_RCWAlert 50;
BA_ "GenSigCycleTime" SG_ 837 RLR_DOWLeftAlert 50;
BA_ "GenSigCycleTime" SG_ 837 RLR_BSD_LCAAlert 50;
BA_ "GenSigCycleTime" SG_ 837 RLR_RCTBActive 50;
BA_ "GenSigCycleTime" SG_ 837 RLR_Right_SEAAlert 50;
BA_ "GenSigCycleTime" SG_ 837 RLR_Right_RCWAlert 50;
BA_ "GenSigCycleTime" SG_ 837 RLR_DOWRightAlert 50;
BA_ "GenSigCycleTime" SG_ 837 RLR_Left_RCTAAlert 50;
BA_ "GenSigCycleTime" SG_ 837 RLR_Right_RCTAAlert 50;

BA_ "GenSigCycleTime" SG_ 692 RLR_CRCCheck_2B4 50;
BA_ "GenSigCycleTime" SG_ 692 RLR_RollingCounter_2B4 50;
BA_ "GenSigCycleTime" SG_ 692 LCDAL_ResetSts 50;
BA_ "GenSigInvalidValue" SG_ 692 LCDAL_ResetSts "7";
BA_ "GenSigCycleTime" SG_ 692 FuncDegradeType_RL 50;
BA_ "GenSigCycleTime" SG_ 692 FUSION_TimeoutCnt_RL 50;
BA_ "GenSigCycleTime" SG_ 692 VALIDATION_TimeoutCnt_RL 50;
BA_ "GenSigCycleTime" SG_ 692 CurFrameCycle_RL 50;
BA_ "GenSigCycleTime" SG_ 692 ProcessTimeoutCnt_RL 50;
BA_ "GenSigCycleTime" SG_ 692 RevFrameCnt_RL 50;
BA_ "GenSigCycleTime" SG_ 692 Local_Pointcloud_Number_RL 50;
BA_ "GenSigCycleTime" SG_ 692 RealTimeCal_PrcssBar_RL 50;
BA_ "GenSigCycleTime" SG_ 692 RealTimeCal_VelErrOutput_RL 50;
BA_ "GenSigCycleTime" SG_ 692 RealTimeCal_HoriMntErrOutput_RL 50;
BA_ "GenSigCycleTime" SG_ 692 RealTimeCal_FailReasonCode_RL 50;
BA_ "GenSigCycleTime" SG_ 692 RealTimeCal_Status_RL 50;
BA_ "GenSigCycleTime" SG_ 692 DiagCal_PrcssBar_RL 50;
BA_ "GenSigCycleTime" SG_ 692 DiagCal_VelErrOutput_RL 50;
BA_ "GenSigCycleTime" SG_ 692 DiagCal_HoriMntErrOutput_RL 50;
BA_ "GenSigCycleTime" SG_ 692 DiagCal_FailReasonCode_RL 50;
BA_ "GenSigCycleTime" SG_ 692 DiagCal_Status_RL 50;
BA_ "GenSigCycleTime" SG_ 692 EolCal_PrcssBar_RL 50;
BA_ "GenSigCycleTime" SG_ 692 EolCal_VelErrOutput_RL 50;
BA_ "GenSigCycleTime" SG_ 692 EolCal_HoriMntErrOutput_RL 50;
BA_ "GenSigCycleTime" SG_ 692 EolCal_FailReasonCode_RL 50;
BA_ "GenSigCycleTime" SG_ 692 EolCal_Status_RL 50;
BA_ "GenSigCycleTime" SG_ 692 PriCounter_RL 50;
BA_ "GenSigCycleTime" SG_ 692 MsgCounter_RL 50;

BA_ "GenSigCycleTime" SG_ 587 Transmitcnt6_R 50;
BA_ "GenSigCycleTime" SG_ 587 Transmitcnt5_R 50;
BA_ "GenSigCycleTime" SG_ 587 Transmitcnt4_R 50;
BA_ "GenSigCycleTime" SG_ 587 Transmitcnt3_R 50;
BA_ "GenSigCycleTime" SG_ 587 Transmitcnt2_R 50;
BA_ "GenSigCycleTime" SG_ 587 Transmitcnt1_R 50;
BA_ "GenSigCycleTime" SG_ 587 RLR_Track_ID_R 50;
BA_ "GenSigCycleTime" SG_ 587 RLR_Measured_R 50;
BA_ "GenSigCycleTime" SG_ 587 RLR_Location_R 50;
BA_ "GenSigCycleTime" SG_ 587 RLR_ClassComfrmFlg_R 50;
BA_ "GenSigCycleTime" SG_ 587 RLR_TrckrType_R 50;
BA_ "GenSigCycleTime" SG_ 587 RLR_TrckrAge_R 50;
BA_ "GenSigCycleTime" SG_ 587 RLR_MotionStatus_R 50;
BA_ "GenSigCycleTime" SG_ 587 RLR_AbsVy_R 50;
BA_ "GenSigCycleTime" SG_ 587 RLR_AbsoVx_R 50;
BA_ "GenSigCycleTime" SG_ 587 RLR_LocDx_R 50;
BA_ "GenSigCycleTime" SG_ 587 RLR_LocDy_R 50;
BA_ "GenSigCycleTime" SG_ 587 RLR_HeadingAngle_R 50;
BA_ "GenSigCycleTime" SG_ 587 RLR_Length_R 50;
BA_ "GenSigCycleTime" SG_ 587 RLR_Width_R 50;
BA_ "GenSigCycleTime" SG_ 587 RLR_Track_ID_L 50;
BA_ "GenSigCycleTime" SG_ 587 RLR_Measured_L 50;
BA_ "GenSigCycleTime" SG_ 587 RLR_Location_L 50;
BA_ "GenSigCycleTime" SG_ 587 RLR_ClassComfrmFlg_L 50;
BA_ "GenSigCycleTime" SG_ 587 RLR_TrckrType_L 50;
BA_ "GenSigCycleTime" SG_ 587 RLR_TrckrAge_L 50;
BA_ "GenSigCycleTime" SG_ 587 RLR_MotionStatus_L 50;
BA_ "GenSigCycleTime" SG_ 587 RLR_AbsVy_L 50;
BA_ "GenSigCycleTime" SG_ 587 RLR_AbsoVx_L 50;
BA_ "GenSigCycleTime" SG_ 587 RLR_LocDx_L 50;
BA_ "GenSigCycleTime" SG_ 587 RLR_LocDy_L 50;
BA_ "GenSigCycleTime" SG_ 587 RLR_HeadingAngle_L 50;
BA_ "GenSigCycleTime" SG_ 587 RLR_Length_L 50;
BA_ "GenSigCycleTime" SG_ 587 RLR_Width_L 50;
BA_ "GenSigCycleTime" SG_ 587 RLR_TrckrNum 50;
BA_ "GenSigCycleTime" SG_ 587 RLR_TrackerTimeStamp 50;

BA_ "GenSigCycleTime" SG_ 695 RLR_CRCCheck_2B7 50;
BA_ "GenSigCycleTime" SG_ 695 RLR_RollingCounter_2B7 50;
BA_ "GenSigCycleTime" SG_ 695 RLR_OBJ32_lAy 50;
BA_ "GenSigInvalidValue" SG_ 695 RLR_OBJ32_lAy "NA";
BA_ "GenSigCycleTime" SG_ 695 RLR_OBJ31_lAy 50;
BA_ "GenSigInvalidValue" SG_ 695 RLR_OBJ31_lAy "NA";
BA_ "GenSigCycleTime" SG_ 695 RLR_OBJ30_lAy 50;
BA_ "GenSigInvalidValue" SG_ 695 RLR_OBJ30_lAy "NA";
BA_ "GenSigCycleTime" SG_ 695 RLR_OBJ29_lAy 50;
BA_ "GenSigInvalidValue" SG_ 695 RLR_OBJ29_lAy "NA";
BA_ "GenSigCycleTime" SG_ 695 RLR_OBJ28_lAy 50;
BA_ "GenSigInvalidValue" SG_ 695 RLR_OBJ28_lAy "NA";
BA_ "GenSigCycleTime" SG_ 695 RLR_OBJ27_lAy 50;
BA_ "GenSigInvalidValue" SG_ 695 RLR_OBJ27_lAy "NA";
BA_ "GenSigCycleTime" SG_ 695 RLR_OBJ26_lAy 50;
BA_ "GenSigInvalidValue" SG_ 695 RLR_OBJ26_lAy "NA";
BA_ "GenSigCycleTime" SG_ 695 RLR_OBJ25_lAy 50;
BA_ "GenSigInvalidValue" SG_ 695 RLR_OBJ25_lAy "NA";
BA_ "GenSigCycleTime" SG_ 695 RLR_OBJ24_lAy 50;
BA_ "GenSigInvalidValue" SG_ 695 RLR_OBJ24_lAy "NA";
BA_ "GenSigCycleTime" SG_ 695 RLR_OBJ23_lAy 50;
BA_ "GenSigInvalidValue" SG_ 695 RLR_OBJ23_lAy "NA";
BA_ "GenSigCycleTime" SG_ 695 RLR_OBJ22_lAy 50;
BA_ "GenSigInvalidValue" SG_ 695 RLR_OBJ22_lAy "NA";
BA_ "GenSigCycleTime" SG_ 695 RLR_OBJ21_lAy 50;
BA_ "GenSigInvalidValue" SG_ 695 RLR_OBJ21_lAy "NA";
BA_ "GenSigCycleTime" SG_ 695 RLR_OBJ20_lAy 50;
BA_ "GenSigInvalidValue" SG_ 695 RLR_OBJ20_lAy "NA";
BA_ "GenSigCycleTime" SG_ 695 RLR_OBJ19_lAy 50;
BA_ "GenSigInvalidValue" SG_ 695 RLR_OBJ19_lAy "NA";
BA_ "GenSigCycleTime" SG_ 695 RLR_OBJ18_lAy 50;
BA_ "GenSigInvalidValue" SG_ 695 RLR_OBJ18_lAy "NA";
BA_ "GenSigCycleTime" SG_ 695 RLR_OBJ17_lAy 50;
BA_ "GenSigInvalidValue" SG_ 695 RLR_OBJ17_lAy "NA";
BA_ "GenSigCycleTime" SG_ 695 RLR_OBJ16_lAy 50;
BA_ "GenSigInvalidValue" SG_ 695 RLR_OBJ16_lAy "NA";
BA_ "GenSigCycleTime" SG_ 695 RLR_OBJ15_lAy 50;
BA_ "GenSigInvalidValue" SG_ 695 RLR_OBJ15_lAy "NA";
BA_ "GenSigCycleTime" SG_ 695 RLR_OBJ14_lAy 50;
BA_ "GenSigInvalidValue" SG_ 695 RLR_OBJ14_lAy "NA";
BA_ "GenSigCycleTime" SG_ 695 RLR_OBJ13_lAy 50;
BA_ "GenSigInvalidValue" SG_ 695 RLR_OBJ13_lAy "NA";
BA_ "GenSigCycleTime" SG_ 695 RLR_OBJ12_lAy 50;
BA_ "GenSigInvalidValue" SG_ 695 RLR_OBJ12_lAy "NA";
BA_ "GenSigCycleTime" SG_ 695 RLR_OBJ11_lAy 50;
BA_ "GenSigInvalidValue" SG_ 695 RLR_OBJ11_lAy "NA";
BA_ "GenSigCycleTime" SG_ 695 RLR_OBJ10_lAy 50;
BA_ "GenSigInvalidValue" SG_ 695 RLR_OBJ10_lAy "NA";
BA_ "GenSigCycleTime" SG_ 695 RLR_OBJ9_lAy 50;
BA_ "GenSigInvalidValue" SG_ 695 RLR_OBJ9_lAy "NA";
BA_ "GenSigCycleTime" SG_ 695 RLR_OBJ8_lAy 50;
BA_ "GenSigInvalidValue" SG_ 695 RLR_OBJ8_lAy "NA";
BA_ "GenSigCycleTime" SG_ 695 RLR_OBJ7_lAy 50;
BA_ "GenSigInvalidValue" SG_ 695 RLR_OBJ7_lAy "NA";
BA_ "GenSigCycleTime" SG_ 695 RLR_OBJ6_lAy 50;
BA_ "GenSigInvalidValue" SG_ 695 RLR_OBJ6_lAy "NA";
BA_ "GenSigCycleTime" SG_ 695 RLR_OBJ5_lAy 50;
BA_ "GenSigInvalidValue" SG_ 695 RLR_OBJ5_lAy "NA";
BA_ "GenSigCycleTime" SG_ 695 RLR_OBJ4_lAy 50;
BA_ "GenSigInvalidValue" SG_ 695 RLR_OBJ4_lAy "NA";
BA_ "GenSigCycleTime" SG_ 695 RLR_OBJ3_lAy 50;
BA_ "GenSigInvalidValue" SG_ 695 RLR_OBJ3_lAy "NA";
BA_ "GenSigCycleTime" SG_ 695 RLR_OBJ2_lAy 50;
BA_ "GenSigInvalidValue" SG_ 695 RLR_OBJ2_lAy "NA";
BA_ "GenSigCycleTime" SG_ 695 RLR_OBJ1_lAy 50;
BA_ "GenSigInvalidValue" SG_ 695 RLR_OBJ1_lAy "NA";

BA_ "GenSigCycleTime" SG_ 841 RRR_Suppliers 50;
BA_ "GenSigCycleTime" SG_ 841 RRR_RS_TiOut 50;
BA_ "GenSigCycleTime" SG_ 841 RRR_RS_TiLeap 50;
BA_ "GenSigCycleTime" SG_ 841 RRR_RS_TiBas 50;
BA_ "GenSigCycleTime" SG_ 841 RRR_RS_TiStamp 50;
BA_ "GenSigCycleTime" SG_ 841 RRR_CRCCheck_349 50;
BA_ "GenSigCycleTime" SG_ 841 RRR_RollingCounter_349 50;
BA_ "GenSigCycleTime" SG_ 841 RRR_ECU_TiOut 50;
BA_ "GenSigCycleTime" SG_ 841 RRR_ECU_TiLeap 50;
BA_ "GenSigCycleTime" SG_ 841 RRR_ECU_TiBas 50;
BA_ "GenSigCycleTime" SG_ 841 RRR_ECU_TiStamp 50;
BA_ "GenSigCycleTime" SG_ 841 RRR_MCUTiStamp 50;
BA_ "GenSigCycleTime" SG_ 841 RRR_SyncTiStamp 50;
BA_ "GenSigCycleTime" SG_ 841 RRR_WorkMode 50;
BA_ "GenSigCycleTime" SG_ 841 RRR_ObjDelay 50;
BA_ "GenSigCycleTime" SG_ 841 RRR_SystemStatus 50;
BA_ "GenSigStartValue" SG_ 841 RRR_SystemStatus 1.000000;
BA_ "GenSigInvalidValue" SG_ 841 RRR_SystemStatus "7";

BA_ "GenSigCycleTime" SG_ 922 RLR_CRCCheck_39A 50;
BA_ "GenSigCycleTime" SG_ 922 RLR_RollingCounter_39A 50;
BA_ "GenSigCycleTime" SG_ 922 RLR_FreespaceSectorKinestate34 50;
BA_ "GenSigCycleTime" SG_ 922 RLR_FreespaceSectorConRidence34 50;
BA_ "GenSigCycleTime" SG_ 922 RLR_FreespaceSectorDistance34 50;
BA_ "GenSigCycleTime" SG_ 922 RLR_FreespaceSectorKinestate33 50;
BA_ "GenSigCycleTime" SG_ 922 RLR_FreespaceSectorConRidence33 50;
BA_ "GenSigCycleTime" SG_ 922 RLR_FreespaceSectorDistance33 50;
BA_ "GenSigCycleTime" SG_ 922 RLR_FreespaceSectorKinestate32 50;
BA_ "GenSigCycleTime" SG_ 922 RLR_FreespaceSectorConRidence32 50;
BA_ "GenSigCycleTime" SG_ 922 RLR_FreespaceSectorDistance32 50;
BA_ "GenSigCycleTime" SG_ 922 RLR_FreespaceSectorKinestate31 50;
BA_ "GenSigCycleTime" SG_ 922 RLR_FreespaceSectorConRidence31 50;
BA_ "GenSigCycleTime" SG_ 922 RLR_FreespaceSectorDistance31 50;
BA_ "GenSigCycleTime" SG_ 922 RLR_FreespaceSectorKinestate30 50;
BA_ "GenSigCycleTime" SG_ 922 RLR_FreespaceSectorConRidence30 50;
BA_ "GenSigCycleTime" SG_ 922 RLR_FreespaceSectorDistance30 50;
BA_ "GenSigCycleTime" SG_ 922 RLR_FreespaceSectorKinestate29 50;
BA_ "GenSigCycleTime" SG_ 922 RLR_FreespaceSectorConRidence29 50;
BA_ "GenSigCycleTime" SG_ 922 RLR_FreespaceSectorDistance29 50;
BA_ "GenSigCycleTime" SG_ 922 RLR_FreespaceSectorKinestate28 50;
BA_ "GenSigCycleTime" SG_ 922 RLR_FreespaceSectorConRidence28 50;
BA_ "GenSigCycleTime" SG_ 922 RLR_FreespaceSectorDistance28 50;
BA_ "GenSigCycleTime" SG_ 922 RLR_FreespaceSectorKinestate27 50;
BA_ "GenSigCycleTime" SG_ 922 RLR_FreespaceSectorConRidence27 50;
BA_ "GenSigCycleTime" SG_ 922 RLR_FreespaceSectorDistance27 50;
BA_ "GenSigCycleTime" SG_ 922 RLR_FreespaceSectorKinestate26 50;
BA_ "GenSigCycleTime" SG_ 922 RLR_FreespaceSectorConRidence26 50;
BA_ "GenSigCycleTime" SG_ 922 RLR_FreespaceSectorDistance26 50;
BA_ "GenSigCycleTime" SG_ 922 RLR_FreespaceSectorKinestate25 50;
BA_ "GenSigCycleTime" SG_ 922 RLR_FreespaceSectorConRidence25 50;
BA_ "GenSigCycleTime" SG_ 922 RLR_FreespaceSectorDistance25 50;
BA_ "GenSigCycleTime" SG_ 922 RLR_FreespaceSectorKinestate24 50;
BA_ "GenSigCycleTime" SG_ 922 RLR_FreespaceSectorConRidence24 50;
BA_ "GenSigCycleTime" SG_ 922 RLR_FreespaceSectorDistance24 50;
BA_ "GenSigCycleTime" SG_ 922 RLR_FreespaceSectorKinestate23 50;
BA_ "GenSigCycleTime" SG_ 922 RLR_FreespaceSectorConRidence23 50;
BA_ "GenSigCycleTime" SG_ 922 RLR_FreespaceSectorDistance23 50;
BA_ "GenSigCycleTime" SG_ 922 RLR_FreespaceSectorKinestate22 50;
BA_ "GenSigCycleTime" SG_ 922 RLR_FreespaceSectorConRidence22 50;
BA_ "GenSigCycleTime" SG_ 922 RLR_FreespaceSectorDistance22 50;
BA_ "GenSigCycleTime" SG_ 922 RLR_FreespaceSectorKinestate21 50;
BA_ "GenSigCycleTime" SG_ 922 RLR_FreespaceSectorConRidence21 50;
BA_ "GenSigCycleTime" SG_ 922 RLR_FreespaceSectorDistance21 50;
BA_ "GenSigCycleTime" SG_ 922 RLR_FreespaceSectorKinestate20 50;
BA_ "GenSigCycleTime" SG_ 922 RLR_FreespaceSectorConRidence20 50;
BA_ "GenSigCycleTime" SG_ 922 RLR_FreespaceSectorDistance20 50;
BA_ "GenSigCycleTime" SG_ 922 RLR_FreespaceSectorKinestate19 50;
BA_ "GenSigCycleTime" SG_ 922 RLR_FreespaceSectorConRidence19 50;
BA_ "GenSigCycleTime" SG_ 922 RLR_FreespaceSectorDistance19 50;
BA_ "GenSigCycleTime" SG_ 922 RLR_FreespaceSectorKinestate18 50;
BA_ "GenSigCycleTime" SG_ 922 RLR_FreespaceSectorConRidence18 50;
BA_ "GenSigCycleTime" SG_ 922 RLR_FreespaceSectorDistance18 50;
BA_ "GenSigCycleTime" SG_ 922 RLR_FreespaceSectorKinestate17 50;
BA_ "GenSigCycleTime" SG_ 922 RLR_FreespaceSectorConRidence17 50;
BA_ "GenSigCycleTime" SG_ 922 RLR_FreespaceSectorDistance17 50;
BA_ "GenSigCycleTime" SG_ 922 RLR_FreespaceSectorKinestate16 50;
BA_ "GenSigCycleTime" SG_ 922 RLR_FreespaceSectorConRidence16 50;
BA_ "GenSigCycleTime" SG_ 922 RLR_FreespaceSectorDistance16 50;
BA_ "GenSigCycleTime" SG_ 922 RLR_FreespaceSectorKinestate15 50;
BA_ "GenSigCycleTime" SG_ 922 RLR_FreespaceSectorConRidence15 50;
BA_ "GenSigCycleTime" SG_ 922 RLR_FreespaceSectorDistance15 50;
BA_ "GenSigCycleTime" SG_ 922 RLR_FreespaceSectorKinestate14 50;
BA_ "GenSigCycleTime" SG_ 922 RLR_FreespaceSectorConRidence14 50;
BA_ "GenSigCycleTime" SG_ 922 RLR_FreespaceSectorDistance14 50;
BA_ "GenSigCycleTime" SG_ 922 RLR_FreespaceSectorKinestate13 50;
BA_ "GenSigCycleTime" SG_ 922 RLR_FreespaceSectorConRidence13 50;
BA_ "GenSigCycleTime" SG_ 922 RLR_FreespaceSectorDistance13 50;
BA_ "GenSigCycleTime" SG_ 922 RLR_FreespaceSectorKinestate12 50;
BA_ "GenSigCycleTime" SG_ 922 RLR_FreespaceSectorConRidence12 50;
BA_ "GenSigCycleTime" SG_ 922 RLR_FreespaceSectorDistance12 50;
BA_ "GenSigCycleTime" SG_ 922 RLR_FreespaceSectorKinestate11 50;
BA_ "GenSigCycleTime" SG_ 922 RLR_FreespaceSectorConRidence11 50;
BA_ "GenSigCycleTime" SG_ 922 RLR_FreespaceSectorDistance11 50;
BA_ "GenSigCycleTime" SG_ 922 RLR_FreespaceSectorKinestate10 50;
BA_ "GenSigCycleTime" SG_ 922 RLR_FreespaceSectorConRidence10 50;
BA_ "GenSigCycleTime" SG_ 922 RLR_FreespaceSectorDistance10 50;
BA_ "GenSigCycleTime" SG_ 922 RLR_FreespaceSectorKinestate9 50;
BA_ "GenSigCycleTime" SG_ 922 RLR_FreespaceSectorConRidence9 50;
BA_ "GenSigCycleTime" SG_ 922 RLR_FreespaceSectorDistance9 50;
BA_ "GenSigCycleTime" SG_ 922 RLR_FreespaceSectorKinestate8 50;
BA_ "GenSigCycleTime" SG_ 922 RLR_FreespaceSectorConRidence8 50;
BA_ "GenSigCycleTime" SG_ 922 RLR_FreespaceSectorDistance8 50;
BA_ "GenSigCycleTime" SG_ 922 RLR_FreespaceSectorKinestate7 50;
BA_ "GenSigCycleTime" SG_ 922 RLR_FreespaceSectorConRidence7 50;
BA_ "GenSigCycleTime" SG_ 922 RLR_FreespaceSectorDistance7 50;
BA_ "GenSigCycleTime" SG_ 922 RLR_FreespaceSectorKinestate6 50;
BA_ "GenSigCycleTime" SG_ 922 RLR_FreespaceSectorConRidence6 50;
BA_ "GenSigCycleTime" SG_ 922 RLR_FreespaceSectorDistance6 50;
BA_ "GenSigCycleTime" SG_ 922 RLR_FreespaceSectorKinestate5 50;
BA_ "GenSigCycleTime" SG_ 922 RLR_FreespaceSectorConRidence5 50;
BA_ "GenSigCycleTime" SG_ 922 RLR_FreespaceSectorDistance5 50;
BA_ "GenSigCycleTime" SG_ 922 RLR_FreespaceSectorKinestate4 50;
BA_ "GenSigCycleTime" SG_ 922 RLR_FreespaceSectorConRidence4 50;
BA_ "GenSigCycleTime" SG_ 922 RLR_FreespaceSectorDistance4 50;
BA_ "GenSigCycleTime" SG_ 922 RLR_FreespaceSectorKinestate3 50;
BA_ "GenSigCycleTime" SG_ 922 RLR_FreespaceSectorConRidence3 50;
BA_ "GenSigCycleTime" SG_ 922 RLR_FreespaceSectorDistance3 50;
BA_ "GenSigCycleTime" SG_ 922 RLR_FreespaceSectorKinestate2 50;
BA_ "GenSigCycleTime" SG_ 922 RLR_FreespaceSectorConRidence2 50;
BA_ "GenSigCycleTime" SG_ 922 RLR_FreespaceSectorDistance2 50;
BA_ "GenSigCycleTime" SG_ 922 RLR_FreespaceSectorKinestate1 50;
BA_ "GenSigCycleTime" SG_ 922 RLR_FreespaceSectorConRidence1 50;
BA_ "GenSigCycleTime" SG_ 922 RLR_FreespaceSectorDistance1 50;

BA_ "GenSigCycleTime" SG_ 923 RLR_CRCCheck_39B 50;
BA_ "GenSigCycleTime" SG_ 923 RLR_RollingCounter_39B 50;
BA_ "GenSigCycleTime" SG_ 923 RLR_FreespaceSectorKinestate68 50;
BA_ "GenSigCycleTime" SG_ 923 RLR_FreespaceSectorConRidence68 50;
BA_ "GenSigCycleTime" SG_ 923 RLR_FreespaceSectorDistance68 50;
BA_ "GenSigCycleTime" SG_ 923 RLR_FreespaceSectorKinestate67 50;
BA_ "GenSigCycleTime" SG_ 923 RLR_FreespaceSectorConRidence67 50;
BA_ "GenSigCycleTime" SG_ 923 RLR_FreespaceSectorDistance67 50;
BA_ "GenSigCycleTime" SG_ 923 RLR_FreespaceSectorKinestate66 50;
BA_ "GenSigCycleTime" SG_ 923 RLR_FreespaceSectorConRidence66 50;
BA_ "GenSigCycleTime" SG_ 923 RLR_FreespaceSectorDistance66 50;
BA_ "GenSigCycleTime" SG_ 923 RLR_FreespaceSectorKinestate65 50;
BA_ "GenSigCycleTime" SG_ 923 RLR_FreespaceSectorConRidence65 50;
BA_ "GenSigCycleTime" SG_ 923 RLR_FreespaceSectorDistance65 50;
BA_ "GenSigCycleTime" SG_ 923 RLR_FreespaceSectorKinestate64 50;
BA_ "GenSigCycleTime" SG_ 923 RLR_FreespaceSectorConRidence64 50;
BA_ "GenSigCycleTime" SG_ 923 RLR_FreespaceSectorDistance64 50;
BA_ "GenSigCycleTime" SG_ 923 RLR_FreespaceSectorKinestate63 50;
BA_ "GenSigCycleTime" SG_ 923 RLR_FreespaceSectorConRidence63 50;
BA_ "GenSigCycleTime" SG_ 923 RLR_FreespaceSectorDistance63 50;
BA_ "GenSigCycleTime" SG_ 923 RLR_FreespaceSectorKinestate62 50;
BA_ "GenSigCycleTime" SG_ 923 RLR_FreespaceSectorConRidence62 50;
BA_ "GenSigCycleTime" SG_ 923 RLR_FreespaceSectorDistance62 50;
BA_ "GenSigCycleTime" SG_ 923 RLR_FreespaceSectorKinestate61 50;
BA_ "GenSigCycleTime" SG_ 923 RLR_FreespaceSectorConRidence61 50;
BA_ "GenSigCycleTime" SG_ 923 RLR_FreespaceSectorDistance61 50;
BA_ "GenSigCycleTime" SG_ 923 RLR_FreespaceSectorKinestate60 50;
BA_ "GenSigCycleTime" SG_ 923 RLR_FreespaceSectorConRidence60 50;
BA_ "GenSigCycleTime" SG_ 923 RLR_FreespaceSectorDistance60 50;
BA_ "GenSigCycleTime" SG_ 923 RLR_FreespaceSectorKinestate59 50;
BA_ "GenSigCycleTime" SG_ 923 RLR_FreespaceSectorConRidence59 50;
BA_ "GenSigCycleTime" SG_ 923 RLR_FreespaceSectorDistance59 50;
BA_ "GenSigCycleTime" SG_ 923 RLR_FreespaceSectorKinestate58 50;
BA_ "GenSigCycleTime" SG_ 923 RLR_FreespaceSectorConRidence58 50;
BA_ "GenSigCycleTime" SG_ 923 RLR_FreespaceSectorDistance58 50;
BA_ "GenSigCycleTime" SG_ 923 RLR_FreespaceSectorKinestate57 50;
BA_ "GenSigCycleTime" SG_ 923 RLR_FreespaceSectorConRidence57 50;
BA_ "GenSigCycleTime" SG_ 923 RLR_FreespaceSectorDistance57 50;
BA_ "GenSigCycleTime" SG_ 923 RLR_FreespaceSectorKinestate56 50;
BA_ "GenSigCycleTime" SG_ 923 RLR_FreespaceSectorConRidence56 50;
BA_ "GenSigCycleTime" SG_ 923 RLR_FreespaceSectorDistance56 50;
BA_ "GenSigCycleTime" SG_ 923 RLR_FreespaceSectorKinestate55 50;
BA_ "GenSigCycleTime" SG_ 923 RLR_FreespaceSectorConRidence55 50;
BA_ "GenSigCycleTime" SG_ 923 RLR_FreespaceSectorDistance55 50;
BA_ "GenSigCycleTime" SG_ 923 RLR_FreespaceSectorKinestate54 50;
BA_ "GenSigCycleTime" SG_ 923 RLR_FreespaceSectorConRidence54 50;
BA_ "GenSigCycleTime" SG_ 923 RLR_FreespaceSectorDistance54 50;
BA_ "GenSigCycleTime" SG_ 923 RLR_FreespaceSectorKinestate53 50;
BA_ "GenSigCycleTime" SG_ 923 RLR_FreespaceSectorConRidence53 50;
BA_ "GenSigCycleTime" SG_ 923 RLR_FreespaceSectorDistance53 50;
BA_ "GenSigCycleTime" SG_ 923 RLR_FreespaceSectorKinestate52 50;
BA_ "GenSigCycleTime" SG_ 923 RLR_FreespaceSectorConRidence52 50;
BA_ "GenSigCycleTime" SG_ 923 RLR_FreespaceSectorDistance52 50;
BA_ "GenSigCycleTime" SG_ 923 RLR_FreespaceSectorKinestate51 50;
BA_ "GenSigCycleTime" SG_ 923 RLR_FreespaceSectorConRidence51 50;
BA_ "GenSigCycleTime" SG_ 923 RLR_FreespaceSectorDistance51 50;
BA_ "GenSigCycleTime" SG_ 923 RLR_FreespaceSectorKinestate50 50;
BA_ "GenSigCycleTime" SG_ 923 RLR_FreespaceSectorConRidence50 50;
BA_ "GenSigCycleTime" SG_ 923 RLR_FreespaceSectorDistance50 50;
BA_ "GenSigCycleTime" SG_ 923 RLR_FreespaceSectorKinestate49 50;
BA_ "GenSigCycleTime" SG_ 923 RLR_FreespaceSectorConRidence49 50;
BA_ "GenSigCycleTime" SG_ 923 RLR_FreespaceSectorDistance49 50;
BA_ "GenSigCycleTime" SG_ 923 RLR_FreespaceSectorKinestate48 50;
BA_ "GenSigCycleTime" SG_ 923 RLR_FreespaceSectorConRidence48 50;
BA_ "GenSigCycleTime" SG_ 923 RLR_FreespaceSectorDistance48 50;
BA_ "GenSigCycleTime" SG_ 923 RLR_FreespaceSectorKinestate47 50;
BA_ "GenSigCycleTime" SG_ 923 RLR_FreespaceSectorConRidence47 50;
BA_ "GenSigCycleTime" SG_ 923 RLR_FreespaceSectorDistance47 50;
BA_ "GenSigCycleTime" SG_ 923 RLR_FreespaceSectorKinestate46 50;
BA_ "GenSigCycleTime" SG_ 923 RLR_FreespaceSectorConRidence46 50;
BA_ "GenSigCycleTime" SG_ 923 RLR_FreespaceSectorDistance46 50;
BA_ "GenSigCycleTime" SG_ 923 RLR_FreespaceSectorKinestate45 50;
BA_ "GenSigCycleTime" SG_ 923 RLR_FreespaceSectorConRidence45 50;
BA_ "GenSigCycleTime" SG_ 923 RLR_FreespaceSectorDistance45 50;
BA_ "GenSigCycleTime" SG_ 923 RLR_FreespaceSectorKinestate44 50;
BA_ "GenSigCycleTime" SG_ 923 RLR_FreespaceSectorConRidence44 50;
BA_ "GenSigCycleTime" SG_ 923 RLR_FreespaceSectorDistance44 50;
BA_ "GenSigCycleTime" SG_ 923 RLR_FreespaceSectorKinestate43 50;
BA_ "GenSigCycleTime" SG_ 923 RLR_FreespaceSectorConRidence43 50;
BA_ "GenSigCycleTime" SG_ 923 RLR_FreespaceSectorDistance43 50;
BA_ "GenSigCycleTime" SG_ 923 RLR_FreespaceSectorKinestate42 50;
BA_ "GenSigCycleTime" SG_ 923 RLR_FreespaceSectorConRidence42 50;
BA_ "GenSigCycleTime" SG_ 923 RLR_FreespaceSectorDistance42 50;
BA_ "GenSigCycleTime" SG_ 923 RLR_FreespaceSectorKinestate41 50;
BA_ "GenSigCycleTime" SG_ 923 RLR_FreespaceSectorConRidence41 50;
BA_ "GenSigCycleTime" SG_ 923 RLR_FreespaceSectorDistance41 50;
BA_ "GenSigCycleTime" SG_ 923 RLR_FreespaceSectorKinestate40 50;
BA_ "GenSigCycleTime" SG_ 923 RLR_FreespaceSectorConRidence40 50;
BA_ "GenSigCycleTime" SG_ 923 RLR_FreespaceSectorDistance40 50;
BA_ "GenSigCycleTime" SG_ 923 RLR_FreespaceSectorKinestate39 50;
BA_ "GenSigCycleTime" SG_ 923 RLR_FreespaceSectorConRidence39 50;
BA_ "GenSigCycleTime" SG_ 923 RLR_FreespaceSectorDistance39 50;
BA_ "GenSigCycleTime" SG_ 923 RLR_FreespaceSectorKinestate38 50;
BA_ "GenSigCycleTime" SG_ 923 RLR_FreespaceSectorConRidence38 50;
BA_ "GenSigCycleTime" SG_ 923 RLR_FreespaceSectorDistance38 50;
BA_ "GenSigCycleTime" SG_ 923 RLR_FreespaceSectorKinestate37 50;
BA_ "GenSigCycleTime" SG_ 923 RLR_FreespaceSectorConRidence37 50;
BA_ "GenSigCycleTime" SG_ 923 RLR_FreespaceSectorDistance37 50;
BA_ "GenSigCycleTime" SG_ 923 RLR_FreespaceSectorKinestate36 50;
BA_ "GenSigCycleTime" SG_ 923 RLR_FreespaceSectorConRidence36 50;
BA_ "GenSigCycleTime" SG_ 923 RLR_FreespaceSectorDistance36 50;
BA_ "GenSigCycleTime" SG_ 923 RLR_FreespaceSectorKinestate35 50;
BA_ "GenSigCycleTime" SG_ 923 RLR_FreespaceSectorConRidence35 50;
BA_ "GenSigCycleTime" SG_ 923 RLR_FreespaceSectorDistance35 50;

VAL_ 859 RLR_OBJ24_Convergence 0 "收敛
0x1=不收敛";
VAL_ 859 RLR_OBJ24_MotionStatus 0 "unknown" 1 "moving " 2 "stopped" 3 "stationary" 4 "crossing" 5 "reserve;";
VAL_ 859 RLR_OBJ23_Convergence 0 "收敛
0x1=不收敛";
VAL_ 859 RLR_OBJ23_MotionStatus 0 "unknown" 1 "moving " 2 "stopped" 3 "stationary" 4 "crossing" 5 "reserve;";
VAL_ 859 RLR_OBJ24_Measured 0 "unknown" 1 "Measured" 2 "Predicted" 3 "Reserved";
VAL_ 859 RLR_OBJ24_Location 0 "unknown" 1 "LeRt Lane" 2 "Right  Lane" 3 "Ego Lane";
VAL_ 859 RLR_OBJ24_Type 0 "Not Detected" 1 "car" 2 "truck" 3 "bicycle/motorbike" 4 "pedestrian" 5 "general" 6 "animal" 7 "uncertain";
VAL_ 859 RLR_OBJ23_Measured 0 "unknown" 1 "Measured" 2 "Predicted" 3 "Reserved";
VAL_ 859 RLR_OBJ23_Location 0 "unknown" 1 "LeRt Lane" 2 "Right  Lane" 3 "Ego Lane";
VAL_ 859 RLR_OBJ23_Type 0 "Not Detected" 1 "car" 2 "truck" 3 "bicycle/motorbike" 4 "pedestrian" 5 "general" 6 "animal" 7 "uncertain";

VAL_ 860 RLR_OBJ26_Convergence 0 "收敛
0x1=不收敛";
VAL_ 860 RLR_OBJ26_MotionStatus 0 "unknown" 1 "moving " 2 "stopped" 3 "stationary" 4 "crossing" 5 "reserve;";
VAL_ 860 RLR_OBJ25_Convergence 0 "收敛
0x1=不收敛";
VAL_ 860 RLR_OBJ25_MotionStatus 0 "unknown" 1 "moving " 2 "stopped" 3 "stationary" 4 "crossing" 5 "reserve;";
VAL_ 860 RLR_OBJ26_Measured 0 "unknown" 1 "Measured" 2 "Predicted" 3 "Reserved";
VAL_ 860 RLR_OBJ26_Location 0 "unknown" 1 "LeRt Lane" 2 "Right  Lane" 3 "Ego Lane";
VAL_ 860 RLR_OBJ26_Type 0 "Not Detected" 1 "car" 2 "truck" 3 "bicycle/motorbike" 4 "pedestrian" 5 "general" 6 "animal" 7 "uncertain";
VAL_ 860 RLR_OBJ25_Measured 0 "unknown" 1 "Measured" 2 "Predicted" 3 "Reserved";
VAL_ 860 RLR_OBJ25_Location 0 "unknown" 1 "LeRt Lane" 2 "Right  Lane" 3 "Ego Lane";
VAL_ 860 RLR_OBJ25_Type 0 "Not Detected" 1 "car" 2 "truck" 3 "bicycle/motorbike" 4 "pedestrian" 5 "general" 6 "animal" 7 "uncertain";

VAL_ 861 RLR_OBJ28_Convergence 0 "收敛
0x1=不收敛";
VAL_ 861 RLR_OBJ28_MotionStatus 0 "unknown" 1 "moving " 2 "stopped" 3 "stationary" 4 "crossing" 5 "reserve;";
VAL_ 861 RLR_OBJ27_Convergence 0 "收敛
0x1=不收敛";
VAL_ 861 RLR_OBJ27_MotionStatus 0 "unknown" 1 "moving " 2 "stopped" 3 "stationary" 4 "crossing" 5 "reserve;";
VAL_ 861 RLR_OBJ28_Measured 0 "unknown" 1 "Measured" 2 "Predicted" 3 "Reserved";
VAL_ 861 RLR_OBJ28_Location 0 "unknown" 1 "LeRt Lane" 2 "Right  Lane" 3 "Ego Lane";
VAL_ 861 RLR_OBJ28_Type 0 "Not Detected" 1 "car" 2 "truck" 3 "bicycle/motorbike" 4 "pedestrian" 5 "general" 6 "animal" 7 "uncertain";
VAL_ 861 RLR_OBJ27_Measured 0 "unknown" 1 "Measured" 2 "Predicted" 3 "Reserved";
VAL_ 861 RLR_OBJ27_Location 0 "unknown" 1 "LeRt Lane" 2 "Right  Lane" 3 "Ego Lane";
VAL_ 861 RLR_OBJ27_Type 0 "Not Detected" 1 "car" 2 "truck" 3 "bicycle/motorbike" 4 "pedestrian" 5 "general" 6 "animal" 7 "uncertain";

VAL_ 862 RLR_OBJ30_Convergence 0 "收敛
0x1=不收敛";
VAL_ 862 RLR_OBJ30_MotionStatus 0 "unknown" 1 "moving " 2 "stopped" 3 "stationary" 4 "crossing" 5 "reserve;";
VAL_ 862 RLR_OBJ29_Convergence 0 "收敛
0x1=不收敛";
VAL_ 862 RLR_OBJ29_MotionStatus 0 "unknown" 1 "moving " 2 "stopped" 3 "stationary" 4 "crossing" 5 "reserve;";
VAL_ 862 RLR_OBJ30_Measured 0 "unknown" 1 "Measured" 2 "Predicted" 3 "Reserved";
VAL_ 862 RLR_OBJ30_Location 0 "unknown" 1 "LeRt Lane" 2 "Right  Lane" 3 "Ego Lane";
VAL_ 862 RLR_OBJ30_Type 0 "Not Detected" 1 "car" 2 "truck" 3 "bicycle/motorbike" 4 "pedestrian" 5 "general" 6 "animal" 7 "uncertain";
VAL_ 862 RLR_OBJ29_Measured 0 "unknown" 1 "Measured" 2 "Predicted" 3 "Reserved";
VAL_ 862 RLR_OBJ29_Location 0 "unknown" 1 "LeRt Lane" 2 "Right  Lane" 3 "Ego Lane";
VAL_ 862 RLR_OBJ29_Type 0 "Not Detected" 1 "car" 2 "truck" 3 "bicycle/motorbike" 4 "pedestrian" 5 "general" 6 "animal" 7 "uncertain";

VAL_ 863 RLR_OBJ32_Convergence 0 "收敛
0x1=不收敛";
VAL_ 863 RLR_OBJ32_MotionStatus 0 "unknown" 1 "moving " 2 "stopped" 3 "stationary" 4 "crossing" 5 "reserve;";
VAL_ 863 RLR_OBJ31_Convergence 0 "收敛
0x1=不收敛";
VAL_ 863 RLR_OBJ31_MotionStatus 0 "unknown" 1 "moving " 2 "stopped" 3 "stationary" 4 "crossing" 5 "reserve;";
VAL_ 863 RLR_OBJ32_Measured 0 "unknown" 1 "Measured" 2 "Predicted" 3 "Reserved";
VAL_ 863 RLR_OBJ32_Location 0 "unknown" 1 "LeRt Lane" 2 "Right  Lane" 3 "Ego Lane";
VAL_ 863 RLR_OBJ32_Type 0 "Not Detected" 1 "car" 2 "truck" 3 "bicycle/motorbike" 4 "pedestrian" 5 "general" 6 "animal" 7 "uncertain";
VAL_ 863 RLR_OBJ31_Measured 0 "unknown" 1 "Measured" 2 "Predicted" 3 "Reserved";
VAL_ 863 RLR_OBJ31_Location 0 "unknown" 1 "LeRt Lane" 2 "Right  Lane" 3 "Ego Lane";
VAL_ 863 RLR_OBJ31_Type 0 "Not Detected" 1 "car" 2 "truck" 3 "bicycle/motorbike" 4 "pedestrian" 5 "general" 6 "animal" 7 "uncertain";

VAL_ 943 RRR_HwVers6 48 "0" 49 "1" 50 "2" 51 "3" 52 "4" 53 "5" 54 "6" 55 "7" 56 "8" 57 "9" 65 "A" 66 "B" 67 "C" 68 "D" 69 "E" 70 "R" 71 "G" 72 "H" 73 "I" 74 "J" 75 "K" 76 "L" 77 "M" 78 "N" 4 "O" 80 "P" 81 "Q" 82 "R" 83 "S" 84 "T" 85 "U" 86 "V" 87 "W" 88 "X" 89 "Y" 90 "Z";
VAL_ 943 RRR_HwVers5 46 ".";
VAL_ 943 RRR_HwVers4 48 "0" 49 "1" 50 "2" 51 "3" 52 "4" 53 "5" 54 "6" 55 "7" 56 "8" 57 "9" 65 "A" 66 "B" 67 "C" 68 "D" 69 "E" 70 "R" 71 "G" 72 "H" 73 "I" 74 "J" 75 "K" 76 "L" 77 "M" 78 "N" 4 "O" 80 "P" 81 "Q" 82 "R" 83 "S" 84 "T" 85 "U" 86 "V" 87 "W" 88 "X" 89 "Y" 90 "Z";
VAL_ 943 RRR_HwVers3 46 ".";
VAL_ 943 RRR_HwVers2 48 "0" 49 "1" 50 "2" 51 "3" 52 "4" 53 "5" 54 "6" 55 "7" 56 "8" 57 "9" 65 "A" 66 "B" 67 "C" 68 "D" 69 "E" 70 "R" 71 "G" 72 "H" 73 "I" 74 "J" 75 "K" 76 "L" 77 "M" 78 "N" 4 "O" 80 "P" 81 "Q" 82 "R" 83 "S" 84 "T" 85 "U" 86 "V" 87 "W" 88 "X" 89 "Y" 90 "Z";
VAL_ 943 RRR_HwVers1 87 "W";
VAL_ 943 RRR_HwVers0 72 "H";
VAL_ 943 RRR_SwVers6 48 "0" 49 "1" 50 "2" 51 "3" 52 "4" 53 "5" 54 "6" 55 "7" 56 "8" 57 "9" 65 "A" 66 "B" 67 "C" 68 "D" 69 "E" 70 "R" 71 "G" 72 "H" 73 "I" 74 "J" 75 "K" 76 "L" 77 "M" 78 "N" 4 "O" 80 "P" 81 "Q" 82 "R" 83 "S" 84 "T" 85 "U" 86 "V" 87 "W" 88 "X" 89 "Y" 90 "Z";
VAL_ 943 RRR_SwVers5 46 ".";
VAL_ 943 RRR_SwVers4 48 "0" 49 "1" 50 "2" 51 "3" 52 "4" 53 "5" 54 "6" 55 "7" 56 "8" 57 "9" 65 "A" 66 "B" 67 "C" 68 "D" 69 "E" 70 "R" 71 "G" 72 "H" 73 "I" 74 "J" 75 "K" 76 "L" 77 "M" 78 "N" 4 "O" 80 "P" 81 "Q" 82 "R" 83 "S" 84 "T" 85 "U" 86 "V" 87 "W" 88 "X" 89 "Y" 90 "Z";
VAL_ 943 RRR_SwVers3 46 ".";
VAL_ 943 RRR_SwVers2 48 "0" 49 "1" 50 "2" 51 "3" 52 "4" 53 "5" 54 "6" 55 "7" 56 "8" 57 "9" 65 "A" 66 "B" 67 "C" 68 "D" 69 "E" 70 "R" 71 "G" 72 "H" 73 "I" 74 "J" 75 "K" 76 "L" 77 "M" 78 "N" 4 "O" 80 "P" 81 "Q" 82 "R" 83 "S" 84 "T" 85 "U" 86 "V" 87 "W" 88 "X" 89 "Y" 90 "Z";
VAL_ 943 RRR_SwVers1 87 "W";
VAL_ 943 RRR_SwVers0 83 "S";
VAL_ 943 RLR_HwVers6 48 "0" 49 "1" 50 "2" 51 "3" 52 "4" 53 "5" 54 "6" 55 "7" 56 "8" 57 "9" 65 "A" 66 "B" 67 "C" 68 "D" 69 "E" 70 "R" 71 "G" 72 "H" 73 "I" 74 "J" 75 "K" 76 "L" 77 "M" 78 "N" 4 "O" 80 "P" 81 "Q" 82 "R" 83 "S" 84 "T" 85 "U" 86 "V" 87 "W" 88 "X" 89 "Y" 90 "Z";
VAL_ 943 RLR_HwVers5 46 ".";
VAL_ 943 RLR_HwVers4 48 "0" 49 "1" 50 "2" 51 "3" 52 "4" 53 "5" 54 "6" 55 "7" 56 "8" 57 "9" 65 "A" 66 "B" 67 "C" 68 "D" 69 "E" 70 "R" 71 "G" 72 "H" 73 "I" 74 "J" 75 "K" 76 "L" 77 "M" 78 "N" 4 "O" 80 "P" 81 "Q" 82 "R" 83 "S" 84 "T" 85 "U" 86 "V" 87 "W" 88 "X" 89 "Y" 90 "Z";
VAL_ 943 RLR_HwVers3 46 ".";
VAL_ 943 RLR_HwVers2 48 "0" 49 "1" 50 "2" 51 "3" 52 "4" 53 "5" 54 "6" 55 "7" 56 "8" 57 "9" 65 "A" 66 "B" 67 "C" 68 "D" 69 "E" 70 "R" 71 "G" 72 "H" 73 "I" 74 "J" 75 "K" 76 "L" 77 "M" 78 "N" 4 "O" 80 "P" 81 "Q" 82 "R" 83 "S" 84 "T" 85 "U" 86 "V" 87 "W" 88 "X" 89 "Y" 90 "Z";
VAL_ 943 RLR_HwVers1 87 "W";
VAL_ 943 RLR_HwVers0 72 "H";
VAL_ 943 RLR_SwVers6 48 "0" 49 "1" 50 "2" 51 "3" 52 "4" 53 "5" 54 "6" 55 "7" 56 "8" 57 "9" 65 "A" 66 "B" 67 "C" 68 "D" 69 "E" 70 "R" 71 "G" 72 "H" 73 "I" 74 "J" 75 "K" 76 "L" 77 "M" 78 "N" 4 "O" 80 "P" 81 "Q" 82 "R" 83 "S" 84 "T" 85 "U" 86 "V" 87 "W" 88 "X" 89 "Y" 90 "Z";
VAL_ 943 RLR_SwVers5 46 ".";
VAL_ 943 RLR_SwVers4 48 "0" 49 "1" 50 "2" 51 "3" 52 "4" 53 "5" 54 "6" 55 "7" 56 "8" 57 "9" 65 "A" 66 "B" 67 "C" 68 "D" 69 "E" 70 "R" 71 "G" 72 "H" 73 "I" 74 "J" 75 "K" 76 "L" 77 "M" 78 "N" 4 "O" 80 "P" 81 "Q" 82 "R" 83 "S" 84 "T" 85 "U" 86 "V" 87 "W" 88 "X" 89 "Y" 90 "Z";
VAL_ 943 RLR_SwVers3 46 ".";
VAL_ 943 RLR_SwVers2 48 "0" 49 "1" 50 "2" 51 "3" 52 "4" 53 "5" 54 "6" 55 "7" 56 "8" 57 "9" 65 "A" 66 "B" 67 "C" 68 "D" 69 "E" 70 "R" 71 "G" 72 "H" 73 "I" 74 "J" 75 "K" 76 "L" 77 "M" 78 "N" 4 "O" 80 "P" 81 "Q" 82 "R" 83 "S" 84 "T" 85 "U" 86 "V" 87 "W" 88 "X" 89 "Y" 90 "Z";
VAL_ 943 RLR_SwVers1 87 "W";
VAL_ 943 RLR_SwVers0 83 "S";

VAL_ 837 RLR_BSDLCAMode 0 "Light" 1 "Light+Vibration" 2 "Light+Voice" 3 "OFF;";
VAL_ 837 RLR_AudioWarningEnableStatus 0 "Off" 1 "On";
VAL_ 837 RLR_SEAEnableStatus 0 "Off" 1 "On";
VAL_ 837 RLR_BSD_LCASoundWar 0 "No Warning" 1 "Warning";
VAL_ 837 RLR_LDWShakeLevStatus 0 "reserved" 1 "low" 2 "normal" 3 "high";
VAL_ 837 RLR_EmergencyLightingRequest 0 "no request" 1 "Level1" 2 "Level2" 3 "OFF";
VAL_ 837 RLR_LDWVibrationWarningReq 0 " No Warning不报警" 1 " Left Warning左报警" 2 "Right Warning右报警" 3 " reserved";
VAL_ 837 RLR_RearColliAstType 0 "";
VAL_ 837 RLR_SEAModeStatus 0 "sound//音效" 1 "voice//语音";
VAL_ 837 RLR_SEAOnOffSts 0 "off//关闭" 1 "on//开启";
VAL_ 837 RLR_BSDLCASetting 0 "";
VAL_ 837 RLR_BSDLCARemindmode 0 "";
VAL_ 837 RLR_BSDLCAOnOff 0 "";
VAL_ 837 RLR_RCWEnableStatus 0 "Off" 1 "On";
VAL_ 837 RLR_RCTAEnableStatus 0 "Off" 1 "On";
VAL_ 837 RLR_AEBVehilceHoldReq 0 " No hold" 1 " hold";
VAL_ 837 RLR_RCTBEnable 0 "off" 1 "on";
VAL_ 837 RLR_BSD_LCAEnableStatus 0 "early" 1 "normal（初始值）" 2 "late" 3 "Off";
VAL_ 837 RLR_SEAStatus 0 "OFF(关闭)" 1 "Inactive(未激活)" 2 "Active" 3 "Failure";
VAL_ 837 RLR_RCWStatus 0 "OFF(关闭)" 1 "Inactive(未激活)" 2 "Active" 3 "Failure";
VAL_ 837 RLR_BSD_LCAStatus 0 "OFF(关闭)" 1 "Inactive(未激活)" 2 "Active" 3 "Failure";
VAL_ 837 RLR_RCTBStatus 0 "OFF(关闭)" 1 "Inactive(未激活)" 2 "Active" 3 "Failure";
VAL_ 837 RLR_RCTAStatus 0 "OFF(关闭)" 1 "Inactive(未激活)" 2 "Active" 3 "Failure";
VAL_ 837 RLR_Left_BSD_LCAAlert 0 "No LCA warning" 1 "LCA warning level 1" 2 "LCA warning level 2" 3 "Reserved";
VAL_ 837 RLR_SEAAlert 0 "No SEA warning
0x1=SEA warning level 1
0x2=SEA Exit
0x3=SEA warning level 2";
VAL_ 837 RLR_RCWAlert 0 "No RCW warning" 1 "RCW warning level1" 2 "RCW warning level2" 3 "RCW warning level3";
VAL_ 837 RLR_DOWLeftAlert 0 " no warning" 1 "level1" 2 "SEA Exit" 3 "level2";
VAL_ 837 RLR_BSD_LCAAlert 0 "No LCA warning" 1 "LCA warning level 1" 2 "LCA warning level 2" 3 "Reserved";
VAL_ 837 RLR_RCTBActive 0 " not Active" 1 " left Active" 2 " right Active";
VAL_ 837 RLR_Right_SEAAlert 0 "No SEA warning
0x1=SEA warning level 1
0x2=SEA Exit
0x3=SEA warning level 2";
VAL_ 837 RLR_Right_RCWAlert 0 "No RCW warning" 1 "RCW warning level1" 2 "RCW warning level2" 3 "RCW warning level3";
VAL_ 837 RLR_DOWRightAlert 0 " no warning" 1 "level1" 2 "SEA Exit" 3 "level2";
VAL_ 837 RLR_Left_RCTAAlert 0 "No RCTA warning" 1 "RCTA warning Level1" 2 "RCTA warning Level2" 3 "RCTA warning Level3";
VAL_ 837 RLR_Right_RCTAAlert 0 "No RCTA warning" 1 "RCTA warning Level1" 2 "RCTA warning Level2" 3 "RCTA warning Level3";

VAL_ 692 LCDAL_ResetSts 0 "Valid" 1 "GW请求复位" 2 "自身判断复位" 3 "不满足复位条件" 4 "Reserve" 7 "Invalid";
VAL_ 692 RealTimeCal_Status_RL 0 "未开始
0x1=开始
0x2=成功
0x3=失败
0x4= 人工取消";
VAL_ 692 DiagCal_Status_RL 0 "未开始
0x1=开始
0x2=成功
0x3=失败
0x4= 人工取消";
VAL_ 692 EolCal_Status_RL 0 "未开始
0x1=开始
0x2=成功
0x3=失败
0x4= 人工取消";

VAL_ 587 RLR_Measured_R 0 "unknown" 1 "Measured" 2 "Predicted" 3 "Reserved";
VAL_ 587 RLR_Location_R 0 "unknown" 1 "Left Lane" 2 "Right  Lane" 3 "Ego Lane";
VAL_ 587 RLR_ClassComfrmFlg_R 0 "未确认" 1 "已确认;";
VAL_ 587 RLR_TrckrType_R 0 "Not Detected" 1 "car" 2 "truck" 3 "bicycle/motorbike" 4 "pedestrian" 5 "general" 6 "animal" 7 "uncertain";
VAL_ 587 RLR_MotionStatus_R 0 "unknown" 1 "moving " 2 "stopped" 3 "stationary" 4 "crossing" 5 "reserve;";
VAL_ 587 RLR_Measured_L 0 "unknown" 1 "Measured" 2 "Predicted" 3 "Reserved";
VAL_ 587 RLR_Location_L 0 "unknown" 1 "Left Lane" 2 "Right  Lane" 3 "Ego Lane";
VAL_ 587 RLR_ClassComfrmFlg_L 0 "未确认" 1 "已确认;";
VAL_ 587 RLR_TrckrType_L 0 "Not Detected" 1 "car" 2 "truck" 3 "bicycle/motorbike" 4 "pedestrian" 5 "general" 6 "animal" 7 "uncertain";
VAL_ 587 RLR_MotionStatus_L 0 "unknown" 1 "moving " 2 "stopped" 3 "stationary" 4 "crossing" 5 "reserve;";

VAL_ 841 RRR_Suppliers 0 " ZM
0x1 = SSTK
0x2~0x15=Reserve";
VAL_ 841 RRR_RS_TiOut 0 "no timeout" 1 "timeout";
VAL_ 841 RRR_ECU_TiOut 0 "no timeout" 1 "timeout";
VAL_ 841 RRR_WorkMode 0 "Initial Value" 1 "行车模式" 2 "泊车模式" 3 "切换中";
VAL_ 841 RRR_SystemStatus 0 "低功耗状态" 1 "StartUp" 2 "Running" 3 "Blocked" 4 "Calibration" 5 "ShutDown" 6 "Hot" 7 "Failure";
