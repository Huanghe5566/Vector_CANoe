VERSION ""

NS_ :

BS_:

BU_: FR C3B

BO_ 518 FR_206: 64 FR
 SG_ FR_H_SwVers6 : 63|8@0+ (1,0) [0|255] ""  C3B
 SG_ FR_H_SwVers5 : 55|8@0+ (1,0) [0|255] ""  C3B
 SG_ FR_H_SwVers4 : 39|16@0+ (1,0) [0|65535] ""  C3B
 SG_ FR_H_SwVers3 : 31|8@0+ (1,0) [0|255] ""  C3B
 SG_ FR_H_SwVers2 : 23|8@0+ (1,0) [0|255] ""  C3B
 SG_ FR_H_SwVers1 : 15|8@0+ (1,0) [0|255] ""  C3B
 SG_ FR_H_SwVers0 : 7|8@0+ (1,0) [0|255] ""  C3B
 SG_ FR_H_HwVers6 : 127|8@0+ (1,0) [0|255] ""  C3B
 SG_ FR_H_HwVers5 : 119|8@0+ (1,0) [0|255] ""  C3B
 SG_ FR_H_HwVers4 : 103|16@0+ (1,0) [0|65535] ""  C3B
 SG_ FR_H_HwVers3 : 95|8@0+ (1,0) [0|255] ""  C3B
 SG_ FR_H_HwVers2 : 87|8@0+ (1,0) [0|255] ""  C3B
 SG_ FR_H_HwVers1 : 79|8@0+ (1,0) [0|255] ""  C3B
 SG_ FR_H_HwVers0 : 71|8@0+ (1,0) [0|255] ""  C3B

BO_ 544 FR_220: 64 FR
 SG_ FR_CRCCheck_220 : 503|16@0+ (1,0) [0|65535] ""  C3B
 SG_ FR_RollingCounter_220 : 491|4@0+ (1,0) [0|15] ""  C3B
 SG_ FR_Obj25_Ax : 303|10@0+ (0.03125,-16) [-16|15.96875] "m/s2"  C3B
 SG_ FR_Obj25_Ay : 280|9@0+ (0.0625,-16) [-16|15.9375] "m/s2"  C3B
 SG_ FR_Obj25_Vx : 276|12@0+ (0.0625,-128) [-128|127.9375] "m/s"  C3B
 SG_ FR_Obj25_Vy : 270|10@0+ (0.0625,-32) [-32|31.9375] "m/s"  C3B
 SG_ FR_Obj25_DelayTime : 254|16@0+ (1,0) [0|65535] "ms"  C3B
 SG_ FR_Obj25_ReferPoint_Dx : 237|4@0+ (1,0) [0|15] "m"  C3B
 SG_ FR_Obj25_HeightGround : 223|9@0+ (0.1,0) [0|51.1] "m"  C3B
 SG_ FR_Obj25_MotionStatusConf : 213|6@0+ (2,0) [0|63] "-"  C3B
 SG_ FR_Obj25_MotionStatus : 200|3@0+ (1,0) [0|7] ""  C3B
 SG_ FR_Obj25_Measured : 202|2@0+ (1,0) [0|3] ""  C3B
 SG_ FR_Obj25_valid : 203|1@0+ (1,0) [0|1] ""  C3B
 SG_ FR_Obj25_Track_Age : 187|16@0+ (1,0) [0|65535] ""  C3B
 SG_ FR_Obj25_Track_ID : 171|16@0+ (1,0) [0|65535] ""  C3B
 SG_ FR_Obj25_ObstacleProb : 161|6@0+ (2,0) [0|100] "%"  C3B
 SG_ FR_Obj25_ExistProb : 167|6@0+ (2,0) [0|100] "%"  C3B
 SG_ FR_Obj25_RelAx : 145|10@0+ (0.03125,-16) [-16|15.96875] "m/s2"  C3B
 SG_ FR_Obj25_RelAy : 138|9@0+ (0.0625,-16) [-16|15.9375] "m/s2"  C3B
 SG_ FR_Obj25_RelVx_std : 134|12@0+ (0.0625,0) [0|255.9375] "m/s"  C3B
 SG_ FR_Obj25_RelVx : 114|12@0+ (0.0625,-128) [-128|127.9375] "m/s"  C3B
 SG_ FR_Obj25_RelVy_std : 108|10@0+ (0.125,0) [0|127.875] "m/s"  C3B
 SG_ FR_Obj25_RelVy : 102|10@0+ (0.0625,-32) [-32|31.9375] "m/s"  C3B
 SG_ FR_Obj25_Dx_Vnce : 84|14@0+ (0.05,0) [0|50] "m2"  C3B
 SG_ FR_Obj25_Dx : 65|13@0+ (0.0625,-100) [-100|411.9375] "m"  C3B
 SG_ FR_Obj25_Dy_Vnce : 59|10@0+ (0.02,0) [0|20] "m2"  C3B
 SG_ FR_Obj25_Dy : 54|11@0+ (0.125,-128) [-128|127.875] "m"  C3B
 SG_ FR_Obj25_HeadingAngle : 32|10@0+ (0.01,-3.14) [-3.14|3.14] "rad"  C3B
 SG_ FR_Obj25_Length : 25|9@0+ (0.05,0) [0|25.5] "m"  C3B
 SG_ FR_Obj25_Height : 18|9@0+ (0.01,0) [0|5.11] "m"  C3B
 SG_ FR_Obj25_Width : 12|10@0+ (0.01,0) [0|10.23] "m"  C3B
 SG_ FR_Obj25_TypeProb : 2|6@0+ (2,0) [0|100] "%"  C3B
 SG_ FR_Obj25_Type : 6|4@0+ (1,0) [0|15] ""  C3B

BO_ 545 FR_221: 64 FR
 SG_ FR_CRCCheck_221 : 503|16@0+ (1,0) [0|65535] ""  C3B
 SG_ FR_RollingCounter_221 : 491|4@0+ (1,0) [0|15] ""  C3B
 SG_ FR_Obj26_Ax : 303|10@0+ (0.03125,-16) [-16|15.96875] "m/s2"  C3B
 SG_ FR_Obj26_Ay : 280|9@0+ (0.0625,-16) [-16|15.9375] "m/s2"  C3B
 SG_ FR_Obj26_Vx : 276|12@0+ (0.0625,-128) [-128|127.9375] "m/s"  C3B
 SG_ FR_Obj26_Vy : 270|10@0+ (0.0625,-32) [-32|31.9375] "m/s"  C3B
 SG_ FR_Obj26_DelayTime : 254|16@0+ (1,0) [0|65535] "ms"  C3B
 SG_ FR_Obj26_ReferPoint_Dx : 237|4@0+ (1,0) [0|15] "m"  C3B
 SG_ FR_Obj26_HeightGround : 223|9@0+ (0.1,0) [0|51.1] "m"  C3B
 SG_ FR_Obj26_MotionStatusConf : 213|6@0+ (2,0) [0|63] "-"  C3B
 SG_ FR_Obj26_MotionStatus : 200|3@0+ (1,0) [0|7] ""  C3B
 SG_ FR_Obj26_Measured : 202|2@0+ (1,0) [0|3] ""  C3B
 SG_ FR_Obj26_valid : 203|1@0+ (1,0) [0|1] ""  C3B
 SG_ FR_Obj26_Track_Age : 187|16@0+ (1,0) [0|65535] ""  C3B
 SG_ FR_Obj26_Track_ID : 171|16@0+ (1,0) [0|65535] ""  C3B
 SG_ FR_Obj26_ObstacleProb : 161|6@0+ (2,0) [0|100] "%"  C3B
 SG_ FR_Obj26_ExistProb : 167|6@0+ (2,0) [0|100] "%"  C3B
 SG_ FR_Obj26_RelAx : 145|10@0+ (0.03125,-16) [-16|15.96875] "m/s2"  C3B
 SG_ FR_Obj26_RelAy : 138|9@0+ (0.0625,-16) [-16|15.9375] "m/s2"  C3B
 SG_ FR_Obj26_RelVx_std : 134|12@0+ (0.0625,0) [0|255.9375] "m/s"  C3B
 SG_ FR_Obj26_RelVx : 114|12@0+ (0.0625,-128) [-128|127.9375] "m/s"  C3B
 SG_ FR_Obj26_RelVy_std : 108|10@0+ (0.125,0) [0|127.875] "m/s"  C3B
 SG_ FR_Obj26_RelVy : 102|10@0+ (0.0625,-32) [-32|31.9375] "m/s"  C3B
 SG_ FR_Obj26_Dx_Vnce : 84|14@0+ (0.05,0) [0|50] "m2"  C3B
 SG_ FR_Obj26_Dx : 65|13@0+ (0.0625,-100) [-100|411.9375] "m"  C3B
 SG_ FR_Obj26_Dy_Vnce : 59|10@0+ (0.02,0) [0|20] "m2"  C3B
 SG_ FR_Obj26_Dy : 54|11@0+ (0.125,-128) [-128|127.875] "m"  C3B
 SG_ FR_Obj26_HeadingAngle : 32|10@0+ (0.01,-3.14) [-3.14|3.14] "rad"  C3B
 SG_ FR_Obj26_Length : 25|9@0+ (0.05,0) [0|25.5] "m"  C3B
 SG_ FR_Obj26_Height : 18|9@0+ (0.01,0) [0|5.11] "m"  C3B
 SG_ FR_Obj26_Width : 12|10@0+ (0.01,0) [0|10.23] "m"  C3B
 SG_ FR_Obj26_TypeProb : 2|6@0+ (2,0) [0|100] "%"  C3B
 SG_ FR_Obj26_Type : 6|4@0+ (1,0) [0|15] ""  C3B

BO_ 546 FR_222: 64 FR
 SG_ FR_CRCCheck_222 : 503|16@0+ (1,0) [0|65535] ""  C3B
 SG_ FR_RollingCounter_222 : 491|4@0+ (1,0) [0|15] ""  C3B
 SG_ FR_Obj27_Ax : 303|10@0+ (0.03125,-16) [-16|15.96875] "m/s2"  C3B
 SG_ FR_Obj27_Ay : 280|9@0+ (0.0625,-16) [-16|15.9375] "m/s2"  C3B
 SG_ FR_Obj27_Vx : 276|12@0+ (0.0625,-128) [-128|127.9375] "m/s"  C3B
 SG_ FR_Obj27_Vy : 270|10@0+ (0.0625,-32) [-32|31.9375] "m/s"  C3B
 SG_ FR_Obj27_DelayTime : 254|16@0+ (1,0) [0|65535] "ms"  C3B
 SG_ FR_Obj27_ReferPoint_Dx : 237|4@0+ (1,0) [0|15] "m"  C3B
 SG_ FR_Obj27_HeightGround : 223|9@0+ (0.1,0) [0|51.1] "m"  C3B
 SG_ FR_Obj27_MotionStatusConf : 213|6@0+ (2,0) [0|63] "-"  C3B
 SG_ FR_Obj27_MotionStatus : 200|3@0+ (1,0) [0|7] ""  C3B
 SG_ FR_Obj27_Measured : 202|2@0+ (1,0) [0|3] ""  C3B
 SG_ FR_Obj27_valid : 203|1@0+ (1,0) [0|1] ""  C3B
 SG_ FR_Obj27_Track_Age : 187|16@0+ (1,0) [0|65535] ""  C3B
 SG_ FR_Obj27_Track_ID : 171|16@0+ (1,0) [0|65535] ""  C3B
 SG_ FR_Obj27_ObstacleProb : 161|6@0+ (2,0) [0|100] "%"  C3B
 SG_ FR_Obj27_ExistProb : 167|6@0+ (2,0) [0|100] "%"  C3B
 SG_ FR_Obj27_RelAx : 145|10@0+ (0.03125,-16) [-16|15.96875] "m/s2"  C3B
 SG_ FR_Obj27_RelAy : 138|9@0+ (0.0625,-16) [-16|15.9375] "m/s2"  C3B
 SG_ FR_Obj27_RelVx_std : 134|12@0+ (0.0625,0) [0|255.9375] "m/s"  C3B
 SG_ FR_Obj27_RelVx : 114|12@0+ (0.0625,-128) [-128|127.9375] "m/s"  C3B
 SG_ FR_Obj27_RelVy_std : 108|10@0+ (0.125,0) [0|127.875] "m/s"  C3B
 SG_ FR_Obj27_RelVy : 102|10@0+ (0.0625,-32) [-32|31.9375] "m/s"  C3B
 SG_ FR_Obj27_Dx_Vnce : 84|14@0+ (0.05,0) [0|50] "m2"  C3B
 SG_ FR_Obj27_Dx : 65|13@0+ (0.0625,-100) [-100|411.9375] "m"  C3B
 SG_ FR_Obj27_Dy_Vnce : 59|10@0+ (0.02,0) [0|20] "m2"  C3B
 SG_ FR_Obj27_Dy : 54|11@0+ (0.125,-128) [-128|127.875] "m"  C3B
 SG_ FR_Obj27_HeadingAngle : 32|10@0+ (0.01,-3.14) [-3.14|3.14] "rad"  C3B
 SG_ FR_Obj27_Length : 25|9@0+ (0.05,0) [0|25.5] "m"  C3B
 SG_ FR_Obj27_Height : 18|9@0+ (0.01,0) [0|5.11] "m"  C3B
 SG_ FR_Obj27_Width : 12|10@0+ (0.01,0) [0|10.23] "m"  C3B
 SG_ FR_Obj27_TypeProb : 2|6@0+ (2,0) [0|100] "%"  C3B
 SG_ FR_Obj27_Type : 6|4@0+ (1,0) [0|15] ""  C3B

BO_ 547 FR_223: 64 FR
 SG_ FR_CRCCheck_223 : 503|16@0+ (1,0) [0|65535] ""  C3B
 SG_ FR_RollingCounter_223 : 491|4@0+ (1,0) [0|15] ""  C3B
 SG_ FR_Obj28_Ax : 303|10@0+ (0.03125,-16) [-16|15.96875] "m/s2"  C3B
 SG_ FR_Obj28_Ay : 280|9@0+ (0.0625,-16) [-16|15.9375] "m/s2"  C3B
 SG_ FR_Obj28_Vx : 276|12@0+ (0.0625,-128) [-128|127.9375] "m/s"  C3B
 SG_ FR_Obj28_Vy : 270|10@0+ (0.0625,-32) [-32|31.9375] "m/s"  C3B
 SG_ FR_Obj28_DelayTime : 254|16@0+ (1,0) [0|65535] "ms"  C3B
 SG_ FR_Obj28_ReferPoint_Dx : 237|4@0+ (1,0) [0|15] "m"  C3B
 SG_ FR_Obj28_HeightGround : 223|9@0+ (0.1,0) [0|51.1] "m"  C3B
 SG_ FR_Obj28_MotionStatusConf : 213|6@0+ (2,0) [0|63] "-"  C3B
 SG_ FR_Obj28_MotionStatus : 200|3@0+ (1,0) [0|7] ""  C3B
 SG_ FR_Obj28_Measured : 202|2@0+ (1,0) [0|3] ""  C3B
 SG_ FR_Obj28_valid : 203|1@0+ (1,0) [0|1] ""  C3B
 SG_ FR_Obj28_Track_Age : 187|16@0+ (1,0) [0|65535] ""  C3B
 SG_ FR_Obj28_Track_ID : 171|16@0+ (1,0) [0|65535] ""  C3B
 SG_ FR_Obj28_ObstacleProb : 161|6@0+ (2,0) [0|100] "%"  C3B
 SG_ FR_Obj28_ExistProb : 167|6@0+ (2,0) [0|100] "%"  C3B
 SG_ FR_Obj28_RelAx : 145|10@0+ (0.03125,-16) [-16|15.96875] "m/s2"  C3B
 SG_ FR_Obj28_RelAy : 138|9@0+ (0.0625,-16) [-16|15.9375] "m/s2"  C3B
 SG_ FR_Obj28_RelVx_std : 134|12@0+ (0.0625,0) [0|255.9375] "m/s"  C3B
 SG_ FR_Obj28_RelVx : 114|12@0+ (0.0625,-128) [-128|127.9375] "m/s"  C3B
 SG_ FR_Obj28_RelVy_std : 108|10@0+ (0.125,0) [0|127.875] "m/s"  C3B
 SG_ FR_Obj28_RelVy : 102|10@0+ (0.0625,-32) [-32|31.9375] "m/s"  C3B
 SG_ FR_Obj28_Dx_Vnce : 84|14@0+ (0.05,0) [0|50] "m2"  C3B
 SG_ FR_Obj28_Dx : 65|13@0+ (0.0625,-100) [-100|411.9375] "m"  C3B
 SG_ FR_Obj28_Dy_Vnce : 59|10@0+ (0.02,0) [0|20] "m2"  C3B
 SG_ FR_Obj28_Dy : 54|11@0+ (0.125,-128) [-128|127.875] "m"  C3B
 SG_ FR_Obj28_HeadingAngle : 32|10@0+ (0.01,-3.14) [-3.14|3.14] "rad"  C3B
 SG_ FR_Obj28_Length : 25|9@0+ (0.05,0) [0|25.5] "m"  C3B
 SG_ FR_Obj28_Height : 18|9@0+ (0.01,0) [0|5.11] "m"  C3B
 SG_ FR_Obj28_Width : 12|10@0+ (0.01,0) [0|10.23] "m"  C3B
 SG_ FR_Obj28_TypeProb : 2|6@0+ (2,0) [0|100] "%"  C3B
 SG_ FR_Obj28_Type : 6|4@0+ (1,0) [0|15] ""  C3B

BO_ 548 FR_224: 64 FR
 SG_ FR_CRCCheck_224 : 503|16@0+ (1,0) [0|65535] ""  C3B
 SG_ FR_RollingCounter_224 : 491|4@0+ (1,0) [0|15] ""  C3B
 SG_ FR_Obj29_Ax : 303|10@0+ (0.03125,-16) [-16|15.96875] "m/s2"  C3B
 SG_ FR_Obj29_Ay : 280|9@0+ (0.0625,-16) [-16|15.9375] "m/s2"  C3B
 SG_ FR_Obj29_Vx : 276|12@0+ (0.0625,-128) [-128|127.9375] "m/s"  C3B
 SG_ FR_Obj29_Vy : 270|10@0+ (0.0625,-32) [-32|31.9375] "m/s"  C3B
 SG_ FR_Obj29_DelayTime : 254|16@0+ (1,0) [0|65535] "ms"  C3B
 SG_ FR_Obj29_ReferPoint_Dx : 237|4@0+ (1,0) [0|15] "m"  C3B
 SG_ FR_Obj29_HeightGround : 223|9@0+ (0.1,0) [0|51.1] "m"  C3B
 SG_ FR_Obj29_MotionStatusConf : 213|6@0+ (2,0) [0|63] "-"  C3B
 SG_ FR_Obj29_MotionStatus : 200|3@0+ (1,0) [0|7] ""  C3B
 SG_ FR_Obj29_Measured : 202|2@0+ (1,0) [0|3] ""  C3B
 SG_ FR_Obj29_valid : 203|1@0+ (1,0) [0|1] ""  C3B
 SG_ FR_Obj29_Track_Age : 187|16@0+ (1,0) [0|65535] ""  C3B
 SG_ FR_Obj29_Track_ID : 171|16@0+ (1,0) [0|65535] ""  C3B
 SG_ FR_Obj29_ObstacleProb : 161|6@0+ (2,0) [0|100] "%"  C3B
 SG_ FR_Obj29_ExistProb : 167|6@0+ (2,0) [0|100] "%"  C3B
 SG_ FR_Obj29_RelAx : 145|10@0+ (0.03125,-16) [-16|15.96875] "m/s2"  C3B
 SG_ FR_Obj29_RelAy : 138|9@0+ (0.0625,-16) [-16|15.9375] "m/s2"  C3B
 SG_ FR_Obj29_RelVx_std : 134|12@0+ (0.0625,0) [0|255.9375] "m/s"  C3B
 SG_ FR_Obj29_RelVx : 114|12@0+ (0.0625,-128) [-128|127.9375] "m/s"  C3B
 SG_ FR_Obj29_RelVy_std : 108|10@0+ (0.125,0) [0|127.875] "m/s"  C3B
 SG_ FR_Obj29_RelVy : 102|10@0+ (0.0625,-32) [-32|31.9375] "m/s"  C3B
 SG_ FR_Obj29_Dx_Vnce : 84|14@0+ (0.05,0) [0|50] "m2"  C3B
 SG_ FR_Obj29_Dx : 65|13@0+ (0.0625,-100) [-100|411.9375] "m"  C3B
 SG_ FR_Obj29_Dy_Vnce : 59|10@0+ (0.02,0) [0|20] "m2"  C3B
 SG_ FR_Obj29_Dy : 54|11@0+ (0.125,-128) [-128|127.875] "m"  C3B
 SG_ FR_Obj29_HeadingAngle : 32|10@0+ (0.01,-3.14) [-3.14|3.14] "rad"  C3B
 SG_ FR_Obj29_Length : 25|9@0+ (0.05,0) [0|25.5] "m"  C3B
 SG_ FR_Obj29_Height : 18|9@0+ (0.01,0) [0|5.11] "m"  C3B
 SG_ FR_Obj29_Width : 12|10@0+ (0.01,0) [0|10.23] "m"  C3B
 SG_ FR_Obj29_TypeProb : 2|6@0+ (2,0) [0|100] "%"  C3B
 SG_ FR_Obj29_Type : 6|4@0+ (1,0) [0|15] ""  C3B

BO_ 549 FR_225: 64 FR
 SG_ FR_CRCCheck_225 : 503|16@0+ (1,0) [0|65535] ""  C3B
 SG_ FR_RollingCounter_225 : 491|4@0+ (1,0) [0|15] ""  C3B
 SG_ FR_Obj30_Ax : 303|10@0+ (0.03125,-16) [-16|15.96875] "m/s2"  C3B
 SG_ FR_Obj30_Ay : 280|9@0+ (0.0625,-16) [-16|15.9375] "m/s2"  C3B
 SG_ FR_Obj30_Vx : 276|12@0+ (0.0625,-128) [-128|127.9375] "m/s"  C3B
 SG_ FR_Obj30_Vy : 270|10@0+ (0.0625,-32) [-32|31.9375] "m/s"  C3B
 SG_ FR_Obj30_DelayTime : 254|16@0+ (1,0) [0|65535] "ms"  C3B
 SG_ FR_Obj30_ReferPoint_Dx : 237|4@0+ (1,0) [0|15] "m"  C3B
 SG_ FR_Obj30_HeightGround : 223|9@0+ (0.1,0) [0|51.1] "m"  C3B
 SG_ FR_Obj30_MotionStatusConf : 213|6@0+ (2,0) [0|63] "-"  C3B
 SG_ FR_Obj30_MotionStatus : 200|3@0+ (1,0) [0|7] ""  C3B
 SG_ FR_Obj30_Measured : 202|2@0+ (1,0) [0|3] ""  C3B
 SG_ FR_Obj30_valid : 203|1@0+ (1,0) [0|1] ""  C3B
 SG_ FR_Obj30_Track_Age : 187|16@0+ (1,0) [0|65535] ""  C3B
 SG_ FR_Obj30_Track_ID : 171|16@0+ (1,0) [0|65535] ""  C3B
 SG_ FR_Obj30_ObstacleProb : 161|6@0+ (2,0) [0|100] "%"  C3B
 SG_ FR_Obj30_ExistProb : 167|6@0+ (2,0) [0|100] "%"  C3B
 SG_ FR_Obj30_RelAx : 145|10@0+ (0.03125,-16) [-16|15.96875] "m/s2"  C3B
 SG_ FR_Obj30_RelAy : 138|9@0+ (0.0625,-16) [-16|15.9375] "m/s2"  C3B
 SG_ FR_Obj30_RelVx_std : 134|12@0+ (0.0625,0) [0|255.9375] "m/s"  C3B
 SG_ FR_Obj30_RelVx : 114|12@0+ (0.0625,-128) [-128|127.9375] "m/s"  C3B
 SG_ FR_Obj30_RelVy_std : 108|10@0+ (0.125,0) [0|127.875] "m/s"  C3B
 SG_ FR_Obj30_RelVy : 102|10@0+ (0.0625,-32) [-32|31.9375] "m/s"  C3B
 SG_ FR_Obj30_Dx_Vnce : 84|14@0+ (0.05,0) [0|50] "m2"  C3B
 SG_ FR_Obj30_Dx : 65|13@0+ (0.0625,-100) [-100|411.9375] "m"  C3B
 SG_ FR_Obj30_Dy_Vnce : 59|10@0+ (0.02,0) [0|20] "m2"  C3B
 SG_ FR_Obj30_Dy : 54|11@0+ (0.125,-128) [-128|127.875] "m"  C3B
 SG_ FR_Obj30_HeadingAngle : 32|10@0+ (0.01,-3.14) [-3.14|3.14] "rad"  C3B
 SG_ FR_Obj30_Length : 25|9@0+ (0.05,0) [0|25.5] "m"  C3B
 SG_ FR_Obj30_Height : 18|9@0+ (0.01,0) [0|5.11] "m"  C3B
 SG_ FR_Obj30_Width : 12|10@0+ (0.01,0) [0|10.23] "m"  C3B
 SG_ FR_Obj30_TypeProb : 2|6@0+ (2,0) [0|100] "%"  C3B
 SG_ FR_Obj30_Type : 6|4@0+ (1,0) [0|15] ""  C3B

BO_ 550 FR_226: 64 FR
 SG_ FR_CRCCheck_226 : 503|16@0+ (1,0) [0|65535] ""  C3B
 SG_ FR_RollingCounter_226 : 491|4@0+ (1,0) [0|15] ""  C3B
 SG_ FR_Obj31_Ax : 303|10@0+ (0.03125,-16) [-16|15.96875] "m/s2"  C3B
 SG_ FR_Obj31_Ay : 280|9@0+ (0.0625,-16) [-16|15.9375] "m/s2"  C3B
 SG_ FR_Obj31_Vx : 276|12@0+ (0.0625,-128) [-128|127.9375] "m/s"  C3B
 SG_ FR_Obj31_Vy : 270|10@0+ (0.0625,-32) [-32|31.9375] "m/s"  C3B
 SG_ FR_Obj31_DelayTime : 254|16@0+ (1,0) [0|65535] "ms"  C3B
 SG_ FR_Obj31_ReferPoint_Dx : 237|4@0+ (1,0) [0|15] "m"  C3B
 SG_ FR_Obj31_HeightGround : 223|9@0+ (0.1,0) [0|51.1] "m"  C3B
 SG_ FR_Obj31_MotionStatusConf : 213|6@0+ (2,0) [0|63] "-"  C3B
 SG_ FR_Obj31_MotionStatus : 200|3@0+ (1,0) [0|7] ""  C3B
 SG_ FR_Obj31_Measured : 202|2@0+ (1,0) [0|3] ""  C3B
 SG_ FR_Obj31_valid : 203|1@0+ (1,0) [0|1] ""  C3B
 SG_ FR_Obj31_Track_Age : 187|16@0+ (1,0) [0|65535] ""  C3B
 SG_ FR_Obj31_Track_ID : 171|16@0+ (1,0) [0|65535] ""  C3B
 SG_ FR_Obj31_ObstacleProb : 161|6@0+ (2,0) [0|100] "%"  C3B
 SG_ FR_Obj31_ExistProb : 167|6@0+ (2,0) [0|100] "%"  C3B
 SG_ FR_Obj31_RelAx : 145|10@0+ (0.03125,-16) [-16|15.96875] "m/s2"  C3B
 SG_ FR_Obj31_RelAy : 138|9@0+ (0.0625,-16) [-16|15.9375] "m/s2"  C3B
 SG_ FR_Obj31_RelVx_std : 134|12@0+ (0.0625,0) [0|255.9375] "m/s"  C3B
 SG_ FR_Obj31_RelVx : 114|12@0+ (0.0625,-128) [-128|127.9375] "m/s"  C3B
 SG_ FR_Obj31_RelVy_std : 108|10@0+ (0.125,0) [0|127.875] "m/s"  C3B
 SG_ FR_Obj31_RelVy : 102|10@0+ (0.0625,-32) [-32|31.9375] "m/s"  C3B
 SG_ FR_Obj31_Dx_Vnce : 84|14@0+ (0.05,0) [0|50] "m2"  C3B
 SG_ FR_Obj31_Dx : 65|13@0+ (0.0625,-100) [-100|411.9375] "m"  C3B
 SG_ FR_Obj31_Dy_Vnce : 59|10@0+ (0.02,0) [0|20] "m2"  C3B
 SG_ FR_Obj31_Dy : 54|11@0+ (0.125,-128) [-128|127.875] "m"  C3B
 SG_ FR_Obj31_HeadingAngle : 32|10@0+ (0.01,-3.14) [-3.14|3.14] "rad"  C3B
 SG_ FR_Obj31_Length : 25|9@0+ (0.05,0) [0|25.5] "m"  C3B
 SG_ FR_Obj31_Height : 18|9@0+ (0.01,0) [0|5.11] "m"  C3B
 SG_ FR_Obj31_Width : 12|10@0+ (0.01,0) [0|10.23] "m"  C3B
 SG_ FR_Obj31_TypeProb : 2|6@0+ (2,0) [0|100] "%"  C3B
 SG_ FR_Obj31_Type : 6|4@0+ (1,0) [0|15] ""  C3B

BO_ 551 FR_227: 64 FR
 SG_ FR_CRCCheck_227 : 503|16@0+ (1,0) [0|65535] ""  C3B
 SG_ FR_RollingCounter_227 : 491|4@0+ (1,0) [0|15] ""  C3B
 SG_ FR_Obj32_Ax : 303|10@0+ (0.03125,-16) [-16|15.96875] "m/s2"  C3B
 SG_ FR_Obj32_Ay : 280|9@0+ (0.0625,-16) [-16|15.9375] "m/s2"  C3B
 SG_ FR_Obj32_Vx : 276|12@0+ (0.0625,-128) [-128|127.9375] "m/s"  C3B
 SG_ FR_Obj32_Vy : 270|10@0+ (0.0625,-32) [-32|31.9375] "m/s"  C3B
 SG_ FR_Obj32_DelayTime : 254|16@0+ (1,0) [0|65535] "ms"  C3B
 SG_ FR_Obj32_ReferPoint_Dx : 237|4@0+ (1,0) [0|15] "m"  C3B
 SG_ FR_Obj32_HeightGround : 223|9@0+ (0.1,0) [0|51.1] "m"  C3B
 SG_ FR_Obj32_MotionStatusConf : 213|6@0+ (2,0) [0|63] "-"  C3B
 SG_ FR_Obj32_MotionStatus : 200|3@0+ (1,0) [0|7] ""  C3B
 SG_ FR_Obj32_Measured : 202|2@0+ (1,0) [0|3] ""  C3B
 SG_ FR_Obj32_valid : 203|1@0+ (1,0) [0|1] ""  C3B
 SG_ FR_Obj32_Track_Age : 187|16@0+ (1,0) [0|65535] ""  C3B
 SG_ FR_Obj32_Track_ID : 171|16@0+ (1,0) [0|65535] ""  C3B
 SG_ FR_Obj32_ObstacleProb : 161|6@0+ (2,0) [0|100] "%"  C3B
 SG_ FR_Obj32_ExistProb : 167|6@0+ (2,0) [0|100] "%"  C3B
 SG_ FR_Obj32_RelAx : 145|10@0+ (0.03125,-16) [-16|15.96875] "m/s2"  C3B
 SG_ FR_Obj32_RelAy : 138|9@0+ (0.0625,-16) [-16|15.9375] "m/s2"  C3B
 SG_ FR_Obj32_RelVx_std : 134|12@0+ (0.0625,0) [0|255.9375] "m/s"  C3B
 SG_ FR_Obj32_RelVx : 114|12@0+ (0.0625,-128) [-128|127.9375] "m/s"  C3B
 SG_ FR_Obj32_RelVy_std : 108|10@0+ (0.125,0) [0|127.875] "m/s"  C3B
 SG_ FR_Obj32_RelVy : 102|10@0+ (0.0625,-32) [-32|31.9375] "m/s"  C3B
 SG_ FR_Obj32_Dx_Vnce : 84|14@0+ (0.05,0) [0|50] "m2"  C3B
 SG_ FR_Obj32_Dx : 65|13@0+ (0.0625,-100) [-100|411.9375] "m"  C3B
 SG_ FR_Obj32_Dy_Vnce : 59|10@0+ (0.02,0) [0|20] "m2"  C3B
 SG_ FR_Obj32_Dy : 54|11@0+ (0.125,-128) [-128|127.875] "m"  C3B
 SG_ FR_Obj32_HeadingAngle : 32|10@0+ (0.01,-3.14) [-3.14|3.14] "rad"  C3B
 SG_ FR_Obj32_Length : 25|9@0+ (0.05,0) [0|25.5] "m"  C3B
 SG_ FR_Obj32_Height : 18|9@0+ (0.01,0) [0|5.11] "m"  C3B
 SG_ FR_Obj32_Width : 12|10@0+ (0.01,0) [0|10.23] "m"  C3B
 SG_ FR_Obj32_TypeProb : 2|6@0+ (2,0) [0|100] "%"  C3B
 SG_ FR_Obj32_Type : 6|4@0+ (1,0) [0|15] ""  C3B

BO_ 552 FR_228: 64 FR
 SG_ FR_CRCCheck_228 : 503|16@0+ (1,0) [0|65535] ""  C3B
 SG_ FR_RollingCounter_228 : 491|4@0+ (1,0) [0|15] ""  C3B
 SG_ FR_FreespaceSectorKinestate34 : 477|2@0+ (1,0) [0|3] "-"  C3B
 SG_ FR_FreespaceSectorConRidence34 : 479|2@0+ (1,0) [0|3] "-"  C3B
 SG_ FR_FreespaceSectorDistance34 : 457|10@0+ (0.1,0) [0|100] "-"  C3B
 SG_ FR_FreespaceSectorKinestate33 : 459|2@0+ (1,0) [0|3] "-"  C3B
 SG_ FR_FreespaceSectorConRidence33 : 461|2@0+ (1,0) [0|3] "-"  C3B
 SG_ FR_FreespaceSectorDistance33 : 455|10@0+ (0.1,0) [0|100] "-"  C3B
 SG_ FR_FreespaceSectorKinestate32 : 441|2@0+ (1,0) [0|3] "-"  C3B
 SG_ FR_FreespaceSectorConRidence32 : 443|2@0+ (1,0) [0|3] "-"  C3B
 SG_ FR_FreespaceSectorDistance32 : 437|10@0+ (0.1,0) [0|100] "-"  C3B
 SG_ FR_FreespaceSectorKinestate31 : 439|2@0+ (1,0) [0|3] "-"  C3B
 SG_ FR_FreespaceSectorConRidence31 : 425|2@0+ (1,0) [0|3] "-"  C3B
 SG_ FR_FreespaceSectorDistance31 : 419|10@0+ (0.1,0) [0|100] "-"  C3B
 SG_ FR_FreespaceSectorKinestate30 : 421|2@0+ (1,0) [0|3] "-"  C3B
 SG_ FR_FreespaceSectorConRidence30 : 423|2@0+ (1,0) [0|3] "-"  C3B
 SG_ FR_FreespaceSectorDistance30 : 401|10@0+ (0.1,0) [0|100] "-"  C3B
 SG_ FR_FreespaceSectorKinestate29 : 403|2@0+ (1,0) [0|3] "-"  C3B
 SG_ FR_FreespaceSectorConRidence29 : 405|2@0+ (1,0) [0|3] "-"  C3B
 SG_ FR_FreespaceSectorDistance29 : 399|10@0+ (0.1,0) [0|100] "-"  C3B
 SG_ FR_FreespaceSectorKinestate28 : 385|2@0+ (1,0) [0|3] "-"  C3B
 SG_ FR_FreespaceSectorConRidence28 : 387|2@0+ (1,0) [0|3] "-"  C3B
 SG_ FR_FreespaceSectorDistance28 : 381|10@0+ (0.1,0) [0|100] "-"  C3B
 SG_ FR_FreespaceSectorKinestate27 : 383|2@0+ (1,0) [0|3] "-"  C3B
 SG_ FR_FreespaceSectorConRidence27 : 369|2@0+ (1,0) [0|3] "-"  C3B
 SG_ FR_FreespaceSectorDistance27 : 363|10@0+ (0.1,0) [0|100] "-"  C3B
 SG_ FR_FreespaceSectorKinestate26 : 365|2@0+ (1,0) [0|3] "-"  C3B
 SG_ FR_FreespaceSectorConRidence26 : 367|2@0+ (1,0) [0|3] "-"  C3B
 SG_ FR_FreespaceSectorDistance26 : 345|10@0+ (0.1,0) [0|100] "-"  C3B
 SG_ FR_FreespaceSectorKinestate25 : 347|2@0+ (1,0) [0|3] "-"  C3B
 SG_ FR_FreespaceSectorConRidence25 : 349|2@0+ (1,0) [0|3] "-"  C3B
 SG_ FR_FreespaceSectorDistance25 : 343|10@0+ (0.1,0) [0|100] "-"  C3B
 SG_ FR_FreespaceSectorKinestate24 : 329|2@0+ (1,0) [0|3] "-"  C3B
 SG_ FR_FreespaceSectorConRidence24 : 331|2@0+ (1,0) [0|3] "-"  C3B
 SG_ FR_FreespaceSectorDistance24 : 325|10@0+ (0.1,0) [0|100] "-"  C3B
 SG_ FR_FreespaceSectorKinestate23 : 327|2@0+ (1,0) [0|3] "-"  C3B
 SG_ FR_FreespaceSectorConRidence23 : 313|2@0+ (1,0) [0|3] "-"  C3B
 SG_ FR_FreespaceSectorDistance23 : 307|10@0+ (0.1,0) [0|100] "-"  C3B
 SG_ FR_FreespaceSectorKinestate22 : 309|2@0+ (1,0) [0|3] "-"  C3B
 SG_ FR_FreespaceSectorConRidence22 : 311|2@0+ (1,0) [0|3] "-"  C3B
 SG_ FR_FreespaceSectorDistance22 : 289|10@0+ (0.1,0) [0|100] "-"  C3B
 SG_ FR_FreespaceSectorKinestate21 : 291|2@0+ (1,0) [0|3] "-"  C3B
 SG_ FR_FreespaceSectorConRidence21 : 293|2@0+ (1,0) [0|3] "-"  C3B
 SG_ FR_FreespaceSectorDistance21 : 287|10@0+ (0.1,0) [0|100] "-"  C3B
 SG_ FR_FreespaceSectorKinestate20 : 273|2@0+ (1,0) [0|3] "-"  C3B
 SG_ FR_FreespaceSectorConRidence20 : 275|2@0+ (1,0) [0|3] "-"  C3B
 SG_ FR_FreespaceSectorDistance20 : 269|10@0+ (0.1,0) [0|100] "-"  C3B
 SG_ FR_FreespaceSectorKinestate19 : 271|2@0+ (1,0) [0|3] "-"  C3B
 SG_ FR_FreespaceSectorConRidence19 : 257|2@0+ (1,0) [0|3] "-"  C3B
 SG_ FR_FreespaceSectorDistance19 : 251|10@0+ (0.1,0) [0|100] "-"  C3B
 SG_ FR_FreespaceSectorKinestate18 : 253|2@0+ (1,0) [0|3] "-"  C3B
 SG_ FR_FreespaceSectorConRidence18 : 255|2@0+ (1,0) [0|3] "-"  C3B
 SG_ FR_FreespaceSectorDistance18 : 233|10@0+ (0.1,0) [0|100] "-"  C3B
 SG_ FR_FreespaceSectorKinestate17 : 235|2@0+ (1,0) [0|3] "-"  C3B
 SG_ FR_FreespaceSectorConRidence17 : 237|2@0+ (1,0) [0|3] "-"  C3B
 SG_ FR_FreespaceSectorDistance17 : 231|10@0+ (0.1,0) [0|100] "-"  C3B
 SG_ FR_FreespaceSectorKinestate16 : 217|2@0+ (1,0) [0|3] "-"  C3B
 SG_ FR_FreespaceSectorConRidence16 : 219|2@0+ (1,0) [0|3] "-"  C3B
 SG_ FR_FreespaceSectorDistance16 : 213|10@0+ (0.1,0) [0|100] "-"  C3B
 SG_ FR_FreespaceSectorKinestate15 : 215|2@0+ (1,0) [0|3] "-"  C3B
 SG_ FR_FreespaceSectorConRidence15 : 201|2@0+ (1,0) [0|3] "-"  C3B
 SG_ FR_FreespaceSectorDistance15 : 195|10@0+ (0.1,0) [0|100] "-"  C3B
 SG_ FR_FreespaceSectorKinestate14 : 197|2@0+ (1,0) [0|3] "-"  C3B
 SG_ FR_FreespaceSectorConRidence14 : 199|2@0+ (1,0) [0|3] "-"  C3B
 SG_ FR_FreespaceSectorDistance14 : 177|10@0+ (0.1,0) [0|100] "-"  C3B
 SG_ FR_FreespaceSectorKinestate13 : 179|2@0+ (1,0) [0|3] "-"  C3B
 SG_ FR_FreespaceSectorConRidence13 : 181|2@0+ (1,0) [0|3] "-"  C3B
 SG_ FR_FreespaceSectorDistance13 : 175|10@0+ (0.1,0) [0|100] "-"  C3B
 SG_ FR_FreespaceSectorKinestate12 : 161|2@0+ (1,0) [0|3] "-"  C3B
 SG_ FR_FreespaceSectorConRidence12 : 163|2@0+ (1,0) [0|3] "-"  C3B
 SG_ FR_FreespaceSectorDistance12 : 157|10@0+ (0.1,0) [0|100] "-"  C3B
 SG_ FR_FreespaceSectorKinestate11 : 159|2@0+ (1,0) [0|3] "-"  C3B
 SG_ FR_FreespaceSectorConRidence11 : 145|2@0+ (1,0) [0|3] "-"  C3B
 SG_ FR_FreespaceSectorDistance11 : 139|10@0+ (0.1,0) [0|100] "-"  C3B
 SG_ FR_FreespaceSectorKinestate10 : 141|2@0+ (1,0) [0|3] "-"  C3B
 SG_ FR_FreespaceSectorConRidence10 : 143|2@0+ (1,0) [0|3] "-"  C3B
 SG_ FR_FreespaceSectorDistance10 : 121|10@0+ (0.1,0) [0|100] "-"  C3B
 SG_ FR_FreespaceSectorKinestate9 : 123|2@0+ (1,0) [0|3] "-"  C3B
 SG_ FR_FreespaceSectorConRidence9 : 125|2@0+ (1,0) [0|3] "-"  C3B
 SG_ FR_FreespaceSectorDistance9 : 119|10@0+ (0.1,0) [0|100] "-"  C3B
 SG_ FR_FreespaceSectorKinestate8 : 105|2@0+ (1,0) [0|3] "-"  C3B
 SG_ FR_FreespaceSectorConRidence8 : 107|2@0+ (1,0) [0|3] "-"  C3B
 SG_ FR_FreespaceSectorDistance8 : 101|10@0+ (0.1,0) [0|100] "-"  C3B
 SG_ FR_FreespaceSectorKinestate7 : 103|2@0+ (1,0) [0|3] "-"  C3B
 SG_ FR_FreespaceSectorConRidence7 : 89|2@0+ (1,0) [0|3] "-"  C3B
 SG_ FR_FreespaceSectorDistance7 : 83|10@0+ (0.1,0) [0|100] "-"  C3B
 SG_ FR_FreespaceSectorKinestate6 : 85|2@0+ (1,0) [0|3] "-"  C3B
 SG_ FR_FreespaceSectorConRidence6 : 87|2@0+ (1,0) [0|3] "-"  C3B
 SG_ FR_FreespaceSectorDistance6 : 65|10@0+ (0.1,0) [0|100] "-"  C3B
 SG_ FR_FreespaceSectorKinestate5 : 67|2@0+ (1,0) [0|3] "-"  C3B
 SG_ FR_FreespaceSectorConRidence5 : 69|2@0+ (1,0) [0|3] "-"  C3B
 SG_ FR_FreespaceSectorDistance5 : 63|10@0+ (0.1,0) [0|100] "-"  C3B
 SG_ FR_FreespaceSectorKinestate4 : 49|2@0+ (1,0) [0|3] "-"  C3B
 SG_ FR_FreespaceSectorConRidence4 : 51|2@0+ (1,0) [0|3] "-"  C3B
 SG_ FR_FreespaceSectorDistance4 : 45|10@0+ (0.1,0) [0|100] "-"  C3B
 SG_ FR_FreespaceSectorKinestate3 : 47|2@0+ (1,0) [0|3] "-"  C3B
 SG_ FR_FreespaceSectorConRidence3 : 33|2@0+ (1,0) [0|3] "-"  C3B
 SG_ FR_FreespaceSectorDistance3 : 27|10@0+ (0.1,0) [0|100] "-"  C3B
 SG_ FR_FreespaceSectorKinestate2 : 29|2@0+ (1,0) [0|3] "-"  C3B
 SG_ FR_FreespaceSectorConRidence2 : 31|2@0+ (1,0) [0|3] "-"  C3B
 SG_ FR_FreespaceSectorDistance2 : 9|10@0+ (0.1,0) [0|100] "-"  C3B
 SG_ FR_FreespaceSectorKinestate1 : 11|2@0+ (1,0) [0|3] "-"  C3B
 SG_ FR_FreespaceSectorConRidence1 : 13|2@0+ (1,0) [0|3] "-"  C3B
 SG_ FR_FreespaceSectorDistance1 : 7|10@0+ (0.1,0) [0|100] "-"  C3B

BO_ 553 FR_229: 64 FR
 SG_ FR_CRCCheck_229 : 503|16@0+ (1,0) [0|65535] ""  C3B
 SG_ FR_RollingCounter_229 : 491|4@0+ (1,0) [0|15] ""  C3B
 SG_ FR_FreespaceSectorKinestate68 : 477|2@0+ (1,0) [0|3] "-"  C3B
 SG_ FR_FreespaceSectorConRidence68 : 479|2@0+ (1,0) [0|3] "-"  C3B
 SG_ FR_FreespaceSectorDistance68 : 457|10@0+ (0.1,0) [0|100] "-"  C3B
 SG_ FR_FreespaceSectorKinestate67 : 459|2@0+ (1,0) [0|3] "-"  C3B
 SG_ FR_FreespaceSectorConRidence67 : 461|2@0+ (1,0) [0|3] "-"  C3B
 SG_ FR_FreespaceSectorDistance67 : 455|10@0+ (0.1,0) [0|100] "-"  C3B
 SG_ FR_FreespaceSectorKinestate66 : 441|2@0+ (1,0) [0|3] "-"  C3B
 SG_ FR_FreespaceSectorConRidence66 : 443|2@0+ (1,0) [0|3] "-"  C3B
 SG_ FR_FreespaceSectorDistance66 : 437|10@0+ (0.1,0) [0|100] "-"  C3B
 SG_ FR_FreespaceSectorKinestate65 : 439|2@0+ (1,0) [0|3] "-"  C3B
 SG_ FR_FreespaceSectorConRidence65 : 425|2@0+ (1,0) [0|3] "-"  C3B
 SG_ FR_FreespaceSectorDistance65 : 419|10@0+ (0.1,0) [0|100] "-"  C3B
 SG_ FR_FreespaceSectorKinestate64 : 421|2@0+ (1,0) [0|3] "-"  C3B
 SG_ FR_FreespaceSectorConRidence64 : 423|2@0+ (1,0) [0|3] "-"  C3B
 SG_ FR_FreespaceSectorDistance64 : 401|10@0+ (0.1,0) [0|100] "-"  C3B
 SG_ FR_FreespaceSectorKinestate63 : 403|2@0+ (1,0) [0|3] "-"  C3B
 SG_ FR_FreespaceSectorConRidence63 : 405|2@0+ (1,0) [0|3] "-"  C3B
 SG_ FR_FreespaceSectorDistance63 : 399|10@0+ (0.1,0) [0|100] "-"  C3B
 SG_ FR_FreespaceSectorKinestate62 : 385|2@0+ (1,0) [0|3] "-"  C3B
 SG_ FR_FreespaceSectorConRidence62 : 387|2@0+ (1,0) [0|3] "-"  C3B
 SG_ FR_FreespaceSectorDistance62 : 381|10@0+ (0.1,0) [0|100] "-"  C3B
 SG_ FR_FreespaceSectorKinestate61 : 383|2@0+ (1,0) [0|3] "-"  C3B
 SG_ FR_FreespaceSectorConRidence61 : 369|2@0+ (1,0) [0|3] "-"  C3B
 SG_ FR_FreespaceSectorDistance61 : 363|10@0+ (0.1,0) [0|100] "-"  C3B
 SG_ FR_FreespaceSectorKinestate60 : 365|2@0+ (1,0) [0|3] "-"  C3B
 SG_ FR_FreespaceSectorConRidence60 : 367|2@0+ (1,0) [0|3] "-"  C3B
 SG_ FR_FreespaceSectorDistance60 : 345|10@0+ (0.1,0) [0|100] "-"  C3B
 SG_ FR_FreespaceSectorKinestate59 : 347|2@0+ (1,0) [0|3] "-"  C3B
 SG_ FR_FreespaceSectorConRidence59 : 349|2@0+ (1,0) [0|3] "-"  C3B
 SG_ FR_FreespaceSectorDistance59 : 343|10@0+ (0.1,0) [0|100] "-"  C3B
 SG_ FR_FreespaceSectorKinestate58 : 329|2@0+ (1,0) [0|3] "-"  C3B
 SG_ FR_FreespaceSectorConRidence58 : 331|2@0+ (1,0) [0|3] "-"  C3B
 SG_ FR_FreespaceSectorDistance58 : 325|10@0+ (0.1,0) [0|100] "-"  C3B
 SG_ FR_FreespaceSectorKinestate57 : 327|2@0+ (1,0) [0|3] "-"  C3B
 SG_ FR_FreespaceSectorConRidence57 : 313|2@0+ (1,0) [0|3] "-"  C3B
 SG_ FR_FreespaceSectorDistance57 : 307|10@0+ (0.1,0) [0|100] "-"  C3B
 SG_ FR_FreespaceSectorKinestate56 : 309|2@0+ (1,0) [0|3] "-"  C3B
 SG_ FR_FreespaceSectorConRidence56 : 311|2@0+ (1,0) [0|3] "-"  C3B
 SG_ FR_FreespaceSectorDistance56 : 289|10@0+ (0.1,0) [0|100] "-"  C3B
 SG_ FR_FreespaceSectorKinestate55 : 291|2@0+ (1,0) [0|3] "-"  C3B
 SG_ FR_FreespaceSectorConRidence55 : 293|2@0+ (1,0) [0|3] "-"  C3B
 SG_ FR_FreespaceSectorDistance55 : 287|10@0+ (0.1,0) [0|100] "-"  C3B
 SG_ FR_FreespaceSectorKinestate54 : 273|2@0+ (1,0) [0|3] "-"  C3B
 SG_ FR_FreespaceSectorConRidence54 : 275|2@0+ (1,0) [0|3] "-"  C3B
 SG_ FR_FreespaceSectorDistance54 : 269|10@0+ (0.1,0) [0|100] "-"  C3B
 SG_ FR_FreespaceSectorKinestate53 : 271|2@0+ (1,0) [0|3] "-"  C3B
 SG_ FR_FreespaceSectorConRidence53 : 257|2@0+ (1,0) [0|3] "-"  C3B
 SG_ FR_FreespaceSectorDistance53 : 251|10@0+ (0.1,0) [0|100] "-"  C3B
 SG_ FR_FreespaceSectorKinestate52 : 253|2@0+ (1,0) [0|3] "-"  C3B
 SG_ FR_FreespaceSectorConRidence52 : 255|2@0+ (1,0) [0|3] "-"  C3B
 SG_ FR_FreespaceSectorDistance52 : 233|10@0+ (0.1,0) [0|100] "-"  C3B
 SG_ FR_FreespaceSectorKinestate51 : 235|2@0+ (1,0) [0|3] "-"  C3B
 SG_ FR_FreespaceSectorConRidence51 : 237|2@0+ (1,0) [0|3] "-"  C3B
 SG_ FR_FreespaceSectorDistance51 : 231|10@0+ (0.1,0) [0|100] "-"  C3B
 SG_ FR_FreespaceSectorKinestate50 : 217|2@0+ (1,0) [0|3] "-"  C3B
 SG_ FR_FreespaceSectorConRidence50 : 219|2@0+ (1,0) [0|3] "-"  C3B
 SG_ FR_FreespaceSectorDistance50 : 213|10@0+ (0.1,0) [0|100] "-"  C3B
 SG_ FR_FreespaceSectorKinestate49 : 215|2@0+ (1,0) [0|3] "-"  C3B
 SG_ FR_FreespaceSectorConRidence49 : 201|2@0+ (1,0) [0|3] "-"  C3B
 SG_ FR_FreespaceSectorDistance49 : 195|10@0+ (0.1,0) [0|100] "-"  C3B
 SG_ FR_FreespaceSectorKinestate48 : 197|2@0+ (1,0) [0|3] "-"  C3B
 SG_ FR_FreespaceSectorConRidence48 : 199|2@0+ (1,0) [0|3] "-"  C3B
 SG_ FR_FreespaceSectorDistance48 : 177|10@0+ (0.1,0) [0|100] "-"  C3B
 SG_ FR_FreespaceSectorKinestate47 : 179|2@0+ (1,0) [0|3] "-"  C3B
 SG_ FR_FreespaceSectorConRidence47 : 181|2@0+ (1,0) [0|3] "-"  C3B
 SG_ FR_FreespaceSectorDistance47 : 175|10@0+ (0.1,0) [0|100] "-"  C3B
 SG_ FR_FreespaceSectorKinestate46 : 161|2@0+ (1,0) [0|3] "-"  C3B
 SG_ FR_FreespaceSectorConRidence46 : 163|2@0+ (1,0) [0|3] "-"  C3B
 SG_ FR_FreespaceSectorDistance46 : 157|10@0+ (0.1,0) [0|100] "-"  C3B
 SG_ FR_FreespaceSectorKinestate45 : 159|2@0+ (1,0) [0|3] "-"  C3B
 SG_ FR_FreespaceSectorConRidence45 : 145|2@0+ (1,0) [0|3] "-"  C3B
 SG_ FR_FreespaceSectorDistance45 : 139|10@0+ (0.1,0) [0|100] "-"  C3B
 SG_ FR_FreespaceSectorKinestate44 : 141|2@0+ (1,0) [0|3] "-"  C3B
 SG_ FR_FreespaceSectorConRidence44 : 143|2@0+ (1,0) [0|3] "-"  C3B
 SG_ FR_FreespaceSectorDistance44 : 121|10@0+ (0.1,0) [0|100] "-"  C3B
 SG_ FR_FreespaceSectorKinestate43 : 123|2@0+ (1,0) [0|3] "-"  C3B
 SG_ FR_FreespaceSectorConRidence43 : 125|2@0+ (1,0) [0|3] "-"  C3B
 SG_ FR_FreespaceSectorDistance43 : 119|10@0+ (0.1,0) [0|100] "-"  C3B
 SG_ FR_FreespaceSectorKinestate42 : 105|2@0+ (1,0) [0|3] "-"  C3B
 SG_ FR_FreespaceSectorConRidence42 : 107|2@0+ (1,0) [0|3] "-"  C3B
 SG_ FR_FreespaceSectorDistance42 : 101|10@0+ (0.1,0) [0|100] "-"  C3B
 SG_ FR_FreespaceSectorKinestate41 : 103|2@0+ (1,0) [0|3] "-"  C3B
 SG_ FR_FreespaceSectorConRidence41 : 89|2@0+ (1,0) [0|3] "-"  C3B
 SG_ FR_FreespaceSectorDistance41 : 83|10@0+ (0.1,0) [0|100] "-"  C3B
 SG_ FR_FreespaceSectorKinestate40 : 85|2@0+ (1,0) [0|3] "-"  C3B
 SG_ FR_FreespaceSectorConRidence40 : 87|2@0+ (1,0) [0|3] "-"  C3B
 SG_ FR_FreespaceSectorDistance40 : 65|10@0+ (0.1,0) [0|100] "-"  C3B
 SG_ FR_FreespaceSectorKinestate39 : 67|2@0+ (1,0) [0|3] "-"  C3B
 SG_ FR_FreespaceSectorConRidence39 : 69|2@0+ (1,0) [0|3] "-"  C3B
 SG_ FR_FreespaceSectorDistance39 : 63|10@0+ (0.1,0) [0|100] "-"  C3B
 SG_ FR_FreespaceSectorKinestate38 : 49|2@0+ (1,0) [0|3] "-"  C3B
 SG_ FR_FreespaceSectorConRidence38 : 51|2@0+ (1,0) [0|3] "-"  C3B
 SG_ FR_FreespaceSectorDistance38 : 45|10@0+ (0.1,0) [0|100] "-"  C3B
 SG_ FR_FreespaceSectorKinestate37 : 47|2@0+ (1,0) [0|3] "-"  C3B
 SG_ FR_FreespaceSectorConRidence37 : 33|2@0+ (1,0) [0|3] "-"  C3B
 SG_ FR_FreespaceSectorDistance37 : 27|10@0+ (0.1,0) [0|100] "-"  C3B
 SG_ FR_FreespaceSectorKinestate36 : 29|2@0+ (1,0) [0|3] "-"  C3B
 SG_ FR_FreespaceSectorConRidence36 : 31|2@0+ (1,0) [0|3] "-"  C3B
 SG_ FR_FreespaceSectorDistance36 : 9|10@0+ (0.1,0) [0|100] "-"  C3B
 SG_ FR_FreespaceSectorKinestate35 : 11|2@0+ (1,0) [0|3] "-"  C3B
 SG_ FR_FreespaceSectorConRidence35 : 13|2@0+ (1,0) [0|3] "-"  C3B
 SG_ FR_FreespaceSectorDistance35 : 7|10@0+ (0.1,0) [0|100] "-"  C3B

BO_ 554 FR_22A: 64 FR
 SG_ FR_CRCCheck_22A : 503|16@0+ (1,0) [0|65535] ""  C3B
 SG_ FR_RollingCounter_22A : 491|4@0+ (1,0) [0|15] ""  C3B
 SG_ FR_FreespaceSectorKinestate102 : 477|2@0+ (1,0) [0|3] "-"  C3B
 SG_ FR_FreespaceSectorConRidence102 : 479|2@0+ (1,0) [0|3] "-"  C3B
 SG_ FR_FreespaceSectorDistance102 : 457|10@0+ (0.1,0) [0|100] "-"  C3B
 SG_ FR_FreespaceSectorKinestate101 : 459|2@0+ (1,0) [0|3] "-"  C3B
 SG_ FR_FreespaceSectorConRidence101 : 461|2@0+ (1,0) [0|3] "-"  C3B
 SG_ FR_FreespaceSectorDistance101 : 455|10@0+ (0.1,0) [0|100] "-"  C3B
 SG_ FR_FreespaceSectorKinestate100 : 441|2@0+ (1,0) [0|3] "-"  C3B
 SG_ FR_FreespaceSectorConRidence100 : 443|2@0+ (1,0) [0|3] "-"  C3B
 SG_ FR_FreespaceSectorDistance100 : 437|10@0+ (0.1,0) [0|100] "-"  C3B
 SG_ FR_FreespaceSectorKinestate99 : 439|2@0+ (1,0) [0|3] "-"  C3B
 SG_ FR_FreespaceSectorConRidence99 : 425|2@0+ (1,0) [0|3] "-"  C3B
 SG_ FR_FreespaceSectorDistance99 : 419|10@0+ (0.1,0) [0|100] "-"  C3B
 SG_ FR_FreespaceSectorKinestate98 : 421|2@0+ (1,0) [0|3] "-"  C3B
 SG_ FR_FreespaceSectorConRidence98 : 423|2@0+ (1,0) [0|3] "-"  C3B
 SG_ FR_FreespaceSectorDistance98 : 401|10@0+ (0.1,0) [0|100] "-"  C3B
 SG_ FR_FreespaceSectorKinestate97 : 403|2@0+ (1,0) [0|3] "-"  C3B
 SG_ FR_FreespaceSectorConRidence97 : 405|2@0+ (1,0) [0|3] "-"  C3B
 SG_ FR_FreespaceSectorDistance97 : 399|10@0+ (0.1,0) [0|100] "-"  C3B
 SG_ FR_FreespaceSectorKinestate96 : 385|2@0+ (1,0) [0|3] "-"  C3B
 SG_ FR_FreespaceSectorConRidence96 : 387|2@0+ (1,0) [0|3] "-"  C3B
 SG_ FR_FreespaceSectorDistance96 : 381|10@0+ (0.1,0) [0|100] "-"  C3B
 SG_ FR_FreespaceSectorKinestate95 : 383|2@0+ (1,0) [0|3] "-"  C3B
 SG_ FR_FreespaceSectorConRidence95 : 369|2@0+ (1,0) [0|3] "-"  C3B
 SG_ FR_FreespaceSectorDistance95 : 363|10@0+ (0.1,0) [0|100] "-"  C3B
 SG_ FR_FreespaceSectorKinestate94 : 365|2@0+ (1,0) [0|3] "-"  C3B
 SG_ FR_FreespaceSectorConRidence94 : 367|2@0+ (1,0) [0|3] "-"  C3B
 SG_ FR_FreespaceSectorDistance94 : 345|10@0+ (0.1,0) [0|100] "-"  C3B
 SG_ FR_FreespaceSectorKinestate93 : 347|2@0+ (1,0) [0|3] "-"  C3B
 SG_ FR_FreespaceSectorConRidence93 : 349|2@0+ (1,0) [0|3] "-"  C3B
 SG_ FR_FreespaceSectorDistance93 : 343|10@0+ (0.1,0) [0|100] "-"  C3B
 SG_ FR_FreespaceSectorKinestate92 : 329|2@0+ (1,0) [0|3] "-"  C3B
 SG_ FR_FreespaceSectorConRidence92 : 331|2@0+ (1,0) [0|3] "-"  C3B
 SG_ FR_FreespaceSectorDistance92 : 325|10@0+ (0.1,0) [0|100] "-"  C3B
 SG_ FR_FreespaceSectorKinestate91 : 327|2@0+ (1,0) [0|3] "-"  C3B
 SG_ FR_FreespaceSectorConRidence91 : 313|2@0+ (1,0) [0|3] "-"  C3B
 SG_ FR_FreespaceSectorDistance91 : 307|10@0+ (0.1,0) [0|100] "-"  C3B
 SG_ FR_FreespaceSectorKinestate90 : 309|2@0+ (1,0) [0|3] "-"  C3B
 SG_ FR_FreespaceSectorConRidence90 : 311|2@0+ (1,0) [0|3] "-"  C3B
 SG_ FR_FreespaceSectorDistance90 : 289|10@0+ (0.1,0) [0|100] "-"  C3B
 SG_ FR_FreespaceSectorKinestate89 : 291|2@0+ (1,0) [0|3] "-"  C3B
 SG_ FR_FreespaceSectorConRidence89 : 293|2@0+ (1,0) [0|3] "-"  C3B
 SG_ FR_FreespaceSectorDistance89 : 287|10@0+ (0.1,0) [0|100] "-"  C3B
 SG_ FR_FreespaceSectorKinestate88 : 273|2@0+ (1,0) [0|3] "-"  C3B
 SG_ FR_FreespaceSectorConRidence88 : 275|2@0+ (1,0) [0|3] "-"  C3B
 SG_ FR_FreespaceSectorDistance88 : 269|10@0+ (0.1,0) [0|100] "-"  C3B
 SG_ FR_FreespaceSectorKinestate87 : 271|2@0+ (1,0) [0|3] "-"  C3B
 SG_ FR_FreespaceSectorConRidence87 : 257|2@0+ (1,0) [0|3] "-"  C3B
 SG_ FR_FreespaceSectorDistance87 : 251|10@0+ (0.1,0) [0|100] "-"  C3B
 SG_ FR_FreespaceSectorKinestate86 : 253|2@0+ (1,0) [0|3] "-"  C3B
 SG_ FR_FreespaceSectorConRidence86 : 255|2@0+ (1,0) [0|3] "-"  C3B
 SG_ FR_FreespaceSectorDistance86 : 233|10@0+ (0.1,0) [0|100] "-"  C3B
 SG_ FR_FreespaceSectorKinestate85 : 235|2@0+ (1,0) [0|3] "-"  C3B
 SG_ FR_FreespaceSectorConRidence85 : 237|2@0+ (1,0) [0|3] "-"  C3B
 SG_ FR_FreespaceSectorDistance85 : 231|10@0+ (0.1,0) [0|100] "-"  C3B
 SG_ FR_FreespaceSectorKinestate84 : 217|2@0+ (1,0) [0|3] "-"  C3B
 SG_ FR_FreespaceSectorConRidence84 : 219|2@0+ (1,0) [0|3] "-"  C3B
 SG_ FR_FreespaceSectorDistance84 : 213|10@0+ (0.1,0) [0|100] "-"  C3B
 SG_ FR_FreespaceSectorKinestate83 : 215|2@0+ (1,0) [0|3] "-"  C3B
 SG_ FR_FreespaceSectorConRidence83 : 201|2@0+ (1,0) [0|3] "-"  C3B
 SG_ FR_FreespaceSectorDistance83 : 195|10@0+ (0.1,0) [0|100] "-"  C3B
 SG_ FR_FreespaceSectorKinestate82 : 197|2@0+ (1,0) [0|3] "-"  C3B
 SG_ FR_FreespaceSectorConRidence82 : 199|2@0+ (1,0) [0|3] "-"  C3B
 SG_ FR_FreespaceSectorDistance82 : 177|10@0+ (0.1,0) [0|100] "-"  C3B
 SG_ FR_FreespaceSectorKinestate81 : 179|2@0+ (1,0) [0|3] "-"  C3B
 SG_ FR_FreespaceSectorConRidence81 : 181|2@0+ (1,0) [0|3] "-"  C3B
 SG_ FR_FreespaceSectorDistance81 : 175|10@0+ (0.1,0) [0|100] "-"  C3B
 SG_ FR_FreespaceSectorKinestate80 : 161|2@0+ (1,0) [0|3] "-"  C3B
 SG_ FR_FreespaceSectorConRidence80 : 163|2@0+ (1,0) [0|3] "-"  C3B
 SG_ FR_FreespaceSectorDistance80 : 157|10@0+ (0.1,0) [0|100] "-"  C3B
 SG_ FR_FreespaceSectorKinestate79 : 159|2@0+ (1,0) [0|3] "-"  C3B
 SG_ FR_FreespaceSectorConRidence79 : 145|2@0+ (1,0) [0|3] "-"  C3B
 SG_ FR_FreespaceSectorDistance79 : 139|10@0+ (0.1,0) [0|100] "-"  C3B
 SG_ FR_FreespaceSectorKinestate78 : 141|2@0+ (1,0) [0|3] "-"  C3B
 SG_ FR_FreespaceSectorConRidence78 : 143|2@0+ (1,0) [0|3] "-"  C3B
 SG_ FR_FreespaceSectorDistance78 : 121|10@0+ (0.1,0) [0|100] "-"  C3B
 SG_ FR_FreespaceSectorKinestate77 : 123|2@0+ (1,0) [0|3] "-"  C3B
 SG_ FR_FreespaceSectorConRidence77 : 125|2@0+ (1,0) [0|3] "-"  C3B
 SG_ FR_FreespaceSectorDistance77 : 119|10@0+ (0.1,0) [0|100] "-"  C3B
 SG_ FR_FreespaceSectorKinestate76 : 105|2@0+ (1,0) [0|3] "-"  C3B
 SG_ FR_FreespaceSectorConRidence76 : 107|2@0+ (1,0) [0|3] "-"  C3B
 SG_ FR_FreespaceSectorDistance76 : 101|10@0+ (0.1,0) [0|100] "-"  C3B
 SG_ FR_FreespaceSectorKinestate75 : 103|2@0+ (1,0) [0|3] "-"  C3B
 SG_ FR_FreespaceSectorConRidence75 : 89|2@0+ (1,0) [0|3] "-"  C3B
 SG_ FR_FreespaceSectorDistance75 : 83|10@0+ (0.1,0) [0|100] "-"  C3B
 SG_ FR_FreespaceSectorKinestate74 : 85|2@0+ (1,0) [0|3] "-"  C3B
 SG_ FR_FreespaceSectorConRidence74 : 87|2@0+ (1,0) [0|3] "-"  C3B
 SG_ FR_FreespaceSectorDistance74 : 65|10@0+ (0.1,0) [0|100] "-"  C3B
 SG_ FR_FreespaceSectorKinestate73 : 67|2@0+ (1,0) [0|3] "-"  C3B
 SG_ FR_FreespaceSectorConRidence73 : 69|2@0+ (1,0) [0|3] "-"  C3B
 SG_ FR_FreespaceSectorDistance73 : 63|10@0+ (0.1,0) [0|100] "-"  C3B
 SG_ FR_FreespaceSectorKinestate72 : 49|2@0+ (1,0) [0|3] "-"  C3B
 SG_ FR_FreespaceSectorConRidence72 : 51|2@0+ (1,0) [0|3] "-"  C3B
 SG_ FR_FreespaceSectorDistance72 : 45|10@0+ (0.1,0) [0|100] "-"  C3B
 SG_ FR_FreespaceSectorKinestate71 : 47|2@0+ (1,0) [0|3] "-"  C3B
 SG_ FR_FreespaceSectorConRidence71 : 33|2@0+ (1,0) [0|3] "-"  C3B
 SG_ FR_FreespaceSectorDistance71 : 27|10@0+ (0.1,0) [0|100] "-"  C3B
 SG_ FR_FreespaceSectorKinestate70 : 29|2@0+ (1,0) [0|3] "-"  C3B
 SG_ FR_FreespaceSectorConRidence70 : 31|2@0+ (1,0) [0|3] "-"  C3B
 SG_ FR_FreespaceSectorDistance70 : 9|10@0+ (0.1,0) [0|100] "-"  C3B
 SG_ FR_FreespaceSectorKinestate69 : 11|2@0+ (1,0) [0|3] "-"  C3B
 SG_ FR_FreespaceSectorConRidence69 : 13|2@0+ (1,0) [0|3] "-"  C3B
 SG_ FR_FreespaceSectorDistance69 : 7|10@0+ (0.1,0) [0|100] "-"  C3B

BO_ 555 FR_22B: 64 FR
 SG_ FR_CRCCheck_22B : 503|16@0+ (1,0) [0|65535] ""  C3B
 SG_ FR_RollingCounter_22B : 491|4@0+ (1,0) [0|15] ""  C3B
 SG_ FR_FreespaceSectorKinestate136 : 477|2@0+ (1,0) [0|3] "-"  C3B
 SG_ FR_FreespaceSectorConRidence136 : 479|2@0+ (1,0) [0|3] "-"  C3B
 SG_ FR_FreespaceSectorDistance136 : 457|10@0+ (0.1,0) [0|100] "-"  C3B
 SG_ FR_FreespaceSectorKinestate135 : 459|2@0+ (1,0) [0|3] "-"  C3B
 SG_ FR_FreespaceSectorConRidence135 : 461|2@0+ (1,0) [0|3] "-"  C3B
 SG_ FR_FreespaceSectorDistance135 : 455|10@0+ (0.1,0) [0|100] "-"  C3B
 SG_ FR_FreespaceSectorKinestate134 : 441|2@0+ (1,0) [0|3] "-"  C3B
 SG_ FR_FreespaceSectorConRidence134 : 443|2@0+ (1,0) [0|3] "-"  C3B
 SG_ FR_FreespaceSectorDistance134 : 437|10@0+ (0.1,0) [0|100] "-"  C3B
 SG_ FR_FreespaceSectorKinestate133 : 439|2@0+ (1,0) [0|3] "-"  C3B
 SG_ FR_FreespaceSectorConRidence133 : 425|2@0+ (1,0) [0|3] "-"  C3B
 SG_ FR_FreespaceSectorDistance133 : 419|10@0+ (0.1,0) [0|100] "-"  C3B
 SG_ FR_FreespaceSectorKinestate132 : 421|2@0+ (1,0) [0|3] "-"  C3B
 SG_ FR_FreespaceSectorConRidence132 : 423|2@0+ (1,0) [0|3] "-"  C3B
 SG_ FR_FreespaceSectorDistance132 : 401|10@0+ (0.1,0) [0|100] "-"  C3B
 SG_ FR_FreespaceSectorKinestate131 : 403|2@0+ (1,0) [0|3] "-"  C3B
 SG_ FR_FreespaceSectorConRidence131 : 405|2@0+ (1,0) [0|3] "-"  C3B
 SG_ FR_FreespaceSectorDistance131 : 399|10@0+ (0.1,0) [0|100] "-"  C3B
 SG_ FR_FreespaceSectorKinestate130 : 385|2@0+ (1,0) [0|3] "-"  C3B
 SG_ FR_FreespaceSectorConRidence130 : 387|2@0+ (1,0) [0|3] "-"  C3B
 SG_ FR_FreespaceSectorDistance130 : 381|10@0+ (0.1,0) [0|100] "-"  C3B
 SG_ FR_FreespaceSectorKinestate129 : 383|2@0+ (1,0) [0|3] "-"  C3B
 SG_ FR_FreespaceSectorConRidence129 : 369|2@0+ (1,0) [0|3] "-"  C3B
 SG_ FR_FreespaceSectorDistance129 : 363|10@0+ (0.1,0) [0|100] "-"  C3B
 SG_ FR_FreespaceSectorKinestate128 : 365|2@0+ (1,0) [0|3] "-"  C3B
 SG_ FR_FreespaceSectorConRidence128 : 367|2@0+ (1,0) [0|3] "-"  C3B
 SG_ FR_FreespaceSectorDistance128 : 345|10@0+ (0.1,0) [0|100] "-"  C3B
 SG_ FR_FreespaceSectorKinestate127 : 347|2@0+ (1,0) [0|3] "-"  C3B
 SG_ FR_FreespaceSectorConRidence127 : 349|2@0+ (1,0) [0|3] "-"  C3B
 SG_ FR_FreespaceSectorDistance127 : 343|10@0+ (0.1,0) [0|100] "-"  C3B
 SG_ FR_FreespaceSectorKinestate126 : 329|2@0+ (1,0) [0|3] "-"  C3B
 SG_ FR_FreespaceSectorConRidence126 : 331|2@0+ (1,0) [0|3] "-"  C3B
 SG_ FR_FreespaceSectorDistance126 : 325|10@0+ (0.1,0) [0|100] "-"  C3B
 SG_ FR_FreespaceSectorKinestate125 : 327|2@0+ (1,0) [0|3] "-"  C3B
 SG_ FR_FreespaceSectorConRidence125 : 313|2@0+ (1,0) [0|3] "-"  C3B
 SG_ FR_FreespaceSectorDistance125 : 307|10@0+ (0.1,0) [0|100] "-"  C3B
 SG_ FR_FreespaceSectorKinestate124 : 309|2@0+ (1,0) [0|3] "-"  C3B
 SG_ FR_FreespaceSectorConRidence124 : 311|2@0+ (1,0) [0|3] "-"  C3B
 SG_ FR_FreespaceSectorDistance124 : 289|10@0+ (0.1,0) [0|100] "-"  C3B
 SG_ FR_FreespaceSectorKinestate123 : 291|2@0+ (1,0) [0|3] "-"  C3B
 SG_ FR_FreespaceSectorConRidence123 : 293|2@0+ (1,0) [0|3] "-"  C3B
 SG_ FR_FreespaceSectorDistance123 : 287|10@0+ (0.1,0) [0|100] "-"  C3B
 SG_ FR_FreespaceSectorKinestate122 : 273|2@0+ (1,0) [0|3] "-"  C3B
 SG_ FR_FreespaceSectorConRidence122 : 275|2@0+ (1,0) [0|3] "-"  C3B
 SG_ FR_FreespaceSectorDistance122 : 269|10@0+ (0.1,0) [0|100] "-"  C3B
 SG_ FR_FreespaceSectorKinestate121 : 271|2@0+ (1,0) [0|3] "-"  C3B
 SG_ FR_FreespaceSectorConRidence121 : 257|2@0+ (1,0) [0|3] "-"  C3B
 SG_ FR_FreespaceSectorDistance121 : 251|10@0+ (0.1,0) [0|100] "-"  C3B
 SG_ FR_FreespaceSectorKinestate120 : 253|2@0+ (1,0) [0|3] "-"  C3B
 SG_ FR_FreespaceSectorConRidence120 : 255|2@0+ (1,0) [0|3] "-"  C3B
 SG_ FR_FreespaceSectorDistance120 : 233|10@0+ (0.1,0) [0|100] "-"  C3B
 SG_ FR_FreespaceSectorKinestate119 : 235|2@0+ (1,0) [0|3] "-"  C3B
 SG_ FR_FreespaceSectorConRidence119 : 237|2@0+ (1,0) [0|3] "-"  C3B
 SG_ FR_FreespaceSectorDistance119 : 231|10@0+ (0.1,0) [0|100] "-"  C3B
 SG_ FR_FreespaceSectorKinestate118 : 217|2@0+ (1,0) [0|3] "-"  C3B
 SG_ FR_FreespaceSectorConRidence118 : 219|2@0+ (1,0) [0|3] "-"  C3B
 SG_ FR_FreespaceSectorDistance118 : 213|10@0+ (0.1,0) [0|100] "-"  C3B
 SG_ FR_FreespaceSectorKinestate117 : 215|2@0+ (1,0) [0|3] "-"  C3B
 SG_ FR_FreespaceSectorConRidence117 : 201|2@0+ (1,0) [0|3] "-"  C3B
 SG_ FR_FreespaceSectorDistance117 : 195|10@0+ (0.1,0) [0|100] "-"  C3B
 SG_ FR_FreespaceSectorKinestate116 : 197|2@0+ (1,0) [0|3] "-"  C3B
 SG_ FR_FreespaceSectorConRidence116 : 199|2@0+ (1,0) [0|3] "-"  C3B
 SG_ FR_FreespaceSectorDistance116 : 177|10@0+ (0.1,0) [0|100] "-"  C3B
 SG_ FR_FreespaceSectorKinestate115 : 179|2@0+ (1,0) [0|3] "-"  C3B
 SG_ FR_FreespaceSectorConRidence115 : 181|2@0+ (1,0) [0|3] "-"  C3B
 SG_ FR_FreespaceSectorDistance115 : 175|10@0+ (0.1,0) [0|100] "-"  C3B
 SG_ FR_FreespaceSectorKinestate114 : 161|2@0+ (1,0) [0|3] "-"  C3B
 SG_ FR_FreespaceSectorConRidence114 : 163|2@0+ (1,0) [0|3] "-"  C3B
 SG_ FR_FreespaceSectorDistance114 : 157|10@0+ (0.1,0) [0|100] "-"  C3B
 SG_ FR_FreespaceSectorKinestate113 : 159|2@0+ (1,0) [0|3] "-"  C3B
 SG_ FR_FreespaceSectorConRidence113 : 145|2@0+ (1,0) [0|3] "-"  C3B
 SG_ FR_FreespaceSectorDistance113 : 139|10@0+ (0.1,0) [0|100] "-"  C3B
 SG_ FR_FreespaceSectorKinestate112 : 141|2@0+ (1,0) [0|3] "-"  C3B
 SG_ FR_FreespaceSectorConRidence112 : 143|2@0+ (1,0) [0|3] "-"  C3B
 SG_ FR_FreespaceSectorDistance112 : 121|10@0+ (0.1,0) [0|100] "-"  C3B
 SG_ FR_FreespaceSectorKinestate111 : 123|2@0+ (1,0) [0|3] "-"  C3B
 SG_ FR_FreespaceSectorConRidence111 : 125|2@0+ (1,0) [0|3] "-"  C3B
 SG_ FR_FreespaceSectorDistance111 : 119|10@0+ (0.1,0) [0|100] "-"  C3B
 SG_ FR_FreespaceSectorKinestate110 : 105|2@0+ (1,0) [0|3] "-"  C3B
 SG_ FR_FreespaceSectorConRidence110 : 107|2@0+ (1,0) [0|3] "-"  C3B
 SG_ FR_FreespaceSectorDistance110 : 101|10@0+ (0.1,0) [0|100] "-"  C3B
 SG_ FR_FreespaceSectorKinestate109 : 103|2@0+ (1,0) [0|3] "-"  C3B
 SG_ FR_FreespaceSectorConRidence109 : 89|2@0+ (1,0) [0|3] "-"  C3B
 SG_ FR_FreespaceSectorDistance109 : 83|10@0+ (0.1,0) [0|100] "-"  C3B
 SG_ FR_FreespaceSectorKinestate108 : 85|2@0+ (1,0) [0|3] "-"  C3B
 SG_ FR_FreespaceSectorConRidence108 : 87|2@0+ (1,0) [0|3] "-"  C3B
 SG_ FR_FreespaceSectorDistance108 : 65|10@0+ (0.1,0) [0|100] "-"  C3B
 SG_ FR_FreespaceSectorKinestate107 : 67|2@0+ (1,0) [0|3] "-"  C3B
 SG_ FR_FreespaceSectorConRidence107 : 69|2@0+ (1,0) [0|3] "-"  C3B
 SG_ FR_FreespaceSectorDistance107 : 63|10@0+ (0.1,0) [0|100] "-"  C3B
 SG_ FR_FreespaceSectorKinestate106 : 49|2@0+ (1,0) [0|3] "-"  C3B
 SG_ FR_FreespaceSectorConRidence106 : 51|2@0+ (1,0) [0|3] "-"  C3B
 SG_ FR_FreespaceSectorDistance106 : 45|10@0+ (0.1,0) [0|100] "-"  C3B
 SG_ FR_FreespaceSectorKinestate105 : 47|2@0+ (1,0) [0|3] "-"  C3B
 SG_ FR_FreespaceSectorConRidence105 : 33|2@0+ (1,0) [0|3] "-"  C3B
 SG_ FR_FreespaceSectorDistance105 : 27|10@0+ (0.1,0) [0|100] "-"  C3B
 SG_ FR_FreespaceSectorKinestate104 : 29|2@0+ (1,0) [0|3] "-"  C3B
 SG_ FR_FreespaceSectorConRidence104 : 31|2@0+ (1,0) [0|3] "-"  C3B
 SG_ FR_FreespaceSectorDistance104 : 9|10@0+ (0.1,0) [0|100] "-"  C3B
 SG_ FR_FreespaceSectorKinestate103 : 11|2@0+ (1,0) [0|3] "-"  C3B
 SG_ FR_FreespaceSectorConRidence103 : 13|2@0+ (1,0) [0|3] "-"  C3B
 SG_ FR_FreespaceSectorDistance103 : 7|10@0+ (0.1,0) [0|100] "-"  C3B

BO_ 556 FR_22C: 64 FR
 SG_ FR_CRCCheck_22C : 503|16@0+ (1,0) [0|65535] ""  C3B
 SG_ FR_RollingCounter_22C : 491|4@0+ (1,0) [0|15] ""  C3B
 SG_ FR_FreespaceSectorKinestate170 : 477|2@0+ (1,0) [0|3] "-"  C3B
 SG_ FR_FreespaceSectorConRidence170 : 479|2@0+ (1,0) [0|3] "-"  C3B
 SG_ FR_FreespaceSectorDistance170 : 457|10@0+ (0.1,0) [0|100] "-"  C3B
 SG_ FR_FreespaceSectorKinestate169 : 459|2@0+ (1,0) [0|3] "-"  C3B
 SG_ FR_FreespaceSectorConRidence169 : 461|2@0+ (1,0) [0|3] "-"  C3B
 SG_ FR_FreespaceSectorDistance169 : 455|10@0+ (0.1,0) [0|100] "-"  C3B
 SG_ FR_FreespaceSectorKinestate168 : 441|2@0+ (1,0) [0|3] "-"  C3B
 SG_ FR_FreespaceSectorConRidence168 : 443|2@0+ (1,0) [0|3] "-"  C3B
 SG_ FR_FreespaceSectorDistance168 : 437|10@0+ (0.1,0) [0|100] "-"  C3B
 SG_ FR_FreespaceSectorKinestate167 : 439|2@0+ (1,0) [0|3] "-"  C3B
 SG_ FR_FreespaceSectorConRidence167 : 425|2@0+ (1,0) [0|3] "-"  C3B
 SG_ FR_FreespaceSectorDistance167 : 419|10@0+ (0.1,0) [0|100] "-"  C3B
 SG_ FR_FreespaceSectorKinestate166 : 421|2@0+ (1,0) [0|3] "-"  C3B
 SG_ FR_FreespaceSectorConRidence166 : 423|2@0+ (1,0) [0|3] "-"  C3B
 SG_ FR_FreespaceSectorDistance166 : 401|10@0+ (0.1,0) [0|100] "-"  C3B
 SG_ FR_FreespaceSectorKinestate165 : 403|2@0+ (1,0) [0|3] "-"  C3B
 SG_ FR_FreespaceSectorConRidence165 : 405|2@0+ (1,0) [0|3] "-"  C3B
 SG_ FR_FreespaceSectorDistance165 : 399|10@0+ (0.1,0) [0|100] "-"  C3B
 SG_ FR_FreespaceSectorKinestate164 : 385|2@0+ (1,0) [0|3] "-"  C3B
 SG_ FR_FreespaceSectorConRidence164 : 387|2@0+ (1,0) [0|3] "-"  C3B
 SG_ FR_FreespaceSectorDistance164 : 381|10@0+ (0.1,0) [0|100] "-"  C3B
 SG_ FR_FreespaceSectorKinestate163 : 383|2@0+ (1,0) [0|3] "-"  C3B
 SG_ FR_FreespaceSectorConRidence163 : 369|2@0+ (1,0) [0|3] "-"  C3B
 SG_ FR_FreespaceSectorDistance163 : 363|10@0+ (0.1,0) [0|100] "-"  C3B
 SG_ FR_FreespaceSectorKinestate162 : 365|2@0+ (1,0) [0|3] "-"  C3B
 SG_ FR_FreespaceSectorConRidence162 : 367|2@0+ (1,0) [0|3] "-"  C3B
 SG_ FR_FreespaceSectorDistance162 : 345|10@0+ (0.1,0) [0|100] "-"  C3B
 SG_ FR_FreespaceSectorKinestate161 : 347|2@0+ (1,0) [0|3] "-"  C3B
 SG_ FR_FreespaceSectorConRidence161 : 349|2@0+ (1,0) [0|3] "-"  C3B
 SG_ FR_FreespaceSectorDistance161 : 343|10@0+ (0.1,0) [0|100] "-"  C3B
 SG_ FR_FreespaceSectorKinestate160 : 329|2@0+ (1,0) [0|3] "-"  C3B
 SG_ FR_FreespaceSectorConRidence160 : 331|2@0+ (1,0) [0|3] "-"  C3B
 SG_ FR_FreespaceSectorDistance160 : 325|10@0+ (0.1,0) [0|100] "-"  C3B
 SG_ FR_FreespaceSectorKinestate159 : 327|2@0+ (1,0) [0|3] "-"  C3B
 SG_ FR_FreespaceSectorConRidence159 : 313|2@0+ (1,0) [0|3] "-"  C3B
 SG_ FR_FreespaceSectorDistance159 : 307|10@0+ (0.1,0) [0|100] "-"  C3B
 SG_ FR_FreespaceSectorKinestate158 : 309|2@0+ (1,0) [0|3] "-"  C3B
 SG_ FR_FreespaceSectorConRidence158 : 311|2@0+ (1,0) [0|3] "-"  C3B
 SG_ FR_FreespaceSectorDistance158 : 289|10@0+ (0.1,0) [0|100] "-"  C3B
 SG_ FR_FreespaceSectorKinestate157 : 291|2@0+ (1,0) [0|3] "-"  C3B
 SG_ FR_FreespaceSectorConRidence157 : 293|2@0+ (1,0) [0|3] "-"  C3B
 SG_ FR_FreespaceSectorDistance157 : 287|10@0+ (0.1,0) [0|100] "-"  C3B
 SG_ FR_FreespaceSectorKinestate156 : 273|2@0+ (1,0) [0|3] "-"  C3B
 SG_ FR_FreespaceSectorConRidence156 : 275|2@0+ (1,0) [0|3] "-"  C3B
 SG_ FR_FreespaceSectorDistance156 : 269|10@0+ (0.1,0) [0|100] "-"  C3B
 SG_ FR_FreespaceSectorKinestate155 : 271|2@0+ (1,0) [0|3] "-"  C3B
 SG_ FR_FreespaceSectorConRidence155 : 257|2@0+ (1,0) [0|3] "-"  C3B
 SG_ FR_FreespaceSectorDistance155 : 251|10@0+ (0.1,0) [0|100] "-"  C3B
 SG_ FR_FreespaceSectorKinestate154 : 253|2@0+ (1,0) [0|3] "-"  C3B
 SG_ FR_FreespaceSectorConRidence154 : 255|2@0+ (1,0) [0|3] "-"  C3B
 SG_ FR_FreespaceSectorDistance154 : 233|10@0+ (0.1,0) [0|100] "-"  C3B
 SG_ FR_FreespaceSectorKinestate153 : 235|2@0+ (1,0) [0|3] "-"  C3B
 SG_ FR_FreespaceSectorConRidence153 : 237|2@0+ (1,0) [0|3] "-"  C3B
 SG_ FR_FreespaceSectorDistance153 : 231|10@0+ (0.1,0) [0|100] "-"  C3B
 SG_ FR_FreespaceSectorKinestate152 : 217|2@0+ (1,0) [0|3] "-"  C3B
 SG_ FR_FreespaceSectorConRidence152 : 219|2@0+ (1,0) [0|3] "-"  C3B
 SG_ FR_FreespaceSectorDistance152 : 213|10@0+ (0.1,0) [0|100] "-"  C3B
 SG_ FR_FreespaceSectorKinestate151 : 215|2@0+ (1,0) [0|3] "-"  C3B
 SG_ FR_FreespaceSectorConRidence151 : 201|2@0+ (1,0) [0|3] "-"  C3B
 SG_ FR_FreespaceSectorDistance151 : 195|10@0+ (0.1,0) [0|100] "-"  C3B
 SG_ FR_FreespaceSectorKinestate150 : 197|2@0+ (1,0) [0|3] "-"  C3B
 SG_ FR_FreespaceSectorConRidence150 : 199|2@0+ (1,0) [0|3] "-"  C3B
 SG_ FR_FreespaceSectorDistance150 : 177|10@0+ (0.1,0) [0|100] "-"  C3B
 SG_ FR_FreespaceSectorKinestate149 : 179|2@0+ (1,0) [0|3] "-"  C3B
 SG_ FR_FreespaceSectorConRidence149 : 181|2@0+ (1,0) [0|3] "-"  C3B
 SG_ FR_FreespaceSectorDistance149 : 175|10@0+ (0.1,0) [0|100] "-"  C3B
 SG_ FR_FreespaceSectorKinestate148 : 161|2@0+ (1,0) [0|3] "-"  C3B
 SG_ FR_FreespaceSectorConRidence148 : 163|2@0+ (1,0) [0|3] "-"  C3B
 SG_ FR_FreespaceSectorDistance148 : 157|10@0+ (0.1,0) [0|100] "-"  C3B
 SG_ FR_FreespaceSectorKinestate147 : 159|2@0+ (1,0) [0|3] "-"  C3B
 SG_ FR_FreespaceSectorConRidence147 : 145|2@0+ (1,0) [0|3] "-"  C3B
 SG_ FR_FreespaceSectorDistance147 : 139|10@0+ (0.1,0) [0|100] "-"  C3B
 SG_ FR_FreespaceSectorKinestate146 : 141|2@0+ (1,0) [0|3] "-"  C3B
 SG_ FR_FreespaceSectorConRidence146 : 143|2@0+ (1,0) [0|3] "-"  C3B
 SG_ FR_FreespaceSectorDistance146 : 121|10@0+ (0.1,0) [0|100] "-"  C3B
 SG_ FR_FreespaceSectorKinestate145 : 123|2@0+ (1,0) [0|3] "-"  C3B
 SG_ FR_FreespaceSectorConRidence145 : 125|2@0+ (1,0) [0|3] "-"  C3B
 SG_ FR_FreespaceSectorDistance145 : 119|10@0+ (0.1,0) [0|100] "-"  C3B
 SG_ FR_FreespaceSectorKinestate144 : 105|2@0+ (1,0) [0|3] "-"  C3B
 SG_ FR_FreespaceSectorConRidence144 : 107|2@0+ (1,0) [0|3] "-"  C3B
 SG_ FR_FreespaceSectorDistance144 : 101|10@0+ (0.1,0) [0|100] "-"  C3B
 SG_ FR_FreespaceSectorKinestate143 : 103|2@0+ (1,0) [0|3] "-"  C3B
 SG_ FR_FreespaceSectorConRidence143 : 89|2@0+ (1,0) [0|3] "-"  C3B
 SG_ FR_FreespaceSectorDistance143 : 83|10@0+ (0.1,0) [0|100] "-"  C3B
 SG_ FR_FreespaceSectorKinestate142 : 85|2@0+ (1,0) [0|3] "-"  C3B
 SG_ FR_FreespaceSectorConRidence142 : 87|2@0+ (1,0) [0|3] "-"  C3B
 SG_ FR_FreespaceSectorDistance142 : 65|10@0+ (0.1,0) [0|100] "-"  C3B
 SG_ FR_FreespaceSectorKinestate141 : 67|2@0+ (1,0) [0|3] "-"  C3B
 SG_ FR_FreespaceSectorConRidence141 : 69|2@0+ (1,0) [0|3] "-"  C3B
 SG_ FR_FreespaceSectorDistance141 : 63|10@0+ (0.1,0) [0|100] "-"  C3B
 SG_ FR_FreespaceSectorKinestate140 : 49|2@0+ (1,0) [0|3] "-"  C3B
 SG_ FR_FreespaceSectorConRidence140 : 51|2@0+ (1,0) [0|3] "-"  C3B
 SG_ FR_FreespaceSectorDistance140 : 45|10@0+ (0.1,0) [0|100] "-"  C3B
 SG_ FR_FreespaceSectorKinestate139 : 47|2@0+ (1,0) [0|3] "-"  C3B
 SG_ FR_FreespaceSectorConRidence139 : 33|2@0+ (1,0) [0|3] "-"  C3B
 SG_ FR_FreespaceSectorDistance139 : 27|10@0+ (0.1,0) [0|100] "-"  C3B
 SG_ FR_FreespaceSectorKinestate138 : 29|2@0+ (1,0) [0|3] "-"  C3B
 SG_ FR_FreespaceSectorConRidence138 : 31|2@0+ (1,0) [0|3] "-"  C3B
 SG_ FR_FreespaceSectorDistance138 : 9|10@0+ (0.1,0) [0|100] "-"  C3B
 SG_ FR_FreespaceSectorKinestate137 : 11|2@0+ (1,0) [0|3] "-"  C3B
 SG_ FR_FreespaceSectorConRidence137 : 13|2@0+ (1,0) [0|3] "-"  C3B
 SG_ FR_FreespaceSectorDistance137 : 7|10@0+ (0.1,0) [0|100] "-"  C3B

CM_ BO_ 518 " ";
CM_ SG_ 518 FR_H_SwVers6 "ASCII码，命名规则按照《QJDT037-2019汽车产品零部件件号和名称编制规范》 ";
CM_ SG_ 518 FR_H_SwVers5 "ASCII码，命名规则按照《QJDT037-2019汽车产品零部件件号和名称编制规范》 ";
CM_ SG_ 518 FR_H_SwVers4 "ASCII码，命名规则按照《QJDT037-2019汽车产品零部件件号和名称编制规范》 ";
CM_ SG_ 518 FR_H_SwVers3 "ASCII码，命名规则按照《QJDT037-2019汽车产品零部件件号和名称编制规范》 ";
CM_ SG_ 518 FR_H_SwVers2 "ASCII码，命名规则按照《QJDT037-2019汽车产品零部件件号和名称编制规范》 ";
CM_ SG_ 518 FR_H_SwVers1 "ASCII码，命名规则按照《QJDT037-2019汽车产品零部件件号和名称编制规范》 ";
CM_ SG_ 518 FR_H_SwVers0 "ASCII码，命名规则按照《QJDT037-2019汽车产品零部件件号和名称编制规范》 ";
CM_ SG_ 518 FR_H_HwVers6 "ASCII码，命名规则按照《QJDT037-2019汽车产品零部件件号和名称编制规范》 ";
CM_ SG_ 518 FR_H_HwVers5 "ASCII码，命名规则按照《QJDT037-2019汽车产品零部件件号和名称编制规范》 ";
CM_ SG_ 518 FR_H_HwVers4 "ASCII码，命名规则按照《QJDT037-2019汽车产品零部件件号和名称编制规范》 ";
CM_ SG_ 518 FR_H_HwVers3 "ASCII码，命名规则按照《QJDT037-2019汽车产品零部件件号和名称编制规范》 ";
CM_ SG_ 518 FR_H_HwVers2 "ASCII码，命名规则按照《QJDT037-2019汽车产品零部件件号和名称编制规范》 ";
CM_ SG_ 518 FR_H_HwVers1 "ASCII码，命名规则按照《QJDT037-2019汽车产品零部件件号和名称编制规范》 ";
CM_ SG_ 518 FR_H_HwVers0 "ASCII码，命名规则按照《QJDT037-2019汽车产品零部件件号和名称编制规范》 ";
CM_ BO_ 544 " ";
CM_ SG_ 544 FR_CRCCheck_220 " ";
CM_ SG_ 544 FR_RollingCounter_220 " ";
CM_ SG_ 544 FR_Obj25_Ax " ";
CM_ SG_ 544 FR_Obj25_Ay " ";
CM_ SG_ 544 FR_Obj25_Vx " ";
CM_ SG_ 544 FR_Obj25_Vy " ";
CM_ SG_ 544 FR_Obj25_DelayTime " ";
CM_ SG_ 544 FR_Obj25_ReferPoint_Dx " ";
CM_ SG_ 544 FR_Obj25_HeightGround "反射点最强点距离地面的高度 ";
CM_ SG_ 544 FR_Obj25_MotionStatusConf " ";
CM_ SG_ 544 FR_Obj25_MotionStatus " ";
CM_ SG_ 544 FR_Obj25_Measured " ";
CM_ SG_ 544 FR_Obj25_valid " ";
CM_ SG_ 544 FR_Obj25_Track_Age " ";
CM_ SG_ 544 FR_Obj25_Track_ID " ";
CM_ SG_ 544 FR_Obj25_ObstacleProb " ";
CM_ SG_ 544 FR_Obj25_ExistProb " ";
CM_ SG_ 544 FR_Obj25_RelAx " ";
CM_ SG_ 544 FR_Obj25_RelAy " ";
CM_ SG_ 544 FR_Obj25_RelVx_std " ";
CM_ SG_ 544 FR_Obj25_RelVx " ";
CM_ SG_ 544 FR_Obj25_RelVy_std " ";
CM_ SG_ 544 FR_Obj25_RelVy " ";
CM_ SG_ 544 FR_Obj25_Dx_Vnce " ";
CM_ SG_ 544 FR_Obj25_Dx " ";
CM_ SG_ 544 FR_Obj25_Dy_Vnce " ";
CM_ SG_ 544 FR_Obj25_Dy " ";
CM_ SG_ 544 FR_Obj25_HeadingAngle " ";
CM_ SG_ 544 FR_Obj25_Length " ";
CM_ SG_ 544 FR_Obj25_Height " ";
CM_ SG_ 544 FR_Obj25_Width " ";
CM_ SG_ 544 FR_Obj25_TypeProb " ";
CM_ SG_ 544 FR_Obj25_Type " ";
CM_ BO_ 545 " ";
CM_ SG_ 545 FR_CRCCheck_221 " ";
CM_ SG_ 545 FR_RollingCounter_221 " ";
CM_ SG_ 545 FR_Obj26_Ax " ";
CM_ SG_ 545 FR_Obj26_Ay " ";
CM_ SG_ 545 FR_Obj26_Vx " ";
CM_ SG_ 545 FR_Obj26_Vy " ";
CM_ SG_ 545 FR_Obj26_DelayTime " ";
CM_ SG_ 545 FR_Obj26_ReferPoint_Dx " ";
CM_ SG_ 545 FR_Obj26_HeightGround "反射点最强点距离地面的高度 ";
CM_ SG_ 545 FR_Obj26_MotionStatusConf " ";
CM_ SG_ 545 FR_Obj26_MotionStatus " ";
CM_ SG_ 545 FR_Obj26_Measured " ";
CM_ SG_ 545 FR_Obj26_valid " ";
CM_ SG_ 545 FR_Obj26_Track_Age " ";
CM_ SG_ 545 FR_Obj26_Track_ID " ";
CM_ SG_ 545 FR_Obj26_ObstacleProb " ";
CM_ SG_ 545 FR_Obj26_ExistProb " ";
CM_ SG_ 545 FR_Obj26_RelAx " ";
CM_ SG_ 545 FR_Obj26_RelAy " ";
CM_ SG_ 545 FR_Obj26_RelVx_std " ";
CM_ SG_ 545 FR_Obj26_RelVx " ";
CM_ SG_ 545 FR_Obj26_RelVy_std " ";
CM_ SG_ 545 FR_Obj26_RelVy " ";
CM_ SG_ 545 FR_Obj26_Dx_Vnce " ";
CM_ SG_ 545 FR_Obj26_Dx " ";
CM_ SG_ 545 FR_Obj26_Dy_Vnce " ";
CM_ SG_ 545 FR_Obj26_Dy " ";
CM_ SG_ 545 FR_Obj26_HeadingAngle " ";
CM_ SG_ 545 FR_Obj26_Length " ";
CM_ SG_ 545 FR_Obj26_Height " ";
CM_ SG_ 545 FR_Obj26_Width " ";
CM_ SG_ 545 FR_Obj26_TypeProb " ";
CM_ SG_ 545 FR_Obj26_Type " ";
CM_ BO_ 546 " ";
CM_ SG_ 546 FR_CRCCheck_222 " ";
CM_ SG_ 546 FR_RollingCounter_222 " ";
CM_ SG_ 546 FR_Obj27_Ax " ";
CM_ SG_ 546 FR_Obj27_Ay " ";
CM_ SG_ 546 FR_Obj27_Vx " ";
CM_ SG_ 546 FR_Obj27_Vy " ";
CM_ SG_ 546 FR_Obj27_DelayTime " ";
CM_ SG_ 546 FR_Obj27_ReferPoint_Dx " ";
CM_ SG_ 546 FR_Obj27_HeightGround "反射点最强点距离地面的高度 ";
CM_ SG_ 546 FR_Obj27_MotionStatusConf " ";
CM_ SG_ 546 FR_Obj27_MotionStatus " ";
CM_ SG_ 546 FR_Obj27_Measured " ";
CM_ SG_ 546 FR_Obj27_valid " ";
CM_ SG_ 546 FR_Obj27_Track_Age " ";
CM_ SG_ 546 FR_Obj27_Track_ID " ";
CM_ SG_ 546 FR_Obj27_ObstacleProb " ";
CM_ SG_ 546 FR_Obj27_ExistProb " ";
CM_ SG_ 546 FR_Obj27_RelAx " ";
CM_ SG_ 546 FR_Obj27_RelAy " ";
CM_ SG_ 546 FR_Obj27_RelVx_std " ";
CM_ SG_ 546 FR_Obj27_RelVx " ";
CM_ SG_ 546 FR_Obj27_RelVy_std " ";
CM_ SG_ 546 FR_Obj27_RelVy " ";
CM_ SG_ 546 FR_Obj27_Dx_Vnce " ";
CM_ SG_ 546 FR_Obj27_Dx " ";
CM_ SG_ 546 FR_Obj27_Dy_Vnce " ";
CM_ SG_ 546 FR_Obj27_Dy " ";
CM_ SG_ 546 FR_Obj27_HeadingAngle " ";
CM_ SG_ 546 FR_Obj27_Length " ";
CM_ SG_ 546 FR_Obj27_Height " ";
CM_ SG_ 546 FR_Obj27_Width " ";
CM_ SG_ 546 FR_Obj27_TypeProb " ";
CM_ SG_ 546 FR_Obj27_Type " ";
CM_ BO_ 547 " ";
CM_ SG_ 547 FR_CRCCheck_223 " ";
CM_ SG_ 547 FR_RollingCounter_223 " ";
CM_ SG_ 547 FR_Obj28_Ax " ";
CM_ SG_ 547 FR_Obj28_Ay " ";
CM_ SG_ 547 FR_Obj28_Vx " ";
CM_ SG_ 547 FR_Obj28_Vy " ";
CM_ SG_ 547 FR_Obj28_DelayTime " ";
CM_ SG_ 547 FR_Obj28_ReferPoint_Dx " ";
CM_ SG_ 547 FR_Obj28_HeightGround "反射点最强点距离地面的高度 ";
CM_ SG_ 547 FR_Obj28_MotionStatusConf " ";
CM_ SG_ 547 FR_Obj28_MotionStatus " ";
CM_ SG_ 547 FR_Obj28_Measured " ";
CM_ SG_ 547 FR_Obj28_valid " ";
CM_ SG_ 547 FR_Obj28_Track_Age " ";
CM_ SG_ 547 FR_Obj28_Track_ID " ";
CM_ SG_ 547 FR_Obj28_ObstacleProb " ";
CM_ SG_ 547 FR_Obj28_ExistProb " ";
CM_ SG_ 547 FR_Obj28_RelAx " ";
CM_ SG_ 547 FR_Obj28_RelAy " ";
CM_ SG_ 547 FR_Obj28_RelVx_std " ";
CM_ SG_ 547 FR_Obj28_RelVx " ";
CM_ SG_ 547 FR_Obj28_RelVy_std " ";
CM_ SG_ 547 FR_Obj28_RelVy " ";
CM_ SG_ 547 FR_Obj28_Dx_Vnce " ";
CM_ SG_ 547 FR_Obj28_Dx " ";
CM_ SG_ 547 FR_Obj28_Dy_Vnce " ";
CM_ SG_ 547 FR_Obj28_Dy " ";
CM_ SG_ 547 FR_Obj28_HeadingAngle " ";
CM_ SG_ 547 FR_Obj28_Length " ";
CM_ SG_ 547 FR_Obj28_Height " ";
CM_ SG_ 547 FR_Obj28_Width " ";
CM_ SG_ 547 FR_Obj28_TypeProb " ";
CM_ SG_ 547 FR_Obj28_Type " ";
CM_ BO_ 548 " ";
CM_ SG_ 548 FR_CRCCheck_224 " ";
CM_ SG_ 548 FR_RollingCounter_224 " ";
CM_ SG_ 548 FR_Obj29_Ax " ";
CM_ SG_ 548 FR_Obj29_Ay " ";
CM_ SG_ 548 FR_Obj29_Vx " ";
CM_ SG_ 548 FR_Obj29_Vy " ";
CM_ SG_ 548 FR_Obj29_DelayTime " ";
CM_ SG_ 548 FR_Obj29_ReferPoint_Dx " ";
CM_ SG_ 548 FR_Obj29_HeightGround "反射点最强点距离地面的高度 ";
CM_ SG_ 548 FR_Obj29_MotionStatusConf " ";
CM_ SG_ 548 FR_Obj29_MotionStatus " ";
CM_ SG_ 548 FR_Obj29_Measured " ";
CM_ SG_ 548 FR_Obj29_valid " ";
CM_ SG_ 548 FR_Obj29_Track_Age " ";
CM_ SG_ 548 FR_Obj29_Track_ID " ";
CM_ SG_ 548 FR_Obj29_ObstacleProb " ";
CM_ SG_ 548 FR_Obj29_ExistProb " ";
CM_ SG_ 548 FR_Obj29_RelAx " ";
CM_ SG_ 548 FR_Obj29_RelAy " ";
CM_ SG_ 548 FR_Obj29_RelVx_std " ";
CM_ SG_ 548 FR_Obj29_RelVx " ";
CM_ SG_ 548 FR_Obj29_RelVy_std " ";
CM_ SG_ 548 FR_Obj29_RelVy " ";
CM_ SG_ 548 FR_Obj29_Dx_Vnce " ";
CM_ SG_ 548 FR_Obj29_Dx " ";
CM_ SG_ 548 FR_Obj29_Dy_Vnce " ";
CM_ SG_ 548 FR_Obj29_Dy " ";
CM_ SG_ 548 FR_Obj29_HeadingAngle " ";
CM_ SG_ 548 FR_Obj29_Length " ";
CM_ SG_ 548 FR_Obj29_Height " ";
CM_ SG_ 548 FR_Obj29_Width " ";
CM_ SG_ 548 FR_Obj29_TypeProb " ";
CM_ SG_ 548 FR_Obj29_Type " ";
CM_ BO_ 549 " ";
CM_ SG_ 549 FR_CRCCheck_225 " ";
CM_ SG_ 549 FR_RollingCounter_225 " ";
CM_ SG_ 549 FR_Obj30_Ax " ";
CM_ SG_ 549 FR_Obj30_Ay " ";
CM_ SG_ 549 FR_Obj30_Vx " ";
CM_ SG_ 549 FR_Obj30_Vy " ";
CM_ SG_ 549 FR_Obj30_DelayTime " ";
CM_ SG_ 549 FR_Obj30_ReferPoint_Dx " ";
CM_ SG_ 549 FR_Obj30_HeightGround "反射点最强点距离地面的高度 ";
CM_ SG_ 549 FR_Obj30_MotionStatusConf " ";
CM_ SG_ 549 FR_Obj30_MotionStatus " ";
CM_ SG_ 549 FR_Obj30_Measured " ";
CM_ SG_ 549 FR_Obj30_valid " ";
CM_ SG_ 549 FR_Obj30_Track_Age " ";
CM_ SG_ 549 FR_Obj30_Track_ID " ";
CM_ SG_ 549 FR_Obj30_ObstacleProb " ";
CM_ SG_ 549 FR_Obj30_ExistProb " ";
CM_ SG_ 549 FR_Obj30_RelAx " ";
CM_ SG_ 549 FR_Obj30_RelAy " ";
CM_ SG_ 549 FR_Obj30_RelVx_std " ";
CM_ SG_ 549 FR_Obj30_RelVx " ";
CM_ SG_ 549 FR_Obj30_RelVy_std " ";
CM_ SG_ 549 FR_Obj30_RelVy " ";
CM_ SG_ 549 FR_Obj30_Dx_Vnce " ";
CM_ SG_ 549 FR_Obj30_Dx " ";
CM_ SG_ 549 FR_Obj30_Dy_Vnce " ";
CM_ SG_ 549 FR_Obj30_Dy " ";
CM_ SG_ 549 FR_Obj30_HeadingAngle " ";
CM_ SG_ 549 FR_Obj30_Length " ";
CM_ SG_ 549 FR_Obj30_Height " ";
CM_ SG_ 549 FR_Obj30_Width " ";
CM_ SG_ 549 FR_Obj30_TypeProb " ";
CM_ SG_ 549 FR_Obj30_Type " ";
CM_ BO_ 550 " ";
CM_ SG_ 550 FR_CRCCheck_226 " ";
CM_ SG_ 550 FR_RollingCounter_226 " ";
CM_ SG_ 550 FR_Obj31_Ax " ";
CM_ SG_ 550 FR_Obj31_Ay " ";
CM_ SG_ 550 FR_Obj31_Vx " ";
CM_ SG_ 550 FR_Obj31_Vy " ";
CM_ SG_ 550 FR_Obj31_DelayTime " ";
CM_ SG_ 550 FR_Obj31_ReferPoint_Dx " ";
CM_ SG_ 550 FR_Obj31_HeightGround "反射点最强点距离地面的高度 ";
CM_ SG_ 550 FR_Obj31_MotionStatusConf " ";
CM_ SG_ 550 FR_Obj31_MotionStatus " ";
CM_ SG_ 550 FR_Obj31_Measured " ";
CM_ SG_ 550 FR_Obj31_valid " ";
CM_ SG_ 550 FR_Obj31_Track_Age " ";
CM_ SG_ 550 FR_Obj31_Track_ID " ";
CM_ SG_ 550 FR_Obj31_ObstacleProb " ";
CM_ SG_ 550 FR_Obj31_ExistProb " ";
CM_ SG_ 550 FR_Obj31_RelAx " ";
CM_ SG_ 550 FR_Obj31_RelAy " ";
CM_ SG_ 550 FR_Obj31_RelVx_std " ";
CM_ SG_ 550 FR_Obj31_RelVx " ";
CM_ SG_ 550 FR_Obj31_RelVy_std " ";
CM_ SG_ 550 FR_Obj31_RelVy " ";
CM_ SG_ 550 FR_Obj31_Dx_Vnce " ";
CM_ SG_ 550 FR_Obj31_Dx " ";
CM_ SG_ 550 FR_Obj31_Dy_Vnce " ";
CM_ SG_ 550 FR_Obj31_Dy " ";
CM_ SG_ 550 FR_Obj31_HeadingAngle " ";
CM_ SG_ 550 FR_Obj31_Length " ";
CM_ SG_ 550 FR_Obj31_Height " ";
CM_ SG_ 550 FR_Obj31_Width " ";
CM_ SG_ 550 FR_Obj31_TypeProb " ";
CM_ SG_ 550 FR_Obj31_Type " ";
CM_ BO_ 551 " ";
CM_ SG_ 551 FR_CRCCheck_227 " ";
CM_ SG_ 551 FR_RollingCounter_227 " ";
CM_ SG_ 551 FR_Obj32_Ax " ";
CM_ SG_ 551 FR_Obj32_Ay " ";
CM_ SG_ 551 FR_Obj32_Vx " ";
CM_ SG_ 551 FR_Obj32_Vy " ";
CM_ SG_ 551 FR_Obj32_DelayTime " ";
CM_ SG_ 551 FR_Obj32_ReferPoint_Dx " ";
CM_ SG_ 551 FR_Obj32_HeightGround "反射点最强点距离地面的高度 ";
CM_ SG_ 551 FR_Obj32_MotionStatusConf " ";
CM_ SG_ 551 FR_Obj32_MotionStatus " ";
CM_ SG_ 551 FR_Obj32_Measured " ";
CM_ SG_ 551 FR_Obj32_valid " ";
CM_ SG_ 551 FR_Obj32_Track_Age " ";
CM_ SG_ 551 FR_Obj32_Track_ID " ";
CM_ SG_ 551 FR_Obj32_ObstacleProb " ";
CM_ SG_ 551 FR_Obj32_ExistProb " ";
CM_ SG_ 551 FR_Obj32_RelAx " ";
CM_ SG_ 551 FR_Obj32_RelAy " ";
CM_ SG_ 551 FR_Obj32_RelVx_std " ";
CM_ SG_ 551 FR_Obj32_RelVx " ";
CM_ SG_ 551 FR_Obj32_RelVy_std " ";
CM_ SG_ 551 FR_Obj32_RelVy " ";
CM_ SG_ 551 FR_Obj32_Dx_Vnce " ";
CM_ SG_ 551 FR_Obj32_Dx " ";
CM_ SG_ 551 FR_Obj32_Dy_Vnce " ";
CM_ SG_ 551 FR_Obj32_Dy " ";
CM_ SG_ 551 FR_Obj32_HeadingAngle " ";
CM_ SG_ 551 FR_Obj32_Length " ";
CM_ SG_ 551 FR_Obj32_Height " ";
CM_ SG_ 551 FR_Obj32_Width " ";
CM_ SG_ 551 FR_Obj32_TypeProb " ";
CM_ SG_ 551 FR_Obj32_Type " ";
CM_ BO_ 552 " ";
CM_ SG_ 552 FR_CRCCheck_228 " ";
CM_ SG_ 552 FR_RollingCounter_228 " ";
CM_ SG_ 552 FR_FreespaceSectorKinestate34 " ";
CM_ SG_ 552 FR_FreespaceSectorConRidence34 " ";
CM_ SG_ 552 FR_FreespaceSectorDistance34 " ";
CM_ SG_ 552 FR_FreespaceSectorKinestate33 " ";
CM_ SG_ 552 FR_FreespaceSectorConRidence33 " ";
CM_ SG_ 552 FR_FreespaceSectorDistance33 " ";
CM_ SG_ 552 FR_FreespaceSectorKinestate32 " ";
CM_ SG_ 552 FR_FreespaceSectorConRidence32 " ";
CM_ SG_ 552 FR_FreespaceSectorDistance32 " ";
CM_ SG_ 552 FR_FreespaceSectorKinestate31 " ";
CM_ SG_ 552 FR_FreespaceSectorConRidence31 " ";
CM_ SG_ 552 FR_FreespaceSectorDistance31 " ";
CM_ SG_ 552 FR_FreespaceSectorKinestate30 " ";
CM_ SG_ 552 FR_FreespaceSectorConRidence30 " ";
CM_ SG_ 552 FR_FreespaceSectorDistance30 " ";
CM_ SG_ 552 FR_FreespaceSectorKinestate29 " ";
CM_ SG_ 552 FR_FreespaceSectorConRidence29 " ";
CM_ SG_ 552 FR_FreespaceSectorDistance29 " ";
CM_ SG_ 552 FR_FreespaceSectorKinestate28 " ";
CM_ SG_ 552 FR_FreespaceSectorConRidence28 " ";
CM_ SG_ 552 FR_FreespaceSectorDistance28 " ";
CM_ SG_ 552 FR_FreespaceSectorKinestate27 " ";
CM_ SG_ 552 FR_FreespaceSectorConRidence27 " ";
CM_ SG_ 552 FR_FreespaceSectorDistance27 " ";
CM_ SG_ 552 FR_FreespaceSectorKinestate26 " ";
CM_ SG_ 552 FR_FreespaceSectorConRidence26 " ";
CM_ SG_ 552 FR_FreespaceSectorDistance26 " ";
CM_ SG_ 552 FR_FreespaceSectorKinestate25 " ";
CM_ SG_ 552 FR_FreespaceSectorConRidence25 " ";
CM_ SG_ 552 FR_FreespaceSectorDistance25 " ";
CM_ SG_ 552 FR_FreespaceSectorKinestate24 " ";
CM_ SG_ 552 FR_FreespaceSectorConRidence24 " ";
CM_ SG_ 552 FR_FreespaceSectorDistance24 " ";
CM_ SG_ 552 FR_FreespaceSectorKinestate23 " ";
CM_ SG_ 552 FR_FreespaceSectorConRidence23 " ";
CM_ SG_ 552 FR_FreespaceSectorDistance23 " ";
CM_ SG_ 552 FR_FreespaceSectorKinestate22 " ";
CM_ SG_ 552 FR_FreespaceSectorConRidence22 " ";
CM_ SG_ 552 FR_FreespaceSectorDistance22 " ";
CM_ SG_ 552 FR_FreespaceSectorKinestate21 " ";
CM_ SG_ 552 FR_FreespaceSectorConRidence21 " ";
CM_ SG_ 552 FR_FreespaceSectorDistance21 " ";
CM_ SG_ 552 FR_FreespaceSectorKinestate20 " ";
CM_ SG_ 552 FR_FreespaceSectorConRidence20 " ";
CM_ SG_ 552 FR_FreespaceSectorDistance20 " ";
CM_ SG_ 552 FR_FreespaceSectorKinestate19 " ";
CM_ SG_ 552 FR_FreespaceSectorConRidence19 " ";
CM_ SG_ 552 FR_FreespaceSectorDistance19 " ";
CM_ SG_ 552 FR_FreespaceSectorKinestate18 " ";
CM_ SG_ 552 FR_FreespaceSectorConRidence18 " ";
CM_ SG_ 552 FR_FreespaceSectorDistance18 " ";
CM_ SG_ 552 FR_FreespaceSectorKinestate17 " ";
CM_ SG_ 552 FR_FreespaceSectorConRidence17 " ";
CM_ SG_ 552 FR_FreespaceSectorDistance17 " ";
CM_ SG_ 552 FR_FreespaceSectorKinestate16 " ";
CM_ SG_ 552 FR_FreespaceSectorConRidence16 " ";
CM_ SG_ 552 FR_FreespaceSectorDistance16 " ";
CM_ SG_ 552 FR_FreespaceSectorKinestate15 " ";
CM_ SG_ 552 FR_FreespaceSectorConRidence15 " ";
CM_ SG_ 552 FR_FreespaceSectorDistance15 " ";
CM_ SG_ 552 FR_FreespaceSectorKinestate14 " ";
CM_ SG_ 552 FR_FreespaceSectorConRidence14 " ";
CM_ SG_ 552 FR_FreespaceSectorDistance14 " ";
CM_ SG_ 552 FR_FreespaceSectorKinestate13 " ";
CM_ SG_ 552 FR_FreespaceSectorConRidence13 " ";
CM_ SG_ 552 FR_FreespaceSectorDistance13 " ";
CM_ SG_ 552 FR_FreespaceSectorKinestate12 " ";
CM_ SG_ 552 FR_FreespaceSectorConRidence12 " ";
CM_ SG_ 552 FR_FreespaceSectorDistance12 " ";
CM_ SG_ 552 FR_FreespaceSectorKinestate11 " ";
CM_ SG_ 552 FR_FreespaceSectorConRidence11 " ";
CM_ SG_ 552 FR_FreespaceSectorDistance11 " ";
CM_ SG_ 552 FR_FreespaceSectorKinestate10 " ";
CM_ SG_ 552 FR_FreespaceSectorConRidence10 " ";
CM_ SG_ 552 FR_FreespaceSectorDistance10 " ";
CM_ SG_ 552 FR_FreespaceSectorKinestate9 " ";
CM_ SG_ 552 FR_FreespaceSectorConRidence9 " ";
CM_ SG_ 552 FR_FreespaceSectorDistance9 " ";
CM_ SG_ 552 FR_FreespaceSectorKinestate8 " ";
CM_ SG_ 552 FR_FreespaceSectorConRidence8 " ";
CM_ SG_ 552 FR_FreespaceSectorDistance8 " ";
CM_ SG_ 552 FR_FreespaceSectorKinestate7 " ";
CM_ SG_ 552 FR_FreespaceSectorConRidence7 " ";
CM_ SG_ 552 FR_FreespaceSectorDistance7 " ";
CM_ SG_ 552 FR_FreespaceSectorKinestate6 " ";
CM_ SG_ 552 FR_FreespaceSectorConRidence6 " ";
CM_ SG_ 552 FR_FreespaceSectorDistance6 " ";
CM_ SG_ 552 FR_FreespaceSectorKinestate5 " ";
CM_ SG_ 552 FR_FreespaceSectorConRidence5 " ";
CM_ SG_ 552 FR_FreespaceSectorDistance5 " ";
CM_ SG_ 552 FR_FreespaceSectorKinestate4 " ";
CM_ SG_ 552 FR_FreespaceSectorConRidence4 " ";
CM_ SG_ 552 FR_FreespaceSectorDistance4 " ";
CM_ SG_ 552 FR_FreespaceSectorKinestate3 " ";
CM_ SG_ 552 FR_FreespaceSectorConRidence3 " ";
CM_ SG_ 552 FR_FreespaceSectorDistance3 " ";
CM_ SG_ 552 FR_FreespaceSectorKinestate2 " ";
CM_ SG_ 552 FR_FreespaceSectorConRidence2 " ";
CM_ SG_ 552 FR_FreespaceSectorDistance2 " ";
CM_ SG_ 552 FR_FreespaceSectorKinestate1 " ";
CM_ SG_ 552 FR_FreespaceSectorConRidence1 " ";
CM_ SG_ 552 FR_FreespaceSectorDistance1 " ";
CM_ BO_ 553 " ";
CM_ SG_ 553 FR_CRCCheck_229 " ";
CM_ SG_ 553 FR_RollingCounter_229 " ";
CM_ SG_ 553 FR_FreespaceSectorKinestate68 " ";
CM_ SG_ 553 FR_FreespaceSectorConRidence68 " ";
CM_ SG_ 553 FR_FreespaceSectorDistance68 " ";
CM_ SG_ 553 FR_FreespaceSectorKinestate67 " ";
CM_ SG_ 553 FR_FreespaceSectorConRidence67 " ";
CM_ SG_ 553 FR_FreespaceSectorDistance67 " ";
CM_ SG_ 553 FR_FreespaceSectorKinestate66 " ";
CM_ SG_ 553 FR_FreespaceSectorConRidence66 " ";
CM_ SG_ 553 FR_FreespaceSectorDistance66 " ";
CM_ SG_ 553 FR_FreespaceSectorKinestate65 " ";
CM_ SG_ 553 FR_FreespaceSectorConRidence65 " ";
CM_ SG_ 553 FR_FreespaceSectorDistance65 " ";
CM_ SG_ 553 FR_FreespaceSectorKinestate64 " ";
CM_ SG_ 553 FR_FreespaceSectorConRidence64 " ";
CM_ SG_ 553 FR_FreespaceSectorDistance64 " ";
CM_ SG_ 553 FR_FreespaceSectorKinestate63 " ";
CM_ SG_ 553 FR_FreespaceSectorConRidence63 " ";
CM_ SG_ 553 FR_FreespaceSectorDistance63 " ";
CM_ SG_ 553 FR_FreespaceSectorKinestate62 " ";
CM_ SG_ 553 FR_FreespaceSectorConRidence62 " ";
CM_ SG_ 553 FR_FreespaceSectorDistance62 " ";
CM_ SG_ 553 FR_FreespaceSectorKinestate61 " ";
CM_ SG_ 553 FR_FreespaceSectorConRidence61 " ";
CM_ SG_ 553 FR_FreespaceSectorDistance61 " ";
CM_ SG_ 553 FR_FreespaceSectorKinestate60 " ";
CM_ SG_ 553 FR_FreespaceSectorConRidence60 " ";
CM_ SG_ 553 FR_FreespaceSectorDistance60 " ";
CM_ SG_ 553 FR_FreespaceSectorKinestate59 " ";
CM_ SG_ 553 FR_FreespaceSectorConRidence59 " ";
CM_ SG_ 553 FR_FreespaceSectorDistance59 " ";
CM_ SG_ 553 FR_FreespaceSectorKinestate58 " ";
CM_ SG_ 553 FR_FreespaceSectorConRidence58 " ";
CM_ SG_ 553 FR_FreespaceSectorDistance58 " ";
CM_ SG_ 553 FR_FreespaceSectorKinestate57 " ";
CM_ SG_ 553 FR_FreespaceSectorConRidence57 " ";
CM_ SG_ 553 FR_FreespaceSectorDistance57 " ";
CM_ SG_ 553 FR_FreespaceSectorKinestate56 " ";
CM_ SG_ 553 FR_FreespaceSectorConRidence56 " ";
CM_ SG_ 553 FR_FreespaceSectorDistance56 " ";
CM_ SG_ 553 FR_FreespaceSectorKinestate55 " ";
CM_ SG_ 553 FR_FreespaceSectorConRidence55 " ";
CM_ SG_ 553 FR_FreespaceSectorDistance55 " ";
CM_ SG_ 553 FR_FreespaceSectorKinestate54 " ";
CM_ SG_ 553 FR_FreespaceSectorConRidence54 " ";
CM_ SG_ 553 FR_FreespaceSectorDistance54 " ";
CM_ SG_ 553 FR_FreespaceSectorKinestate53 " ";
CM_ SG_ 553 FR_FreespaceSectorConRidence53 " ";
CM_ SG_ 553 FR_FreespaceSectorDistance53 " ";
CM_ SG_ 553 FR_FreespaceSectorKinestate52 " ";
CM_ SG_ 553 FR_FreespaceSectorConRidence52 " ";
CM_ SG_ 553 FR_FreespaceSectorDistance52 " ";
CM_ SG_ 553 FR_FreespaceSectorKinestate51 " ";
CM_ SG_ 553 FR_FreespaceSectorConRidence51 " ";
CM_ SG_ 553 FR_FreespaceSectorDistance51 " ";
CM_ SG_ 553 FR_FreespaceSectorKinestate50 " ";
CM_ SG_ 553 FR_FreespaceSectorConRidence50 " ";
CM_ SG_ 553 FR_FreespaceSectorDistance50 " ";
CM_ SG_ 553 FR_FreespaceSectorKinestate49 " ";
CM_ SG_ 553 FR_FreespaceSectorConRidence49 " ";
CM_ SG_ 553 FR_FreespaceSectorDistance49 " ";
CM_ SG_ 553 FR_FreespaceSectorKinestate48 " ";
CM_ SG_ 553 FR_FreespaceSectorConRidence48 " ";
CM_ SG_ 553 FR_FreespaceSectorDistance48 " ";
CM_ SG_ 553 FR_FreespaceSectorKinestate47 " ";
CM_ SG_ 553 FR_FreespaceSectorConRidence47 " ";
CM_ SG_ 553 FR_FreespaceSectorDistance47 " ";
CM_ SG_ 553 FR_FreespaceSectorKinestate46 " ";
CM_ SG_ 553 FR_FreespaceSectorConRidence46 " ";
CM_ SG_ 553 FR_FreespaceSectorDistance46 " ";
CM_ SG_ 553 FR_FreespaceSectorKinestate45 " ";
CM_ SG_ 553 FR_FreespaceSectorConRidence45 " ";
CM_ SG_ 553 FR_FreespaceSectorDistance45 " ";
CM_ SG_ 553 FR_FreespaceSectorKinestate44 " ";
CM_ SG_ 553 FR_FreespaceSectorConRidence44 " ";
CM_ SG_ 553 FR_FreespaceSectorDistance44 " ";
CM_ SG_ 553 FR_FreespaceSectorKinestate43 " ";
CM_ SG_ 553 FR_FreespaceSectorConRidence43 " ";
CM_ SG_ 553 FR_FreespaceSectorDistance43 " ";
CM_ SG_ 553 FR_FreespaceSectorKinestate42 " ";
CM_ SG_ 553 FR_FreespaceSectorConRidence42 " ";
CM_ SG_ 553 FR_FreespaceSectorDistance42 " ";
CM_ SG_ 553 FR_FreespaceSectorKinestate41 " ";
CM_ SG_ 553 FR_FreespaceSectorConRidence41 " ";
CM_ SG_ 553 FR_FreespaceSectorDistance41 " ";
CM_ SG_ 553 FR_FreespaceSectorKinestate40 " ";
CM_ SG_ 553 FR_FreespaceSectorConRidence40 " ";
CM_ SG_ 553 FR_FreespaceSectorDistance40 " ";
CM_ SG_ 553 FR_FreespaceSectorKinestate39 " ";
CM_ SG_ 553 FR_FreespaceSectorConRidence39 " ";
CM_ SG_ 553 FR_FreespaceSectorDistance39 " ";
CM_ SG_ 553 FR_FreespaceSectorKinestate38 " ";
CM_ SG_ 553 FR_FreespaceSectorConRidence38 " ";
CM_ SG_ 553 FR_FreespaceSectorDistance38 " ";
CM_ SG_ 553 FR_FreespaceSectorKinestate37 " ";
CM_ SG_ 553 FR_FreespaceSectorConRidence37 " ";
CM_ SG_ 553 FR_FreespaceSectorDistance37 " ";
CM_ SG_ 553 FR_FreespaceSectorKinestate36 " ";
CM_ SG_ 553 FR_FreespaceSectorConRidence36 " ";
CM_ SG_ 553 FR_FreespaceSectorDistance36 " ";
CM_ SG_ 553 FR_FreespaceSectorKinestate35 " ";
CM_ SG_ 553 FR_FreespaceSectorConRidence35 " ";
CM_ SG_ 553 FR_FreespaceSectorDistance35 " ";
CM_ BO_ 554 " ";
CM_ SG_ 554 FR_CRCCheck_22A " ";
CM_ SG_ 554 FR_RollingCounter_22A " ";
CM_ SG_ 554 FR_FreespaceSectorKinestate102 " ";
CM_ SG_ 554 FR_FreespaceSectorConRidence102 " ";
CM_ SG_ 554 FR_FreespaceSectorDistance102 " ";
CM_ SG_ 554 FR_FreespaceSectorKinestate101 " ";
CM_ SG_ 554 FR_FreespaceSectorConRidence101 " ";
CM_ SG_ 554 FR_FreespaceSectorDistance101 " ";
CM_ SG_ 554 FR_FreespaceSectorKinestate100 " ";
CM_ SG_ 554 FR_FreespaceSectorConRidence100 " ";
CM_ SG_ 554 FR_FreespaceSectorDistance100 " ";
CM_ SG_ 554 FR_FreespaceSectorKinestate99 " ";
CM_ SG_ 554 FR_FreespaceSectorConRidence99 " ";
CM_ SG_ 554 FR_FreespaceSectorDistance99 " ";
CM_ SG_ 554 FR_FreespaceSectorKinestate98 " ";
CM_ SG_ 554 FR_FreespaceSectorConRidence98 " ";
CM_ SG_ 554 FR_FreespaceSectorDistance98 " ";
CM_ SG_ 554 FR_FreespaceSectorKinestate97 " ";
CM_ SG_ 554 FR_FreespaceSectorConRidence97 " ";
CM_ SG_ 554 FR_FreespaceSectorDistance97 " ";
CM_ SG_ 554 FR_FreespaceSectorKinestate96 " ";
CM_ SG_ 554 FR_FreespaceSectorConRidence96 " ";
CM_ SG_ 554 FR_FreespaceSectorDistance96 " ";
CM_ SG_ 554 FR_FreespaceSectorKinestate95 " ";
CM_ SG_ 554 FR_FreespaceSectorConRidence95 " ";
CM_ SG_ 554 FR_FreespaceSectorDistance95 " ";
CM_ SG_ 554 FR_FreespaceSectorKinestate94 " ";
CM_ SG_ 554 FR_FreespaceSectorConRidence94 " ";
CM_ SG_ 554 FR_FreespaceSectorDistance94 " ";
CM_ SG_ 554 FR_FreespaceSectorKinestate93 " ";
CM_ SG_ 554 FR_FreespaceSectorConRidence93 " ";
CM_ SG_ 554 FR_FreespaceSectorDistance93 " ";
CM_ SG_ 554 FR_FreespaceSectorKinestate92 " ";
CM_ SG_ 554 FR_FreespaceSectorConRidence92 " ";
CM_ SG_ 554 FR_FreespaceSectorDistance92 " ";
CM_ SG_ 554 FR_FreespaceSectorKinestate91 " ";
CM_ SG_ 554 FR_FreespaceSectorConRidence91 " ";
CM_ SG_ 554 FR_FreespaceSectorDistance91 " ";
CM_ SG_ 554 FR_FreespaceSectorKinestate90 " ";
CM_ SG_ 554 FR_FreespaceSectorConRidence90 " ";
CM_ SG_ 554 FR_FreespaceSectorDistance90 " ";
CM_ SG_ 554 FR_FreespaceSectorKinestate89 " ";
CM_ SG_ 554 FR_FreespaceSectorConRidence89 " ";
CM_ SG_ 554 FR_FreespaceSectorDistance89 " ";
CM_ SG_ 554 FR_FreespaceSectorKinestate88 " ";
CM_ SG_ 554 FR_FreespaceSectorConRidence88 " ";
CM_ SG_ 554 FR_FreespaceSectorDistance88 " ";
CM_ SG_ 554 FR_FreespaceSectorKinestate87 " ";
CM_ SG_ 554 FR_FreespaceSectorConRidence87 " ";
CM_ SG_ 554 FR_FreespaceSectorDistance87 " ";
CM_ SG_ 554 FR_FreespaceSectorKinestate86 " ";
CM_ SG_ 554 FR_FreespaceSectorConRidence86 " ";
CM_ SG_ 554 FR_FreespaceSectorDistance86 " ";
CM_ SG_ 554 FR_FreespaceSectorKinestate85 " ";
CM_ SG_ 554 FR_FreespaceSectorConRidence85 " ";
CM_ SG_ 554 FR_FreespaceSectorDistance85 " ";
CM_ SG_ 554 FR_FreespaceSectorKinestate84 " ";
CM_ SG_ 554 FR_FreespaceSectorConRidence84 " ";
CM_ SG_ 554 FR_FreespaceSectorDistance84 " ";
CM_ SG_ 554 FR_FreespaceSectorKinestate83 " ";
CM_ SG_ 554 FR_FreespaceSectorConRidence83 " ";
CM_ SG_ 554 FR_FreespaceSectorDistance83 " ";
CM_ SG_ 554 FR_FreespaceSectorKinestate82 " ";
CM_ SG_ 554 FR_FreespaceSectorConRidence82 " ";
CM_ SG_ 554 FR_FreespaceSectorDistance82 " ";
CM_ SG_ 554 FR_FreespaceSectorKinestate81 " ";
CM_ SG_ 554 FR_FreespaceSectorConRidence81 " ";
CM_ SG_ 554 FR_FreespaceSectorDistance81 " ";
CM_ SG_ 554 FR_FreespaceSectorKinestate80 " ";
CM_ SG_ 554 FR_FreespaceSectorConRidence80 " ";
CM_ SG_ 554 FR_FreespaceSectorDistance80 " ";
CM_ SG_ 554 FR_FreespaceSectorKinestate79 " ";
CM_ SG_ 554 FR_FreespaceSectorConRidence79 " ";
CM_ SG_ 554 FR_FreespaceSectorDistance79 " ";
CM_ SG_ 554 FR_FreespaceSectorKinestate78 " ";
CM_ SG_ 554 FR_FreespaceSectorConRidence78 " ";
CM_ SG_ 554 FR_FreespaceSectorDistance78 " ";
CM_ SG_ 554 FR_FreespaceSectorKinestate77 " ";
CM_ SG_ 554 FR_FreespaceSectorConRidence77 " ";
CM_ SG_ 554 FR_FreespaceSectorDistance77 " ";
CM_ SG_ 554 FR_FreespaceSectorKinestate76 " ";
CM_ SG_ 554 FR_FreespaceSectorConRidence76 " ";
CM_ SG_ 554 FR_FreespaceSectorDistance76 " ";
CM_ SG_ 554 FR_FreespaceSectorKinestate75 " ";
CM_ SG_ 554 FR_FreespaceSectorConRidence75 " ";
CM_ SG_ 554 FR_FreespaceSectorDistance75 " ";
CM_ SG_ 554 FR_FreespaceSectorKinestate74 " ";
CM_ SG_ 554 FR_FreespaceSectorConRidence74 " ";
CM_ SG_ 554 FR_FreespaceSectorDistance74 " ";
CM_ SG_ 554 FR_FreespaceSectorKinestate73 " ";
CM_ SG_ 554 FR_FreespaceSectorConRidence73 " ";
CM_ SG_ 554 FR_FreespaceSectorDistance73 " ";
CM_ SG_ 554 FR_FreespaceSectorKinestate72 " ";
CM_ SG_ 554 FR_FreespaceSectorConRidence72 " ";
CM_ SG_ 554 FR_FreespaceSectorDistance72 " ";
CM_ SG_ 554 FR_FreespaceSectorKinestate71 " ";
CM_ SG_ 554 FR_FreespaceSectorConRidence71 " ";
CM_ SG_ 554 FR_FreespaceSectorDistance71 " ";
CM_ SG_ 554 FR_FreespaceSectorKinestate70 " ";
CM_ SG_ 554 FR_FreespaceSectorConRidence70 " ";
CM_ SG_ 554 FR_FreespaceSectorDistance70 " ";
CM_ SG_ 554 FR_FreespaceSectorKinestate69 " ";
CM_ SG_ 554 FR_FreespaceSectorConRidence69 " ";
CM_ SG_ 554 FR_FreespaceSectorDistance69 " ";
CM_ BO_ 555 " ";
CM_ SG_ 555 FR_CRCCheck_22B " ";
CM_ SG_ 555 FR_RollingCounter_22B " ";
CM_ SG_ 555 FR_FreespaceSectorKinestate136 " ";
CM_ SG_ 555 FR_FreespaceSectorConRidence136 " ";
CM_ SG_ 555 FR_FreespaceSectorDistance136 " ";
CM_ SG_ 555 FR_FreespaceSectorKinestate135 " ";
CM_ SG_ 555 FR_FreespaceSectorConRidence135 " ";
CM_ SG_ 555 FR_FreespaceSectorDistance135 " ";
CM_ SG_ 555 FR_FreespaceSectorKinestate134 " ";
CM_ SG_ 555 FR_FreespaceSectorConRidence134 " ";
CM_ SG_ 555 FR_FreespaceSectorDistance134 " ";
CM_ SG_ 555 FR_FreespaceSectorKinestate133 " ";
CM_ SG_ 555 FR_FreespaceSectorConRidence133 " ";
CM_ SG_ 555 FR_FreespaceSectorDistance133 " ";
CM_ SG_ 555 FR_FreespaceSectorKinestate132 " ";
CM_ SG_ 555 FR_FreespaceSectorConRidence132 " ";
CM_ SG_ 555 FR_FreespaceSectorDistance132 " ";
CM_ SG_ 555 FR_FreespaceSectorKinestate131 " ";
CM_ SG_ 555 FR_FreespaceSectorConRidence131 " ";
CM_ SG_ 555 FR_FreespaceSectorDistance131 " ";
CM_ SG_ 555 FR_FreespaceSectorKinestate130 " ";
CM_ SG_ 555 FR_FreespaceSectorConRidence130 " ";
CM_ SG_ 555 FR_FreespaceSectorDistance130 " ";
CM_ SG_ 555 FR_FreespaceSectorKinestate129 " ";
CM_ SG_ 555 FR_FreespaceSectorConRidence129 " ";
CM_ SG_ 555 FR_FreespaceSectorDistance129 " ";
CM_ SG_ 555 FR_FreespaceSectorKinestate128 " ";
CM_ SG_ 555 FR_FreespaceSectorConRidence128 " ";
CM_ SG_ 555 FR_FreespaceSectorDistance128 " ";
CM_ SG_ 555 FR_FreespaceSectorKinestate127 " ";
CM_ SG_ 555 FR_FreespaceSectorConRidence127 " ";
CM_ SG_ 555 FR_FreespaceSectorDistance127 " ";
CM_ SG_ 555 FR_FreespaceSectorKinestate126 " ";
CM_ SG_ 555 FR_FreespaceSectorConRidence126 " ";
CM_ SG_ 555 FR_FreespaceSectorDistance126 " ";
CM_ SG_ 555 FR_FreespaceSectorKinestate125 " ";
CM_ SG_ 555 FR_FreespaceSectorConRidence125 " ";
CM_ SG_ 555 FR_FreespaceSectorDistance125 " ";
CM_ SG_ 555 FR_FreespaceSectorKinestate124 " ";
CM_ SG_ 555 FR_FreespaceSectorConRidence124 " ";
CM_ SG_ 555 FR_FreespaceSectorDistance124 " ";
CM_ SG_ 555 FR_FreespaceSectorKinestate123 " ";
CM_ SG_ 555 FR_FreespaceSectorConRidence123 " ";
CM_ SG_ 555 FR_FreespaceSectorDistance123 " ";
CM_ SG_ 555 FR_FreespaceSectorKinestate122 " ";
CM_ SG_ 555 FR_FreespaceSectorConRidence122 " ";
CM_ SG_ 555 FR_FreespaceSectorDistance122 " ";
CM_ SG_ 555 FR_FreespaceSectorKinestate121 " ";
CM_ SG_ 555 FR_FreespaceSectorConRidence121 " ";
CM_ SG_ 555 FR_FreespaceSectorDistance121 " ";
CM_ SG_ 555 FR_FreespaceSectorKinestate120 " ";
CM_ SG_ 555 FR_FreespaceSectorConRidence120 " ";
CM_ SG_ 555 FR_FreespaceSectorDistance120 " ";
CM_ SG_ 555 FR_FreespaceSectorKinestate119 " ";
CM_ SG_ 555 FR_FreespaceSectorConRidence119 " ";
CM_ SG_ 555 FR_FreespaceSectorDistance119 " ";
CM_ SG_ 555 FR_FreespaceSectorKinestate118 " ";
CM_ SG_ 555 FR_FreespaceSectorConRidence118 " ";
CM_ SG_ 555 FR_FreespaceSectorDistance118 " ";
CM_ SG_ 555 FR_FreespaceSectorKinestate117 " ";
CM_ SG_ 555 FR_FreespaceSectorConRidence117 " ";
CM_ SG_ 555 FR_FreespaceSectorDistance117 " ";
CM_ SG_ 555 FR_FreespaceSectorKinestate116 " ";
CM_ SG_ 555 FR_FreespaceSectorConRidence116 " ";
CM_ SG_ 555 FR_FreespaceSectorDistance116 " ";
CM_ SG_ 555 FR_FreespaceSectorKinestate115 " ";
CM_ SG_ 555 FR_FreespaceSectorConRidence115 " ";
CM_ SG_ 555 FR_FreespaceSectorDistance115 " ";
CM_ SG_ 555 FR_FreespaceSectorKinestate114 " ";
CM_ SG_ 555 FR_FreespaceSectorConRidence114 " ";
CM_ SG_ 555 FR_FreespaceSectorDistance114 " ";
CM_ SG_ 555 FR_FreespaceSectorKinestate113 " ";
CM_ SG_ 555 FR_FreespaceSectorConRidence113 " ";
CM_ SG_ 555 FR_FreespaceSectorDistance113 " ";
CM_ SG_ 555 FR_FreespaceSectorKinestate112 " ";
CM_ SG_ 555 FR_FreespaceSectorConRidence112 " ";
CM_ SG_ 555 FR_FreespaceSectorDistance112 " ";
CM_ SG_ 555 FR_FreespaceSectorKinestate111 " ";
CM_ SG_ 555 FR_FreespaceSectorConRidence111 " ";
CM_ SG_ 555 FR_FreespaceSectorDistance111 " ";
CM_ SG_ 555 FR_FreespaceSectorKinestate110 " ";
CM_ SG_ 555 FR_FreespaceSectorConRidence110 " ";
CM_ SG_ 555 FR_FreespaceSectorDistance110 " ";
CM_ SG_ 555 FR_FreespaceSectorKinestate109 " ";
CM_ SG_ 555 FR_FreespaceSectorConRidence109 " ";
CM_ SG_ 555 FR_FreespaceSectorDistance109 " ";
CM_ SG_ 555 FR_FreespaceSectorKinestate108 " ";
CM_ SG_ 555 FR_FreespaceSectorConRidence108 " ";
CM_ SG_ 555 FR_FreespaceSectorDistance108 " ";
CM_ SG_ 555 FR_FreespaceSectorKinestate107 " ";
CM_ SG_ 555 FR_FreespaceSectorConRidence107 " ";
CM_ SG_ 555 FR_FreespaceSectorDistance107 " ";
CM_ SG_ 555 FR_FreespaceSectorKinestate106 " ";
CM_ SG_ 555 FR_FreespaceSectorConRidence106 " ";
CM_ SG_ 555 FR_FreespaceSectorDistance106 " ";
CM_ SG_ 555 FR_FreespaceSectorKinestate105 " ";
CM_ SG_ 555 FR_FreespaceSectorConRidence105 " ";
CM_ SG_ 555 FR_FreespaceSectorDistance105 " ";
CM_ SG_ 555 FR_FreespaceSectorKinestate104 " ";
CM_ SG_ 555 FR_FreespaceSectorConRidence104 " ";
CM_ SG_ 555 FR_FreespaceSectorDistance104 " ";
CM_ SG_ 555 FR_FreespaceSectorKinestate103 " ";
CM_ SG_ 555 FR_FreespaceSectorConRidence103 " ";
CM_ SG_ 555 FR_FreespaceSectorDistance103 " ";
CM_ BO_ 556 " ";
CM_ SG_ 556 FR_CRCCheck_22C " ";
CM_ SG_ 556 FR_RollingCounter_22C " ";
CM_ SG_ 556 FR_FreespaceSectorKinestate170 " ";
CM_ SG_ 556 FR_FreespaceSectorConRidence170 " ";
CM_ SG_ 556 FR_FreespaceSectorDistance170 " ";
CM_ SG_ 556 FR_FreespaceSectorKinestate169 " ";
CM_ SG_ 556 FR_FreespaceSectorConRidence169 " ";
CM_ SG_ 556 FR_FreespaceSectorDistance169 " ";
CM_ SG_ 556 FR_FreespaceSectorKinestate168 " ";
CM_ SG_ 556 FR_FreespaceSectorConRidence168 " ";
CM_ SG_ 556 FR_FreespaceSectorDistance168 " ";
CM_ SG_ 556 FR_FreespaceSectorKinestate167 " ";
CM_ SG_ 556 FR_FreespaceSectorConRidence167 " ";
CM_ SG_ 556 FR_FreespaceSectorDistance167 " ";
CM_ SG_ 556 FR_FreespaceSectorKinestate166 " ";
CM_ SG_ 556 FR_FreespaceSectorConRidence166 " ";
CM_ SG_ 556 FR_FreespaceSectorDistance166 " ";
CM_ SG_ 556 FR_FreespaceSectorKinestate165 " ";
CM_ SG_ 556 FR_FreespaceSectorConRidence165 " ";
CM_ SG_ 556 FR_FreespaceSectorDistance165 " ";
CM_ SG_ 556 FR_FreespaceSectorKinestate164 " ";
CM_ SG_ 556 FR_FreespaceSectorConRidence164 " ";
CM_ SG_ 556 FR_FreespaceSectorDistance164 " ";
CM_ SG_ 556 FR_FreespaceSectorKinestate163 " ";
CM_ SG_ 556 FR_FreespaceSectorConRidence163 " ";
CM_ SG_ 556 FR_FreespaceSectorDistance163 " ";
CM_ SG_ 556 FR_FreespaceSectorKinestate162 " ";
CM_ SG_ 556 FR_FreespaceSectorConRidence162 " ";
CM_ SG_ 556 FR_FreespaceSectorDistance162 " ";
CM_ SG_ 556 FR_FreespaceSectorKinestate161 " ";
CM_ SG_ 556 FR_FreespaceSectorConRidence161 " ";
CM_ SG_ 556 FR_FreespaceSectorDistance161 " ";
CM_ SG_ 556 FR_FreespaceSectorKinestate160 " ";
CM_ SG_ 556 FR_FreespaceSectorConRidence160 " ";
CM_ SG_ 556 FR_FreespaceSectorDistance160 " ";
CM_ SG_ 556 FR_FreespaceSectorKinestate159 " ";
CM_ SG_ 556 FR_FreespaceSectorConRidence159 " ";
CM_ SG_ 556 FR_FreespaceSectorDistance159 " ";
CM_ SG_ 556 FR_FreespaceSectorKinestate158 " ";
CM_ SG_ 556 FR_FreespaceSectorConRidence158 " ";
CM_ SG_ 556 FR_FreespaceSectorDistance158 " ";
CM_ SG_ 556 FR_FreespaceSectorKinestate157 " ";
CM_ SG_ 556 FR_FreespaceSectorConRidence157 " ";
CM_ SG_ 556 FR_FreespaceSectorDistance157 " ";
CM_ SG_ 556 FR_FreespaceSectorKinestate156 " ";
CM_ SG_ 556 FR_FreespaceSectorConRidence156 " ";
CM_ SG_ 556 FR_FreespaceSectorDistance156 " ";
CM_ SG_ 556 FR_FreespaceSectorKinestate155 " ";
CM_ SG_ 556 FR_FreespaceSectorConRidence155 " ";
CM_ SG_ 556 FR_FreespaceSectorDistance155 " ";
CM_ SG_ 556 FR_FreespaceSectorKinestate154 " ";
CM_ SG_ 556 FR_FreespaceSectorConRidence154 " ";
CM_ SG_ 556 FR_FreespaceSectorDistance154 " ";
CM_ SG_ 556 FR_FreespaceSectorKinestate153 " ";
CM_ SG_ 556 FR_FreespaceSectorConRidence153 " ";
CM_ SG_ 556 FR_FreespaceSectorDistance153 " ";
CM_ SG_ 556 FR_FreespaceSectorKinestate152 " ";
CM_ SG_ 556 FR_FreespaceSectorConRidence152 " ";
CM_ SG_ 556 FR_FreespaceSectorDistance152 " ";
CM_ SG_ 556 FR_FreespaceSectorKinestate151 " ";
CM_ SG_ 556 FR_FreespaceSectorConRidence151 " ";
CM_ SG_ 556 FR_FreespaceSectorDistance151 " ";
CM_ SG_ 556 FR_FreespaceSectorKinestate150 " ";
CM_ SG_ 556 FR_FreespaceSectorConRidence150 " ";
CM_ SG_ 556 FR_FreespaceSectorDistance150 " ";
CM_ SG_ 556 FR_FreespaceSectorKinestate149 " ";
CM_ SG_ 556 FR_FreespaceSectorConRidence149 " ";
CM_ SG_ 556 FR_FreespaceSectorDistance149 " ";
CM_ SG_ 556 FR_FreespaceSectorKinestate148 " ";
CM_ SG_ 556 FR_FreespaceSectorConRidence148 " ";
CM_ SG_ 556 FR_FreespaceSectorDistance148 " ";
CM_ SG_ 556 FR_FreespaceSectorKinestate147 " ";
CM_ SG_ 556 FR_FreespaceSectorConRidence147 " ";
CM_ SG_ 556 FR_FreespaceSectorDistance147 " ";
CM_ SG_ 556 FR_FreespaceSectorKinestate146 " ";
CM_ SG_ 556 FR_FreespaceSectorConRidence146 " ";
CM_ SG_ 556 FR_FreespaceSectorDistance146 " ";
CM_ SG_ 556 FR_FreespaceSectorKinestate145 " ";
CM_ SG_ 556 FR_FreespaceSectorConRidence145 " ";
CM_ SG_ 556 FR_FreespaceSectorDistance145 " ";
CM_ SG_ 556 FR_FreespaceSectorKinestate144 " ";
CM_ SG_ 556 FR_FreespaceSectorConRidence144 " ";
CM_ SG_ 556 FR_FreespaceSectorDistance144 " ";
CM_ SG_ 556 FR_FreespaceSectorKinestate143 " ";
CM_ SG_ 556 FR_FreespaceSectorConRidence143 " ";
CM_ SG_ 556 FR_FreespaceSectorDistance143 " ";
CM_ SG_ 556 FR_FreespaceSectorKinestate142 " ";
CM_ SG_ 556 FR_FreespaceSectorConRidence142 " ";
CM_ SG_ 556 FR_FreespaceSectorDistance142 " ";
CM_ SG_ 556 FR_FreespaceSectorKinestate141 " ";
CM_ SG_ 556 FR_FreespaceSectorConRidence141 " ";
CM_ SG_ 556 FR_FreespaceSectorDistance141 " ";
CM_ SG_ 556 FR_FreespaceSectorKinestate140 " ";
CM_ SG_ 556 FR_FreespaceSectorConRidence140 " ";
CM_ SG_ 556 FR_FreespaceSectorDistance140 " ";
CM_ SG_ 556 FR_FreespaceSectorKinestate139 " ";
CM_ SG_ 556 FR_FreespaceSectorConRidence139 " ";
CM_ SG_ 556 FR_FreespaceSectorDistance139 " ";
CM_ SG_ 556 FR_FreespaceSectorKinestate138 " ";
CM_ SG_ 556 FR_FreespaceSectorConRidence138 " ";
CM_ SG_ 556 FR_FreespaceSectorDistance138 " ";
CM_ SG_ 556 FR_FreespaceSectorKinestate137 " ";
CM_ SG_ 556 FR_FreespaceSectorConRidence137 " ";
CM_ SG_ 556 FR_FreespaceSectorDistance137 " ";
BA_DEF_ SG_  "GenSigStartValue" INT 0 0;
BA_DEF_ SG_  "GenSigInvalidValue" STRING ;
BA_DEF_ SG_  "GenSigCycleTime" INT 0 0;
BA_DEF_ SG_  "GenSigSendType" ENUM  "Cyclic","OnWrite","OnWriteWithRepetition","OnChange","OnChangeWithRepetition","IfActive","IfActiveWithRepetition","NoSigSendType","NotUsed","NotUsed","NotUsed","NotUsed","NotUsed";
BA_DEF_ BO_  "GenMsgSendType" ENUM  "Cyclic","Event","Direct","NotUsed","NotUsed","Cyclic","NotUsed","IfActive","NoMsgSendType","NotUsed";
BA_DEF_ BO_  "GenMsgILSupport" ENUM  "No","Yes";
BA_DEF_ BO_  "GenMsgCycleTime" INT 0 65535;
BA_DEF_ BO_  "CANFD_BRS" ENUM  "0","1";
BA_DEF_ BO_  "VFrameFormat" ENUM  "StandardCAN","ExtendedCAN","reserved","reserved","reserved","reserved","reserved","reserved","reserved","reserved","reserved","reserved","reserved","reserved","StandardCAN_FD","ExtendedCAN_FD";
BA_DEF_DEF_  "GenSigStartValue" 0;
BA_DEF_DEF_  "GenSigInvalidValue" "/";
BA_DEF_DEF_  "GenSigCycleTime" 0;
BA_DEF_DEF_  "GenSigSendType" "Cyclic";
BA_DEF_DEF_  "GenMsgSendType" "NoMsgSendType";
BA_DEF_DEF_  "GenMsgILSupport" "Yes";
BA_DEF_DEF_  "GenMsgCycleTime" 0;
BA_DEF_DEF_  "CANFD_BRS" "1";
BA_DEF_DEF_  "VFrameFormat" "StandardCAN";
BA_ "GenMsgSendType" BO_ 518 0;
BA_ "GenMsgCycleTime" BO_ 518 1000;
BA_ "VFrameFormat" BO_ 518 14;
BA_ "GenMsgSendType" BO_ 544 0;
BA_ "GenMsgCycleTime" BO_ 544 60;
BA_ "VFrameFormat" BO_ 544 14;
BA_ "GenMsgSendType" BO_ 545 0;
BA_ "GenMsgCycleTime" BO_ 545 60;
BA_ "VFrameFormat" BO_ 545 14;
BA_ "GenMsgSendType" BO_ 546 0;
BA_ "GenMsgCycleTime" BO_ 546 60;
BA_ "VFrameFormat" BO_ 546 14;
BA_ "GenMsgSendType" BO_ 547 0;
BA_ "GenMsgCycleTime" BO_ 547 60;
BA_ "VFrameFormat" BO_ 547 14;
BA_ "GenMsgSendType" BO_ 548 0;
BA_ "GenMsgCycleTime" BO_ 548 60;
BA_ "VFrameFormat" BO_ 548 14;
BA_ "GenMsgSendType" BO_ 549 0;
BA_ "GenMsgCycleTime" BO_ 549 60;
BA_ "VFrameFormat" BO_ 549 14;
BA_ "GenMsgSendType" BO_ 550 0;
BA_ "GenMsgCycleTime" BO_ 550 60;
BA_ "VFrameFormat" BO_ 550 14;
BA_ "GenMsgSendType" BO_ 551 0;
BA_ "GenMsgCycleTime" BO_ 551 60;
BA_ "VFrameFormat" BO_ 551 14;
BA_ "GenMsgSendType" BO_ 552 0;
BA_ "GenMsgCycleTime" BO_ 552 60;
BA_ "VFrameFormat" BO_ 552 14;
BA_ "GenMsgSendType" BO_ 553 0;
BA_ "GenMsgCycleTime" BO_ 553 60;
BA_ "VFrameFormat" BO_ 553 14;
BA_ "GenMsgSendType" BO_ 554 0;
BA_ "GenMsgCycleTime" BO_ 554 60;
BA_ "VFrameFormat" BO_ 554 14;
BA_ "GenMsgSendType" BO_ 555 0;
BA_ "GenMsgCycleTime" BO_ 555 60;
BA_ "VFrameFormat" BO_ 555 14;
BA_ "GenMsgSendType" BO_ 556 0;
BA_ "GenMsgCycleTime" BO_ 556 60;
BA_ "VFrameFormat" BO_ 556 14;
BA_ "GenSigInvalidValue" SG_ 518 FR_H_SwVers6 "NA";
BA_ "GenSigCycleTime" SG_ 518 FR_H_SwVers6 1000;
BA_ "GenSigInvalidValue" SG_ 518 FR_H_SwVers5 "NA";
BA_ "GenSigCycleTime" SG_ 518 FR_H_SwVers5 1000;
BA_ "GenSigInvalidValue" SG_ 518 FR_H_SwVers4 "NA";
BA_ "GenSigCycleTime" SG_ 518 FR_H_SwVers4 1000;
BA_ "GenSigInvalidValue" SG_ 518 FR_H_SwVers3 "NA";
BA_ "GenSigCycleTime" SG_ 518 FR_H_SwVers3 1000;
BA_ "GenSigInvalidValue" SG_ 518 FR_H_SwVers2 "NA";
BA_ "GenSigCycleTime" SG_ 518 FR_H_SwVers2 1000;
BA_ "GenSigInvalidValue" SG_ 518 FR_H_SwVers1 "NA";
BA_ "GenSigCycleTime" SG_ 518 FR_H_SwVers1 1000;
BA_ "GenSigInvalidValue" SG_ 518 FR_H_SwVers0 "NA";
BA_ "GenSigCycleTime" SG_ 518 FR_H_SwVers0 1000;
BA_ "GenSigInvalidValue" SG_ 518 FR_H_HwVers6 "NA";
BA_ "GenSigCycleTime" SG_ 518 FR_H_HwVers6 1000;
BA_ "GenSigInvalidValue" SG_ 518 FR_H_HwVers5 "NA";
BA_ "GenSigCycleTime" SG_ 518 FR_H_HwVers5 1000;
BA_ "GenSigInvalidValue" SG_ 518 FR_H_HwVers4 "NA";
BA_ "GenSigCycleTime" SG_ 518 FR_H_HwVers4 1000;
BA_ "GenSigInvalidValue" SG_ 518 FR_H_HwVers3 "NA";
BA_ "GenSigCycleTime" SG_ 518 FR_H_HwVers3 1000;
BA_ "GenSigInvalidValue" SG_ 518 FR_H_HwVers2 "NA";
BA_ "GenSigCycleTime" SG_ 518 FR_H_HwVers2 1000;
BA_ "GenSigInvalidValue" SG_ 518 FR_H_HwVers1 "NA";
BA_ "GenSigCycleTime" SG_ 518 FR_H_HwVers1 1000;
BA_ "GenSigInvalidValue" SG_ 518 FR_H_HwVers0 "NA";
BA_ "GenSigCycleTime" SG_ 518 FR_H_HwVers0 1000;
BA_ "GenSigCycleTime" SG_ 544 FR_CRCCheck_220 60;
BA_ "GenSigCycleTime" SG_ 544 FR_RollingCounter_220 60;
BA_ "GenSigCycleTime" SG_ 544 FR_Obj25_Ax 60;
BA_ "GenSigCycleTime" SG_ 544 FR_Obj25_Ay 60;
BA_ "GenSigCycleTime" SG_ 544 FR_Obj25_Vx 60;
BA_ "GenSigCycleTime" SG_ 544 FR_Obj25_Vy 60;
BA_ "GenSigCycleTime" SG_ 544 FR_Obj25_DelayTime 60;
BA_ "GenSigCycleTime" SG_ 544 FR_Obj25_ReferPoint_Dx 60;
BA_ "GenSigCycleTime" SG_ 544 FR_Obj25_HeightGround 60;
BA_ "GenSigCycleTime" SG_ 544 FR_Obj25_MotionStatusConf 60;
BA_ "GenSigCycleTime" SG_ 544 FR_Obj25_MotionStatus 60;
BA_ "GenSigCycleTime" SG_ 544 FR_Obj25_Measured 60;
BA_ "GenSigCycleTime" SG_ 544 FR_Obj25_valid 60;
BA_ "GenSigCycleTime" SG_ 544 FR_Obj25_Track_Age 60;
BA_ "GenSigCycleTime" SG_ 544 FR_Obj25_Track_ID 60;
BA_ "GenSigCycleTime" SG_ 544 FR_Obj25_ObstacleProb 60;
BA_ "GenSigCycleTime" SG_ 544 FR_Obj25_ExistProb 60;
BA_ "GenSigCycleTime" SG_ 544 FR_Obj25_RelAx 60;
BA_ "GenSigCycleTime" SG_ 544 FR_Obj25_RelAy 60;
BA_ "GenSigInvalidValue" SG_ 544 FR_Obj25_RelVx_std "4095";
BA_ "GenSigCycleTime" SG_ 544 FR_Obj25_RelVx_std 60;
BA_ "GenSigCycleTime" SG_ 544 FR_Obj25_RelVx 60;
BA_ "GenSigInvalidValue" SG_ 544 FR_Obj25_RelVy_std "1023";
BA_ "GenSigCycleTime" SG_ 544 FR_Obj25_RelVy_std 60;
BA_ "GenSigCycleTime" SG_ 544 FR_Obj25_RelVy 60;
BA_ "GenSigInvalidValue" SG_ 544 FR_Obj25_Dx_Vnce "16383";
BA_ "GenSigCycleTime" SG_ 544 FR_Obj25_Dx_Vnce 60;
BA_ "GenSigCycleTime" SG_ 544 FR_Obj25_Dx 60;
BA_ "GenSigInvalidValue" SG_ 544 FR_Obj25_Dy_Vnce "1023";
BA_ "GenSigCycleTime" SG_ 544 FR_Obj25_Dy_Vnce 60;
BA_ "GenSigCycleTime" SG_ 544 FR_Obj25_Dy 60;
BA_ "GenSigCycleTime" SG_ 544 FR_Obj25_HeadingAngle 60;
BA_ "GenSigCycleTime" SG_ 544 FR_Obj25_Length 60;
BA_ "GenSigCycleTime" SG_ 544 FR_Obj25_Height 60;
BA_ "GenSigCycleTime" SG_ 544 FR_Obj25_Width 60;
BA_ "GenSigCycleTime" SG_ 544 FR_Obj25_TypeProb 60;
BA_ "GenSigCycleTime" SG_ 544 FR_Obj25_Type 60;
BA_ "GenSigCycleTime" SG_ 545 FR_CRCCheck_221 60;
BA_ "GenSigCycleTime" SG_ 545 FR_RollingCounter_221 60;
BA_ "GenSigCycleTime" SG_ 545 FR_Obj26_Ax 60;
BA_ "GenSigCycleTime" SG_ 545 FR_Obj26_Ay 60;
BA_ "GenSigCycleTime" SG_ 545 FR_Obj26_Vx 60;
BA_ "GenSigCycleTime" SG_ 545 FR_Obj26_Vy 60;
BA_ "GenSigCycleTime" SG_ 545 FR_Obj26_DelayTime 60;
BA_ "GenSigCycleTime" SG_ 545 FR_Obj26_ReferPoint_Dx 60;
BA_ "GenSigCycleTime" SG_ 545 FR_Obj26_HeightGround 60;
BA_ "GenSigCycleTime" SG_ 545 FR_Obj26_MotionStatusConf 60;
BA_ "GenSigCycleTime" SG_ 545 FR_Obj26_MotionStatus 60;
BA_ "GenSigCycleTime" SG_ 545 FR_Obj26_Measured 60;
BA_ "GenSigCycleTime" SG_ 545 FR_Obj26_valid 60;
BA_ "GenSigCycleTime" SG_ 545 FR_Obj26_Track_Age 60;
BA_ "GenSigCycleTime" SG_ 545 FR_Obj26_Track_ID 60;
BA_ "GenSigCycleTime" SG_ 545 FR_Obj26_ObstacleProb 60;
BA_ "GenSigCycleTime" SG_ 545 FR_Obj26_ExistProb 60;
BA_ "GenSigCycleTime" SG_ 545 FR_Obj26_RelAx 60;
BA_ "GenSigCycleTime" SG_ 545 FR_Obj26_RelAy 60;
BA_ "GenSigInvalidValue" SG_ 545 FR_Obj26_RelVx_std "4095";
BA_ "GenSigCycleTime" SG_ 545 FR_Obj26_RelVx_std 60;
BA_ "GenSigCycleTime" SG_ 545 FR_Obj26_RelVx 60;
BA_ "GenSigInvalidValue" SG_ 545 FR_Obj26_RelVy_std "1023";
BA_ "GenSigCycleTime" SG_ 545 FR_Obj26_RelVy_std 60;
BA_ "GenSigCycleTime" SG_ 545 FR_Obj26_RelVy 60;
BA_ "GenSigInvalidValue" SG_ 545 FR_Obj26_Dx_Vnce "16383";
BA_ "GenSigCycleTime" SG_ 545 FR_Obj26_Dx_Vnce 60;
BA_ "GenSigCycleTime" SG_ 545 FR_Obj26_Dx 60;
BA_ "GenSigInvalidValue" SG_ 545 FR_Obj26_Dy_Vnce "1023";
BA_ "GenSigCycleTime" SG_ 545 FR_Obj26_Dy_Vnce 60;
BA_ "GenSigCycleTime" SG_ 545 FR_Obj26_Dy 60;
BA_ "GenSigCycleTime" SG_ 545 FR_Obj26_HeadingAngle 60;
BA_ "GenSigCycleTime" SG_ 545 FR_Obj26_Length 60;
BA_ "GenSigCycleTime" SG_ 545 FR_Obj26_Height 60;
BA_ "GenSigCycleTime" SG_ 545 FR_Obj26_Width 60;
BA_ "GenSigCycleTime" SG_ 545 FR_Obj26_TypeProb 60;
BA_ "GenSigCycleTime" SG_ 545 FR_Obj26_Type 60;
BA_ "GenSigCycleTime" SG_ 546 FR_CRCCheck_222 60;
BA_ "GenSigCycleTime" SG_ 546 FR_RollingCounter_222 60;
BA_ "GenSigCycleTime" SG_ 546 FR_Obj27_Ax 60;
BA_ "GenSigCycleTime" SG_ 546 FR_Obj27_Ay 60;
BA_ "GenSigCycleTime" SG_ 546 FR_Obj27_Vx 60;
BA_ "GenSigCycleTime" SG_ 546 FR_Obj27_Vy 60;
BA_ "GenSigCycleTime" SG_ 546 FR_Obj27_DelayTime 60;
BA_ "GenSigCycleTime" SG_ 546 FR_Obj27_ReferPoint_Dx 60;
BA_ "GenSigCycleTime" SG_ 546 FR_Obj27_HeightGround 60;
BA_ "GenSigCycleTime" SG_ 546 FR_Obj27_MotionStatusConf 60;
BA_ "GenSigCycleTime" SG_ 546 FR_Obj27_MotionStatus 60;
BA_ "GenSigCycleTime" SG_ 546 FR_Obj27_Measured 60;
BA_ "GenSigCycleTime" SG_ 546 FR_Obj27_valid 60;
BA_ "GenSigCycleTime" SG_ 546 FR_Obj27_Track_Age 60;
BA_ "GenSigCycleTime" SG_ 546 FR_Obj27_Track_ID 60;
BA_ "GenSigCycleTime" SG_ 546 FR_Obj27_ObstacleProb 60;
BA_ "GenSigCycleTime" SG_ 546 FR_Obj27_ExistProb 60;
BA_ "GenSigCycleTime" SG_ 546 FR_Obj27_RelAx 60;
BA_ "GenSigCycleTime" SG_ 546 FR_Obj27_RelAy 60;
BA_ "GenSigInvalidValue" SG_ 546 FR_Obj27_RelVx_std "4095";
BA_ "GenSigCycleTime" SG_ 546 FR_Obj27_RelVx_std 60;
BA_ "GenSigCycleTime" SG_ 546 FR_Obj27_RelVx 60;
BA_ "GenSigInvalidValue" SG_ 546 FR_Obj27_RelVy_std "1023";
BA_ "GenSigCycleTime" SG_ 546 FR_Obj27_RelVy_std 60;
BA_ "GenSigCycleTime" SG_ 546 FR_Obj27_RelVy 60;
BA_ "GenSigInvalidValue" SG_ 546 FR_Obj27_Dx_Vnce "16383";
BA_ "GenSigCycleTime" SG_ 546 FR_Obj27_Dx_Vnce 60;
BA_ "GenSigCycleTime" SG_ 546 FR_Obj27_Dx 60;
BA_ "GenSigInvalidValue" SG_ 546 FR_Obj27_Dy_Vnce "1023";
BA_ "GenSigCycleTime" SG_ 546 FR_Obj27_Dy_Vnce 60;
BA_ "GenSigCycleTime" SG_ 546 FR_Obj27_Dy 60;
BA_ "GenSigCycleTime" SG_ 546 FR_Obj27_HeadingAngle 60;
BA_ "GenSigCycleTime" SG_ 546 FR_Obj27_Length 60;
BA_ "GenSigCycleTime" SG_ 546 FR_Obj27_Height 60;
BA_ "GenSigCycleTime" SG_ 546 FR_Obj27_Width 60;
BA_ "GenSigCycleTime" SG_ 546 FR_Obj27_TypeProb 60;
BA_ "GenSigCycleTime" SG_ 546 FR_Obj27_Type 60;
BA_ "GenSigCycleTime" SG_ 547 FR_CRCCheck_223 60;
BA_ "GenSigCycleTime" SG_ 547 FR_RollingCounter_223 60;
BA_ "GenSigCycleTime" SG_ 547 FR_Obj28_Ax 60;
BA_ "GenSigCycleTime" SG_ 547 FR_Obj28_Ay 60;
BA_ "GenSigCycleTime" SG_ 547 FR_Obj28_Vx 60;
BA_ "GenSigCycleTime" SG_ 547 FR_Obj28_Vy 60;
BA_ "GenSigCycleTime" SG_ 547 FR_Obj28_DelayTime 60;
BA_ "GenSigCycleTime" SG_ 547 FR_Obj28_ReferPoint_Dx 60;
BA_ "GenSigCycleTime" SG_ 547 FR_Obj28_HeightGround 60;
BA_ "GenSigCycleTime" SG_ 547 FR_Obj28_MotionStatusConf 60;
BA_ "GenSigCycleTime" SG_ 547 FR_Obj28_MotionStatus 60;
BA_ "GenSigCycleTime" SG_ 547 FR_Obj28_Measured 60;
BA_ "GenSigCycleTime" SG_ 547 FR_Obj28_valid 60;
BA_ "GenSigCycleTime" SG_ 547 FR_Obj28_Track_Age 60;
BA_ "GenSigCycleTime" SG_ 547 FR_Obj28_Track_ID 60;
BA_ "GenSigCycleTime" SG_ 547 FR_Obj28_ObstacleProb 60;
BA_ "GenSigCycleTime" SG_ 547 FR_Obj28_ExistProb 60;
BA_ "GenSigCycleTime" SG_ 547 FR_Obj28_RelAx 60;
BA_ "GenSigCycleTime" SG_ 547 FR_Obj28_RelAy 60;
BA_ "GenSigInvalidValue" SG_ 547 FR_Obj28_RelVx_std "4095";
BA_ "GenSigCycleTime" SG_ 547 FR_Obj28_RelVx_std 60;
BA_ "GenSigCycleTime" SG_ 547 FR_Obj28_RelVx 60;
BA_ "GenSigInvalidValue" SG_ 547 FR_Obj28_RelVy_std "1023";
BA_ "GenSigCycleTime" SG_ 547 FR_Obj28_RelVy_std 60;
BA_ "GenSigCycleTime" SG_ 547 FR_Obj28_RelVy 60;
BA_ "GenSigInvalidValue" SG_ 547 FR_Obj28_Dx_Vnce "16383";
BA_ "GenSigCycleTime" SG_ 547 FR_Obj28_Dx_Vnce 60;
BA_ "GenSigCycleTime" SG_ 547 FR_Obj28_Dx 60;
BA_ "GenSigInvalidValue" SG_ 547 FR_Obj28_Dy_Vnce "1023";
BA_ "GenSigCycleTime" SG_ 547 FR_Obj28_Dy_Vnce 60;
BA_ "GenSigCycleTime" SG_ 547 FR_Obj28_Dy 60;
BA_ "GenSigCycleTime" SG_ 547 FR_Obj28_HeadingAngle 60;
BA_ "GenSigCycleTime" SG_ 547 FR_Obj28_Length 60;
BA_ "GenSigCycleTime" SG_ 547 FR_Obj28_Height 60;
BA_ "GenSigCycleTime" SG_ 547 FR_Obj28_Width 60;
BA_ "GenSigCycleTime" SG_ 547 FR_Obj28_TypeProb 60;
BA_ "GenSigCycleTime" SG_ 547 FR_Obj28_Type 60;
BA_ "GenSigCycleTime" SG_ 548 FR_CRCCheck_224 60;
BA_ "GenSigCycleTime" SG_ 548 FR_RollingCounter_224 60;
BA_ "GenSigCycleTime" SG_ 548 FR_Obj29_Ax 60;
BA_ "GenSigCycleTime" SG_ 548 FR_Obj29_Ay 60;
BA_ "GenSigCycleTime" SG_ 548 FR_Obj29_Vx 60;
BA_ "GenSigCycleTime" SG_ 548 FR_Obj29_Vy 60;
BA_ "GenSigCycleTime" SG_ 548 FR_Obj29_DelayTime 60;
BA_ "GenSigCycleTime" SG_ 548 FR_Obj29_ReferPoint_Dx 60;
BA_ "GenSigCycleTime" SG_ 548 FR_Obj29_HeightGround 60;
BA_ "GenSigCycleTime" SG_ 548 FR_Obj29_MotionStatusConf 60;
BA_ "GenSigCycleTime" SG_ 548 FR_Obj29_MotionStatus 60;
BA_ "GenSigCycleTime" SG_ 548 FR_Obj29_Measured 60;
BA_ "GenSigCycleTime" SG_ 548 FR_Obj29_valid 60;
BA_ "GenSigCycleTime" SG_ 548 FR_Obj29_Track_Age 60;
BA_ "GenSigCycleTime" SG_ 548 FR_Obj29_Track_ID 60;
BA_ "GenSigCycleTime" SG_ 548 FR_Obj29_ObstacleProb 60;
BA_ "GenSigCycleTime" SG_ 548 FR_Obj29_ExistProb 60;
BA_ "GenSigCycleTime" SG_ 548 FR_Obj29_RelAx 60;
BA_ "GenSigCycleTime" SG_ 548 FR_Obj29_RelAy 60;
BA_ "GenSigInvalidValue" SG_ 548 FR_Obj29_RelVx_std "4095";
BA_ "GenSigCycleTime" SG_ 548 FR_Obj29_RelVx_std 60;
BA_ "GenSigCycleTime" SG_ 548 FR_Obj29_RelVx 60;
BA_ "GenSigInvalidValue" SG_ 548 FR_Obj29_RelVy_std "1023";
BA_ "GenSigCycleTime" SG_ 548 FR_Obj29_RelVy_std 60;
BA_ "GenSigCycleTime" SG_ 548 FR_Obj29_RelVy 60;
BA_ "GenSigInvalidValue" SG_ 548 FR_Obj29_Dx_Vnce "16383";
BA_ "GenSigCycleTime" SG_ 548 FR_Obj29_Dx_Vnce 60;
BA_ "GenSigCycleTime" SG_ 548 FR_Obj29_Dx 60;
BA_ "GenSigInvalidValue" SG_ 548 FR_Obj29_Dy_Vnce "1023";
BA_ "GenSigCycleTime" SG_ 548 FR_Obj29_Dy_Vnce 60;
BA_ "GenSigCycleTime" SG_ 548 FR_Obj29_Dy 60;
BA_ "GenSigCycleTime" SG_ 548 FR_Obj29_HeadingAngle 60;
BA_ "GenSigCycleTime" SG_ 548 FR_Obj29_Length 60;
BA_ "GenSigCycleTime" SG_ 548 FR_Obj29_Height 60;
BA_ "GenSigCycleTime" SG_ 548 FR_Obj29_Width 60;
BA_ "GenSigCycleTime" SG_ 548 FR_Obj29_TypeProb 60;
BA_ "GenSigCycleTime" SG_ 548 FR_Obj29_Type 60;
BA_ "GenSigCycleTime" SG_ 549 FR_CRCCheck_225 60;
BA_ "GenSigCycleTime" SG_ 549 FR_RollingCounter_225 60;
BA_ "GenSigCycleTime" SG_ 549 FR_Obj30_Ax 60;
BA_ "GenSigCycleTime" SG_ 549 FR_Obj30_Ay 60;
BA_ "GenSigCycleTime" SG_ 549 FR_Obj30_Vx 60;
BA_ "GenSigCycleTime" SG_ 549 FR_Obj30_Vy 60;
BA_ "GenSigCycleTime" SG_ 549 FR_Obj30_DelayTime 60;
BA_ "GenSigCycleTime" SG_ 549 FR_Obj30_ReferPoint_Dx 60;
BA_ "GenSigCycleTime" SG_ 549 FR_Obj30_HeightGround 60;
BA_ "GenSigCycleTime" SG_ 549 FR_Obj30_MotionStatusConf 60;
BA_ "GenSigCycleTime" SG_ 549 FR_Obj30_MotionStatus 60;
BA_ "GenSigCycleTime" SG_ 549 FR_Obj30_Measured 60;
BA_ "GenSigCycleTime" SG_ 549 FR_Obj30_valid 60;
BA_ "GenSigCycleTime" SG_ 549 FR_Obj30_Track_Age 60;
BA_ "GenSigCycleTime" SG_ 549 FR_Obj30_Track_ID 60;
BA_ "GenSigCycleTime" SG_ 549 FR_Obj30_ObstacleProb 60;
BA_ "GenSigCycleTime" SG_ 549 FR_Obj30_ExistProb 60;
BA_ "GenSigCycleTime" SG_ 549 FR_Obj30_RelAx 60;
BA_ "GenSigCycleTime" SG_ 549 FR_Obj30_RelAy 60;
BA_ "GenSigInvalidValue" SG_ 549 FR_Obj30_RelVx_std "4095";
BA_ "GenSigCycleTime" SG_ 549 FR_Obj30_RelVx_std 60;
BA_ "GenSigCycleTime" SG_ 549 FR_Obj30_RelVx 60;
BA_ "GenSigInvalidValue" SG_ 549 FR_Obj30_RelVy_std "1023";
BA_ "GenSigCycleTime" SG_ 549 FR_Obj30_RelVy_std 60;
BA_ "GenSigCycleTime" SG_ 549 FR_Obj30_RelVy 60;
BA_ "GenSigInvalidValue" SG_ 549 FR_Obj30_Dx_Vnce "16383";
BA_ "GenSigCycleTime" SG_ 549 FR_Obj30_Dx_Vnce 60;
BA_ "GenSigCycleTime" SG_ 549 FR_Obj30_Dx 60;
BA_ "GenSigInvalidValue" SG_ 549 FR_Obj30_Dy_Vnce "1023";
BA_ "GenSigCycleTime" SG_ 549 FR_Obj30_Dy_Vnce 60;
BA_ "GenSigCycleTime" SG_ 549 FR_Obj30_Dy 60;
BA_ "GenSigCycleTime" SG_ 549 FR_Obj30_HeadingAngle 60;
BA_ "GenSigCycleTime" SG_ 549 FR_Obj30_Length 60;
BA_ "GenSigCycleTime" SG_ 549 FR_Obj30_Height 60;
BA_ "GenSigCycleTime" SG_ 549 FR_Obj30_Width 60;
BA_ "GenSigCycleTime" SG_ 549 FR_Obj30_TypeProb 60;
BA_ "GenSigCycleTime" SG_ 549 FR_Obj30_Type 60;
BA_ "GenSigCycleTime" SG_ 550 FR_CRCCheck_226 60;
BA_ "GenSigCycleTime" SG_ 550 FR_RollingCounter_226 60;
BA_ "GenSigCycleTime" SG_ 550 FR_Obj31_Ax 60;
BA_ "GenSigCycleTime" SG_ 550 FR_Obj31_Ay 60;
BA_ "GenSigCycleTime" SG_ 550 FR_Obj31_Vx 60;
BA_ "GenSigCycleTime" SG_ 550 FR_Obj31_Vy 60;
BA_ "GenSigCycleTime" SG_ 550 FR_Obj31_DelayTime 60;
BA_ "GenSigCycleTime" SG_ 550 FR_Obj31_ReferPoint_Dx 60;
BA_ "GenSigCycleTime" SG_ 550 FR_Obj31_HeightGround 60;
BA_ "GenSigCycleTime" SG_ 550 FR_Obj31_MotionStatusConf 60;
BA_ "GenSigCycleTime" SG_ 550 FR_Obj31_MotionStatus 60;
BA_ "GenSigCycleTime" SG_ 550 FR_Obj31_Measured 60;
BA_ "GenSigCycleTime" SG_ 550 FR_Obj31_valid 60;
BA_ "GenSigCycleTime" SG_ 550 FR_Obj31_Track_Age 60;
BA_ "GenSigCycleTime" SG_ 550 FR_Obj31_Track_ID 60;
BA_ "GenSigCycleTime" SG_ 550 FR_Obj31_ObstacleProb 60;
BA_ "GenSigCycleTime" SG_ 550 FR_Obj31_ExistProb 60;
BA_ "GenSigCycleTime" SG_ 550 FR_Obj31_RelAx 60;
BA_ "GenSigCycleTime" SG_ 550 FR_Obj31_RelAy 60;
BA_ "GenSigInvalidValue" SG_ 550 FR_Obj31_RelVx_std "4095";
BA_ "GenSigCycleTime" SG_ 550 FR_Obj31_RelVx_std 60;
BA_ "GenSigCycleTime" SG_ 550 FR_Obj31_RelVx 60;
BA_ "GenSigInvalidValue" SG_ 550 FR_Obj31_RelVy_std "1023";
BA_ "GenSigCycleTime" SG_ 550 FR_Obj31_RelVy_std 60;
BA_ "GenSigCycleTime" SG_ 550 FR_Obj31_RelVy 60;
BA_ "GenSigInvalidValue" SG_ 550 FR_Obj31_Dx_Vnce "16383";
BA_ "GenSigCycleTime" SG_ 550 FR_Obj31_Dx_Vnce 60;
BA_ "GenSigCycleTime" SG_ 550 FR_Obj31_Dx 60;
BA_ "GenSigInvalidValue" SG_ 550 FR_Obj31_Dy_Vnce "1023";
BA_ "GenSigCycleTime" SG_ 550 FR_Obj31_Dy_Vnce 60;
BA_ "GenSigCycleTime" SG_ 550 FR_Obj31_Dy 60;
BA_ "GenSigCycleTime" SG_ 550 FR_Obj31_HeadingAngle 60;
BA_ "GenSigCycleTime" SG_ 550 FR_Obj31_Length 60;
BA_ "GenSigCycleTime" SG_ 550 FR_Obj31_Height 60;
BA_ "GenSigCycleTime" SG_ 550 FR_Obj31_Width 60;
BA_ "GenSigCycleTime" SG_ 550 FR_Obj31_TypeProb 60;
BA_ "GenSigCycleTime" SG_ 550 FR_Obj31_Type 60;
BA_ "GenSigCycleTime" SG_ 551 FR_CRCCheck_227 60;
BA_ "GenSigCycleTime" SG_ 551 FR_RollingCounter_227 60;
BA_ "GenSigCycleTime" SG_ 551 FR_Obj32_Ax 60;
BA_ "GenSigCycleTime" SG_ 551 FR_Obj32_Ay 60;
BA_ "GenSigCycleTime" SG_ 551 FR_Obj32_Vx 60;
BA_ "GenSigCycleTime" SG_ 551 FR_Obj32_Vy 60;
BA_ "GenSigCycleTime" SG_ 551 FR_Obj32_DelayTime 60;
BA_ "GenSigCycleTime" SG_ 551 FR_Obj32_ReferPoint_Dx 60;
BA_ "GenSigCycleTime" SG_ 551 FR_Obj32_HeightGround 60;
BA_ "GenSigCycleTime" SG_ 551 FR_Obj32_MotionStatusConf 60;
BA_ "GenSigCycleTime" SG_ 551 FR_Obj32_MotionStatus 60;
BA_ "GenSigCycleTime" SG_ 551 FR_Obj32_Measured 60;
BA_ "GenSigCycleTime" SG_ 551 FR_Obj32_valid 60;
BA_ "GenSigCycleTime" SG_ 551 FR_Obj32_Track_Age 60;
BA_ "GenSigCycleTime" SG_ 551 FR_Obj32_Track_ID 60;
BA_ "GenSigCycleTime" SG_ 551 FR_Obj32_ObstacleProb 60;
BA_ "GenSigCycleTime" SG_ 551 FR_Obj32_ExistProb 60;
BA_ "GenSigCycleTime" SG_ 551 FR_Obj32_RelAx 60;
BA_ "GenSigCycleTime" SG_ 551 FR_Obj32_RelAy 60;
BA_ "GenSigInvalidValue" SG_ 551 FR_Obj32_RelVx_std "4095";
BA_ "GenSigCycleTime" SG_ 551 FR_Obj32_RelVx_std 60;
BA_ "GenSigCycleTime" SG_ 551 FR_Obj32_RelVx 60;
BA_ "GenSigInvalidValue" SG_ 551 FR_Obj32_RelVy_std "1023";
BA_ "GenSigCycleTime" SG_ 551 FR_Obj32_RelVy_std 60;
BA_ "GenSigCycleTime" SG_ 551 FR_Obj32_RelVy 60;
BA_ "GenSigInvalidValue" SG_ 551 FR_Obj32_Dx_Vnce "16383";
BA_ "GenSigCycleTime" SG_ 551 FR_Obj32_Dx_Vnce 60;
BA_ "GenSigCycleTime" SG_ 551 FR_Obj32_Dx 60;
BA_ "GenSigInvalidValue" SG_ 551 FR_Obj32_Dy_Vnce "1023";
BA_ "GenSigCycleTime" SG_ 551 FR_Obj32_Dy_Vnce 60;
BA_ "GenSigCycleTime" SG_ 551 FR_Obj32_Dy 60;
BA_ "GenSigCycleTime" SG_ 551 FR_Obj32_HeadingAngle 60;
BA_ "GenSigCycleTime" SG_ 551 FR_Obj32_Length 60;
BA_ "GenSigCycleTime" SG_ 551 FR_Obj32_Height 60;
BA_ "GenSigCycleTime" SG_ 551 FR_Obj32_Width 60;
BA_ "GenSigCycleTime" SG_ 551 FR_Obj32_TypeProb 60;
BA_ "GenSigCycleTime" SG_ 551 FR_Obj32_Type 60;
BA_ "GenSigCycleTime" SG_ 552 FR_CRCCheck_228 60;
BA_ "GenSigCycleTime" SG_ 552 FR_RollingCounter_228 60;
BA_ "GenSigCycleTime" SG_ 552 FR_FreespaceSectorKinestate34 60;
BA_ "GenSigCycleTime" SG_ 552 FR_FreespaceSectorConRidence34 60;
BA_ "GenSigCycleTime" SG_ 552 FR_FreespaceSectorDistance34 60;
BA_ "GenSigCycleTime" SG_ 552 FR_FreespaceSectorKinestate33 60;
BA_ "GenSigCycleTime" SG_ 552 FR_FreespaceSectorConRidence33 60;
BA_ "GenSigCycleTime" SG_ 552 FR_FreespaceSectorDistance33 60;
BA_ "GenSigCycleTime" SG_ 552 FR_FreespaceSectorKinestate32 60;
BA_ "GenSigCycleTime" SG_ 552 FR_FreespaceSectorConRidence32 60;
BA_ "GenSigCycleTime" SG_ 552 FR_FreespaceSectorDistance32 60;
BA_ "GenSigCycleTime" SG_ 552 FR_FreespaceSectorKinestate31 60;
BA_ "GenSigCycleTime" SG_ 552 FR_FreespaceSectorConRidence31 60;
BA_ "GenSigCycleTime" SG_ 552 FR_FreespaceSectorDistance31 60;
BA_ "GenSigCycleTime" SG_ 552 FR_FreespaceSectorKinestate30 60;
BA_ "GenSigCycleTime" SG_ 552 FR_FreespaceSectorConRidence30 60;
BA_ "GenSigCycleTime" SG_ 552 FR_FreespaceSectorDistance30 60;
BA_ "GenSigCycleTime" SG_ 552 FR_FreespaceSectorKinestate29 60;
BA_ "GenSigCycleTime" SG_ 552 FR_FreespaceSectorConRidence29 60;
BA_ "GenSigCycleTime" SG_ 552 FR_FreespaceSectorDistance29 60;
BA_ "GenSigCycleTime" SG_ 552 FR_FreespaceSectorKinestate28 60;
BA_ "GenSigCycleTime" SG_ 552 FR_FreespaceSectorConRidence28 60;
BA_ "GenSigCycleTime" SG_ 552 FR_FreespaceSectorDistance28 60;
BA_ "GenSigCycleTime" SG_ 552 FR_FreespaceSectorKinestate27 60;
BA_ "GenSigCycleTime" SG_ 552 FR_FreespaceSectorConRidence27 60;
BA_ "GenSigCycleTime" SG_ 552 FR_FreespaceSectorDistance27 60;
BA_ "GenSigCycleTime" SG_ 552 FR_FreespaceSectorKinestate26 60;
BA_ "GenSigCycleTime" SG_ 552 FR_FreespaceSectorConRidence26 60;
BA_ "GenSigCycleTime" SG_ 552 FR_FreespaceSectorDistance26 60;
BA_ "GenSigCycleTime" SG_ 552 FR_FreespaceSectorKinestate25 60;
BA_ "GenSigCycleTime" SG_ 552 FR_FreespaceSectorConRidence25 60;
BA_ "GenSigCycleTime" SG_ 552 FR_FreespaceSectorDistance25 60;
BA_ "GenSigCycleTime" SG_ 552 FR_FreespaceSectorKinestate24 60;
BA_ "GenSigCycleTime" SG_ 552 FR_FreespaceSectorConRidence24 60;
BA_ "GenSigCycleTime" SG_ 552 FR_FreespaceSectorDistance24 60;
BA_ "GenSigCycleTime" SG_ 552 FR_FreespaceSectorKinestate23 60;
BA_ "GenSigCycleTime" SG_ 552 FR_FreespaceSectorConRidence23 60;
BA_ "GenSigCycleTime" SG_ 552 FR_FreespaceSectorDistance23 60;
BA_ "GenSigCycleTime" SG_ 552 FR_FreespaceSectorKinestate22 60;
BA_ "GenSigCycleTime" SG_ 552 FR_FreespaceSectorConRidence22 60;
BA_ "GenSigCycleTime" SG_ 552 FR_FreespaceSectorDistance22 60;
BA_ "GenSigCycleTime" SG_ 552 FR_FreespaceSectorKinestate21 60;
BA_ "GenSigCycleTime" SG_ 552 FR_FreespaceSectorConRidence21 60;
BA_ "GenSigCycleTime" SG_ 552 FR_FreespaceSectorDistance21 60;
BA_ "GenSigCycleTime" SG_ 552 FR_FreespaceSectorKinestate20 60;
BA_ "GenSigCycleTime" SG_ 552 FR_FreespaceSectorConRidence20 60;
BA_ "GenSigCycleTime" SG_ 552 FR_FreespaceSectorDistance20 60;
BA_ "GenSigCycleTime" SG_ 552 FR_FreespaceSectorKinestate19 60;
BA_ "GenSigCycleTime" SG_ 552 FR_FreespaceSectorConRidence19 60;
BA_ "GenSigCycleTime" SG_ 552 FR_FreespaceSectorDistance19 60;
BA_ "GenSigCycleTime" SG_ 552 FR_FreespaceSectorKinestate18 60;
BA_ "GenSigCycleTime" SG_ 552 FR_FreespaceSectorConRidence18 60;
BA_ "GenSigCycleTime" SG_ 552 FR_FreespaceSectorDistance18 60;
BA_ "GenSigCycleTime" SG_ 552 FR_FreespaceSectorKinestate17 60;
BA_ "GenSigCycleTime" SG_ 552 FR_FreespaceSectorConRidence17 60;
BA_ "GenSigCycleTime" SG_ 552 FR_FreespaceSectorDistance17 60;
BA_ "GenSigCycleTime" SG_ 552 FR_FreespaceSectorKinestate16 60;
BA_ "GenSigCycleTime" SG_ 552 FR_FreespaceSectorConRidence16 60;
BA_ "GenSigCycleTime" SG_ 552 FR_FreespaceSectorDistance16 60;
BA_ "GenSigCycleTime" SG_ 552 FR_FreespaceSectorKinestate15 60;
BA_ "GenSigCycleTime" SG_ 552 FR_FreespaceSectorConRidence15 60;
BA_ "GenSigCycleTime" SG_ 552 FR_FreespaceSectorDistance15 60;
BA_ "GenSigCycleTime" SG_ 552 FR_FreespaceSectorKinestate14 60;
BA_ "GenSigCycleTime" SG_ 552 FR_FreespaceSectorConRidence14 60;
BA_ "GenSigCycleTime" SG_ 552 FR_FreespaceSectorDistance14 60;
BA_ "GenSigCycleTime" SG_ 552 FR_FreespaceSectorKinestate13 60;
BA_ "GenSigCycleTime" SG_ 552 FR_FreespaceSectorConRidence13 60;
BA_ "GenSigCycleTime" SG_ 552 FR_FreespaceSectorDistance13 60;
BA_ "GenSigCycleTime" SG_ 552 FR_FreespaceSectorKinestate12 60;
BA_ "GenSigCycleTime" SG_ 552 FR_FreespaceSectorConRidence12 60;
BA_ "GenSigCycleTime" SG_ 552 FR_FreespaceSectorDistance12 60;
BA_ "GenSigCycleTime" SG_ 552 FR_FreespaceSectorKinestate11 60;
BA_ "GenSigCycleTime" SG_ 552 FR_FreespaceSectorConRidence11 60;
BA_ "GenSigCycleTime" SG_ 552 FR_FreespaceSectorDistance11 60;
BA_ "GenSigCycleTime" SG_ 552 FR_FreespaceSectorKinestate10 60;
BA_ "GenSigCycleTime" SG_ 552 FR_FreespaceSectorConRidence10 60;
BA_ "GenSigCycleTime" SG_ 552 FR_FreespaceSectorDistance10 60;
BA_ "GenSigCycleTime" SG_ 552 FR_FreespaceSectorKinestate9 60;
BA_ "GenSigCycleTime" SG_ 552 FR_FreespaceSectorConRidence9 60;
BA_ "GenSigCycleTime" SG_ 552 FR_FreespaceSectorDistance9 60;
BA_ "GenSigCycleTime" SG_ 552 FR_FreespaceSectorKinestate8 60;
BA_ "GenSigCycleTime" SG_ 552 FR_FreespaceSectorConRidence8 60;
BA_ "GenSigCycleTime" SG_ 552 FR_FreespaceSectorDistance8 60;
BA_ "GenSigCycleTime" SG_ 552 FR_FreespaceSectorKinestate7 60;
BA_ "GenSigCycleTime" SG_ 552 FR_FreespaceSectorConRidence7 60;
BA_ "GenSigCycleTime" SG_ 552 FR_FreespaceSectorDistance7 60;
BA_ "GenSigCycleTime" SG_ 552 FR_FreespaceSectorKinestate6 60;
BA_ "GenSigCycleTime" SG_ 552 FR_FreespaceSectorConRidence6 60;
BA_ "GenSigCycleTime" SG_ 552 FR_FreespaceSectorDistance6 60;
BA_ "GenSigCycleTime" SG_ 552 FR_FreespaceSectorKinestate5 60;
BA_ "GenSigCycleTime" SG_ 552 FR_FreespaceSectorConRidence5 60;
BA_ "GenSigCycleTime" SG_ 552 FR_FreespaceSectorDistance5 60;
BA_ "GenSigCycleTime" SG_ 552 FR_FreespaceSectorKinestate4 60;
BA_ "GenSigCycleTime" SG_ 552 FR_FreespaceSectorConRidence4 60;
BA_ "GenSigCycleTime" SG_ 552 FR_FreespaceSectorDistance4 60;
BA_ "GenSigCycleTime" SG_ 552 FR_FreespaceSectorKinestate3 60;
BA_ "GenSigCycleTime" SG_ 552 FR_FreespaceSectorConRidence3 60;
BA_ "GenSigCycleTime" SG_ 552 FR_FreespaceSectorDistance3 60;
BA_ "GenSigCycleTime" SG_ 552 FR_FreespaceSectorKinestate2 60;
BA_ "GenSigCycleTime" SG_ 552 FR_FreespaceSectorConRidence2 60;
BA_ "GenSigCycleTime" SG_ 552 FR_FreespaceSectorDistance2 60;
BA_ "GenSigCycleTime" SG_ 552 FR_FreespaceSectorKinestate1 60;
BA_ "GenSigCycleTime" SG_ 552 FR_FreespaceSectorConRidence1 60;
BA_ "GenSigCycleTime" SG_ 552 FR_FreespaceSectorDistance1 60;
BA_ "GenSigCycleTime" SG_ 553 FR_CRCCheck_229 60;
BA_ "GenSigCycleTime" SG_ 553 FR_RollingCounter_229 60;
BA_ "GenSigCycleTime" SG_ 553 FR_FreespaceSectorKinestate68 60;
BA_ "GenSigCycleTime" SG_ 553 FR_FreespaceSectorConRidence68 60;
BA_ "GenSigCycleTime" SG_ 553 FR_FreespaceSectorDistance68 60;
BA_ "GenSigCycleTime" SG_ 553 FR_FreespaceSectorKinestate67 60;
BA_ "GenSigCycleTime" SG_ 553 FR_FreespaceSectorConRidence67 60;
BA_ "GenSigCycleTime" SG_ 553 FR_FreespaceSectorDistance67 60;
BA_ "GenSigCycleTime" SG_ 553 FR_FreespaceSectorKinestate66 60;
BA_ "GenSigCycleTime" SG_ 553 FR_FreespaceSectorConRidence66 60;
BA_ "GenSigCycleTime" SG_ 553 FR_FreespaceSectorDistance66 60;
BA_ "GenSigCycleTime" SG_ 553 FR_FreespaceSectorKinestate65 60;
BA_ "GenSigCycleTime" SG_ 553 FR_FreespaceSectorConRidence65 60;
BA_ "GenSigCycleTime" SG_ 553 FR_FreespaceSectorDistance65 60;
BA_ "GenSigCycleTime" SG_ 553 FR_FreespaceSectorKinestate64 60;
BA_ "GenSigCycleTime" SG_ 553 FR_FreespaceSectorConRidence64 60;
BA_ "GenSigCycleTime" SG_ 553 FR_FreespaceSectorDistance64 60;
BA_ "GenSigCycleTime" SG_ 553 FR_FreespaceSectorKinestate63 60;
BA_ "GenSigCycleTime" SG_ 553 FR_FreespaceSectorConRidence63 60;
BA_ "GenSigCycleTime" SG_ 553 FR_FreespaceSectorDistance63 60;
BA_ "GenSigCycleTime" SG_ 553 FR_FreespaceSectorKinestate62 60;
BA_ "GenSigCycleTime" SG_ 553 FR_FreespaceSectorConRidence62 60;
BA_ "GenSigCycleTime" SG_ 553 FR_FreespaceSectorDistance62 60;
BA_ "GenSigCycleTime" SG_ 553 FR_FreespaceSectorKinestate61 60;
BA_ "GenSigCycleTime" SG_ 553 FR_FreespaceSectorConRidence61 60;
BA_ "GenSigCycleTime" SG_ 553 FR_FreespaceSectorDistance61 60;
BA_ "GenSigCycleTime" SG_ 553 FR_FreespaceSectorKinestate60 60;
BA_ "GenSigCycleTime" SG_ 553 FR_FreespaceSectorConRidence60 60;
BA_ "GenSigCycleTime" SG_ 553 FR_FreespaceSectorDistance60 60;
BA_ "GenSigCycleTime" SG_ 553 FR_FreespaceSectorKinestate59 60;
BA_ "GenSigCycleTime" SG_ 553 FR_FreespaceSectorConRidence59 60;
BA_ "GenSigCycleTime" SG_ 553 FR_FreespaceSectorDistance59 60;
BA_ "GenSigCycleTime" SG_ 553 FR_FreespaceSectorKinestate58 60;
BA_ "GenSigCycleTime" SG_ 553 FR_FreespaceSectorConRidence58 60;
BA_ "GenSigCycleTime" SG_ 553 FR_FreespaceSectorDistance58 60;
BA_ "GenSigCycleTime" SG_ 553 FR_FreespaceSectorKinestate57 60;
BA_ "GenSigCycleTime" SG_ 553 FR_FreespaceSectorConRidence57 60;
BA_ "GenSigCycleTime" SG_ 553 FR_FreespaceSectorDistance57 60;
BA_ "GenSigCycleTime" SG_ 553 FR_FreespaceSectorKinestate56 60;
BA_ "GenSigCycleTime" SG_ 553 FR_FreespaceSectorConRidence56 60;
BA_ "GenSigCycleTime" SG_ 553 FR_FreespaceSectorDistance56 60;
BA_ "GenSigCycleTime" SG_ 553 FR_FreespaceSectorKinestate55 60;
BA_ "GenSigCycleTime" SG_ 553 FR_FreespaceSectorConRidence55 60;
BA_ "GenSigCycleTime" SG_ 553 FR_FreespaceSectorDistance55 60;
BA_ "GenSigCycleTime" SG_ 553 FR_FreespaceSectorKinestate54 60;
BA_ "GenSigCycleTime" SG_ 553 FR_FreespaceSectorConRidence54 60;
BA_ "GenSigCycleTime" SG_ 553 FR_FreespaceSectorDistance54 60;
BA_ "GenSigCycleTime" SG_ 553 FR_FreespaceSectorKinestate53 60;
BA_ "GenSigCycleTime" SG_ 553 FR_FreespaceSectorConRidence53 60;
BA_ "GenSigCycleTime" SG_ 553 FR_FreespaceSectorDistance53 60;
BA_ "GenSigCycleTime" SG_ 553 FR_FreespaceSectorKinestate52 60;
BA_ "GenSigCycleTime" SG_ 553 FR_FreespaceSectorConRidence52 60;
BA_ "GenSigCycleTime" SG_ 553 FR_FreespaceSectorDistance52 60;
BA_ "GenSigCycleTime" SG_ 553 FR_FreespaceSectorKinestate51 60;
BA_ "GenSigCycleTime" SG_ 553 FR_FreespaceSectorConRidence51 60;
BA_ "GenSigCycleTime" SG_ 553 FR_FreespaceSectorDistance51 60;
BA_ "GenSigCycleTime" SG_ 553 FR_FreespaceSectorKinestate50 60;
BA_ "GenSigCycleTime" SG_ 553 FR_FreespaceSectorConRidence50 60;
BA_ "GenSigCycleTime" SG_ 553 FR_FreespaceSectorDistance50 60;
BA_ "GenSigCycleTime" SG_ 553 FR_FreespaceSectorKinestate49 60;
BA_ "GenSigCycleTime" SG_ 553 FR_FreespaceSectorConRidence49 60;
BA_ "GenSigCycleTime" SG_ 553 FR_FreespaceSectorDistance49 60;
BA_ "GenSigCycleTime" SG_ 553 FR_FreespaceSectorKinestate48 60;
BA_ "GenSigCycleTime" SG_ 553 FR_FreespaceSectorConRidence48 60;
BA_ "GenSigCycleTime" SG_ 553 FR_FreespaceSectorDistance48 60;
BA_ "GenSigCycleTime" SG_ 553 FR_FreespaceSectorKinestate47 60;
BA_ "GenSigCycleTime" SG_ 553 FR_FreespaceSectorConRidence47 60;
BA_ "GenSigCycleTime" SG_ 553 FR_FreespaceSectorDistance47 60;
BA_ "GenSigCycleTime" SG_ 553 FR_FreespaceSectorKinestate46 60;
BA_ "GenSigCycleTime" SG_ 553 FR_FreespaceSectorConRidence46 60;
BA_ "GenSigCycleTime" SG_ 553 FR_FreespaceSectorDistance46 60;
BA_ "GenSigCycleTime" SG_ 553 FR_FreespaceSectorKinestate45 60;
BA_ "GenSigCycleTime" SG_ 553 FR_FreespaceSectorConRidence45 60;
BA_ "GenSigCycleTime" SG_ 553 FR_FreespaceSectorDistance45 60;
BA_ "GenSigCycleTime" SG_ 553 FR_FreespaceSectorKinestate44 60;
BA_ "GenSigCycleTime" SG_ 553 FR_FreespaceSectorConRidence44 60;
BA_ "GenSigCycleTime" SG_ 553 FR_FreespaceSectorDistance44 60;
BA_ "GenSigCycleTime" SG_ 553 FR_FreespaceSectorKinestate43 60;
BA_ "GenSigCycleTime" SG_ 553 FR_FreespaceSectorConRidence43 60;
BA_ "GenSigCycleTime" SG_ 553 FR_FreespaceSectorDistance43 60;
BA_ "GenSigCycleTime" SG_ 553 FR_FreespaceSectorKinestate42 60;
BA_ "GenSigCycleTime" SG_ 553 FR_FreespaceSectorConRidence42 60;
BA_ "GenSigCycleTime" SG_ 553 FR_FreespaceSectorDistance42 60;
BA_ "GenSigCycleTime" SG_ 553 FR_FreespaceSectorKinestate41 60;
BA_ "GenSigCycleTime" SG_ 553 FR_FreespaceSectorConRidence41 60;
BA_ "GenSigCycleTime" SG_ 553 FR_FreespaceSectorDistance41 60;
BA_ "GenSigCycleTime" SG_ 553 FR_FreespaceSectorKinestate40 60;
BA_ "GenSigCycleTime" SG_ 553 FR_FreespaceSectorConRidence40 60;
BA_ "GenSigCycleTime" SG_ 553 FR_FreespaceSectorDistance40 60;
BA_ "GenSigCycleTime" SG_ 553 FR_FreespaceSectorKinestate39 60;
BA_ "GenSigCycleTime" SG_ 553 FR_FreespaceSectorConRidence39 60;
BA_ "GenSigCycleTime" SG_ 553 FR_FreespaceSectorDistance39 60;
BA_ "GenSigCycleTime" SG_ 553 FR_FreespaceSectorKinestate38 60;
BA_ "GenSigCycleTime" SG_ 553 FR_FreespaceSectorConRidence38 60;
BA_ "GenSigCycleTime" SG_ 553 FR_FreespaceSectorDistance38 60;
BA_ "GenSigCycleTime" SG_ 553 FR_FreespaceSectorKinestate37 60;
BA_ "GenSigCycleTime" SG_ 553 FR_FreespaceSectorConRidence37 60;
BA_ "GenSigCycleTime" SG_ 553 FR_FreespaceSectorDistance37 60;
BA_ "GenSigCycleTime" SG_ 553 FR_FreespaceSectorKinestate36 60;
BA_ "GenSigCycleTime" SG_ 553 FR_FreespaceSectorConRidence36 60;
BA_ "GenSigCycleTime" SG_ 553 FR_FreespaceSectorDistance36 60;
BA_ "GenSigCycleTime" SG_ 553 FR_FreespaceSectorKinestate35 60;
BA_ "GenSigCycleTime" SG_ 553 FR_FreespaceSectorConRidence35 60;
BA_ "GenSigCycleTime" SG_ 553 FR_FreespaceSectorDistance35 60;
BA_ "GenSigCycleTime" SG_ 554 FR_CRCCheck_22A 60;
BA_ "GenSigCycleTime" SG_ 554 FR_RollingCounter_22A 60;
BA_ "GenSigCycleTime" SG_ 554 FR_FreespaceSectorKinestate102 60;
BA_ "GenSigCycleTime" SG_ 554 FR_FreespaceSectorConRidence102 60;
BA_ "GenSigCycleTime" SG_ 554 FR_FreespaceSectorDistance102 60;
BA_ "GenSigCycleTime" SG_ 554 FR_FreespaceSectorKinestate101 60;
BA_ "GenSigCycleTime" SG_ 554 FR_FreespaceSectorConRidence101 60;
BA_ "GenSigCycleTime" SG_ 554 FR_FreespaceSectorDistance101 60;
BA_ "GenSigCycleTime" SG_ 554 FR_FreespaceSectorKinestate100 60;
BA_ "GenSigCycleTime" SG_ 554 FR_FreespaceSectorConRidence100 60;
BA_ "GenSigCycleTime" SG_ 554 FR_FreespaceSectorDistance100 60;
BA_ "GenSigCycleTime" SG_ 554 FR_FreespaceSectorKinestate99 60;
BA_ "GenSigCycleTime" SG_ 554 FR_FreespaceSectorConRidence99 60;
BA_ "GenSigCycleTime" SG_ 554 FR_FreespaceSectorDistance99 60;
BA_ "GenSigCycleTime" SG_ 554 FR_FreespaceSectorKinestate98 60;
BA_ "GenSigCycleTime" SG_ 554 FR_FreespaceSectorConRidence98 60;
BA_ "GenSigCycleTime" SG_ 554 FR_FreespaceSectorDistance98 60;
BA_ "GenSigCycleTime" SG_ 554 FR_FreespaceSectorKinestate97 60;
BA_ "GenSigCycleTime" SG_ 554 FR_FreespaceSectorConRidence97 60;
BA_ "GenSigCycleTime" SG_ 554 FR_FreespaceSectorDistance97 60;
BA_ "GenSigCycleTime" SG_ 554 FR_FreespaceSectorKinestate96 60;
BA_ "GenSigCycleTime" SG_ 554 FR_FreespaceSectorConRidence96 60;
BA_ "GenSigCycleTime" SG_ 554 FR_FreespaceSectorDistance96 60;
BA_ "GenSigCycleTime" SG_ 554 FR_FreespaceSectorKinestate95 60;
BA_ "GenSigCycleTime" SG_ 554 FR_FreespaceSectorConRidence95 60;
BA_ "GenSigCycleTime" SG_ 554 FR_FreespaceSectorDistance95 60;
BA_ "GenSigCycleTime" SG_ 554 FR_FreespaceSectorKinestate94 60;
BA_ "GenSigCycleTime" SG_ 554 FR_FreespaceSectorConRidence94 60;
BA_ "GenSigCycleTime" SG_ 554 FR_FreespaceSectorDistance94 60;
BA_ "GenSigCycleTime" SG_ 554 FR_FreespaceSectorKinestate93 60;
BA_ "GenSigCycleTime" SG_ 554 FR_FreespaceSectorConRidence93 60;
BA_ "GenSigCycleTime" SG_ 554 FR_FreespaceSectorDistance93 60;
BA_ "GenSigCycleTime" SG_ 554 FR_FreespaceSectorKinestate92 60;
BA_ "GenSigCycleTime" SG_ 554 FR_FreespaceSectorConRidence92 60;
BA_ "GenSigCycleTime" SG_ 554 FR_FreespaceSectorDistance92 60;
BA_ "GenSigCycleTime" SG_ 554 FR_FreespaceSectorKinestate91 60;
BA_ "GenSigCycleTime" SG_ 554 FR_FreespaceSectorConRidence91 60;
BA_ "GenSigCycleTime" SG_ 554 FR_FreespaceSectorDistance91 60;
BA_ "GenSigCycleTime" SG_ 554 FR_FreespaceSectorKinestate90 60;
BA_ "GenSigCycleTime" SG_ 554 FR_FreespaceSectorConRidence90 60;
BA_ "GenSigCycleTime" SG_ 554 FR_FreespaceSectorDistance90 60;
BA_ "GenSigCycleTime" SG_ 554 FR_FreespaceSectorKinestate89 60;
BA_ "GenSigCycleTime" SG_ 554 FR_FreespaceSectorConRidence89 60;
BA_ "GenSigCycleTime" SG_ 554 FR_FreespaceSectorDistance89 60;
BA_ "GenSigCycleTime" SG_ 554 FR_FreespaceSectorKinestate88 60;
BA_ "GenSigCycleTime" SG_ 554 FR_FreespaceSectorConRidence88 60;
BA_ "GenSigCycleTime" SG_ 554 FR_FreespaceSectorDistance88 60;
BA_ "GenSigCycleTime" SG_ 554 FR_FreespaceSectorKinestate87 60;
BA_ "GenSigCycleTime" SG_ 554 FR_FreespaceSectorConRidence87 60;
BA_ "GenSigCycleTime" SG_ 554 FR_FreespaceSectorDistance87 60;
BA_ "GenSigCycleTime" SG_ 554 FR_FreespaceSectorKinestate86 60;
BA_ "GenSigCycleTime" SG_ 554 FR_FreespaceSectorConRidence86 60;
BA_ "GenSigCycleTime" SG_ 554 FR_FreespaceSectorDistance86 60;
BA_ "GenSigCycleTime" SG_ 554 FR_FreespaceSectorKinestate85 60;
BA_ "GenSigCycleTime" SG_ 554 FR_FreespaceSectorConRidence85 60;
BA_ "GenSigCycleTime" SG_ 554 FR_FreespaceSectorDistance85 60;
BA_ "GenSigCycleTime" SG_ 554 FR_FreespaceSectorKinestate84 60;
BA_ "GenSigCycleTime" SG_ 554 FR_FreespaceSectorConRidence84 60;
BA_ "GenSigCycleTime" SG_ 554 FR_FreespaceSectorDistance84 60;
BA_ "GenSigCycleTime" SG_ 554 FR_FreespaceSectorKinestate83 60;
BA_ "GenSigCycleTime" SG_ 554 FR_FreespaceSectorConRidence83 60;
BA_ "GenSigCycleTime" SG_ 554 FR_FreespaceSectorDistance83 60;
BA_ "GenSigCycleTime" SG_ 554 FR_FreespaceSectorKinestate82 60;
BA_ "GenSigCycleTime" SG_ 554 FR_FreespaceSectorConRidence82 60;
BA_ "GenSigCycleTime" SG_ 554 FR_FreespaceSectorDistance82 60;
BA_ "GenSigCycleTime" SG_ 554 FR_FreespaceSectorKinestate81 60;
BA_ "GenSigCycleTime" SG_ 554 FR_FreespaceSectorConRidence81 60;
BA_ "GenSigCycleTime" SG_ 554 FR_FreespaceSectorDistance81 60;
BA_ "GenSigCycleTime" SG_ 554 FR_FreespaceSectorKinestate80 60;
BA_ "GenSigCycleTime" SG_ 554 FR_FreespaceSectorConRidence80 60;
BA_ "GenSigCycleTime" SG_ 554 FR_FreespaceSectorDistance80 60;
BA_ "GenSigCycleTime" SG_ 554 FR_FreespaceSectorKinestate79 60;
BA_ "GenSigCycleTime" SG_ 554 FR_FreespaceSectorConRidence79 60;
BA_ "GenSigCycleTime" SG_ 554 FR_FreespaceSectorDistance79 60;
BA_ "GenSigCycleTime" SG_ 554 FR_FreespaceSectorKinestate78 60;
BA_ "GenSigCycleTime" SG_ 554 FR_FreespaceSectorConRidence78 60;
BA_ "GenSigCycleTime" SG_ 554 FR_FreespaceSectorDistance78 60;
BA_ "GenSigCycleTime" SG_ 554 FR_FreespaceSectorKinestate77 60;
BA_ "GenSigCycleTime" SG_ 554 FR_FreespaceSectorConRidence77 60;
BA_ "GenSigCycleTime" SG_ 554 FR_FreespaceSectorDistance77 60;
BA_ "GenSigCycleTime" SG_ 554 FR_FreespaceSectorKinestate76 60;
BA_ "GenSigCycleTime" SG_ 554 FR_FreespaceSectorConRidence76 60;
BA_ "GenSigCycleTime" SG_ 554 FR_FreespaceSectorDistance76 60;
BA_ "GenSigCycleTime" SG_ 554 FR_FreespaceSectorKinestate75 60;
BA_ "GenSigCycleTime" SG_ 554 FR_FreespaceSectorConRidence75 60;
BA_ "GenSigCycleTime" SG_ 554 FR_FreespaceSectorDistance75 60;
BA_ "GenSigCycleTime" SG_ 554 FR_FreespaceSectorKinestate74 60;
BA_ "GenSigCycleTime" SG_ 554 FR_FreespaceSectorConRidence74 60;
BA_ "GenSigCycleTime" SG_ 554 FR_FreespaceSectorDistance74 60;
BA_ "GenSigCycleTime" SG_ 554 FR_FreespaceSectorKinestate73 60;
BA_ "GenSigCycleTime" SG_ 554 FR_FreespaceSectorConRidence73 60;
BA_ "GenSigCycleTime" SG_ 554 FR_FreespaceSectorDistance73 60;
BA_ "GenSigCycleTime" SG_ 554 FR_FreespaceSectorKinestate72 60;
BA_ "GenSigCycleTime" SG_ 554 FR_FreespaceSectorConRidence72 60;
BA_ "GenSigCycleTime" SG_ 554 FR_FreespaceSectorDistance72 60;
BA_ "GenSigCycleTime" SG_ 554 FR_FreespaceSectorKinestate71 60;
BA_ "GenSigCycleTime" SG_ 554 FR_FreespaceSectorConRidence71 60;
BA_ "GenSigCycleTime" SG_ 554 FR_FreespaceSectorDistance71 60;
BA_ "GenSigCycleTime" SG_ 554 FR_FreespaceSectorKinestate70 60;
BA_ "GenSigCycleTime" SG_ 554 FR_FreespaceSectorConRidence70 60;
BA_ "GenSigCycleTime" SG_ 554 FR_FreespaceSectorDistance70 60;
BA_ "GenSigCycleTime" SG_ 554 FR_FreespaceSectorKinestate69 60;
BA_ "GenSigCycleTime" SG_ 554 FR_FreespaceSectorConRidence69 60;
BA_ "GenSigCycleTime" SG_ 554 FR_FreespaceSectorDistance69 60;
BA_ "GenSigCycleTime" SG_ 555 FR_CRCCheck_22B 60;
BA_ "GenSigCycleTime" SG_ 555 FR_RollingCounter_22B 60;
BA_ "GenSigCycleTime" SG_ 555 FR_FreespaceSectorKinestate136 60;
BA_ "GenSigCycleTime" SG_ 555 FR_FreespaceSectorConRidence136 60;
BA_ "GenSigCycleTime" SG_ 555 FR_FreespaceSectorDistance136 60;
BA_ "GenSigCycleTime" SG_ 555 FR_FreespaceSectorKinestate135 60;
BA_ "GenSigCycleTime" SG_ 555 FR_FreespaceSectorConRidence135 60;
BA_ "GenSigCycleTime" SG_ 555 FR_FreespaceSectorDistance135 60;
BA_ "GenSigCycleTime" SG_ 555 FR_FreespaceSectorKinestate134 60;
BA_ "GenSigCycleTime" SG_ 555 FR_FreespaceSectorConRidence134 60;
BA_ "GenSigCycleTime" SG_ 555 FR_FreespaceSectorDistance134 60;
BA_ "GenSigCycleTime" SG_ 555 FR_FreespaceSectorKinestate133 60;
BA_ "GenSigCycleTime" SG_ 555 FR_FreespaceSectorConRidence133 60;
BA_ "GenSigCycleTime" SG_ 555 FR_FreespaceSectorDistance133 60;
BA_ "GenSigCycleTime" SG_ 555 FR_FreespaceSectorKinestate132 60;
BA_ "GenSigCycleTime" SG_ 555 FR_FreespaceSectorConRidence132 60;
BA_ "GenSigCycleTime" SG_ 555 FR_FreespaceSectorDistance132 60;
BA_ "GenSigCycleTime" SG_ 555 FR_FreespaceSectorKinestate131 60;
BA_ "GenSigCycleTime" SG_ 555 FR_FreespaceSectorConRidence131 60;
BA_ "GenSigCycleTime" SG_ 555 FR_FreespaceSectorDistance131 60;
BA_ "GenSigCycleTime" SG_ 555 FR_FreespaceSectorKinestate130 60;
BA_ "GenSigCycleTime" SG_ 555 FR_FreespaceSectorConRidence130 60;
BA_ "GenSigCycleTime" SG_ 555 FR_FreespaceSectorDistance130 60;
BA_ "GenSigCycleTime" SG_ 555 FR_FreespaceSectorKinestate129 60;
BA_ "GenSigCycleTime" SG_ 555 FR_FreespaceSectorConRidence129 60;
BA_ "GenSigCycleTime" SG_ 555 FR_FreespaceSectorDistance129 60;
BA_ "GenSigCycleTime" SG_ 555 FR_FreespaceSectorKinestate128 60;
BA_ "GenSigCycleTime" SG_ 555 FR_FreespaceSectorConRidence128 60;
BA_ "GenSigCycleTime" SG_ 555 FR_FreespaceSectorDistance128 60;
BA_ "GenSigCycleTime" SG_ 555 FR_FreespaceSectorKinestate127 60;
BA_ "GenSigCycleTime" SG_ 555 FR_FreespaceSectorConRidence127 60;
BA_ "GenSigCycleTime" SG_ 555 FR_FreespaceSectorDistance127 60;
BA_ "GenSigCycleTime" SG_ 555 FR_FreespaceSectorKinestate126 60;
BA_ "GenSigCycleTime" SG_ 555 FR_FreespaceSectorConRidence126 60;
BA_ "GenSigCycleTime" SG_ 555 FR_FreespaceSectorDistance126 60;
BA_ "GenSigCycleTime" SG_ 555 FR_FreespaceSectorKinestate125 60;
BA_ "GenSigCycleTime" SG_ 555 FR_FreespaceSectorConRidence125 60;
BA_ "GenSigCycleTime" SG_ 555 FR_FreespaceSectorDistance125 60;
BA_ "GenSigCycleTime" SG_ 555 FR_FreespaceSectorKinestate124 60;
BA_ "GenSigCycleTime" SG_ 555 FR_FreespaceSectorConRidence124 60;
BA_ "GenSigCycleTime" SG_ 555 FR_FreespaceSectorDistance124 60;
BA_ "GenSigCycleTime" SG_ 555 FR_FreespaceSectorKinestate123 60;
BA_ "GenSigCycleTime" SG_ 555 FR_FreespaceSectorConRidence123 60;
BA_ "GenSigCycleTime" SG_ 555 FR_FreespaceSectorDistance123 60;
BA_ "GenSigCycleTime" SG_ 555 FR_FreespaceSectorKinestate122 60;
BA_ "GenSigCycleTime" SG_ 555 FR_FreespaceSectorConRidence122 60;
BA_ "GenSigCycleTime" SG_ 555 FR_FreespaceSectorDistance122 60;
BA_ "GenSigCycleTime" SG_ 555 FR_FreespaceSectorKinestate121 60;
BA_ "GenSigCycleTime" SG_ 555 FR_FreespaceSectorConRidence121 60;
BA_ "GenSigCycleTime" SG_ 555 FR_FreespaceSectorDistance121 60;
BA_ "GenSigCycleTime" SG_ 555 FR_FreespaceSectorKinestate120 60;
BA_ "GenSigCycleTime" SG_ 555 FR_FreespaceSectorConRidence120 60;
BA_ "GenSigCycleTime" SG_ 555 FR_FreespaceSectorDistance120 60;
BA_ "GenSigCycleTime" SG_ 555 FR_FreespaceSectorKinestate119 60;
BA_ "GenSigCycleTime" SG_ 555 FR_FreespaceSectorConRidence119 60;
BA_ "GenSigCycleTime" SG_ 555 FR_FreespaceSectorDistance119 60;
BA_ "GenSigCycleTime" SG_ 555 FR_FreespaceSectorKinestate118 60;
BA_ "GenSigCycleTime" SG_ 555 FR_FreespaceSectorConRidence118 60;
BA_ "GenSigCycleTime" SG_ 555 FR_FreespaceSectorDistance118 60;
BA_ "GenSigCycleTime" SG_ 555 FR_FreespaceSectorKinestate117 60;
BA_ "GenSigCycleTime" SG_ 555 FR_FreespaceSectorConRidence117 60;
BA_ "GenSigCycleTime" SG_ 555 FR_FreespaceSectorDistance117 60;
BA_ "GenSigCycleTime" SG_ 555 FR_FreespaceSectorKinestate116 60;
BA_ "GenSigCycleTime" SG_ 555 FR_FreespaceSectorConRidence116 60;
BA_ "GenSigCycleTime" SG_ 555 FR_FreespaceSectorDistance116 60;
BA_ "GenSigCycleTime" SG_ 555 FR_FreespaceSectorKinestate115 60;
BA_ "GenSigCycleTime" SG_ 555 FR_FreespaceSectorConRidence115 60;
BA_ "GenSigCycleTime" SG_ 555 FR_FreespaceSectorDistance115 60;
BA_ "GenSigCycleTime" SG_ 555 FR_FreespaceSectorKinestate114 60;
BA_ "GenSigCycleTime" SG_ 555 FR_FreespaceSectorConRidence114 60;
BA_ "GenSigCycleTime" SG_ 555 FR_FreespaceSectorDistance114 60;
BA_ "GenSigCycleTime" SG_ 555 FR_FreespaceSectorKinestate113 60;
BA_ "GenSigCycleTime" SG_ 555 FR_FreespaceSectorConRidence113 60;
BA_ "GenSigCycleTime" SG_ 555 FR_FreespaceSectorDistance113 60;
BA_ "GenSigCycleTime" SG_ 555 FR_FreespaceSectorKinestate112 60;
BA_ "GenSigCycleTime" SG_ 555 FR_FreespaceSectorConRidence112 60;
BA_ "GenSigCycleTime" SG_ 555 FR_FreespaceSectorDistance112 60;
BA_ "GenSigCycleTime" SG_ 555 FR_FreespaceSectorKinestate111 60;
BA_ "GenSigCycleTime" SG_ 555 FR_FreespaceSectorConRidence111 60;
BA_ "GenSigCycleTime" SG_ 555 FR_FreespaceSectorDistance111 60;
BA_ "GenSigCycleTime" SG_ 555 FR_FreespaceSectorKinestate110 60;
BA_ "GenSigCycleTime" SG_ 555 FR_FreespaceSectorConRidence110 60;
BA_ "GenSigCycleTime" SG_ 555 FR_FreespaceSectorDistance110 60;
BA_ "GenSigCycleTime" SG_ 555 FR_FreespaceSectorKinestate109 60;
BA_ "GenSigCycleTime" SG_ 555 FR_FreespaceSectorConRidence109 60;
BA_ "GenSigCycleTime" SG_ 555 FR_FreespaceSectorDistance109 60;
BA_ "GenSigCycleTime" SG_ 555 FR_FreespaceSectorKinestate108 60;
BA_ "GenSigCycleTime" SG_ 555 FR_FreespaceSectorConRidence108 60;
BA_ "GenSigCycleTime" SG_ 555 FR_FreespaceSectorDistance108 60;
BA_ "GenSigCycleTime" SG_ 555 FR_FreespaceSectorKinestate107 60;
BA_ "GenSigCycleTime" SG_ 555 FR_FreespaceSectorConRidence107 60;
BA_ "GenSigCycleTime" SG_ 555 FR_FreespaceSectorDistance107 60;
BA_ "GenSigCycleTime" SG_ 555 FR_FreespaceSectorKinestate106 60;
BA_ "GenSigCycleTime" SG_ 555 FR_FreespaceSectorConRidence106 60;
BA_ "GenSigCycleTime" SG_ 555 FR_FreespaceSectorDistance106 60;
BA_ "GenSigCycleTime" SG_ 555 FR_FreespaceSectorKinestate105 60;
BA_ "GenSigCycleTime" SG_ 555 FR_FreespaceSectorConRidence105 60;
BA_ "GenSigCycleTime" SG_ 555 FR_FreespaceSectorDistance105 60;
BA_ "GenSigCycleTime" SG_ 555 FR_FreespaceSectorKinestate104 60;
BA_ "GenSigCycleTime" SG_ 555 FR_FreespaceSectorConRidence104 60;
BA_ "GenSigCycleTime" SG_ 555 FR_FreespaceSectorDistance104 60;
BA_ "GenSigCycleTime" SG_ 555 FR_FreespaceSectorKinestate103 60;
BA_ "GenSigCycleTime" SG_ 555 FR_FreespaceSectorConRidence103 60;
BA_ "GenSigCycleTime" SG_ 555 FR_FreespaceSectorDistance103 60;
BA_ "GenSigCycleTime" SG_ 556 FR_CRCCheck_22C 60;
BA_ "GenSigCycleTime" SG_ 556 FR_RollingCounter_22C 60;
BA_ "GenSigCycleTime" SG_ 556 FR_FreespaceSectorKinestate170 60;
BA_ "GenSigCycleTime" SG_ 556 FR_FreespaceSectorConRidence170 60;
BA_ "GenSigCycleTime" SG_ 556 FR_FreespaceSectorDistance170 60;
BA_ "GenSigCycleTime" SG_ 556 FR_FreespaceSectorKinestate169 60;
BA_ "GenSigCycleTime" SG_ 556 FR_FreespaceSectorConRidence169 60;
BA_ "GenSigCycleTime" SG_ 556 FR_FreespaceSectorDistance169 60;
BA_ "GenSigCycleTime" SG_ 556 FR_FreespaceSectorKinestate168 60;
BA_ "GenSigCycleTime" SG_ 556 FR_FreespaceSectorConRidence168 60;
BA_ "GenSigCycleTime" SG_ 556 FR_FreespaceSectorDistance168 60;
BA_ "GenSigCycleTime" SG_ 556 FR_FreespaceSectorKinestate167 60;
BA_ "GenSigCycleTime" SG_ 556 FR_FreespaceSectorConRidence167 60;
BA_ "GenSigCycleTime" SG_ 556 FR_FreespaceSectorDistance167 60;
BA_ "GenSigCycleTime" SG_ 556 FR_FreespaceSectorKinestate166 60;
BA_ "GenSigCycleTime" SG_ 556 FR_FreespaceSectorConRidence166 60;
BA_ "GenSigCycleTime" SG_ 556 FR_FreespaceSectorDistance166 60;
BA_ "GenSigCycleTime" SG_ 556 FR_FreespaceSectorKinestate165 60;
BA_ "GenSigCycleTime" SG_ 556 FR_FreespaceSectorConRidence165 60;
BA_ "GenSigCycleTime" SG_ 556 FR_FreespaceSectorDistance165 60;
BA_ "GenSigCycleTime" SG_ 556 FR_FreespaceSectorKinestate164 60;
BA_ "GenSigCycleTime" SG_ 556 FR_FreespaceSectorConRidence164 60;
BA_ "GenSigCycleTime" SG_ 556 FR_FreespaceSectorDistance164 60;
BA_ "GenSigCycleTime" SG_ 556 FR_FreespaceSectorKinestate163 60;
BA_ "GenSigCycleTime" SG_ 556 FR_FreespaceSectorConRidence163 60;
BA_ "GenSigCycleTime" SG_ 556 FR_FreespaceSectorDistance163 60;
BA_ "GenSigCycleTime" SG_ 556 FR_FreespaceSectorKinestate162 60;
BA_ "GenSigCycleTime" SG_ 556 FR_FreespaceSectorConRidence162 60;
BA_ "GenSigCycleTime" SG_ 556 FR_FreespaceSectorDistance162 60;
BA_ "GenSigCycleTime" SG_ 556 FR_FreespaceSectorKinestate161 60;
BA_ "GenSigCycleTime" SG_ 556 FR_FreespaceSectorConRidence161 60;
BA_ "GenSigCycleTime" SG_ 556 FR_FreespaceSectorDistance161 60;
BA_ "GenSigCycleTime" SG_ 556 FR_FreespaceSectorKinestate160 60;
BA_ "GenSigCycleTime" SG_ 556 FR_FreespaceSectorConRidence160 60;
BA_ "GenSigCycleTime" SG_ 556 FR_FreespaceSectorDistance160 60;
BA_ "GenSigCycleTime" SG_ 556 FR_FreespaceSectorKinestate159 60;
BA_ "GenSigCycleTime" SG_ 556 FR_FreespaceSectorConRidence159 60;
BA_ "GenSigCycleTime" SG_ 556 FR_FreespaceSectorDistance159 60;
BA_ "GenSigCycleTime" SG_ 556 FR_FreespaceSectorKinestate158 60;
BA_ "GenSigCycleTime" SG_ 556 FR_FreespaceSectorConRidence158 60;
BA_ "GenSigCycleTime" SG_ 556 FR_FreespaceSectorDistance158 60;
BA_ "GenSigCycleTime" SG_ 556 FR_FreespaceSectorKinestate157 60;
BA_ "GenSigCycleTime" SG_ 556 FR_FreespaceSectorConRidence157 60;
BA_ "GenSigCycleTime" SG_ 556 FR_FreespaceSectorDistance157 60;
BA_ "GenSigCycleTime" SG_ 556 FR_FreespaceSectorKinestate156 60;
BA_ "GenSigCycleTime" SG_ 556 FR_FreespaceSectorConRidence156 60;
BA_ "GenSigCycleTime" SG_ 556 FR_FreespaceSectorDistance156 60;
BA_ "GenSigCycleTime" SG_ 556 FR_FreespaceSectorKinestate155 60;
BA_ "GenSigCycleTime" SG_ 556 FR_FreespaceSectorConRidence155 60;
BA_ "GenSigCycleTime" SG_ 556 FR_FreespaceSectorDistance155 60;
BA_ "GenSigCycleTime" SG_ 556 FR_FreespaceSectorKinestate154 60;
BA_ "GenSigCycleTime" SG_ 556 FR_FreespaceSectorConRidence154 60;
BA_ "GenSigCycleTime" SG_ 556 FR_FreespaceSectorDistance154 60;
BA_ "GenSigCycleTime" SG_ 556 FR_FreespaceSectorKinestate153 60;
BA_ "GenSigCycleTime" SG_ 556 FR_FreespaceSectorConRidence153 60;
BA_ "GenSigCycleTime" SG_ 556 FR_FreespaceSectorDistance153 60;
BA_ "GenSigCycleTime" SG_ 556 FR_FreespaceSectorKinestate152 60;
BA_ "GenSigCycleTime" SG_ 556 FR_FreespaceSectorConRidence152 60;
BA_ "GenSigCycleTime" SG_ 556 FR_FreespaceSectorDistance152 60;
BA_ "GenSigCycleTime" SG_ 556 FR_FreespaceSectorKinestate151 60;
BA_ "GenSigCycleTime" SG_ 556 FR_FreespaceSectorConRidence151 60;
BA_ "GenSigCycleTime" SG_ 556 FR_FreespaceSectorDistance151 60;
BA_ "GenSigCycleTime" SG_ 556 FR_FreespaceSectorKinestate150 60;
BA_ "GenSigCycleTime" SG_ 556 FR_FreespaceSectorConRidence150 60;
BA_ "GenSigCycleTime" SG_ 556 FR_FreespaceSectorDistance150 60;
BA_ "GenSigCycleTime" SG_ 556 FR_FreespaceSectorKinestate149 60;
BA_ "GenSigCycleTime" SG_ 556 FR_FreespaceSectorConRidence149 60;
BA_ "GenSigCycleTime" SG_ 556 FR_FreespaceSectorDistance149 60;
BA_ "GenSigCycleTime" SG_ 556 FR_FreespaceSectorKinestate148 60;
BA_ "GenSigCycleTime" SG_ 556 FR_FreespaceSectorConRidence148 60;
BA_ "GenSigCycleTime" SG_ 556 FR_FreespaceSectorDistance148 60;
BA_ "GenSigCycleTime" SG_ 556 FR_FreespaceSectorKinestate147 60;
BA_ "GenSigCycleTime" SG_ 556 FR_FreespaceSectorConRidence147 60;
BA_ "GenSigCycleTime" SG_ 556 FR_FreespaceSectorDistance147 60;
BA_ "GenSigCycleTime" SG_ 556 FR_FreespaceSectorKinestate146 60;
BA_ "GenSigCycleTime" SG_ 556 FR_FreespaceSectorConRidence146 60;
BA_ "GenSigCycleTime" SG_ 556 FR_FreespaceSectorDistance146 60;
BA_ "GenSigCycleTime" SG_ 556 FR_FreespaceSectorKinestate145 60;
BA_ "GenSigCycleTime" SG_ 556 FR_FreespaceSectorConRidence145 60;
BA_ "GenSigCycleTime" SG_ 556 FR_FreespaceSectorDistance145 60;
BA_ "GenSigCycleTime" SG_ 556 FR_FreespaceSectorKinestate144 60;
BA_ "GenSigCycleTime" SG_ 556 FR_FreespaceSectorConRidence144 60;
BA_ "GenSigCycleTime" SG_ 556 FR_FreespaceSectorDistance144 60;
BA_ "GenSigCycleTime" SG_ 556 FR_FreespaceSectorKinestate143 60;
BA_ "GenSigCycleTime" SG_ 556 FR_FreespaceSectorConRidence143 60;
BA_ "GenSigCycleTime" SG_ 556 FR_FreespaceSectorDistance143 60;
BA_ "GenSigCycleTime" SG_ 556 FR_FreespaceSectorKinestate142 60;
BA_ "GenSigCycleTime" SG_ 556 FR_FreespaceSectorConRidence142 60;
BA_ "GenSigCycleTime" SG_ 556 FR_FreespaceSectorDistance142 60;
BA_ "GenSigCycleTime" SG_ 556 FR_FreespaceSectorKinestate141 60;
BA_ "GenSigCycleTime" SG_ 556 FR_FreespaceSectorConRidence141 60;
BA_ "GenSigCycleTime" SG_ 556 FR_FreespaceSectorDistance141 60;
BA_ "GenSigCycleTime" SG_ 556 FR_FreespaceSectorKinestate140 60;
BA_ "GenSigCycleTime" SG_ 556 FR_FreespaceSectorConRidence140 60;
BA_ "GenSigCycleTime" SG_ 556 FR_FreespaceSectorDistance140 60;
BA_ "GenSigCycleTime" SG_ 556 FR_FreespaceSectorKinestate139 60;
BA_ "GenSigCycleTime" SG_ 556 FR_FreespaceSectorConRidence139 60;
BA_ "GenSigCycleTime" SG_ 556 FR_FreespaceSectorDistance139 60;
BA_ "GenSigCycleTime" SG_ 556 FR_FreespaceSectorKinestate138 60;
BA_ "GenSigCycleTime" SG_ 556 FR_FreespaceSectorConRidence138 60;
BA_ "GenSigCycleTime" SG_ 556 FR_FreespaceSectorDistance138 60;
BA_ "GenSigCycleTime" SG_ 556 FR_FreespaceSectorKinestate137 60;
BA_ "GenSigCycleTime" SG_ 556 FR_FreespaceSectorConRidence137 60;
BA_ "GenSigCycleTime" SG_ 556 FR_FreespaceSectorDistance137 60;
VAL_ 518 FR_H_SwVers6 48 "0
0x31=1
0x32=2
0x33=3
0x34=4
0x35=5
0x36=6
0x37=7
0x38=8
0x39=9
0x41=A
0x42=B
0x43=C
0x44=D
0x45=E
0x46=F
0x47=G
0x48=H
0x49=I
0x4A=J
0x4B=K
0x4C=L
0x4D=M
0x4E=N
0x4F=O
0x50=P
0x51=Q
0x52=R
0x53=S
0x54=T
0x55=U
0x56=V
0x57=W
0x58=X
0x59=Y
0x5A=Z" ;
VAL_ 518 FR_H_SwVers5 46 "." ;
VAL_ 518 FR_H_SwVers4 48 "0
0x31=1
0x32=2
0x33=3
0x34=4
0x35=5
0x36=6
0x37=7
0x38=8
0x39=9
0x41=A
0x42=B
0x43=C
0x44=D
0x45=E
0x46=F
0x47=G
0x48=H
0x49=I
0x4A=J
0x4B=K
0x4C=L
0x4D=M
0x4E=N
0x4F=O
0x50=P
0x51=Q
0x52=R
0x53=S
0x54=T
0x55=U
0x56=V
0x57=W
0x58=X
0x59=Y
0x5A=Z" ;
VAL_ 518 FR_H_SwVers3 46 "." ;
VAL_ 518 FR_H_SwVers2 48 "0
0x31=1
0x32=2
0x33=3
0x34=4
0x35=5
0x36=6
0x37=7
0x38=8
0x39=9
0x41=A
0x42=B
0x43=C
0x44=D
0x45=E
0x46=F
0x47=G
0x48=H
0x49=I
0x4A=J
0x4B=K
0x4C=L
0x4D=M
0x4E=N
0x4F=O
0x50=P
0x51=Q
0x52=R
0x53=S
0x54=T
0x55=U
0x56=V
0x57=W
0x58=X
0x59=Y
0x5A=Z" ;
VAL_ 518 FR_H_SwVers1 87 "W" ;
VAL_ 518 FR_H_SwVers0 83 "S" ;
VAL_ 518 FR_H_HwVers6 48 "0
0x31=1
0x32=2
0x33=3
0x34=4
0x35=5
0x36=6
0x37=7
0x38=8
0x39=9
0x41=A
0x42=B
0x43=C
0x44=D
0x45=E
0x46=F
0x47=G
0x48=H
0x49=I
0x4A=J
0x4B=K
0x4C=L
0x4D=M
0x4E=N
0x4F=O
0x50=P
0x51=Q
0x52=R
0x53=S
0x54=T
0x55=U
0x56=V
0x57=W
0x58=X
0x59=Y
0x5A=Z" ;
VAL_ 518 FR_H_HwVers5 46 "." ;
VAL_ 518 FR_H_HwVers4 48 "0
0x31=1
0x32=2
0x33=3
0x34=4
0x35=5
0x36=6
0x37=7
0x38=8
0x39=9
0x41=A
0x42=B
0x43=C
0x44=D
0x45=E
0x46=F
0x47=G
0x48=H
0x49=I
0x4A=J
0x4B=K
0x4C=L
0x4D=M
0x4E=N
0x4F=O
0x50=P
0x51=Q
0x52=R
0x53=S
0x54=T
0x55=U
0x56=V
0x57=W
0x58=X
0x59=Y
0x5A=Z" ;
VAL_ 518 FR_H_HwVers3 46 "." ;
VAL_ 518 FR_H_HwVers2 48 "0
0x31=1
0x32=2
0x33=3
0x34=4
0x35=5
0x36=6
0x37=7
0x38=8
0x39=9
0x41=A
0x42=B
0x43=C
0x44=D
0x45=E
0x46=F
0x47=G
0x48=H
0x49=I
0x4A=J
0x4B=K
0x4C=L
0x4D=M
0x4E=N
0x4F=O
0x50=P
0x51=Q
0x52=R
0x53=S
0x54=T
0x55=U
0x56=V
0x57=W
0x58=X
0x59=Y
0x5A=Z" ;
VAL_ 518 FR_H_HwVers1 87 "W" ;
VAL_ 518 FR_H_HwVers0 72 "H" ;
VAL_ 544 FR_Obj25_ReferPoint_Dx 0 "参考点未知
0x1=后方左角点
0x2=后方中心
0x3=后方右角点
0x4=左边中心
0x5=中心
0x6=右边中心
0x7=前方左角点
0x8=前方中心
0x9=前方右角点
0x10=前轮
0x11=后轮
0x12=内部轮" ;
VAL_ 544 FR_Obj25_MotionStatus 0 "unknown" 1 "moving " 2 "stopped" 3 "stationary" 4 "crossing" 5 "reserve;" ;
VAL_ 544 FR_Obj25_Measured 0 "unknown" 1 "Measured" 2 "Predicted" 3 "Reserved" ;
VAL_ 544 FR_Obj25_valid 0 "" ;
VAL_ 544 FR_Obj25_Type 0 "Not Detected" 1 "car" 2 "truck" 3 "bicycle/motorbike" 4 "pedestrian" 5 "tricycle" 6 "animal" 7 "uncertain" ;
VAL_ 545 FR_Obj26_ReferPoint_Dx 0 "参考点未知
0x1=后方左角点
0x2=后方中心
0x3=后方右角点
0x4=左边中心
0x5=中心
0x6=右边中心
0x7=前方左角点
0x8=前方中心
0x9=前方右角点
0x10=前轮
0x11=后轮
0x12=内部轮" ;
VAL_ 545 FR_Obj26_MotionStatus 0 "unknown" 1 "moving " 2 "stopped" 3 "stationary" 4 "crossing" 5 "reserve;" ;
VAL_ 545 FR_Obj26_Measured 0 "unknown" 1 "Measured" 2 "Predicted" 3 "Reserved" ;
VAL_ 545 FR_Obj26_valid 0 "" ;
VAL_ 545 FR_Obj26_Type 0 "Not Detected" 1 "car" 2 "truck" 3 "bicycle/motorbike" 4 "pedestrian" 5 "tricycle" 6 "animal" 7 "uncertain" ;
VAL_ 546 FR_Obj27_ReferPoint_Dx 0 "参考点未知
0x1=后方左角点
0x2=后方中心
0x3=后方右角点
0x4=左边中心
0x5=中心
0x6=右边中心
0x7=前方左角点
0x8=前方中心
0x9=前方右角点
0x10=前轮
0x11=后轮
0x12=内部轮" ;
VAL_ 546 FR_Obj27_MotionStatus 0 "unknown" 1 "moving " 2 "stopped" 3 "stationary" 4 "crossing" 5 "reserve;" ;
VAL_ 546 FR_Obj27_Measured 0 "unknown" 1 "Measured" 2 "Predicted" 3 "Reserved" ;
VAL_ 546 FR_Obj27_valid 0 "" ;
VAL_ 546 FR_Obj27_Type 0 "Not Detected" 1 "car" 2 "truck" 3 "bicycle/motorbike" 4 "pedestrian" 5 "tricycle" 6 "animal" 7 "uncertain" ;
VAL_ 547 FR_Obj28_ReferPoint_Dx 0 "参考点未知
0x1=后方左角点
0x2=后方中心
0x3=后方右角点
0x4=左边中心
0x5=中心
0x6=右边中心
0x7=前方左角点
0x8=前方中心
0x9=前方右角点
0x10=前轮
0x11=后轮
0x12=内部轮" ;
VAL_ 547 FR_Obj28_MotionStatus 0 "unknown" 1 "moving " 2 "stopped" 3 "stationary" 4 "crossing" 5 "reserve;" ;
VAL_ 547 FR_Obj28_Measured 0 "unknown" 1 "Measured" 2 "Predicted" 3 "Reserved" ;
VAL_ 547 FR_Obj28_valid 0 "" ;
VAL_ 547 FR_Obj28_Type 0 "Not Detected" 1 "car" 2 "truck" 3 "bicycle/motorbike" 4 "pedestrian" 5 "tricycle" 6 "animal" 7 "uncertain" ;
VAL_ 548 FR_Obj29_ReferPoint_Dx 0 "参考点未知
0x1=后方左角点
0x2=后方中心
0x3=后方右角点
0x4=左边中心
0x5=中心
0x6=右边中心
0x7=前方左角点
0x8=前方中心
0x9=前方右角点
0x10=前轮
0x11=后轮
0x12=内部轮" ;
VAL_ 548 FR_Obj29_MotionStatus 0 "unknown" 1 "moving " 2 "stopped" 3 "stationary" 4 "crossing" 5 "reserve;" ;
VAL_ 548 FR_Obj29_Measured 0 "unknown" 1 "Measured" 2 "Predicted" 3 "Reserved" ;
VAL_ 548 FR_Obj29_valid 0 "" ;
VAL_ 548 FR_Obj29_Type 0 "Not Detected" 1 "car" 2 "truck" 3 "bicycle/motorbike" 4 "pedestrian" 5 "tricycle" 6 "animal" 7 "uncertain" ;
VAL_ 549 FR_Obj30_ReferPoint_Dx 0 "参考点未知
0x1=后方左角点
0x2=后方中心
0x3=后方右角点
0x4=左边中心
0x5=中心
0x6=右边中心
0x7=前方左角点
0x8=前方中心
0x9=前方右角点
0x10=前轮
0x11=后轮
0x12=内部轮" ;
VAL_ 549 FR_Obj30_MotionStatus 0 "unknown" 1 "moving " 2 "stopped" 3 "stationary" 4 "crossing" 5 "reserve;" ;
VAL_ 549 FR_Obj30_Measured 0 "unknown" 1 "Measured" 2 "Predicted" 3 "Reserved" ;
VAL_ 549 FR_Obj30_valid 0 "" ;
VAL_ 549 FR_Obj30_Type 0 "Not Detected" 1 "car" 2 "truck" 3 "bicycle/motorbike" 4 "pedestrian" 5 "tricycle" 6 "animal" 7 "uncertain" ;
VAL_ 550 FR_Obj31_ReferPoint_Dx 0 "参考点未知
0x1=后方左角点
0x2=后方中心
0x3=后方右角点
0x4=左边中心
0x5=中心
0x6=右边中心
0x7=前方左角点
0x8=前方中心
0x9=前方右角点
0x10=前轮
0x11=后轮
0x12=内部轮" ;
VAL_ 550 FR_Obj31_MotionStatus 0 "unknown" 1 "moving " 2 "stopped" 3 "stationary" 4 "crossing" 5 "reserve;" ;
VAL_ 550 FR_Obj31_Measured 0 "unknown" 1 "Measured" 2 "Predicted" 3 "Reserved" ;
VAL_ 550 FR_Obj31_valid 0 "" ;
VAL_ 550 FR_Obj31_Type 0 "Not Detected" 1 "car" 2 "truck" 3 "bicycle/motorbike" 4 "pedestrian" 5 "tricycle" 6 "animal" 7 "uncertain" ;
VAL_ 551 FR_Obj32_ReferPoint_Dx 0 "参考点未知
0x1=后方左角点
0x2=后方中心
0x3=后方右角点
0x4=左边中心
0x5=中心
0x6=右边中心
0x7=前方左角点
0x8=前方中心
0x9=前方右角点
0x10=前轮
0x11=后轮
0x12=内部轮" ;
VAL_ 551 FR_Obj32_MotionStatus 0 "unknown" 1 "moving " 2 "stopped" 3 "stationary" 4 "crossing" 5 "reserve;" ;
VAL_ 551 FR_Obj32_Measured 0 "unknown" 1 "Measured" 2 "Predicted" 3 "Reserved" ;
VAL_ 551 FR_Obj32_valid 0 "" ;
VAL_ 551 FR_Obj32_Type 0 "Not Detected" 1 "car" 2 "truck" 3 "bicycle/motorbike" 4 "pedestrian" 5 "tricycle" 6 "animal" 7 "uncertain" ;
