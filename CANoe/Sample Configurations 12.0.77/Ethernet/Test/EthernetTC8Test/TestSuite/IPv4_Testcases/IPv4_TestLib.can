/*@!Encoding:1252*/
/***************************************************************************************
 * Demo- and Example-Programs
 *
 * Please note: The demo and example programs only show special aspects of the software.
 * With regard to the fact that these programs are meant for demonstration purposes only,
 * Vector Informatik´s liability shall be expressly excluded in cases of ordinary
 * negligence, to the extent admissible by law or statute.
 *
 * Beta-Version
 *
 * These programs are fully operative programs. However, they are not thoroughly tested
 * yet (beta-version). With regard to the fact that the programs are a beta-version only,
 * Vector Informatik´s liability shall be expressly excluded in cases of ordinary
 * negligence, to the extent admissible by law or statute.
 *
 * DESCRIPTION:
 *
 * Demo test implementation of the 'OPEN Alliance Automotive Ethernet ECU Test
 * Specification - TC8 ECU Test' (Document Version 2.0, August 23, 2017)
 *
 * Copyright (c) Vector Informatik GmbH. All rights reserved.
 ***************************************************************************************/

includes
{
  #include "../TestUnit_TC8/Tc8TestLib/BasicFunctionsTestLib.cin"
}

variables
{
  enum SendingType
  {
    kCompleteMessage,
    kFirstHalf,
    kSecondHalf,
    kInvalidChecksum
  };
}

export ClearAllParameters()
 {
  InternalClearAllParameters();
 }

export ClearAllParametersAndSetDefaultValues()
 {
  ClearAllParametersAndSetDefaultValues(syspar::kIpAddressDut);
 }

export ClearAllParametersAndSetDefaultValues(char ipAddressDestination[])
 {
  InternalClearAllParameters();
  InternalAddSendingParameter("eth","source",ConvertMacAddressStringToInt64(syspar::kMacAddressTester));
  InternalAddSendingParameter("eth","destination",ConvertMacAddressStringToInt64(syspar::kMacAddressDut));
  InternalAddSendingParameter("ipv4","source",ConvertIpAddressStringToInt64(syspar::kIpAddressTester));
  InternalAddSendingParameter("ipv4","destination",ConvertIpAddressStringToInt64(ipAddressDestination));
 }

export Init_TextFixture()
 {
  EthReceivePacket("OnEthPacketIpv4");
 }

export Init_Testcase(char testCaseName[],int testCaseNumber)
 {
  Internal_InitTestCase(testCaseName,testCaseNumber,kFalse);
 }

export End_TextFixture()
 {
  Internal_EndTestCase();
 }

export End_Testcase(char testCaseName[],int testCaseNumber)
 {
  Internal_EndTestCase();
 }

void OnEthPacketIpv4(long channel,long dir,long packet)
{
  enum Bool match;
  if(ShouldIncomingPacketBeProcessed(channel,packet) == kFalse)
  {
    return;
  }
  match = CompareParameters(packet);
  if(match == kTrue)
  {
    EthernetPacketReceived();
  }
}

export AddSendingParameter(char protocol[],char token[],int value)
 {
  InternalAddSendingParameter(protocol,token,value);
 }

export AddSendingParameterAfterComplete(char protocol[],char token[],int value)
{
  InternalAddSendingParameterAfterComplete(protocol,token,value);
}

export AddSendingDataParameter(char protocol[],char token[],char value[])
 {
  //to do: char to byte arry convertieren
  //void memcpy( byte dest[], char source[], dword length);
  byte data [1024];
  int i;
  memcpy(data,value,elcount(value));
  for(i = 0; i < elcount(value); i++)
  {
    write("data[%d]=%2X",i,data[i]);
  }
  InternalAddSendingDataParameter(protocol,token,data,elcount(value));
 }

export AddSendingDataParameter(char protocol[],char token[],byte value[])
 {
  InternalAddSendingDataParameter(protocol,token,value,0);
}

export AddSendingDataParameterZeros(char protocol[],char token[],int count)
 {
  byte data[1024];
  InternalAddSendingDataParameter(protocol,token,data,count);
}

export AddSendingParameterIpAddress(char protocol[],char token[],char value[])
 {
  InternalAddSendingParameter(protocol,token,ConvertIpAddressStringToInt64(value));
 }

export AddExpectedParameter(char protocol[],char token[],int value,enum CheckType checkType)
 {
  InternalAddExpectedParameter(protocol,token,value,checkType);
 }

export AddExpectedParameterIpAddress(char protocol[],char token[],char value[],enum CheckType checktype)
 {
 InternalAddExpectedParameter(protocol,token,ConvertIpAddressStringToInt64(value),checktype);
 }

export AddExpectedDataParameter(char protocol[],char token[],byte value[])
 {
  InternalAddExpectedDataParameter(protocol,token,value,0);
 }

export AddExpectedDataParameterZeros(char protocol[],char token[],int count)
 {
  byte data[1024];
  InternalAddExpectedDataParameter(protocol,token,data,count);
}

export AddExpectedParametersForEchoReply()
 {
  InternalAddExpectedParameter("ipv4","protocol",1);
  InternalAddExpectedParameter("icmpv4","type",0);
 }

export SendingMessageTTLIteration(int ttl)
 {
  ClearAllParametersAndSetDefaultValues();
  InternalAddSendingParameter("ipv4","ttl",ttl);
  AddExpectedParametersForEchoReply();
  SendIcmpEchoRequest(kCompleteMessage,kAnswerExpected,syspar::kParamListenTimeMs);
 }

export SendIcmpEchoRequest(enum SendingType sendingType, enum ExpectedResult expectedResult,int timeoutMilliseconds)
 {
  long packetHandle;
  int64 checksum;
  long dataLength;
  byte buffer[1024];
  byte buffer2[8];
  char tempstr[1024];
  int i;
  long result;
    
  AddSendingParameter("icmpv4","type",8);
  
  packetHandle = EthInitPacket("icmpv4","echo");
  
  if (syspar::kDIface0VLAN >= 0)
  {
    EthAddToken(packetHandle, "eth", "vlanId");
    EthSetTokenInt(packetHandle, "eth", "vlanId", syspar::kDIface0VLAN);
  }
  
  AddAllSendingParametersToEthernetPackage(packetHandle);
  AddAllSendingDataParametersToEthernetPackage(packetHandle);
  AddAllOptionsToEthernetPackage(packetHandle);
  EthCompletePacket(packetHandle);
  AddAllSendingParametersAfterCompleteToEthernetPackage(packetHandle);
  
  //Send only first or second half of package, if requested
   if(sendingType == kFirstHalf)
   {
    dataLength = EthGetTokenLengthBit(packetHandle,"ipv4","data")/8;
    //write("dataLength = %d",dataLength);
    result = EthGetTokenData(packetHandle,"ipv4","data",dataLength/2,buffer);
    //write("EthGetToken data returns %d",result);
    result = EthResizeToken(packetHandle,"ipv4","data",dataLength/2*8);
    if(result != 0) write("error @ EthResizeToken %d",result);
    result = EthSetTokenData(packetHandle,"ipv4","data",dataLength/2,buffer);
    if(result != 0) write("error @ EthSetTokenData %d",result);
   }
   if(sendingType == kSecondHalf)
   {
    dataLength = EthGetTokenLengthBit(packetHandle,"ipv4","data")/8;
    EthGetTokenData(packetHandle,"ipv4","data",dataLength,buffer);
    for(i = 0; i < dataLength/2; i++)
    {
      buffer[i] = buffer[i+dataLength/2-1];
    }
    EthResizeToken(packetHandle,"ipv4","data",dataLength/2*8);
    EthSetTokenData(packetHandle,"ipv4","data",dataLength/2,buffer);
    EthSetTokenInt64(packetHandle,"ipv4","offset",dataLength/2);
    EthCompletePacket(packetHandle);
   }
  
   // Make checksum invald, if requested
   // Has to be done AFTER EthCompletePackage
   if(sendingType == kInvalidChecksum)
   {
    //raise checksum by one to make it invalid
    checksum = EthGetTokenInt64(packetHandle,"icmpv4","checksum");
    checksum++;
    EthSetTokenInt64(packetHandle,"icmpv4","checksum",checksum);
   }
  
  
  if(expectedResult != kNoCheck)
  {
    StartObservationOfIncomingPackets(expectedResult);
  }
  //Send and release package
  EthOutputPacket(packetHandle);
  EthReleasePacket(packetHandle);
  if(expectedResult != kNoCheck)
  {
    WaitForIncomingPacket(expectedResult,timeoutMilliseconds);
  }
 }

export ListenForIncomingPacket(enum ExpectedResult expectedResult,int timeoutMilliseconds)
 {
  StartObservationOfIncomingPackets(expectedResult);
  WaitForIncomingPacket(expectedResult,timeoutMilliseconds);
 }

export SetReportInformation(char teststep[],char descriptionPass[],char descriptionFail[])
 {
  Internal_SetReportInformation(teststep,descriptionPass,descriptionFail);
 }

export CauseDutSendIcmpEchoRequest(char ipAddressDestination[],enum ExpectedResult expectedResult,int timeoutMilliseconds)
{
  Internal_CauseDutToSendIcmpEchoRequest(ipAddressDestination,expectedResult,timeoutMilliseconds);
}