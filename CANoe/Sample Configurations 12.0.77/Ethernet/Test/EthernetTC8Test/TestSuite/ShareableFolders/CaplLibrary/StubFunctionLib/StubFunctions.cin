/*@!Encoding:1252*/
/***************************************************************************************
 * Demo- and Example-Programs
 *
 * Please note: The demo and example programs only show special aspects of the software.
 * With regard to the fact that these programs are meant for demonstration purposes only,
 * Vector Informatik´s liability shall be expressly excluded in cases of ordinary
 * negligence, to the extent admissible by law or statute.
 *
 * Beta-Version
 *
 * These programs are fully operative programs. However, they are not thoroughly tested
 * yet (beta-version). With regard to the fact that the programs are a beta-version only,
 * Vector Informatik´s liability shall be expressly excluded in cases of ordinary
 * negligence, to the extent admissible by law or statute.
 *
 * DESCRIPTION:
 *
 * Demo test implementation of the 'OPEN Alliance Automotive Ethernet ECU Test
 * Specification - TC8 ECU Test' (Document Version 2.0, August 23, 2017)
 *
 * Copyright (c) Vector Informatik GmbH. All rights reserved.
 ***************************************************************************************/

/* Change this include block to use the testability protocol instead */
includes
{
  #include "TestabilityStubFunctions/All_StubFunctions.cin" // Testability Protocol Stub Functions
  // #include "OwnStubFunctions/All_StubFunctions.cin" // Here you can add your own Stub Functions and comment out the Stub Function Vector has implemented
}

/* Stubfunction error message map */
variables
{
  char[50] kStubErrorMessages[long, 20];
  long gSocketId[10]; // socket id. -1 if socket is not open
  qword gLastReceivedTestabilityReply; // in contrast to its name, this is the timestamp of the last sent testability request
}

void InitStubErrorMessages()
{
  /* standard results */
  strncpy(kStubErrorMessages[0x00], "The service primitive has performed successfully", 50);
  strncpy(kStubErrorMessages[0x01], "General error", 50);

  /* testability specific */
  strncpy(kStubErrorMessages[0xFF], "The service primitive has performed successfully", 50);
  strncpy(kStubErrorMessages[0xFE], "The Upper Tester or a service primitive is pending", 50);
  strncpy(kStubErrorMessages[0xFD], "Insufficient buffer size", 50);
  strncpy(kStubErrorMessages[0xFC], "Invalid Input or Parameter", 50);

  /*  service primitve specific */
  strncpy(kStubErrorMessages[0xEF], "Invalid socket ID", 50);
  strncpy(kStubErrorMessages[0xEE], "Unable to create socket or no free socket", 50);
  strncpy(kStubErrorMessages[0xED], "Unable to bind socket, port taken", 50);
  strncpy(kStubErrorMessages[0xEC], "Invalid network or virtual interface", 50);
  strncpy(kStubErrorMessages[0xEB], "TCP error: \"precedence not allowed\"", 50);
  strncpy(kStubErrorMessages[0xEA], "TCP error: \"foreign socket unspecified\"", 50);
  strncpy(kStubErrorMessages[0xE9], "TCP error: \"connection illegal for this process\"", 50);
  strncpy(kStubErrorMessages[0xE8], "TCP error: \"insufficient resources\"", 50);
  strncpy(kStubErrorMessages[0xE7], "TCP error: \"connection already exists\"", 50);
  strncpy(kStubErrorMessages[0xE6], "TCP error: \"connection closing\"", 50);
  strncpy(kStubErrorMessages[0xE5], "TCP error: \"connection does not exist\"", 50);
  strncpy(kStubErrorMessages[0xE4], "TCP error: \"connection reset\"", 50);
  strncpy(kStubErrorMessages[0xE3], "TCP error: \"connection aborted due to user timeout\"", 50);
  strncpy(kStubErrorMessages[0xE2], "TCP Error: \"connection refused\"", 50);
}

enum Bool ComparePayload(char payload[], word payloadLength, byte outPayload[], word outPayloadLength)
{
  dword i;
  byte b1, b2;
  if (payloadLength != outPayloadLength)
  {
    //write("Payload length missmatch. expected=%d, observed=%d",payloadLength, outPayloadLength);
    return kFalse;
  }
  
  for(i = 0; i < payloadLength; i++)
  {
    b1 = (byte) payload[i];
    b2 = (byte) outPayload[i];
    //write("string=%02X, byte=%02X", b1, b2);
    if(b1 != b2)
    {
      return kFalse;
    }
  }
  return kTrue;
}

byte ConvertSubnetMaskFromStringToCiddr(char netMask[])
{
  byte netMaskCidr;
  dword netMaskRaw;
  int i;
  
   netMaskRaw = IpGetAddressAsNumber(netMask);
   netMaskCidr = 0;
   i = 1;
   while((i & netMaskRaw) > 0)
   {
    i *= 2;
    netMaskCidr++;
   }
  return netMaskCidr;
}
