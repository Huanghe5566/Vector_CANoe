/*@!Encoding:1252*/
/***************************************************************************************
 * Demo- and Example-Programs
 *
 * Please note: The demo and example programs only show special aspects of the software.
 * With regard to the fact that these programs are meant for demonstration purposes only,
 * Vector Informatik´s liability shall be expressly excluded in cases of ordinary
 * negligence, to the extent admissible by law or statute.
 *
 * Beta-Version
 *
 * These programs are fully operative programs. However, they are not thoroughly tested
 * yet (beta-version). With regard to the fact that the programs are a beta-version only,
 * Vector Informatik´s liability shall be expressly excluded in cases of ordinary
 * negligence, to the extent admissible by law or statute.
 *
 * DESCRIPTION:
 *
 * Demo test implementation of the 'OPEN Alliance Automotive Ethernet ECU Test
 * Specification - TC8 ECU Test' (Document Version 2.0, August 23, 2017)
 *
 * Copyright (c) Vector Informatik GmbH. All rights reserved.
 ***************************************************************************************/

variables
{
  char gTestCaseName[64];
  word gTestCaseNumber;
  enum Bool gStubFunctionRequired;
}

void Internal_InitTestFixture(enum TestGroup testGroup, char ethReceivePacketFunctionName[])
{
  Internal_InitTestFixture(testGroup, ethReceivePacketFunctionName, 2);
}

void Internal_InitTestFixture(enum TestGroup testGroup, char ethReceivePacketFunctionName[], int numberOfBusses)
{
  long res;
  char tempstr[12];
  int i;
  
  sysSetVariableInt(sysvar::TC8_DUT_Config::TestGroup, (dword)testGroup);
  
  gMaximumChannelNumber = numberOfBusses;
  
    /* store bus contexts */
  for(i = 1; i <= numberOfBusses; i++)
  {
    snprintf(tempstr, elcount(tempstr), "Ethernet_%d", i);
    if (GetBusNameContext(tempstr) == 0)
    {
      write("Failed to get context of bus %s", tempstr);
    }
    SetBusContext(GetBusNameContext(tempstr));
    res = EthReceivePacket(ethReceivePacketFunctionName);
 
    if (res != 0)
    {
     write("Failed to subscribe to EthReceivePacket for Eth 1 (%d)", res);
    }
  }
  
  StubInitialization();
  InitStubErrorMessages();
  testWaitForTimeout(syspar::kInitialBootTimeMs);
    
}

void Internal_InitTestCase(char testCaseName[], int testGroup, char testGroupName[], int testCaseNumber, enum Bool stubFunctionRequired)
{
  long retCode;
  
  write("===========================================");
  write("Starting Testcase %s", testCaseName);
  write("===========================================");

  strncpy(gTestCaseName, testCaseName, elcount(gTestCaseName));
  gTestCaseNumber = testCaseNumber;
  gStubFunctionRequired = stubFunctionRequired;
  sysSetVariableInt(sysvar::TC8_DUT_Config::RunTestabilityStartAndEndFunctions, syspar::kRunTestabilityStartAndEndFunctions);

  sysSetVariableString(sysvar::TC8_DUT_Config::CurrentTestcaseName, testCaseName);
  sysSetVariableInt(sysvar::TC8_DUT_Config::TestcaseNumber, testCaseNumber);
  sysSetVariableInt(sysvar::TC8_DUT_Config::TestGroup, testGroup);
  sysSetVariableString(sysvar::TC8_DUT_Config::TestGroupName, testGroupName);

  if ((syspar::kRunTestabilityStartAndEndFunctions == 1 && gStubFunctionRequired == kTrue) || syspar::kRunTestabilityStartAndEndFunctions == 2) {
    retCode = Internal_Stub_GeneralStartTest();
    // Error reporting
    if (retCode == E_OK)
      testStepPass("Stub_GeneralStartTest", "Stubfunction for start test case succeeded");
    else
    {
      if (kStubErrorMessages.containsKey(retCode))
        testStepFail("Stub_GeneralStartTest", kStubErrorMessages[retCode]);
      else
        testStepFail("Stub_GeneralStartTest", "Unknown error.");
    }
  }
  // Leave the DUT some additional time to prepare the test case
  testWaitForTimeout(syspar::kTestCompletionTimeMs);
  
  gExtractingParameters.Clear();
  gExtractingParametersCount = 0;
  
  InternalClearAllParameters();
}

void Internal_EndTestFixture()
{

  sysSetVariableInt(sysvar::TC8_DUT_Config::TestGroup, kNoTestGroup);
  StubCleanup();
}

void Internal_EndTestCase()
{
  long retCode;
  if ((syspar::kRunTestabilityStartAndEndFunctions == 1 && gStubFunctionRequired == kTrue) || syspar::kRunTestabilityStartAndEndFunctions == 2) {
    retCode = Internal_Stub_GeneralEndTest(gTestCaseNumber, gTestCaseName);
    // Error reporting
    if (retCode == E_OK)
      testStepPass("Stub_GeneralEndTest", "Stubfunction for end test case succeeded");
    else
    {
      if (kStubErrorMessages.containsKey(retCode))
        testStepFail("Stub_GeneralEndTest", kStubErrorMessages[retCode]);
      else
        testStepFail("Stub_GeneralEndTest", "Unknown error.");
    }
    // leave the test case time to complete
    
    testWaitForTimeout(syspar::kTestCompletionTimeMs);
  }
  
  sysSetVariableString(sysvar::TC8_DUT_Config::CurrentTestcaseName, "");
}

void InternalRemoveHostAddresses()
{
  const dword IPV4_STR_SIZE = 16;    // IPv4 string size
  const dword AF_INET = 2;           // IPv4 adapter family
  const dword BUFSIZE = 10;          // Buffer size of the address-array
  dword i;                           // a loop variable
  dword ipv4Addr[BUFSIZE];           // an array where all ipv4 adapter addresses are stored in
  char ipv4AddrStr[IPV4_STR_SIZE];   // human readable ipv4 string buffer.
  long ipv4AdrCount;                 // IPv4 address count
  dword ifIdx;                       // interface index
  long result;                       // function result.
  dword host1Ip;
  dword host1Subnet;
  
  host1Ip = ipGetAddressAsNumber(syspar::kHost1Ip);
  host1Subnet = ipGetAddressAsNumber(syspar::kHost1SubnetMask);

  for (ifIdx = 1; ifIdx <= 2; ifIdx++)
  {
    ipv4AdrCount = IpGetAdapterAddressCount( ifIdx, AF_INET );
    if (ipv4AdrCount >= 0)
    {
      result = IpGetAdapterAddress( ifIdx, ipv4Addr, elcount(ipv4Addr) );
      if (result == 0)
      {
        for (i = 0; i < ipv4AdrCount; i++)
        {
          if (ipv4Addr[i] == host1Ip)
          {
            result = IpRemoveAdapterAddress(i, ipGetAddressAsNumber(syspar::kHost1Ip), ipGetAddressAsNumber(syspar::kHost1SubnetMask));
            if( result != 0 )
            {
              write( "IpRemoveAdapterAddress Host1 failed, error code %d, last error %d", result, IpGetLastError());
            }
          }
        }
      }
    }
  }
}
