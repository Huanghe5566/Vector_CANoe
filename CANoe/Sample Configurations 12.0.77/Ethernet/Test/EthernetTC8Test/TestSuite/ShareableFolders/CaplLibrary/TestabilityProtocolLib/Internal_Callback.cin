/*@!Encoding:1252*/
/***************************************************************************************
 * Demo- and Example-Programs
 *
 * Please note: The demo and example programs only show special aspects of the software.
 * With regard to the fact that these programs are meant for demonstration purposes only,
 * Vector Informatik´s liability shall be expressly excluded in cases of ordinary
 * negligence, to the extent admissible by law or statute.
 *
 * Beta-Version
 *
 * These programs are fully operative programs. However, they are not thoroughly tested
 * yet (beta-version). With regard to the fact that the programs are a beta-version only,
 * Vector Informatik´s liability shall be expressly excluded in cases of ordinary
 * negligence, to the extent admissible by law or statute.
 *
 * DESCRIPTION:
 *
 * Demo test implementation of the 'OPEN Alliance Automotive Ethernet ECU Test
 * Specification - TC8 ECU Test' (Document Version 2.0, August 23, 2017)
 *
 * Copyright (c) Vector Informatik GmbH. All rights reserved.
 ***************************************************************************************/

includes
{

}

variables
{
  BYTE   gInternalDummyBuffer[1]; // Max. UDP payload without fragmentation
  BYTE   gDummyBuffer[1];

  dword     gInternalUdpRemoteAddr = 0;
  word      gInternalUdpRemotePort = 0;
  dword     gInternalUdpLocalAddr = 0;
  word      gInternalUdpLocalPort = 0;

  char      kInternalEventTcpReceive[20] = "ExpectedTcpResponse";

  //for UDP socket callback 
  BYTE      gTesterUdpRxBuffer[kTestabilityMessageMaxPayloadByteLength + kTestabilityMessageHeaderByteLength]; // Max. UDP payload without fragmentation

  const word kMAX_TIMESTAMP_OPTION_MAX_LEN = 40; // max header size is 40, data size is 40
  word gIPv4TimestampOptionLen;
  byte gIPv4TimestampOptionData[kMAX_TIMESTAMP_OPTION_MAX_LEN]; // max header size is 40, data size is 40

  struct _TCP_TCB
  {
    dword dwSeq;
    dword dwAck;
    word wWindw;
  };
  
  struct _TCP_TCB kTcpTcbInfo;
  
  // tcp not send flag
  byte gbNotSendTcpAckFlag; // tester not send ack flag
  byte gbNotSendTcpFinFlag; // tester not send fin flag
  byte gbNotSendTcpRstFlag; // tester not send rst flag
  
  byte gbNotRecvTcpAckPshFlag; //drop ACK, PSH packet, Tester doesn't receive ACK,PSH
  byte gbRemoveSendTcpAckFlag; //tester remove send ack flag(but send, data)
  byte gbDelayTckAckPacket; // tester delay ack packet to ack,psh
  ethernetpacket gEthDelayAckPacket; //
  word gwDelayTime;    // delay time for ack packet
  msTimer gTimDelayAck; // timer for delay ack packet 
  byte gbNotRecvTcpSynFlag; //drop SYN packet, Tester doesn't receive SYN and send ACK, SYN
  
  byte gbNotRecvTcpAckOrAckPshFlag; //drop ACK or ACK, PSH flag not to receive the ack packet
  byte gbNotRecvTcpAckOrAckPshFlagStartCnt;
  byte gbNotRecvTcpAckOrAckPshFlagCnt;
  byte gbNotRecvTcpAckOrAckPshFlagStopCnt;
  byte gbMonitoringAckFlag;
  ethernetPacket gEthDuplicateAckPacket;
  
  msTimer gTimDuplicateAckDelay;
  int gwDeplicateAckSendCnt;

  msTimer gTimResponseDelay;
  word gwResponseDelayFlag;
  word gwResponseDelayTime;
  ethernetPacket gEthDelayRes;
  
  ethernetPacket gEthHoldAckPacket[12];
  
  ethernetPacket gEthLastAckPacket; // for TCP_IMPROVED_WINDOWING_0x test
  word gTcpReceivedLength;
  
  
  byte gbNotSendTcpAckCnt;
  byte gbNotSendTcpAckStartCnt;
  byte gbNotSendTcpAckStopCnt;
  word gwChangeAckWindowSizeFlag;
  word gwChangeAckWindowSizeStartCnt;
  word gwChangeAckWindowSizeVal;
  
  byte gbRemoveSendTcpPshFlag; //remove PSH flag from ACK/PSH packet

  struct _SET_NUM 
  {
    byte bEnable;
    word value;
  };
  struct _SET_DWORDNUM 
  {
    byte bEnable;
    dword value;
  };
  
  struct _SET_TCPOPTION
  {
    byte bFlag;
    byte bId;
    byte bLength;
    word wData;
  };

  struct _SET_DATA
  {
    byte bEnable;
    char bData[100];
    word dataLength;
  };
    
  byte gbTcpReservedNum;  // reserved number in tcp header
  
  struct _SET_NUM gTcpWindow;       // window in tcp header
  struct _SET_TCPOPTION gTcpOption; // tcp header option  
  struct _SET_NUM gTcpSendFlags;    // tcp flags
  struct _SET_DATA gTcpData;        // tcp data
  struct _SET_DWORDNUM gTcpSendSeq;      // tcp sending sequence number

  char      kInternalEventTcpAckSend[20] = "TcpAckSending";

  byte gbIpSendBlockFlag; // 0:Not block for TCP/IP stack simulation, 1:Block
}

on preStart
{
  gbTcpReservedNum = 0;
  gInternalUdpDataLength = 0;
  gbIpSendBlockFlag = 0;
}

long OnIpReceivePrepare( ethernetPacket * packet)
{  
  // for tcp
  if( forTcpRecvPrep(packet) == 0)
  {
    return 0;
  }
      
  return 1;
}

long OnIpSendPrepare(dword socket, ethernetPacket * packet)
{
  //long ethPacket;
  long lUDPLength;
  char cErrors[100];
  long lRet;
  word wUDPCheckSum;
  long lPacketH;
    
  if(gbIpSendBlockFlag == 1) return 0;
  
  if(@sysvar::TesterUDPFaultInjection::TruncatedUDPLength == 1)
  {
    // (a packet with the length field smaller than the actual size of the data coming from the Ethernet frame
        
    lUDPLength = UDPGetDataLength(packet);
    //write("OnIpSendPrepare() TruncatedUDPLength == 1");
    if(EthGetLastError() == 0)
    {
      write("TESTER OnIpSendPrepare() TruncatedUDPLength == 1 %d", lUDPLength);
      UDPSetDataLength(packet, lUDPLength - 2); // specify only data size, plus 8 inside the function
      UDPUpdateChecksum_diffLen(packet, lUDPLength);
      //Ipv4UpdateChecksum(packet);
      @sysvar::TesterUDPFaultInjection::TruncatedUDPLength = 0;
      return 1;
    }    
    else
    {
      EthGetLastErrorText( elCount(cErrors), cErrors );
      write("Error: %s", cErrors );
      @sysvar::TesterUDPFaultInjection::TruncatedUDPLength = 0;
    }
    @sysvar::TesterUDPFaultInjection::TruncatedUDPLength = 0;
  }
  if(@sysvar::TesterUDPFaultInjection::TruncatedUDPHeader == 1)
  {
    UDPChangeDataLength(packet, @sysvar::TesterUDPFaultInjection::TruncatedUDPHeaderSize);
    UDPCalcChecksum_diffLen(packet, 0);
    //Ipv4UpdateChecksum(packet);    
    @sysvar::TesterUDPFaultInjection::TruncatedUDPHeader = 0;
    @sysvar::TesterUDPFaultInjection::TruncatedUDPHeaderSize = 8;
    return 1;
  }

  if(@sysvar::TesterUDPFaultInjection::SourcePortZero == 1)
  {
    UDPSetSrcPort(packet, 0);
    UDPUpdateChecksum(packet);      
    @sysvar::TesterUDPFaultInjection::SourcePortZero = 0;
    return 1;
  }
  if(@sysvar::TesterUDPFaultInjection::SourceAddressChangeFlag == 1)
  {
    IPv4SetSrcAddress(packet, @sysvar::TesterUDPFaultInjection::IPv4Address);
    //UDPUpdateChecksum(packet);
    Ipv4UpdateChecksum(packet);
    @sysvar::TesterUDPFaultInjection::SourceAddressChangeFlag = 0;
    return 1;
  }
  if(@sysvar::TesterUDPFaultInjection::ZeroCheckSum == 1)
  {
    UDPChangeChecksum(packet, 0x0000);   
    @sysvar::TesterUDPFaultInjection::ZeroCheckSum == 0;
    return 1;
  }
  if(@sysvar::TesterUDPFaultInjection::IncorrectCheckSum == 1)
  {
    UDPChangeChecksumIncorrect(packet);
    @sysvar::TesterUDPFaultInjection::IncorrectCheckSum = 0;
    return 1;
  }
  if(@sysvar::TesterUDPFaultInjection::InsertIpTimestampOption == 1)
  {
    InsertIpv4TimeStampOption(packet);
    @sysvar::TesterUDPFaultInjection::InsertIpTimestampOption = 0;
    return 1;
  }
  if(@sysvar::TesterUDPFaultInjection::GreaterUDPLength == 1)
  {
    //- length field set to (Length of <UDPData> + 8 ) + 1 
    lUDPLength = UDPGetDataLength(packet);
    UDPSetDataLength(packet,lUDPLength + 1);
    UDPCalcChecksum_diffLen(packet, lUDPLength);
    @sysvar::TesterUDPFaultInjection::GreaterUDPLength = 0;
  }

  // for tcp
  lRet = forTcpSendPrep(packet);
  
  return lRet;
}

word forTcpRecvPrep(ethernetPacket * packet)
{
  word i;
//  word offset;
  
  // if send direction is DUT -> DUT or packet type isn't ipv4
  if(packet.source == ethGetMacAddressAsNumber(syspar::kMacAddressTester) || IPv4IsEthTypeIPv4(packet) != 1)
  {
    // fin
    return 1;
  }
  
  // reset rx buffer
  for(i=0; i<elCount(gInternalRxBuffer); i++)
  {
    gInternalRxBuffer[i] = 0;
  }
  
//  offset = UDPGetHeaderOffset(packet);  
  for(i=0; (i<packet.length) && (i<elCount(gInternalRxBuffer)); i++)
  {
    gInternalRxBuffer[i] = packet.byte(i);
  } 
  

    
  if(isTcp(packet))
  {
    // set socket tcb
    kTcpTcbInfo.dwSeq = TCPgetSequence(packet);
    kTcpTcbInfo.dwAck = TCPgetAckNumber(packet);
    kTcpTcbInfo.wWindw = TcpGetWindow(packet);

    @sysvar::TesterTCP::tcpRecvAck = TCPgetAckNumber(packet);
    @sysvar::TesterTCP::tcpRecvSeq = TCPgetSequence(packet);
    gTcpReceivedLength = TCPGetDataLength(packet);

    // set tcp receive event
    testSupplyTextEvent(kInternalEventTcpReceive);
    
    //drop ACK,PSH packet before receiving
    if( (gbNotRecvTcpAckPshFlag == 1) && ((TCPGetFlags(packet) & 0x18) == 0x18) )
    {
      //Write("drop ACK, PSH only once");
      //gbNotRecvTcpAckPshFlag = 0;
      return 0;
    }
    //drop SYN
    if( (gbNotRecvTcpSynFlag == 1) && ((TCPGetFlags(packet) & 0x02) == 0x02))
    {
      //Write("drop SYN");
      return 0;
    }
    //drop ACK,PSH or ACK before receiving data
    if( (gbNotRecvTcpAckOrAckPshFlag == 1) && 
        ((TCPGetFlags(packet) & 0x18) == 0x18 || (TCPGetFlags(packet) & 0x10) == 0x10) )
    {
      // TODO: IPv6 handling
      if(IPv4GetDstAddress(packet) != ipGetAddressAsNumber(syspar::kIpAddressTester))
      {
        return 1;
      }
      if(gbNotRecvTcpAckOrAckPshFlagCnt < gbNotRecvTcpAckOrAckPshFlagStopCnt)
      {
        Write("drop ACK or ACK PHSH cnt[%d], stop[%d], SEQ[%x], ACK[%x], wnd[%x]", gbNotRecvTcpAckOrAckPshFlagCnt, gbNotRecvTcpAckOrAckPshFlagStopCnt, 
            kTcpTcbInfo.dwSeq, kTcpTcbInfo.dwAck, kTcpTcbInfo.wWindw);
        gbNotRecvTcpAckOrAckPshFlagCnt++;
        
        if(gbNotRecvTcpAckOrAckPshFlagCnt == gbNotRecvTcpAckOrAckPshFlagStopCnt)
        {
          //duplicate ACK to every received packet
          gwDeplicateAckSendCnt = gbNotRecvTcpAckOrAckPshFlagStopCnt;
          setTimer(gTimDuplicateAckDelay, 10);
          gbNotRecvTcpAckOrAckPshFlag = 0;
          
          Write("gTimDuplicateAckDelay Timer Start");
        }
        return 0;
      }
    }
    //drop ACK,PSH or ACK before receiving data
    //@@@
    if( (gbNotRecvTcpAckOrAckPshFlag == 2) && 
        ((TCPGetFlags(packet) & 0x18) == 0x18 || (TCPGetFlags(packet) & 0x10) == 0x10) )
    {
      // TODO: IPv6 handling
      if(IPv4GetDstAddress(packet) != ipGetAddressAsNumber(syspar::kIpAddressTester))
      {
        return 1;
      }
      if(gbNotRecvTcpAckOrAckPshFlagCnt < gbNotRecvTcpAckOrAckPshFlagStartCnt)
      {
        Write("drop ACK or ACK PHSH cnt[%d], stop[%d], SEQ[%x], ACK[%x], wnd[%x]", gbNotRecvTcpAckOrAckPshFlagCnt, gbNotRecvTcpAckOrAckPshFlagStopCnt, 
            kTcpTcbInfo.dwSeq, kTcpTcbInfo.dwAck, kTcpTcbInfo.wWindw);
        gbNotRecvTcpAckOrAckPshFlagCnt++;
        gbNotSendTcpAckFlag = 4;
        gbMonitoringAckFlag = 1;
        
      }
//      else if(gbNotRecvTcpAckOrAckPshFlagCnt == gbNotRecvTcpAckOrAckPshFlagStartCnt)
//      {
//        gbNotSendTcpAckFlag = 4;
//        gbMonitoringAckFlag = 2;
//        gbNotRecvTcpAckOrAckPshFlagCnt++;
//        
//      }
      else if(gbNotRecvTcpAckOrAckPshFlagCnt < gbNotRecvTcpAckOrAckPshFlagStopCnt)
      {
        Write("drop ACK or ACK PHSH cnt[%d], stop[%d], SEQ[%x], ACK[%x], wnd[%x]", gbNotRecvTcpAckOrAckPshFlagCnt, gbNotRecvTcpAckOrAckPshFlagStopCnt, 
            kTcpTcbInfo.dwSeq, kTcpTcbInfo.dwAck, kTcpTcbInfo.wWindw);
        gbNotRecvTcpAckOrAckPshFlagCnt++;
        gbNotSendTcpAckFlag = 4;
        gbMonitoringAckFlag = 2;
        
        if(gbNotRecvTcpAckOrAckPshFlagCnt == gbNotRecvTcpAckOrAckPshFlagStopCnt)
        {
         //duplicate ACK 3 times
          gwDeplicateAckSendCnt = 3;
          setTimer(gTimDuplicateAckDelay, 100);
          Write("gTimDuplicateAckDelay Timer Start");
        }
        //return 0;
      }
      else if(gbNotRecvTcpAckOrAckPshFlagCnt >= gbNotRecvTcpAckOrAckPshFlagStopCnt)
      {
        //response ack to retransmit packet
        gbNotSendTcpAckFlag = 0;
      }
    }
    //drop ACK,PSH or ACK before receiving data
    //@@@
    if( (gbNotRecvTcpAckOrAckPshFlag == 3) && 
        ((TCPGetFlags(packet) & 0x18) == 0x18 || (TCPGetFlags(packet) & 0x10) == 0x10) )
    {
      return 0;
    }
  }
  else 
  {
    // set other receive event
    //@@@
    //testSupplyTextEvent(kInternalEventTcpReceive);
  }
  return 1;
}

word forTcpSendPrep(ethernetPacket * packet)
{
  const byte kbACK_FLAG = 0x10;
  const byte kbSYN_FLAG = 0x02;
  const byte kbPSH_FLAG = 0x08;
  byte bACKFlag_ON;
  byte bSYNFlag_ON;
  byte bPSHFlag_ON;
  
  // if packet type isn't ipv4 or protocol isn't tcp
  if(IPv4IsEthTypeIPv4(packet) != 1 || isTcp(packet) == 0)
  {
    return 1;
  }

  bACKFlag_ON = ((TCPGetFlags(packet) & kbACK_FLAG) == kbACK_FLAG) ? 1 : 0;
  bSYNFlag_ON = ((TCPGetFlags(packet) & kbSYN_FLAG) == kbSYN_FLAG) ? 1 : 0;
  bPSHFlag_ON = ((TCPGetFlags(packet) & kbPSH_FLAG) == kbPSH_FLAG) ? 1 : 0;
  
  // check not send ack
  if(gbNotSendTcpAckFlag == 1 && bACKFlag_ON == 1)
  {
    // not send ack
    return 0;
  }
  // ack sending control and window size
  else if(gbNotSendTcpAckFlag == 2 && bACKFlag_ON == 1)
  {
    //Write("gbNotSendTcpAckFlag = 2 : Ack count[%d]", gbNotSendTcpAckCnt); 
    if(gwChangeAckWindowSizeFlag == 1)
    {
      if(gbNotSendTcpAckCnt >= gwChangeAckWindowSizeStartCnt)
      {
        //Todo change window size in ack
        TcpSetWindow(packet, gwChangeAckWindowSizeVal);
      }
    }
    if(gbNotSendTcpAckCnt < gbNotSendTcpAckStartCnt)
    {
      gbNotSendTcpAckCnt++; //Send Ack
    }
    else if( (gbNotSendTcpAckStopCnt == 0) || (gbNotSendTcpAckCnt < gbNotSendTcpAckStopCnt))
    {
      //Write("No Ack Send : Ack count[%d]", gbNotSendTcpAckCnt); 
      gbNotSendTcpAckCnt++;
      return 0; //No Ack Send
    }
    else if( gbNotSendTcpAckCnt >= gbNotSendTcpAckStopCnt)
    {
      gbNotSendTcpAckFlag = 0;
      gbNotSendTcpAckCnt = 0;
      gbNotSendTcpAckStartCnt = 0;
      gbNotSendTcpAckStopCnt = 0;
      //return 1;
    }
  }
  // ack duplicate every times
  else if( (gbNotSendTcpAckFlag == 3) && bACKFlag_ON == 1)
  {
    Write("gbNotSendTcpAckFlag == 3 && bACKFlag_ON == 1");
    if(gbNotSendTcpAckCnt < gbNotSendTcpAckStartCnt)
    {
      gbNotSendTcpAckCnt++; //Send Ack
      if(gbNotSendTcpAckCnt == gbNotSendTcpAckStartCnt)
      {
        Write("send ACK finish gbNotSendTcpAckCnt[%d], gbNotSendTcpAckStartCnt[%d]", gbNotSendTcpAckCnt, gbNotSendTcpAckStartCnt);
        //save last ACK packet
        gEthDuplicateAckPacket = packet;
        //enable drop data packet
          gbNotRecvTcpAckOrAckPshFlag = 1;
          gbNotRecvTcpAckOrAckPshFlagCnt = 0;
          gbNotRecvTcpAckOrAckPshFlagStopCnt = gbNotSendTcpAckStopCnt - gbNotSendTcpAckStartCnt;
          gbNotSendTcpAckFlag = 0;
      }
    }
  }
  //ACK packet monitoring or not sending  
  else if( (gbNotSendTcpAckFlag == 4) && bACKFlag_ON == 1 && bSYNFlag_ON == 0)
  {
    //@@@
    Write("gbNotSendTcpAckFlag == 4 && bACKFlag_ON == 1");
    if(gbMonitoringAckFlag == 1)
    {
      gEthDuplicateAckPacket = packet;
    }
    else if(gbMonitoringAckFlag == 2)
    {
      return 0;
    }
    else if(gbMonitoringAckFlag == 3)
    {
      gEthDuplicateAckPacket = packet;
      gbMonitoringAckFlag = 0;
    }
  }
  else if( (gbNotSendTcpAckFlag == 5) && bACKFlag_ON == 1  && bSYNFlag_ON == 0)
  {
    if(gbNotSendTcpAckCnt < gbNotSendTcpAckStartCnt)
    {
      gbNotSendTcpAckCnt++; //Send Ack
    }
    else
    {
      gEthLastAckPacket = packet;
      gbNotSendTcpAckCnt++; //Send Ack
      return 0;
    }
  }
  
  // check not send fin
  if(gbNotSendTcpFinFlag == 1 && (TCPGetFlags(packet) & 1) == 1)
  {
    // not send fin
    return 0;
  }
  
  // check not send rst
  if(gbNotSendTcpRstFlag == 1 && (TCPGetFlags(packet) & 4) == 4)
  {
    // not send rst
    return 0;
  }
      
  // set reserved Num
  if(gbTcpReservedNum > 0)
  {
    TcpSetReserved(packet, gbTcpReservedNum);
    gbTcpReservedNum = 0;
  }      
  // set window Num
  if(gTcpWindow.bEnable == 1)
  {
    TcpSetWindow(packet, gTcpWindow.value);
//    gwTcpWindow = 0;
  }

  // set sequence number
  if(gTcpSendSeq.bEnable == 1)
  {
    TcpSetSequence(packet, gTcpSendSeq.value);
    gTcpSendSeq.bEnable = 0;
    
    writeLineEx(1,1,"send:%X", TCPgetSequence(packet));
  }

  // Those functions are invalid
  // TODO: check "TcpSetOption" function
//  // set mss option
//  if(gTcpOption.flag == 1)
//  {
//    TcpSetOption(packet, gTcpOption.bId, gTcpOption.bLength, gTcpOption.data);
//    gTcpOption.flag = 0;
//  }
//  
//  // set tcp flags
//  if(gTcpSendFlags.bEnable == 1)
//  {
//    // set flag number
//    TcpSetFlags(packet, gTcpSendFlags.value);
//    gTcpSendFlags.bEnable = 0;
//  }
//  
//  // set tcp data
//  if(gTcpData.bEnable == 1)
//  {
//    // set flag number
//    TcpSetPayload(packet, gTcpData.bData, gTcpData.dataLength);
//    gTcpData.bEnable = 0;
//  }

  //
  // MSS options
  //
  
  // set mss option for SYN
  if(gTcpOption.bFlag == 1 && (TCPGetFlags(packet) & 0x02) == 0x02)
  {
    TcpSetMssOptions(packet, gTcpOption.bId, gTcpOption.bLength, gTcpOption.wData);
    gTcpOption.bFlag = 0;
  }
  // remove mss option for SYN
  else if(gTcpOption.bFlag == 4 && (TCPGetFlags(packet) & 0x02) == 0x02)
  {
    //SYN
    TcpRemoveMssOptions(packet);
  }
  // set mss option for only ACK
  else if(gTcpOption.bFlag == 2)
  {
    //SYN
    if((TCPGetFlags(packet) & 0x02) == 0x02)
    {
      TcpRemoveMssOptions(packet);
    }
    //ACK
    else if(bACKFlag_ON == 1)
    {
      TcpSetMssOptions(packet, gTcpOption.bId, gTcpOption.bLength, gTcpOption.wData);
      gTcpOption.bFlag = 0;
    }
  }
  // set mss option for PSH, ACK
  else if(gTcpOption.bFlag == 3 && (TCPGetFlags(packet) & 0x18) == 0x18)
  {
    TcpSetMssOptions(packet, gTcpOption.bId, gTcpOption.bLength, gTcpOption.wData);
    gTcpOption.bFlag = 0;
  }
  
  //
  //for Retransmit
  //
  
  //Remove ACK flag
  if( (gbRemoveSendTcpAckFlag == 1) && (bACKFlag_ON == 1) )
  {
    TcpRemoveAckFlag(packet);
    gbRemoveSendTcpAckFlag = 0;
    return 1;
  }
  
  //Remove PSH flag
  if( (gbRemoveSendTcpPshFlag == 1) && (bPSHFlag_ON == 1) && (bACKFlag_ON == 1) )
  {
    Write("gbRemoveSendTcpPshFlag()");
    TcpRemovePshFlag(packet);
    gbRemoveSendTcpPshFlag = 0;
    return 1;
  }
  
  
  //ACK delay transmit
  if( (gbDelayTckAckPacket == 1) && (bACKFlag_ON == 1) )
  {
    Write("gbDelayTckAckPacket on");
    gEthDelayAckPacket = packet;
    setTimer(gTimDelayAck, gwDelayTime);
    gbDelayTckAckPacket = 0;
    return 0;
  }
  // Response Delay to increase RTO become to large  
  if(gwResponseDelayFlag == 1)
  {
    gEthDelayRes = packet;
    setTimer(gTimResponseDelay, gwResponseDelayTime);
    return 0;
  }
  
  if(bACKFlag_ON == 1)
  {
    testSupplyTextEvent(kInternalEventTcpAckSend);
  }
  
  return 1;
}

on timer gTimDelayAck
{
  write("gTimDelayAck() %f", timeNow()/100000.0);
  output(gEthDelayAckPacket);
}

on timer gTimDuplicateAckDelay
{
  int i = 0;
  write("gTimDuplicateAckDelay() %f", timeNow()/100000.0);
  for(i = 0; i < gwDeplicateAckSendCnt; i++)
  {
    output(gEthDuplicateAckPacket);
  }
}

on timer gTimResponseDelay
{
  write("gTimResponseDelay() %f", timeNow()/100000.0);
  output(gEthDelayRes);
}

/// <UDP>
word UDPCalcChecksum_diffLen( ethernetPacket * pkt , word wDataLen)
{
  dword sum;
  dword offset;
  dword count;
  word  val;
  word  i;

  sum    = 0;
  offset = UDPGetHeaderOffset( pkt );
  //count  = UDPGetDataLength( pkt );
  count  = wDataLen;

  // calc checkusm of pseudo header
  sum += IPv4GetProtocol(pkt);            // IP protocol
  sum += swapWord(pkt.Word(offset + 4 )); // UDP protocol length
  sum += swapWord(pkt.Word( 12 ));        // IP addresses
  sum += swapWord(pkt.Word( 14 ));        // IP addresses
  sum += swapWord(pkt.Word( 16 ));        // IP addresses
  sum += swapWord(pkt.Word( 18 ));        // IP addresses

  // calc checksum over UDP header and payload
  for( i = 0; i < count + 8; i += 2 )
  {
    if (i == 6)
    {
      // ignore checksum
      val = 0;
    }
    else if (i + 1 >= count + 8)
    {
      val = ((((WORD)pkt.Byte(offset+i)) << 8) & 0xFF00);
    }
    else {
      val  = swapWord( pkt.Word(offset+i) );
    }
    
    sum += val;
  }

  while(sum >> 16)
  {
    sum = (sum & 0xFFFF) + ((sum >> 16) & 0xFFFF);
  }

  // set checksum of packet
  sum = ~sum;

  return sum; 
}



/// <UDP>
word UDPSetDataLength( ethernetPacket * pkt, word wLen)
{
  if (pkt.type == kEthertype_IPv4)
  {
    word offset;
    offset = UDPGetHeaderOffset( pkt );
    pkt.Word(offset + 4) = swapWord(wLen + 8); //data + header len
    //return swapWord(pkt.Word(offset + 4)) - 8; // UDP data length;
    return 1;
  }
  else
  {
    write( "<%FILE_NAME%> UDPGetHeaderOffset: Ethertype not supported. Measurement is stopped!" );
    stop();
    
    return 0;
  }
}

/// <UDP>
word UDPChangeDataLength( ethernetPacket * pkt, word wLenNoOffset)
{
  if (pkt.type == kEthertype_IPv4)
  {
    word offset;
    offset = UDPGetHeaderOffset( pkt );
    pkt.Word(offset + 4) = swapWord(wLenNoOffset); //data + header len
    //return swapWord(pkt.Word(offset + 4)) - 8; // UDP data length;
    return 1;
  }
  else
  {
    write( "<%FILE_NAME%> UDPGetHeaderOffset: Ethertype not supported. Measurement is stopped!" );
    stop();
    
    return 0;
  }
}

/// <UDP>
word UDPSetSrcPort( ethernetPacket * pkt, word wPort)
{
  if (pkt.type == kEthertype_IPv4)
  {
    word offset;
    offset = UDPGetHeaderOffset( pkt );
    pkt.Word(offset) = swapWord(wPort); //data + header len
    //return swapWord(pkt.Word(offset + 4)) - 8; // UDP data length;
    return 1;
  }
  else
  {
    write( "<%FILE_NAME%> UDPGetHeaderOffset: Ethertype not supported. Measurement is stopped!" );
    stop();
    
    return 0;
  }
}

/// <IPv4>
word IPv4SetSrcAddress( ethernetPacket * pkt, dword dwAddress)
{
  if (pkt.type == kEthertype_IPv4)
  {
    //pkt.DWord(12) = swapDWord(dwAddress); //IP address offset = 12
    pkt.DWord(12) = dwAddress; //IP address offset = 12
    return 1;
  }
  else
  {
    write( "<%FILE_NAME%> UDPGetHeaderOffset: Ethertype not supported. Measurement is stopped!" );
    stop();
    
    return 0;
  }
}

/// <UDP>
void UDPUpdateChecksum_diffLen( ethernetPacket * pkt, word wLen)
{
  word offset;
  offset = UDPGetHeaderOffset( pkt );
  
  pkt.Word (offset+6) = swapWord(UDPCalcChecksum_diffLen(pkt, wLen)); // Checksum
}

/// <IPv4>
long InsertIpv4TimeStampOption(ethernetPacket * packet)
{
  word wTotalLen;
  word wTimestampLen;
  word wIPv4HeaderLen;
  word wIPv4TotalLen;
  word wIPv4PayloadLen;
  int pos;
  //long lRet = 0;
  
  //
  //calculate total length, IPv4 header/total length
  //
  wTimestampLen = gIPv4TimestampOptionLen;
  packet.Length = packet.Length + wTimestampLen;

  //
  // Update IPv4 header length and Total Length
  //
  wIPv4HeaderLen = IPv4GetHeaderLength(packet);
  IPv4SetHeaderLength(packet, wIPv4HeaderLen + wTimestampLen);  

  //
  // Update IPv4 total length (header plus payload)
  //
  wIPv4TotalLen = IPv4GetTotalLength(packet);
  IPv4SetTotalLength(packet, wIPv4TotalLen + wTimestampLen);  
  
  //
  //Copy UDP header and payload
  //
  wIPv4PayloadLen = wIPv4TotalLen - wIPv4HeaderLen;
  for(pos = wIPv4PayloadLen - 1; pos >= 0; pos--)
  {
    packet.byte(wIPv4HeaderLen + wTimestampLen + pos) = packet.byte(wIPv4HeaderLen + pos);
  }
  //
  //Insert IP timestamp option header
  //
  for(pos = 0 ; pos < wTimestampLen; pos++)
  {
    packet.byte(wIPv4HeaderLen+pos) = gIPv4TimestampOptionData[pos];
  }
  
  //calculate IPv4 check sum
  Ipv4UpdateChecksum(packet);
  
  
  return 1;
}
