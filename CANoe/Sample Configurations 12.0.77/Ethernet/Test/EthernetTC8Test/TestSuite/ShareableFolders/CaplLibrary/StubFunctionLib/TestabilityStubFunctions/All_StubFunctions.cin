/*@!Encoding:1252*/
/***************************************************************************************
 * Demo- and Example-Programs
 *
 * Please note: The demo and example programs only show special aspects of the software.
 * With regard to the fact that these programs are meant for demonstration purposes only,
 * Vector Informatik´s liability shall be expressly excluded in cases of ordinary
 * negligence, to the extent admissible by law or statute.
 *
 * Beta-Version
 *
 * These programs are fully operative programs. However, they are not thoroughly tested
 * yet (beta-version). With regard to the fact that the programs are a beta-version only,
 * Vector Informatik´s liability shall be expressly excluded in cases of ordinary
 * negligence, to the extent admissible by law or statute.
 *
 * DESCRIPTION:
 *
 * Demo test implementation of the 'OPEN Alliance Automotive Ethernet ECU Test
 * Specification - TC8 ECU Test' (Document Version 2.0, August 23, 2017)
 *
 * Copyright (c) Vector Informatik GmbH. All rights reserved.
 ***************************************************************************************/

/* Change this include block to use the testability protocol instead */
includes
{
  #include "Arp_UserDefinedStubFunctions.cin"
  #include "Eth_StubFunctions.cin"
  #include "General_StubFunctions.cin"
  #include "Icmp_StubFunctions.cin"
  #include "Icmp_UserDefinedStubFunctions.cin"
  #include "IP_StubFunctions.cin"
  #include "IP_UserDefinedStubFunctions.cin"
  #include "Dhcp_StubFunctions.cin"
  #include "Dhcp_UserDefinedStubFunctions.cin"
  #include "Udp_StubFunctions.cin"
  #include "Tcp_StubFunctions.cin"
  #include "Tcp_UserDefinedStubFunctions.cin"
  #include "Someip_UserDefinedStubFunctions.cin"
  #include "Layer2_UserDefinedStubFunctions.cin"
  #include "..\..\TestabilityProtocolLib\Interface_TestabilityServices.cin"
}

void StubInitialization()
{
  InternalInitTestabilityServiceClient(syspar::kTestabilityServicesResponseTimeoutMs);
}

void StubCleanup()
{
  InternalCleanupTestabilityServiceClient();
}