AUTOSAR XML (schema 4-2-2)
package /Vector
  ethernet cluster Vehicle_Ethernet: baudrate=100000000, protocol-name=ETHERNET, speed=100
    ethernet physical channel powertrain_chassis_channel: comm-connectors=[vgw_pt_connector, ic_pt_connector]
      pdu triggering pdu_triggering_VGW_Example_PDU: pdu=VGW_Example_PDU, from VGW
      pdu triggering pdu_triggering_IC_Example_PDU: pdu=IC_Example_PDU, from IC
      network endpoint vgw_pt_nep: network-endpoint-addresses=ipv-4-configuration={ipv-4-address=192.168.2.1, ipv-4-address-source=FIXED, network-mask=255.255.255.0}
      network endpoint ic_pt_nep: network-endpoint-addresses=ipv-4-configuration={ipv-4-address=192.168.2.2, ipv-4-address-source=FIXED, network-mask=255.255.255.0}
      network endpoint broadcast_pt_nep: network-endpoint-addresses=ipv-4-configuration={ipv-4-address=192.168.2.255, ipv-4-address-source=FIXED, network-mask=255.255.255.0}
      so-ad-config:
        socket connection bundle ID1: socket-connection=socket_address_broadcast_pt_aep, pdus=socket-connection-ipdu-identifier=pdu_triggering_VGW_Example_PDU, server-port=socket_address_vgw_pt_aep
        socket connection bundle ID3: socket-connection=socket_address_broadcast_pt_aep, pdus=socket-connection-ipdu-identifier=pdu_triggering_IC_Example_PDU, server-port=socket_address_ic_pt_aep
        socket address socket_address_vgw_pt_aep: connector=vgw_pt_connector
          application endpoint vgw_pt_aep: network-endpoint=vgw_pt_nep, tp-configuration=udp-tp=udp-tp-port=port-number=40001
        socket address socket_address_ic_pt_aep: connector=ic_pt_connector
          application endpoint ic_pt_aep: network-endpoint=ic_pt_nep, tp-configuration=udp-tp=udp-tp-port=port-number=40001
        socket address socket_address_broadcast_pt_aep
          application endpoint broadcast_pt_aep: network-endpoint=broadcast_pt_nep, tp-configuration=udp-tp=udp-tp-port=port-number=40001
      vlan VLAN_Powertrain_Chassis: vlan-identifier=2
    ethernet physical channel nm_channel: comm-connectors=[vgw_nm_connector, ic_nm_connector, hu_nm_connector, amp_nm_connector]
      pdu triggering pdu_triggering_VGW_UDP_NM: pdu=VGW_UDP_NM, from VGW
      pdu triggering pdu_triggering_IC_UDP_NM: pdu=IC_UDP_NM, from IC
      pdu triggering pdu_triggering_HU_UDP_NM: pdu=HU_UDP_NM, from HU
      pdu triggering pdu_triggering_AMP_UDP_NM: pdu=AMP_UDP_NM, from AMP
      5 x network endpoint:
        nm_multicast_nep: network-endpoint-addresses=ipv-4-configuration={ipv-4-address=192.168.1.255, ipv-4-address-source=FIXED, network-mask=255.255.255.0}
        vgw_nm_nep: network-endpoint-addresses=ipv-4-configuration={ipv-4-address=192.168.1.1, ipv-4-address-source=FIXED, network-mask=255.255.255.0}
        ic_nm_nep: network-endpoint-addresses=ipv-4-configuration={ipv-4-address=192.168.1.2, ipv-4-address-source=FIXED, network-mask=255.255.255.0}
        hu_nm_nep: network-endpoint-addresses=ipv-4-configuration={ipv-4-address=192.168.1.3, ipv-4-address-source=FIXED, network-mask=255.255.255.0}
        amp_nm_nep: network-endpoint-addresses=ipv-4-configuration={ipv-4-address=192.168.1.8, ipv-4-address-source=FIXED, network-mask=255.255.255.0}
      so-ad-config:
        4 x socket connection bundle, all with socket-connection=socket_address_nm_multicast_aep:
          ID5: pdus=socket-connection-ipdu-identifier=pdu_triggering_VGW_UDP_NM, server-port=socket_address_vgw_nm_aep
          ID7: pdus=socket-connection-ipdu-identifier=pdu_triggering_IC_UDP_NM, server-port=socket_address_ic_nm_aep
          ID9: pdus=socket-connection-ipdu-identifier=pdu_triggering_HU_UDP_NM, server-port=socket_address_hu_nm_aep
          ID11: pdus=socket-connection-ipdu-identifier=pdu_triggering_AMP_UDP_NM, server-port=socket_address_amp_nm_aep
        5 x socket address:
          socket_address_nm_multicast_aep
            application endpoint nm_multicast_aep: network-endpoint=nm_multicast_nep, tp-configuration=udp-tp=udp-tp-port=port-number=50002
          socket_address_vgw_nm_aep: connector=vgw_nm_connector
            application endpoint vgw_nm_aep: network-endpoint=vgw_nm_nep, tp-configuration=udp-tp=udp-tp-port=port-number=50001
          socket_address_ic_nm_aep: connector=ic_nm_connector
            application endpoint ic_nm_aep: network-endpoint=ic_nm_nep, tp-configuration=udp-tp=udp-tp-port=port-number=50001
          socket_address_hu_nm_aep: connector=hu_nm_connector
            application endpoint hu_nm_aep: network-endpoint=hu_nm_nep, tp-configuration=udp-tp=udp-tp-port=port-number=50001
          socket_address_amp_nm_aep: connector=amp_nm_connector
            application endpoint amp_nm_aep: network-endpoint=amp_nm_nep, tp-configuration=udp-tp=udp-tp-port=port-number=50001
      vlan VLAN_NM: vlan-identifier=1
    ethernet physical channel info_channel: comm-connectors=[hu_info_connector, amp_info_connector]
      pdu triggering pdu_triggering_HU_Example_PDU: pdu=HU_Example_PDU, from HU
      pdu triggering pdu_triggering_AMP_Example_PDU: pdu=AMP_Example_PDU, from AMP
      network endpoint hu_info_nep: network-endpoint-addresses=ipv-4-configuration={ipv-4-address=192.168.4.3, ipv-4-address-source=FIXED, network-mask=255.255.255.0}
      network endpoint amp_info_nep: network-endpoint-addresses=ipv-4-configuration={ipv-4-address=192.168.4.8, ipv-4-address-source=FIXED, network-mask=255.255.255.0}
      network endpoint broadcast_info_nep: network-endpoint-addresses=ipv-4-configuration={ipv-4-address=192.168.4.255, ipv-4-address-source=FIXED, network-mask=255.255.255.0}
      so-ad-config:
        socket connection bundle ID13: socket-connection=socket_address_broadcast_info_aep, pdus=socket-connection-ipdu-identifier=pdu_triggering_HU_Example_PDU, server-port=socket_address_hu_info_aep
        socket connection bundle ID15: socket-connection=socket_address_broadcast_info_aep, pdus=socket-connection-ipdu-identifier=pdu_triggering_AMP_Example_PDU, server-port=socket_address_amp_info_aep
        socket address socket_address_hu_info_aep: connector=hu_info_connector
          application endpoint hu_info_aep: network-endpoint=hu_info_nep, tp-configuration=udp-tp=udp-tp-port=port-number=40001
        socket address socket_address_amp_info_aep: connector=amp_info_connector
          application endpoint amp_info_aep: network-endpoint=amp_info_nep, tp-configuration=udp-tp=udp-tp-port=port-number=40001
        socket address socket_address_broadcast_info_aep
          application endpoint broadcast_info_aep: network-endpoint=broadcast_info_nep, tp-configuration=udp-tp=udp-tp-port=port-number=40001
      vlan VLAN_Infotainment: vlan-identifier=4
package /Vector/ECUs
  4 x ecu instance:
    VGW
      ethernet communication controller vgw_controller: mac-unicast-address=20:00:00:00:01:01
      ethernet communication connector vgw_nm_connector: comm-controller=vgw_controller, network-endpoint=vgw_nm_nep
      ethernet communication connector vgw_pt_connector: comm-controller=vgw_controller, network-endpoint=vgw_pt_nep
    IC
      ethernet communication controller ic_controller: mac-unicast-address=20:00:00:00:01:02
      ethernet communication connector ic_nm_connector: comm-controller=ic_controller, network-endpoint=ic_nm_nep
      ethernet communication connector ic_pt_connector: comm-controller=ic_controller, network-endpoint=ic_pt_nep
    HU
      ethernet communication controller hu_controller: mac-unicast-address=20:00:00:00:01:03
      ethernet communication connector hu_nm_connector: comm-controller=hu_controller, network-endpoint=hu_nm_nep
      ethernet communication connector hu_info_connector: comm-controller=hu_controller, network-endpoint=hu_info_nep
    AMP
      ethernet communication controller amp_controller: mac-unicast-address=20:00:00:00:01:07
      ethernet communication connector amp_nm_connector: comm-controller=amp_controller, network-endpoint=amp_nm_nep
      ethernet communication connector amp_info_connector: comm-controller=amp_controller, network-endpoint=amp_info_nep
package /Vector/PDUs
  pdu VGW_Example_PDU: length=4, transmission-mode-true-timing=cyclic-timing=time-period=0.5, unused-bit-pattern=0
    signal Value: start 0, 32 bit, little-endian, data-type-policy=OVERRIDE, base-type=A_UINT32, compu {}
  pdu IC_Example_PDU: length=4, transmission-mode-true-timing=cyclic-timing=time-period=0.5, unused-bit-pattern=0
    signal Value: start 0, 32 bit, little-endian, data-type-policy=OVERRIDE, base-type=A_UINT32, compu {}
  pdu HU_Example_PDU: length=4, transmission-mode-true-timing=cyclic-timing=time-period=0.5, unused-bit-pattern=0
    signal Value: start 0, 32 bit, little-endian, data-type-policy=OVERRIDE, base-type=A_UINT32, compu {}
  pdu AMP_Example_PDU: length=4, transmission-mode-true-timing=cyclic-timing=time-period=0.5, unused-bit-pattern=0
    signal Value: start 0, 32 bit, little-endian, data-type-policy=OVERRIDE, base-type=A_UINT32, compu {}
  nm pdu VGW_UDP_NM: length=8, unused-bit-pattern=0
    signal RepeatMessageRequest: start 0, 1 bit, little-endian, data-type-policy=OVERRIDE, base-type=BaseTypes/A_UINT8, compu {}
    signal NMCoordinatorSleeptReadyBit: start 3, 1 bit, little-endian, data-type-policy=OVERRIDE, base-type=BaseTypes/A_UINT8, compu {}
    signal ActiveWakeupBit: start 4, 1 bit, little-endian, data-type-policy=OVERRIDE, base-type=BaseTypes/A_UINT8, compu {}
    signal PartialNetworkInformationBit: start 6, 1 bit, little-endian, data-type-policy=OVERRIDE, base-type=BaseTypes/A_UINT8, compu {}
    signal NodeId: start 8, 8 bit, little-endian, data-type-policy=OVERRIDE, base-type=BaseTypes/A_UINT8, compu {}
    signal PNCVector: start 16, 16 bit, little-endian, data-type-policy=OVERRIDE, base-type=A_UINT16, compu {}
  nm pdu HU_UDP_NM: length=8, unused-bit-pattern=0
    signal RepeatMessageRequest: start 0, 1 bit, little-endian, data-type-policy=OVERRIDE, base-type=BaseTypes/A_UINT8, compu {}
    signal NMCoordinatorSleeptReadyBit: start 3, 1 bit, little-endian, data-type-policy=OVERRIDE, base-type=BaseTypes/A_UINT8, compu {}
    signal ActiveWakeupBit: start 4, 1 bit, little-endian, data-type-policy=OVERRIDE, base-type=BaseTypes/A_UINT8, compu {}
    signal PartialNetworkInformationBit: start 6, 1 bit, little-endian, data-type-policy=OVERRIDE, base-type=BaseTypes/A_UINT8, compu {}
    signal NodeId: start 8, 8 bit, little-endian, data-type-policy=OVERRIDE, base-type=BaseTypes/A_UINT8, compu {}
    signal PNCVector: start 16, 16 bit, little-endian, data-type-policy=OVERRIDE, base-type=A_UINT16, compu {}
  nm pdu IC_UDP_NM: length=8, unused-bit-pattern=0
    signal RepeatMessageRequest: start 0, 1 bit, little-endian, data-type-policy=OVERRIDE, base-type=BaseTypes/A_UINT8, compu {}
    signal NMCoordinatorSleeptReadyBit: start 3, 1 bit, little-endian, data-type-policy=OVERRIDE, base-type=BaseTypes/A_UINT8, compu {}
    signal ActiveWakeupBit: start 4, 1 bit, little-endian, data-type-policy=OVERRIDE, base-type=BaseTypes/A_UINT8, compu {}
    signal PartialNetworkInformationBit: start 6, 1 bit, little-endian, data-type-policy=OVERRIDE, base-type=BaseTypes/A_UINT8, compu {}
    signal NodeId: start 8, 8 bit, little-endian, data-type-policy=OVERRIDE, base-type=BaseTypes/A_UINT8, compu {}
    signal PNCVector: start 16, 16 bit, little-endian, data-type-policy=OVERRIDE, base-type=A_UINT16, compu {}
  nm pdu AMP_UDP_NM: length=8, unused-bit-pattern=0
    signal RepeatMessageRequest: start 0, 1 bit, little-endian, data-type-policy=OVERRIDE, base-type=BaseTypes/A_UINT8, compu {}
    signal NMCoordinatorSleeptReadyBit: start 3, 1 bit, little-endian, data-type-policy=OVERRIDE, base-type=BaseTypes/A_UINT8, compu {}
    signal ActiveWakeupBit: start 4, 1 bit, little-endian, data-type-policy=OVERRIDE, base-type=BaseTypes/A_UINT8, compu {}
    signal PartialNetworkInformationBit: start 6, 1 bit, little-endian, data-type-policy=OVERRIDE, base-type=BaseTypes/A_UINT8, compu {}
    signal NodeId: start 8, 8 bit, little-endian, data-type-policy=OVERRIDE, base-type=BaseTypes/A_UINT8, compu {}
    signal PNCVector: start 16, 16 bit, little-endian, data-type-policy=OVERRIDE, base-type=A_UINT16, compu {}
package /Vector/CompuMethods
  compu method Temperature: phys=raw*0.1-273.15; unit °C
  compu method Speed: phys=raw*0.1; unit km/h
  compu method Distance: phys=raw*0.1-1000000, 0=NoDistance; unit m
  compu method Current: phys=raw*0.001-1000; unit A
  compu method Power: phys=raw*0.001-1000; unit kW
  compu method Capacity: phys=raw*0.001; unit kWh
package /Vector/Units
  6 x unit:
    degree: display-name=°C
    kmh: display-name=km/h
    meter: display-name=m
    ampere: display-name=A
    kw: display-name=kW
    kwh: display-name=kWh
package /AUTOSAR/BaseTypes
  4 x base type, all with base-type-encoding=NONE:
    A_UINT8: base-type-size=8
    A_UINT8: base-type-size=8
    A_UINT16: base-type-size=16
    A_UINT32: base-type-size=32
