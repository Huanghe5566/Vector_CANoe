/* !Encoding: 65001  */
includes
{
  #include "__VariablesLib.cin"
  #include "__CaplGeneratorLib.cin"
  #include "__CANoeReportFuntionsLib.cin"
}

variables
{
  // Global variables defined within this CAPL file
}

export void Checkpoints_9e15e65899744eae95e1717f3bbcd5ec(int64 __generatorHandle)
{
}

export void Checkpoints_cf5cf194a4924537a8813c30b2792b30()
{
  {
    dword __func;
    CreateCaplIFFunction("__Cp8", __eFct);
    AddIFParameterDouble(0);
    __func = CallInterfaceFunctionParallel();
    testJoinParallelTestThread(__func);
  }


  {
    dword __func;
    CreateCaplIFFunction("__Cp9", __eFct);
    AddIFParameterDouble(0);
    __func = CallInterfaceFunctionParallel();
    testJoinParallelTestThread(__func);
  }


  {
    dword __func;
    CreateCaplIFFunction("__Cp10", __eFct);
    AddIFParameterDouble(1);
    __func = CallInterfaceFunctionParallel();
    testJoinParallelTestThread(__func);
  }


  {
    dword __func;
    CreateCaplIFFunction("__Cp11", __eFct);
    AddIFParameterDouble(1);
    __func = CallInterfaceFunctionParallel();
    testJoinParallelTestThread(__func);
  }
  testWaitForAllJoinedEventsSilent(0);


}

export void __Cp8(double currentCheckpointValue)
{
  TestCommandBegin(__eSet, __cSet, "", __cEmpty);
  {
  
    __ReportTableHead3Columns(__cSetCaption , __cTSym, __cTOp, __cAssigned); 
    {
      $`CAN::dbNode::`SUT_Driver::`VehicleMotion::`EngineRunning.phys = 1;
      __ReportSignalSetLValue("CAN signal 'EngineRunning'", `CAN::dbNode::`SUT_Driver::`VehicleMotion::`EngineRunning, __cArray);
      __ReportTableRow(0, __cArray, __cAOp, 1, "");
    }
    {
      $`CAN::dbNode::`SUT_Driver::`VehicleMotion::`CrashDetected.phys = 0;
      __ReportSignalSetLValue("CAN signal 'CrashDetected'", `CAN::dbNode::`SUT_Driver::`VehicleMotion::`CrashDetected, __cArray);
      __ReportTableRow(0, __cArray, __cAOp, 0, "");
    }
    {
      $`CAN::dbNode::`SUT::`CentralLockingSystemState::`LockState.phys = currentCheckpointValue;
      __ReportSignalSetLValue("CAN signal 'LockState'", `CAN::dbNode::`SUT::`CentralLockingSystemState::`LockState, __cArray);
      __ReportTableRow(0, __cArray, __cAOp, currentCheckpointValue, "currentCheckpointValue");
    }
    {
      $`CAN::dbNode::`SUT_Driver::`LockingRemoteControlRequest::`LockRequest.phys = 0;
      __ReportSignalSetLValue("CAN signal 'LockRequest'", `CAN::dbNode::`SUT_Driver::`LockingRemoteControlRequest::`LockRequest, __cArray);
      __ReportTableRow(0, __cArray, __cAOp, 0, "idle");
    }
    __ReportTableEndTestStep("1");
  }
  TestCommandEnd();

}

export void __Cp9(double currentCheckpointValue)
{
  testWaitForTimeoutNSDBSilent(1350 * 1000000);

  TestCommandBegin(__eCheck, __cCheck, "Check doors are \'unlocked\'", __cEmpty);
  {
    __bVerdict = __eVerdictPass;
    __ReportTableHead5Columns(__cCheckCaption, __cTSym, __cTOp, __cRefVal, __cActual, __cRes);
    {
      __csr = CheckSignalMatch(`CAN::dbNode::`SUT::`CentralLockingSystemState::`LockState, currentCheckpointValue, "==") == 1;
      __ReportTableRow(0, "CAN signal 'LockState'", "==", currentCheckpointValue, "currentCheckpointValue");
      __ReportCell(`CAN::dbNode::`SUT::`CentralLockingSystemState::`LockState);
      __ReportCellResult(__csr, __ePassFail);
      __bVerdict = __bVerdict && __csr;
    }
    __ReportTableEndVerdict("1", __bVerdict);
  }
  TestCommandEnd();

}

export void __Cp10(double currentCheckpointValue)
{
  testWaitForTimeoutNSDBSilent(1750 * 1000000);

  TestCommandBegin(__eCheck, __cCheck, "Check doors are \'unlocked\'", __cEmpty);
  {
    __bVerdict = __eVerdictPass;
    __ReportTableHead5Columns(__cCheckCaption, __cTSym, __cTOp, __cRefVal, __cActual, __cRes);
    {
      __csr = CheckSignalMatch(`CAN::dbNode::`SUT::`CentralLockingSystemState::`LockState, currentCheckpointValue, "==") == 1;
      __ReportTableRow(0, "CAN signal 'LockState'", "==", currentCheckpointValue, "currentCheckpointValue");
      __ReportCell(`CAN::dbNode::`SUT::`CentralLockingSystemState::`LockState);
      __ReportCellResult(__csr, __ePassFail);
      __bVerdict = __bVerdict && __csr;
    }
    __ReportTableEndVerdict("1", __bVerdict);
  }
  TestCommandEnd();

}

export void __Cp11(double currentCheckpointValue)
{
  testWaitForTimeoutNSDBSilent(2150 * 1000000);

  TestCommandBegin(__eCheck, __cCheck, "Check doors are \'unlocked\'", __cEmpty);
  {
    __bVerdict = __eVerdictPass;
    __ReportTableHead5Columns(__cCheckCaption, __cTSym, __cTOp, __cRefVal, __cActual, __cRes);
    {
      __csr = CheckSignalMatch(`CAN::dbNode::`SUT::`CentralLockingSystemState::`LockState, currentCheckpointValue, "==") == 1;
      __ReportTableRow(0, "CAN signal 'LockState'", "==", currentCheckpointValue, "currentCheckpointValue");
      __ReportCell(`CAN::dbNode::`SUT::`CentralLockingSystemState::`LockState);
      __ReportCellResult(__csr, __ePassFail);
      __bVerdict = __bVerdict && __csr;
    }
    __ReportTableEndVerdict("1", __bVerdict);
  }
  TestCommandEnd();

}

