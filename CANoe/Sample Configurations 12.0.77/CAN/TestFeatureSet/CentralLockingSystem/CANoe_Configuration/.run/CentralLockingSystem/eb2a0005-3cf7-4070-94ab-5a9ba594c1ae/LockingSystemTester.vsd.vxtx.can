/* !Encoding: 65001  */
includes
{
  #include "__DiagLibrary.cin"
  #include "__VariablesLib.cin"
  #include "__CaplGeneratorLib.cin"
  #include "__CANoeReportFuntionsLib.cin"
}

variables
{
  // Global variables defined within this CAPL file
}

void Tt5_MelFunction_Initial_2e816e05_3215_4162_8d74_dbd0ca8c305d_0()
{
  TestCommandBegin(__eFaultMemoryClear, __cFaultMemoryClear, "", "0");
  {
    long __res;
    long __dtc;
    
    __DiagSetTarget("SUT");
  
    DiagSetReportDetailLevel(EnumServiceDetails_onfail);
    TestStep("Query fault memory", "Clearing fault memory of target Diagnostic ECU 'SUT'");
  
    __res = TestWaitForDiagTroubleCodesCleared(-1, cDiagAppTimeoutDefault);
    if (__EvaluateWaitResWithVerdict(__res, 1, "DTC cleared successfully"))
      TestReportWriteFaultMemoryDetails(__bVerdict); }
  TestCommandEnd();

}

void Tt5_MelFunction_BinaryLink_c67ad6d0_00e5_410d_b968_befac6eaf581_1()
{
  TestCommandBegin(__eSet, __cSet, "", "1");
  {
  
    __ReportTableHead3Columns(__cSetCaption , __cTSym, __cTOp, __cAssigned); 
    {
      $`CAN::dbNode::`SUT_Driver::`VehicleMotion::`Velocity.phys = 0;
      __ReportSignalSetLValue("CAN signal 'Velocity'", `CAN::dbNode::`SUT_Driver::`VehicleMotion::`Velocity, __cArray);
      __ReportTableRow(0, __cArray, __cAOp, 0, "");
    }
    {
      $`CAN::dbNode::`SUT_Driver::`VehicleMotion::`CrashDetected.phys = 0;
      __ReportSignalSetLValue("CAN signal 'CrashDetected'", `CAN::dbNode::`SUT_Driver::`VehicleMotion::`CrashDetected, __cArray);
      __ReportTableRow(0, __cArray, __cAOp, 0, "");
    }
    {
      $`CAN::dbNode::`SUT_Driver::`LockingRemoteControlRequest::`LockRequest.phys = 0;
      __ReportSignalSetLValue("CAN signal 'LockRequest'", `CAN::dbNode::`SUT_Driver::`LockingRemoteControlRequest::`LockRequest, __cArray);
      __ReportTableRow(0, __cArray, __cAOp, 0, "idle");
    }
    {
      $`CAN::dbNode::`SUT_Driver::`VehicleMotion::`EngineRunning.phys = 1;
      __ReportSignalSetLValue("CAN signal 'EngineRunning'", `CAN::dbNode::`SUT_Driver::`VehicleMotion::`EngineRunning, __cArray);
      __ReportTableRow(0, __cArray, __cAOp, 1, "");
    }
    {
      $`CAN::dbNode::`SUT::`CentralLockingSystemState::`LockState.phys = 0;
      __ReportSignalSetLValue("CAN signal 'LockState'", `CAN::dbNode::`SUT::`CentralLockingSystemState::`LockState, __cArray);
      __ReportTableRow(0, __cArray, __cAOp, 0, "");
    }
    __ReportTableEndTestStep("1");
  }
  TestCommandEnd();

  TestCommandBegin(__eWait, __cWait, "", "2");
  {
    __Wait("1", (500 * 1000000), 1000000, "");
  }
  TestCommandEnd();

}

void Tt5_MelFunction_State_710e4754_7ec7_4eb4_8fb4_a71436e41a95_2()
{
  TestCommandBegin(__eCheck, __cCheck, "", "3");
  {
    __bVerdict = __eVerdictPass;
    __ReportTableHead5Columns(__cCheckCaption, __cTSym, __cTOp, __cRefVal, __cActual, __cRes);
    {
      __csr = CheckSignalMatch(`CAN::dbNode::`SUT::`CentralLockingSystemState::`LockState, 0, "==") == 1;
      __ReportTableRow(0, "CAN signal 'LockState'", "==", 0, "Unlocked");
      __ReportCell(`CAN::dbNode::`SUT::`CentralLockingSystemState::`LockState);
      __ReportCellResult(__csr, __ePassFail);
      __bVerdict = __bVerdict && __csr;
    }
    __ReportTableEndVerdict("1", __bVerdict);
  }
  TestCommandEnd();

}

void Tt5_MelFunction_BinaryLink_99367b4a_387f_45ed_b38b_27d0d2bf00f1_3()
{
  {
    CreateTTEIFFunction("UnlockManually", __eFct, __eGlobal);
    CallInterfaceFunction(__cEmpty, __cEmpty, "6461ed5a-14d4-4a03-91f9-bd4e139cdfba");
  }


}

void Tt5_MelFunction_BinaryLink_55c0398b_0f03_45f2_914e_def909df752a_4()
{
  testReportAddExternalRef("PREEvision", "lock statically", "preevision://myServer/Ma31342c143aea0ddc86624XMa31342c143aea0ddc8662310Ma31342c143aea0ddc86623", "vTESTstudio Traceability");


  {
    CreateTTEIFFunction("LockManually", __eFct, __eGlobal);
    CallInterfaceFunction(__cEmpty, __cEmpty, "31632e16-4189-4d45-a402-b37a0198abdf");
  }


}

void Tt5_MelFunction_State_cd9a6b21_9a93_48c8_a009_33e2c86d75a1_5()
{
  TestCommandBegin(__eCheck, __cCheck, "", "6");
  {
    __bVerdict = __eVerdictPass;
    __ReportTableHead5Columns(__cCheckCaption, __cTSym, __cTOp, __cRefVal, __cActual, __cRes);
    {
      __csr = CheckSignalMatch(`CAN::dbNode::`SUT::`CentralLockingSystemState::`LockState, 1, "==") == 1;
      __ReportTableRow(0, "CAN signal 'LockState'", "==", 1, "Locked");
      __ReportCell(`CAN::dbNode::`SUT::`CentralLockingSystemState::`LockState);
      __ReportCellResult(__csr, __ePassFail);
      __bVerdict = __bVerdict && __csr;
    }
    __ReportTableEndVerdict("1", __bVerdict);
  }
  TestCommandEnd();

}

void Tt5_MelFunction_BinaryLink_7f3a2376_4fce_4bf8_8a96_3791a2ef6efc_6()
{
  TestCommandBegin(__eSet, __cSet, "", "7");
  {
  
    __ReportTableHead3Columns(__cSetCaption , __cTSym, __cTOp, __cAssigned); 
    {
      $`CAN::dbNode::`SUT_Driver::`VehicleMotion::`Velocity.phys = 0;
      __ReportSignalSetLValue("CAN signal 'Velocity'", `CAN::dbNode::`SUT_Driver::`VehicleMotion::`Velocity, __cArray);
      __ReportTableRow(0, __cArray, __cAOp, 0, "");
    }
    {
      $`CAN::dbNode::`SUT_Driver::`VehicleMotion::`CrashDetected.phys = 0;
      __ReportSignalSetLValue("CAN signal 'CrashDetected'", `CAN::dbNode::`SUT_Driver::`VehicleMotion::`CrashDetected, __cArray);
      __ReportTableRow(0, __cArray, __cAOp, 0, "");
    }
    {
      $`CAN::dbNode::`SUT_Driver::`VehicleMotion::`EngineRunning.phys = 0;
      __ReportSignalSetLValue("CAN signal 'EngineRunning'", `CAN::dbNode::`SUT_Driver::`VehicleMotion::`EngineRunning, __cArray);
      __ReportTableRow(0, __cArray, __cAOp, 0, "");
    }
    __ReportTableEndTestStep("1");
  }
  TestCommandEnd();

  TestCommandBegin(__eWait, __cWait, "", "8");
  {
    __Wait("1", (500 * 1000000), 1000000, "");
  }
  TestCommandEnd();

}

void Tt5_MelFunction_Final_2a444042_5fe9_4e05_9c5b_1918a93cd7af_7()
{
    
  TestCommandBegin(__eFaultMemoryStatus, __cFaultMemoryStatus, "Check that fault memory is still empty since no errors provoked", "9");
  {
    long  __res;
    DWORD __statusByte;
    
    __bVerdict = __eVerdictPass;
    __DiagSetTarget("SUT");
    DiagSetReportDetailLevel(EnumServiceDetails_onfail);
    TestStep("Query fault memory", "Checking status of fault memory for Diagnostic ECU  'SUT'");
  
    __statusByte = -1;
  
    __res = TestWaitForDiagTroubleCodes(__statusByte, cDiagAppTimeoutDefault);
    if(__EvaluateWaitResWithVerdict(__res, 1))
    {
      long __dtcCount;
  	  
      __dtcCount = DiagGetDTCCount();
      if(__dtcCount >= 0)
      {
        __ReportTableHead5Columns("Check received number of relevant DTCs", __cTSym, __cTOp, __cRefVal, __cActual, __cRes);
        __csr = (CheckSignalMatch(__dtcCount, 0, "==") == 1);
        __ReportTableRow(0, "Expected number of DTCs", "==", 0, "");
        __ReportCell(__dtcCount);
        __ReportCellResult(__csr, __ePassFail);
        __ReportTableEndVerdict(__cEmpty, __csr);
        __bVerdict = __bVerdict && __csr;
      }
  
      TestReportWriteFaultMemoryDetails(__bVerdict);
    }
  }
  TestCommandEnd();

}

void Tt5_MelFunction_BinaryLink_754ed7c6_961b_4ace_bb84_b2a64e0813a4_8()
{
  {
    CreateTTEIFFunction("SpeedUpToLockVelocity", __eFct, __eGlobal);
    AddIFParameterInt64(-1);
    CallInterfaceFunction(__cEmpty, __cEmpty, "b1984b16-de90-49d4-93b9-0c5a934f8295");
  }


}

void Tt5_MelFunction_BinaryLink_075f6e54_1088_4f3c_8dd1_77635afb91bd_9()
{
  testReportAddExternalRef("PREEvision", "lock by increasing velocity", "preevision://myServer/Ma31342c143aea0ddc86636XMa31342c143aea0ddc8663510Ma31342c143aea0ddc86635", "vTESTstudio Traceability");


  {
    CreateTTEIFFunction("SpeedUpToLockVelocity", __eFct, __eGlobal);
    AddIFParameterInt64(+1);
    CallInterfaceFunction(__cEmpty, __cEmpty, "b1984b16-de90-49d4-93b9-0c5a934f8295");
  }


}

void Tt5_MelFunction_BinaryLink_76558bb6_c5bf_4855_ac19_84f1c8391c1a_10()
{
  testReportAddExternalRef("PREEvision", "unlock statically", "preevision://myServer/Ma31342c143aea0ddc8662aXMa31342c143aea0ddc8662910Ma31342c143aea0ddc86629", "vTESTstudio Traceability");


  {
    CreateTTEIFFunction("UnlockManually", __eFct, __eGlobal);
    CallInterfaceFunction(__cEmpty, __cEmpty, "6461ed5a-14d4-4a03-91f9-bd4e139cdfba");
  }


}

void Tt5_MelFunction_BinaryLink_32bb774b_2cf1_40bd_9b58_96c7f4db86de_11()
{
  {
    CreateTTEIFFunction("LockManually", __eFct, __eGlobal);
    CallInterfaceFunction(__cEmpty, __cEmpty, "31632e16-4189-4d45-a402-b37a0198abdf");
  }


}

void Tt5_MelFunction_BinaryLink_6b0048f0_02ae_40f1_ad0f_50e274dbe5e7_12()
{
  testReportAddExternalRef("PREEvision", "no unlock by slowing down", "preevision://myServer/Ma31342c143aea0ddc8663cXMa31342c143aea0ddc8663b10Ma31342c143aea0ddc8663b", "vTESTstudio Traceability");


  {
    CreateTTEIFFunction("SpeedUpToLockVelocity", __eFct, __eGlobal);
    AddIFParameterInt64(-1);
    CallInterfaceFunction(__cEmpty, __cEmpty, "b1984b16-de90-49d4-93b9-0c5a934f8295");
  }


}

void Tt5_Tet_TtInit()
{

}

void Tt5_Tet_Tc0()
{
  CreateTTEIFFunction("Tt5_Tc0", __eTcDef, __eLocal);  
  AddIFParameterTestCaseAttribute("Lifecycle", "ready for review");
  AddIFParameterTestCaseAttribute("Note", "Use algorithm for short paths (based on breadth-first search)");
  CallInterfaceFunction("Initialize_LockRequest=RequestUnlock_LockRequest=RequestLock_Finalize", __cEmpty , __cEmpty );
}
testcase Tt5_Tc0()
{	
  SetBreakOnFail(1);

  Tt5_MelFunction_Initial_2e816e05_3215_4162_8d74_dbd0ca8c305d_0();


  Tt5_MelFunction_BinaryLink_c67ad6d0_00e5_410d_b968_befac6eaf581_1();


  Tt5_MelFunction_State_710e4754_7ec7_4eb4_8fb4_a71436e41a95_2();


  Tt5_MelFunction_BinaryLink_99367b4a_387f_45ed_b38b_27d0d2bf00f1_3();


  Tt5_MelFunction_State_710e4754_7ec7_4eb4_8fb4_a71436e41a95_2();


  Tt5_MelFunction_BinaryLink_55c0398b_0f03_45f2_914e_def909df752a_4();


  Tt5_MelFunction_State_cd9a6b21_9a93_48c8_a009_33e2c86d75a1_5();


  Tt5_MelFunction_BinaryLink_7f3a2376_4fce_4bf8_8a96_3791a2ef6efc_6();


  Tt5_MelFunction_Final_2a444042_5fe9_4e05_9c5b_1918a93cd7af_7();


}

void Tt5_Tet_Tc1()
{
  CreateTTEIFFunction("Tt5_Tc1", __eTcDef, __eLocal);  
  AddIFParameterTestCaseAttribute("Lifecycle", "ready for review");
  AddIFParameterTestCaseAttribute("Note", "Use algorithm for short paths (based on breadth-first search)");
  CallInterfaceFunction("Initialize_0<Velocity<LockVelocity_LockRequest=RequestLock_Finalize", __cEmpty , __cEmpty );
}
testcase Tt5_Tc1()
{	
  SetBreakOnFail(1);

  Tt5_MelFunction_Initial_2e816e05_3215_4162_8d74_dbd0ca8c305d_0();


  Tt5_MelFunction_BinaryLink_c67ad6d0_00e5_410d_b968_befac6eaf581_1();


  Tt5_MelFunction_State_710e4754_7ec7_4eb4_8fb4_a71436e41a95_2();


  Tt5_MelFunction_BinaryLink_754ed7c6_961b_4ace_bb84_b2a64e0813a4_8();


  Tt5_MelFunction_State_710e4754_7ec7_4eb4_8fb4_a71436e41a95_2();


  Tt5_MelFunction_BinaryLink_55c0398b_0f03_45f2_914e_def909df752a_4();


  Tt5_MelFunction_State_cd9a6b21_9a93_48c8_a009_33e2c86d75a1_5();


  Tt5_MelFunction_BinaryLink_7f3a2376_4fce_4bf8_8a96_3791a2ef6efc_6();


  Tt5_MelFunction_Final_2a444042_5fe9_4e05_9c5b_1918a93cd7af_7();


}

void Tt5_Tet_Tc2()
{
  CreateTTEIFFunction("Tt5_Tc2", __eTcDef, __eLocal);  
  AddIFParameterTestCaseAttribute("Lifecycle", "ready for review");
  AddIFParameterTestCaseAttribute("Note", "Use algorithm for short paths (based on breadth-first search)");
  CallInterfaceFunction("Initialize_Velocity>LockVelocity_Finalize", __cEmpty , __cEmpty );
}
testcase Tt5_Tc2()
{	
  SetBreakOnFail(1);

  Tt5_MelFunction_Initial_2e816e05_3215_4162_8d74_dbd0ca8c305d_0();


  Tt5_MelFunction_BinaryLink_c67ad6d0_00e5_410d_b968_befac6eaf581_1();


  Tt5_MelFunction_State_710e4754_7ec7_4eb4_8fb4_a71436e41a95_2();


  Tt5_MelFunction_BinaryLink_075f6e54_1088_4f3c_8dd1_77635afb91bd_9();


  Tt5_MelFunction_State_cd9a6b21_9a93_48c8_a009_33e2c86d75a1_5();


  Tt5_MelFunction_BinaryLink_7f3a2376_4fce_4bf8_8a96_3791a2ef6efc_6();


  Tt5_MelFunction_Final_2a444042_5fe9_4e05_9c5b_1918a93cd7af_7();


}

void Tt5_Tet_Tc3()
{
  CreateTTEIFFunction("Tt5_Tc3", __eTcDef, __eLocal);  
  AddIFParameterTestCaseAttribute("Lifecycle", "ready for review");
  AddIFParameterTestCaseAttribute("Note", "Use algorithm for short paths (based on breadth-first search)");
  CallInterfaceFunction("Initialize_LockRequest=RequestLock_LockRequest=RequestUnlock(2)_LockRequest=RequestLock_Finalize", __cEmpty , __cEmpty );
}
testcase Tt5_Tc3()
{	
  SetBreakOnFail(1);

  Tt5_MelFunction_Initial_2e816e05_3215_4162_8d74_dbd0ca8c305d_0();


  Tt5_MelFunction_BinaryLink_c67ad6d0_00e5_410d_b968_befac6eaf581_1();


  Tt5_MelFunction_State_710e4754_7ec7_4eb4_8fb4_a71436e41a95_2();


  Tt5_MelFunction_BinaryLink_55c0398b_0f03_45f2_914e_def909df752a_4();


  Tt5_MelFunction_State_cd9a6b21_9a93_48c8_a009_33e2c86d75a1_5();


  Tt5_MelFunction_BinaryLink_76558bb6_c5bf_4855_ac19_84f1c8391c1a_10();


  Tt5_MelFunction_State_710e4754_7ec7_4eb4_8fb4_a71436e41a95_2();


  Tt5_MelFunction_BinaryLink_55c0398b_0f03_45f2_914e_def909df752a_4();


  Tt5_MelFunction_State_cd9a6b21_9a93_48c8_a009_33e2c86d75a1_5();


  Tt5_MelFunction_BinaryLink_7f3a2376_4fce_4bf8_8a96_3791a2ef6efc_6();


  Tt5_MelFunction_Final_2a444042_5fe9_4e05_9c5b_1918a93cd7af_7();


}

void Tt5_Tet_Tc4()
{
  CreateTTEIFFunction("Tt5_Tc4", __eTcDef, __eLocal);  
  AddIFParameterTestCaseAttribute("Lifecycle", "ready for review");
  AddIFParameterTestCaseAttribute("Note", "Use algorithm for short paths (based on breadth-first search)");
  CallInterfaceFunction("Initialize_LockRequest=RequestLock_LockRequest=RequestLock(2)_Finalize", __cEmpty , __cEmpty );
}
testcase Tt5_Tc4()
{	
  SetBreakOnFail(1);

  Tt5_MelFunction_Initial_2e816e05_3215_4162_8d74_dbd0ca8c305d_0();


  Tt5_MelFunction_BinaryLink_c67ad6d0_00e5_410d_b968_befac6eaf581_1();


  Tt5_MelFunction_State_710e4754_7ec7_4eb4_8fb4_a71436e41a95_2();


  Tt5_MelFunction_BinaryLink_55c0398b_0f03_45f2_914e_def909df752a_4();


  Tt5_MelFunction_State_cd9a6b21_9a93_48c8_a009_33e2c86d75a1_5();


  Tt5_MelFunction_BinaryLink_32bb774b_2cf1_40bd_9b58_96c7f4db86de_11();


  Tt5_MelFunction_State_cd9a6b21_9a93_48c8_a009_33e2c86d75a1_5();


  Tt5_MelFunction_BinaryLink_7f3a2376_4fce_4bf8_8a96_3791a2ef6efc_6();


  Tt5_MelFunction_Final_2a444042_5fe9_4e05_9c5b_1918a93cd7af_7();


}

void Tt5_Tet_Tc5()
{
  CreateTTEIFFunction("Tt5_Tc5", __eTcDef, __eLocal);  
  AddIFParameterTestCaseAttribute("Lifecycle", "ready for review");
  AddIFParameterTestCaseAttribute("Note", "Use algorithm for short paths (based on breadth-first search)");
  CallInterfaceFunction("Initialize_LockRequest=RequestLock_Velocity<LockVelocity_Finalize", __cEmpty , __cEmpty );
}
testcase Tt5_Tc5()
{	
  SetBreakOnFail(1);

  Tt5_MelFunction_Initial_2e816e05_3215_4162_8d74_dbd0ca8c305d_0();


  Tt5_MelFunction_BinaryLink_c67ad6d0_00e5_410d_b968_befac6eaf581_1();


  Tt5_MelFunction_State_710e4754_7ec7_4eb4_8fb4_a71436e41a95_2();


  Tt5_MelFunction_BinaryLink_55c0398b_0f03_45f2_914e_def909df752a_4();


  Tt5_MelFunction_State_cd9a6b21_9a93_48c8_a009_33e2c86d75a1_5();


  Tt5_MelFunction_BinaryLink_6b0048f0_02ae_40f1_ad0f_50e274dbe5e7_12();


  Tt5_MelFunction_State_cd9a6b21_9a93_48c8_a009_33e2c86d75a1_5();


  Tt5_MelFunction_BinaryLink_7f3a2376_4fce_4bf8_8a96_3791a2ef6efc_6();


  Tt5_MelFunction_Final_2a444042_5fe9_4e05_9c5b_1918a93cd7af_7();


}

