VERSION ""

NS_ :

BS_:

BU_:

BO_ 2362179326 PD: 14 Vector__XXX
 SG_ ActualCanopyHeight m520 : 32|32@1+ (1,0) [0|2147483647] "mm" Vector__XXX
 SG_ GNSSInstallationType m521 : 32|32@1+ (1,0) [0|100] "" Vector__XXX
 SG_ LastBaleLifetimeCount m519 : 32|32@1+ (1,0) [0|2147483647] "" Vector__XXX
 SG_ ActualTramlineCondensedWorkState m518 : 32|32@1+ (1,0) [0|4294967295] "" Vector__XXX
 SG_ SetpointTramlineCondensedWorkSta m517 : 32|32@1+ (1,0) [0|4294967295] "" Vector__XXX
 SG_ TramlineOverdosingRate m516 : 32|32@1+ (1,0) [0|2147483647] "ppm" Vector__XXX
 SG_ TramlineControlState m515 : 32|32@1+ (1,0) [0|3] "" Vector__XXX
 SG_ GNSSQuality m514 : 32|32@1+ (1,0) [0|2147483647] "" Vector__XXX
 SG_ GuidanceLineDeviation m513 : 32|32@1- (1,0) [-2147483648|2147483647] "mm" Vector__XXX
 SG_ GuidanceLineSwathWidth m512 : 32|32@1+ (1,0) [0|2147483647] "mm" Vector__XXX
 SG_ TrackNumberToLeft m511 : 32|32@1- (1,0) [-2147483648|2147483647] "" Vector__XXX
 SG_ TrackNumberToRight m510 : 32|32@1- (1,0) [-2147483648|2147483647] "" Vector__XXX
 SG_ ActualTrackNumber m509 : 32|32@1- (1,0) [-2147483648|2147483647] "" Vector__XXX
 SG_ UniqueABGuidanceReferenceLineID m508 : 32|32@1+ (1,0) [0|2147483647] "" Vector__XXX
 SG_ TramlineSequenceNumber m507 : 32|32@1+ (1,0) [0|2147483647] "" Vector__XXX
 SG_ SetpointTramlineControlLevel m506 : 32|32@1+ (1,0) [0|3] "" Vector__XXX
 SG_ TramlineControlLevel m505 : 32|32@1+ (1,0) [0|7] "" Vector__XXX
 SG_ MaxEngineTorque m504 : 32|32@1+ (0.001,0) [0|2147483.647] "%" Vector__XXX
 SG_ MinEngineTorque m503 : 32|32@1+ (0.001,0) [0|2147483.647] "%" Vector__XXX
 SG_ ActualEngineTorque m502 : 32|32@1+ (0.001,0) [0|2147483.647] "%" Vector__XXX
 SG_ SetpointEngineTorque m501 : 32|32@1+ (0.001,0) [0|2147483.647] "%" Vector__XXX
 SG_ LastEventPartnerIDDeviceClass m500 : 32|32@1+ (1,0) [0|0] "" Vector__XXX
 SG_ LastEventPartnerIDManufacturerID m499 : 32|32@1+ (1,0) [0|0] "" Vector__XXX
 SG_ LastEventPartnerIdType m498 : 32|32@1+ (1,0) [0|0] "" Vector__XXX
 SG_ LastEventPartnerID_Byte13to16 m497 : 32|32@1+ (1,0) [0|0] "" Vector__XXX
 SG_ LastEventPartnerID_Byte9to12 m496 : 32|32@1+ (1,0) [0|0] "" Vector__XXX
 SG_ LastEventPartnerID_Byte5to8 m495 : 32|32@1+ (1,0) [0|0] "" Vector__XXX
 SG_ LastEventPartnerID_Byte1to4 m494 : 32|32@1+ (1,0) [0|0] "" Vector__XXX
 SG_ LifetimeEngineHours m493 : 32|32@1+ (0.1,0) [0|214748364.7] "h" Vector__XXX
 SG_ TotalEngineHours m492 : 32|32@1+ (0.05,0) [0|210554060.75] "h" Vector__XXX
 SG_ FuelPercentageLevel m491 : 32|32@1- (0.01,0) [0|21474836.47] "%" Vector__XXX
 SG_ MaxFuelTankContent m490 : 32|32@1+ (1,0) [0|2147483647] "ml" Vector__XXX
 SG_ MaxDieselExhaustFluidTankContent m489 : 32|32@1+ (1,0) [0|2147483647] "ml" Vector__XXX
 SG_ DieselExhaustFluidTankPercentage m488 : 32|32@1+ (0.01,0) [0|100] "%" Vector__XXX
 SG_ MaxEngineSpeed m486 : 32|32@1- (0.0001,0) [0|214748.3647] "r/min" Vector__XXX
 SG_ MinEngineSpeed m485 : 32|32@1- (0.0001,0) [0|214748.3647] "r/min" Vector__XXX
 SG_ ActualEngineSpeed m484 : 32|32@1- (0.0001,0) [0|214748.3647] "r/min" Vector__XXX
 SG_ SetpointEngineSpeed m483 : 32|32@1- (0.0001,0) [0|214748.3647] "r/min" Vector__XXX
 SG_ LastBaleNumberOfSubbales m482 : 32|32@1+ (1,0) [0|2147483647] "" Vector__XXX
 SG_ SetpointNumberOfSubbales m481 : 32|32@1+ (1,0) [0|2147483647] "" Vector__XXX
 SG_ MaxFlakeSize m480 : 32|32@1- (1,0) [0|1000] "mm" Vector__XXX
 SG_ MinFlakeSize m479 : 32|32@1- (1,0) [0|1000] "mm" Vector__XXX
 SG_ SetpointFlakeSize m478 : 32|32@1- (1,0) [0|1000] "mm" Vector__XXX
 SG_ MaxBaleHydraulicPressure m477 : 32|32@1+ (1,0) [0|2147483647] "Pa" Vector__XXX
 SG_ MinBaleHydraulicPressure m476 : 32|32@1+ (1,0) [0|2147483647] "Pa" Vector__XXX
 SG_ SetpointBaleHydraulicPressure m475 : 32|32@1+ (1,0) [0|2147483647] "Pa" Vector__XXX
 SG_ MaxLengthOfCut m474 : 32|32@1+ (0.001,0) [0|2147483.647] "mm" Vector__XXX
 SG_ MinLengthOfCut m473 : 32|32@1+ (0.001,0) [0|2147483.647] "mm" Vector__XXX
 SG_ SetpointLengthOfCut m472 : 32|32@1+ (0.001,0) [0|2147483.647] "mm" Vector__XXX
 SG_ ActualPercentageContent m467 : 32|32@1+ (0.01,0) [0|100] "%" Vector__XXX
 SG_ ActualRelativeConnectorAngle m466 : 32|32@1- (0.001,0) [-180|180] "°" Vector__XXX
 SG_ LifetimeHaulCounter m465 : 32|32@1+ (1,0) [0|2147483647] "" Vector__XXX
 SG_ HaulCounter m464 : 32|32@1+ (1,0) [0|2147483647] "" Vector__XXX
 SG_ LastUnloadedCount m463 : 32|32@1+ (1,0) [0|2147483647] "" Vector__XXX
 SG_ LastLoadedCount m462 : 32|32@1+ (1,0) [0|2147483647] "" Vector__XXX
 SG_ LifetimeUnloadedTotalCount m461 : 32|32@1+ (1,0) [0|2147483647] "" Vector__XXX
 SG_ LifetimeLoadedTotalCount m460 : 32|32@1+ (1,0) [0|2147483647] "" Vector__XXX
 SG_ UnloadedTotalCount m459 : 32|32@1+ (1,0) [0|2147483647] "" Vector__XXX
 SG_ LoadedTotalCount m458 : 32|32@1+ (1,0) [0|2147483647] "" Vector__XXX
 SG_ LastUnloadedVolume m457 : 32|32@1+ (1,0) [0|2147483647] "ml" Vector__XXX
 SG_ LastLoadedVolume m456 : 32|32@1+ (1,0) [0|2147483647] "ml" Vector__XXX
 SG_ LifetimeUnloadedTotalVolume m455 : 32|32@1+ (1,0) [0|2147483647] "L" Vector__XXX
 SG_ LifetimeLoadedTotalVolume m454 : 32|32@1+ (1,0) [0|2147483647] "L" Vector__XXX
 SG_ UnloadedTotalVolume m453 : 32|32@1+ (1,0) [0|2147483647] "ml" Vector__XXX
 SG_ LoadedTotalVolume m452 : 32|32@1+ (1,0) [0|2147483647] "ml" Vector__XXX
 SG_ MaxAppRateOfDryMatter m451 : 32|32@1+ (1,0) [0|2147483647] "ppm" Vector__XXX
 SG_ MinAppRateOfDryMatter m450 : 32|32@1+ (1,0) [0|2147483647] "ppm" Vector__XXX
 SG_ ActualAppRateOfDryMatter m449 : 32|32@1+ (1,0) [0|2147483647] "ppm" Vector__XXX
 SG_ SetpointAppRateOfDryMatter m448 : 32|32@1+ (1,0) [0|2147483647] "ppm" Vector__XXX
 SG_ MaxAppRateOfPotassium m447 : 32|32@1+ (1,0) [0|4294967295] "mg/m²" Vector__XXX
 SG_ MinAppRateOfPotassium m446 : 32|32@1+ (1,0) [0|4294967295] "mg/m²" Vector__XXX
 SG_ ActualAppRateOfPotassium m445 : 32|32@1+ (1,0) [0|4294967295] "mg/m²" Vector__XXX
 SG_ SetpointAppRateOfPotassium m444 : 32|32@1+ (1,0) [0|4294967295] "mg/m²" Vector__XXX
 SG_ MaxAppRateOfPhosphor m443 : 32|32@1+ (1,0) [0|4294967295] "mg/m²" Vector__XXX
 SG_ MinAppRateOfPhosphor m442 : 32|32@1+ (1,0) [0|4294967295] "mg/m²" Vector__XXX
 SG_ ActualAppRateOfPhosphor m441 : 32|32@1+ (1,0) [0|4294967295] "mg/m²" Vector__XXX
 SG_ SetpointAppRateOfPhosphor m440 : 32|32@1+ (1,0) [0|4294967295] "mg/m²" Vector__XXX
 SG_ MaxAppRateOfAmmonium m439 : 32|32@1+ (1,0) [0|4294967295] "mg/m²" Vector__XXX
 SG_ MinAppRateOfAmmonium m438 : 32|32@1+ (1,0) [0|4294967295] "mg/m²" Vector__XXX
 SG_ ActualAppRateOfAmmonium m437 : 32|32@1+ (1,0) [0|4294967295] "mg/m²" Vector__XXX
 SG_ SetpointAppRateOfAmmonium m436 : 32|32@1+ (1,0) [0|4294967295] "mg/m²" Vector__XXX
 SG_ MaxAppRateOfNitrogen m435 : 32|32@1+ (1,0) [0|4294967295] "mg/m²" Vector__XXX
 SG_ MinAppRateOfNitrogen m434 : 32|32@1+ (1,0) [0|4294967295] "mg/m²" Vector__XXX
 SG_ ActualAppRateOfNitrogen m433 : 32|32@1+ (1,0) [0|4294967295] "mg/m²" Vector__XXX
 SG_ SetpointAppRateOfNitrogen m432 : 32|32@1+ (1,0) [0|4294967295] "mg/m²" Vector__XXX
 SG_ LifetimeUnloadedTotalMass m431 : 32|32@1+ (1,0) [0|2147483647] "kg" Vector__XXX
 SG_ LifetimeLoadedTotalMass m430 : 32|32@1+ (1,0) [0|2147483647] "kg" Vector__XXX
 SG_ UnloadedTotalMass m429 : 32|32@1+ (1,0) [0|2147483647] "kg" Vector__XXX
 SG_ LoadedTotalMass m428 : 32|32@1+ (1,0) [0|2147483647] "kg" Vector__XXX
 SG_ ActualDownforceAsForce m427 : 32|32@1- (1,0) [-2147483648|2147483647] "N" Vector__XXX
 SG_ SetpointDownforceAsForce m426 : 32|32@1- (1,0) [-2147483648|2147483647] "N" Vector__XXX
 SG_ SetpointMaxAllowedSeedSpacingDev m425 : 32|32@1+ (1,0) [0|2147483647] "mm" Vector__XXX
 SG_ AvgCoeffOfVariationOfSeedSpacing m424 : 32|32@1+ (1,0) [0|1000000] "ppm" Vector__XXX
 SG_ ActCoeffOfVariationOfSeedSpacing m423 : 32|32@1+ (1,0) [0|1000000] "ppm" Vector__XXX
 SG_ AverageSeedSpacingDeviation_Copy m422 : 32|32@1+ (1,0) [0|2147483647] "mm" Vector__XXX
 SG_ ActualSeedSpacingDeviation m421 : 32|32@1+ (1,0) [0|2147483647] "mm" Vector__XXX
 SG_ AverageSeedMultiplePercentage m420 : 32|32@1+ (1,0) [0|1000000] "ppm" Vector__XXX
 SG_ ActualSeedMultiplePercentage m419 : 32|32@1+ (1,0) [0|1000000] "ppm" Vector__XXX
 SG_ AverageSeedSkipPercentage m418 : 32|32@1+ (1,0) [0|1000000] "ppm" Vector__XXX
 SG_ ActualSeedSkipPercentage m417 : 32|32@1+ (1,0) [0|1000000] "ppm" Vector__XXX
 SG_ AverageSeedSingulationPercentage m416 : 32|32@1+ (1,0) [0|1000000] "ppm" Vector__XXX
 SG_ ActualSeedSingulationPercentage m415 : 32|32@1+ (1,0) [0|1000000] "ppm" Vector__XXX
 SG_ LifetimeAvgDieselExhFluidConsump m414 : 32|32@1+ (1,0) [0|2147483647] "mm³/m²" Vector__XXX
 SG_ LifetimeAvgDieselExhFluidCo_0000 m413 : 32|32@1+ (1,0) [0|2147483647] "mm³/s" Vector__XXX
 SG_ LifetimeDieselExhaustFluidConsum m412 : 32|32@1+ (0.5,0) [0|1073741823.5] "L" Vector__XXX
 SG_ InstantDieselExhaustFluidConsump m411 : 32|32@1+ (1,0) [0|2147483647] "mm³/m²" Vector__XXX
 SG_ InstantDieselExhaustFluidCo_0000 m410 : 32|32@1+ (1,0) [0|2147483647] "mm³/s" Vector__XXX
 SG_ TotalDieselExhaustFluidConsumpti m409 : 32|32@1+ (1,0) [0|2147483647] "ml" Vector__XXX
 SG_ AverageCropContamination m408 : 32|32@1+ (1,0) [0|2147483647] "ppm" Vector__XXX
 SG_ AverageProteinContent m407 : 32|32@1+ (1,0) [0|2147483647] "ppm" Vector__XXX
 SG_ ActualProteinContent m406 : 32|32@1+ (1,0) [0|2147483647] "ppm" Vector__XXX
 SG_ ActualApplicationOfDryMatter m405 : 32|32@1+ (1,0) [0|2147483647] "mg/l" Vector__XXX
 SG_ ActualApplicationOfPotassium m404 : 32|32@1+ (1,0) [0|2147483647] "mg/l" Vector__XXX
 SG_ ActualApplicationOfPhosphor m403 : 32|32@1+ (1,0) [0|2147483647] "mg/l" Vector__XXX
 SG_ ActualApplicationOfAmmonium m402 : 32|32@1+ (1,0) [0|2147483647] "mg/l" Vector__XXX
 SG_ ActualApplicationOfNitrogen m401 : 32|32@1+ (1,0) [0|2147483647] "mg/l" Vector__XXX
 SG_ SpeedSource m400 : 32|32@1- (1,0) [0|100] "" Vector__XXX
 SG_ MaximumSpeed m399 : 32|32@1- (1,0) [-2147483648|2147483647] "mm/s" Vector__XXX
 SG_ MinimumSpeed m398 : 32|32@1- (1,0) [-2147483648|2147483647] "mm/s" Vector__XXX
 SG_ ActualSpeed m397 : 32|32@1- (1,0) [-2147483648|2147483647] "mm/s" Vector__XXX
 SG_ SetpointSpeed m396 : 32|32@1- (1,0) [-2147483648|2147483647] "mm/s" Vector__XXX
 SG_ ActualDieselExhaustFluidTankCont m395 : 32|32@1+ (1,0) [0|4294967295] "ml" Vector__XXX
 SG_ ActualFuelTankContent m394 : 32|32@1+ (1,0) [0|2147483647] "ml" Vector__XXX
 SG_ MaximumRevolutionsPerTime m393 : 32|32@1- (0.0001,0) [-214748.3648|214748.3647] "r/min" Vector__XXX
 SG_ MinimumRevolutionsPerTime m392 : 32|32@1- (0.0001,0) [-214748.3648|214748.3647] "r/min" Vector__XXX
 SG_ DefaultRevolutionsPerTime m391 : 32|32@1- (0.0001,0) [-214748.3647|214748.3647] "r/min" Vector__XXX
 SG_ ActualRevolutionsPerTime m390 : 32|32@1- (0.0001,0) [-214748.3648|214748.3647] "r/min" Vector__XXX
 SG_ SetpointRevolutionsAsCountPerTim m389 : 32|32@1- (0.0001,0) [-214748.3647|214748.3647] "r/min" Vector__XXX
 SG_ TotalRevolutionsInCompleteRevolu m388 : 32|32@1- (0.0001,0) [-214748.3648|214748.3647] "" Vector__XXX
 SG_ TotalRevolutionsInFractionalRevo m387 : 32|32@1- (0.0001,0) [-214748.3648|214748.3647] "" Vector__XXX
 SG_ ActualAtmosphericPressure m386 : 32|32@1+ (0.1,0) [0|200000] "Pa" Vector__XXX
 SG_ MSLAtmosphericPressure m385 : 32|32@1+ (0.1,0) [0|200000] "Pa" Vector__XXX
 SG_ ApparentWindSpeed m384 : 32|32@1+ (1,0) [0|100000000] "mm/s" Vector__XXX
 SG_ ApparentWindDirection m383 : 32|32@1+ (1,0) [0|359] "°" Vector__XXX
 SG_ CondensedSectionOverrideState241 m382 : 32|32@1+ (1,0) [0|4294967295] "" Vector__XXX
 SG_ CondensedSectionOverrideState225 m381 : 32|32@1+ (1,0) [0|4294967295] "" Vector__XXX
 SG_ CondensedSectionOverrideState209 m380 : 32|32@1+ (1,0) [0|4294967295] "" Vector__XXX
 SG_ CondensedSectionOverrideState193 m379 : 32|32@1+ (1,0) [0|4294967295] "" Vector__XXX
 SG_ CondensedSectionOverrideState177 m378 : 32|32@1+ (1,0) [0|4294967295] "" Vector__XXX
 SG_ CondensedSectionOverrideState161 m377 : 32|32@1+ (1,0) [0|4294967295] "" Vector__XXX
 SG_ CondensedSectionOverrideState145 m376 : 32|32@1+ (1,0) [0|4294967295] "" Vector__XXX
 SG_ CondensedSectionOverrideState129 m375 : 32|32@1+ (1,0) [0|4294967295] "" Vector__XXX
 SG_ CondensedSectionOverrideState113 m374 : 32|32@1+ (1,0) [0|4294967295] "" Vector__XXX
 SG_ CondensedSectionOverrideState97t m373 : 32|32@1+ (1,0) [0|4294967295] "" Vector__XXX
 SG_ CondensedSectionOverrideState81t m372 : 32|32@1+ (1,0) [0|4294967295] "" Vector__XXX
 SG_ CondensedSectionOverrideState65t m371 : 32|32@1+ (1,0) [0|4294967295] "" Vector__XXX
 SG_ CondensedSectionOverrideState49t m370 : 32|32@1+ (1,0) [0|4294967295] "" Vector__XXX
 SG_ CondensedSectionOverrideState33t m369 : 32|32@1+ (1,0) [0|4294967295] "" Vector__XXX
 SG_ CondensedSectionOverrideState17t m368 : 32|32@1+ (1,0) [0|4294967295] "" Vector__XXX
 SG_ CondensedSectionOverrideState01t m367 : 32|32@1+ (1,0) [0|4294967295] "" Vector__XXX
 SG_ ActualDownforcePressure m366 : 32|32@1- (1,0) [-2147483648|2147483647] "Pa" Vector__XXX
 SG_ SetpointDownforcePressure m365 : 32|32@1- (1,0) [-2147483648|2147483647] "Pa" Vector__XXX
 SG_ ActualFlakeSize m364 : 32|32@1+ (1,0) [0|1000] "mm" Vector__XXX
 SG_ LastBaleDryMass m363 : 32|32@1+ (1,0) [0|2147483647] "g" Vector__XXX
 SG_ TotalBaleLength m362 : 32|32@1+ (1,0) [0|2147483647] "mm" Vector__XXX
 SG_ LastBaleDensity m361 : 32|32@1+ (1,0) [0|2147483647] "mg/l" Vector__XXX
 SG_ LastBaleSize m360 : 32|32@1+ (1,0) [0|2147483647] "mm" Vector__XXX
 SG_ AverageDryYieldMassPerArea m359 : 32|32@1+ (1,0) [0|2147483647] "mg/m²" Vector__XXX
 SG_ AverageDryYieldMassPerTime m358 : 32|32@1+ (1,0) [0|2147483647] "mg/s" Vector__XXX
 SG_ TotalApplicationOfDryMatter m357 : 32|32@1+ (1,0) [0|2147483647] "kg" Vector__XXX
 SG_ TotalApplicationOfPotassium m356 : 32|32@1+ (1,0) [0|2147483647] "g" Vector__XXX
 SG_ TotalApplicationOfPhosphor m355 : 32|32@1+ (1,0) [0|2147483647] "g" Vector__XXX
 SG_ TotalApplicationOfAmmonium m354 : 32|32@1+ (1,0) [0|2147483647] "g" Vector__XXX
 SG_ TotalApplicationofNitrogen m353 : 32|32@1+ (1,0) [0|2147483647] "g" Vector__XXX
 SG_ ApplicationTotalMass m352 : 32|32@1- (1,0) [0|2147483647] "g" Vector__XXX
 SG_ ApplicationTotalVolume m351 : 32|32@1- (1,0) [0|2147483647] "ml" Vector__XXX
 SG_ FunctionType m350 : 32|32@1- (1,0) [0|2147483647] "" Vector__XXX
 SG_ NozzleDriftReduction m349 : 32|32@1- (1,0) [0|100] "ppm" Vector__XXX
 SG_ MaximumSwathingWidth m348 : 32|32@1- (1,0) [0|2147483647] "mm" Vector__XXX
 SG_ MinimumSwathingWidth m347 : 32|32@1- (1,0) [0|2147483647] "mm" Vector__XXX
 SG_ ActualSwathingWidth m346 : 32|32@1- (1,0) [0|2147483647] "mm" Vector__XXX
 SG_ SetpointSwathingWidth m345 : 32|32@1- (1,0) [0|2147483647] "mm" Vector__XXX
 SG_ MaximumGrainKernelCrackerGap m344 : 32|32@1- (0.001,0) [0|2147483.647] "mm" Vector__XXX
 SG_ MinimumGrainKernelCrackerGap m343 : 32|32@1- (0.001,0) [0|2147483.647] "mm" Vector__XXX
 SG_ ActualGrainKernelCrackerGap m342 : 32|32@1- (0.001,0) [-0|2147483.647] "mm" Vector__XXX
 SG_ SetpointGrainKernelCrackerGap m341 : 32|32@1- (0.001,0) [-0|2147483.647] "mm" Vector__XXX
 SG_ EffectiveUnloadingTime m340 : 32|32@1- (1,0) [-0|2147483647] "s" Vector__XXX
 SG_ EffectiveLoadingTime m339 : 32|32@1- (1,0) [0|2147483647] "s" Vector__XXX
 SG_ LiftimeRearPTOHours m338 : 32|32@1- (0.1,0) [0|214748364.7] "h" Vector__XXX
 SG_ LifetimeFrontPTOHours m337 : 32|32@1- (0.1,0) [0|214748364.7] "h" Vector__XXX
 SG_ RearPTOHours m336 : 32|32@1- (1,0) [0|2147480000] "s" Vector__XXX
 SG_ FrontPTOHours m335 : 32|32@1- (1,0) [0|2147483647] "s" Vector__XXX
 SG_ OperatingHoursSinceLastSharpenin m334 : 32|32@1- (1,0) [0|2147483647] "s" Vector__XXX
 SG_ MaximumCuttingDrumSpeed m333 : 32|32@1- (0.001,0) [0|2147483.647] "1/s" Vector__XXX
 SG_ ActualCuttingDrumSpeed m331 : 32|32@1- (0.001,0) [0|2147483.647] "1/s" Vector__XXX
 SG_ SetpointCuttingDrumSpeed m330 : 32|32@1- (0.001,0) [0|2147483.647] "1/s" Vector__XXX
 SG_ MaximumHeaderSpeed m329 : 32|32@1- (0.001,0) [0|2147483.647] "1/s" Vector__XXX
 SG_ MinimumHeaderSpeed m328 : 32|32@1- (0.001,0) [0|2147483.647] "1/s" Vector__XXX
 SG_ ActualHeaderSpeed m327 : 32|32@1- (0.001,0) [0|2147483.647] "1/s" Vector__XXX
 SG_ SetpointHeaderSpeed m326 : 32|32@1- (0.001,0) [0|2147483.647] "1/s" Vector__XXX
 SG_ LifetimeApplicationTotalVolume m325 : 32|32@1+ (1,0) [0|2147483647] "L" Vector__XXX
 SG_ ChopperEngagementTotalTime m324 : 32|32@1+ (1,0) [0|2147483647] "s" Vector__XXX
 SG_ UnloadIdentificationNumber m323 : 32|32@1+ (1,0) [0|2147483647] "" Vector__XXX
 SG_ LoadIdentificationNumber m322 : 32|32@1+ (1,0) [0|4294967296] "" Vector__XXX
 SG_ ArbitraryAddressCapable m0 : 111|1@1+ (1,0) [0|1] "" Vector__XXX
 SG_ IndustryGroup m0 : 108|3@1+ (1,0) [0|7] "" Vector__XXX
 SG_ VehicleSystemInstance m0 : 104|4@1+ (1,0) [0|15] "" Vector__XXX
 SG_ VehicleSystem2 m0 : 97|7@1+ (1,0) [0|127] "" Vector__XXX
 SG_ Function m0 : 88|8@1+ (1,0) [0|255] "" Vector__XXX
 SG_ FunctionInstance m0 : 83|5@1+ (1,0) [0|31] "" Vector__XXX
 SG_ ECUInstance m0 : 80|3@1+ (1,0) [0|7] "" Vector__XXX
 SG_ ManufacturerCode m0 : 69|11@1+ (1,0) [0|2047] "" Vector__XXX
 SG_ TemperatureUnits m2 : 54|2@1+ (1,0) [0|3] "" Vector__XXX
 SG_ PressureUnits m2 : 52|2@1+ (1,0) [0|3] "" Vector__XXX
 SG_ ErrorCodeObjPool4 m9 : 51|1@1+ (1,0) [0|0] "" Vector__XXX
 SG_ ErrorCodeObjPool3 m9 : 50|1@1+ (1,0) [0|0] "" Vector__XXX
 SG_ ForceUnits m2 : 50|2@1+ (1,0) [0|3] "" Vector__XXX
 SG_ ErrorCodeObjPool2 m9 : 49|1@1+ (1,0) [0|0] "" Vector__XXX
 SG_ IdentityNumber m0 : 48|21@1+ (1,0) [0|2097152] "" Vector__XXX
 SG_ NumberOfSection m1 : 48|8@1+ (1,0) [0|255] "" Vector__XXX
 SG_ ExecutedCommand m14 : 48|8@1+ (1,0) [0|65535] "" Vector__XXX
 SG_ UnitsSystem m2 : 48|2@1+ (1,0) [0|3] "" Vector__XXX
 SG_ ErrorCodeObjPool1 m9 : 48|1@1+ (1,0) [0|0] "" Vector__XXX
 SG_ DistanceUnitCmd m2 : 46|2@1+ (1,0) [0|3] "" Vector__XXX
 SG_ AreaUnitCmd m2 : 44|2@1+ (1,0) [0|3] "" Vector__XXX
 SG_ VolumeUnitCmd m2 : 42|2@1+ (1,0) [0|3] "" Vector__XXX
 SG_ SourceAddressWSM m14 : 40|8@1+ (1,0) [0|65535] "" Vector__XXX
 SG_ MassUnitCmd m2 : 40|2@1+ (1,0) [0|3] "" Vector__XXX
 SG_ NumberOfBooms m1 : 40|8@1+ (1,0) [0|255] "" Vector__XXX
 SG_ OriginCommand m13 : 40|4@1+ (1,0) [0|15] "" Vector__XXX
 SG_ ErrorCodeProcessData8 m13 : 39|1@1+ (1,0) [0|1] "" Vector__XXX
 SG_ ErrorCodeProcessData7 m13 : 38|1@1+ (1,0) [0|1] "" Vector__XXX
 SG_ ErrorCodeProcessData6 m13 : 37|1@1+ (1,0) [0|1] "" Vector__XXX
 SG_ DestinationElementNumber m3 : 36|12@1+ (1,0) [0|4095] "" Vector__XXX
 SG_ ErrorCodeProcessData5 m13 : 36|1@1+ (1,0) [0|1] "" Vector__XXX
 SG_ ErrorCodeProcessData4 m13 : 35|1@1+ (1,0) [0|1] "" Vector__XXX
 SG_ StatusBusyExecuting m14 : 35|1@1+ (1,0) [0|1] "" Vector__XXX
 SG_ ErrorCodeProcessData3 m13 : 34|1@1+ (1,0) [0|1] "" Vector__XXX
 SG_ StatusBusyReading m14 : 34|1@1+ (1,0) [0|1] "" Vector__XXX
 SG_ ErrorCodeProcessData2 m13 : 33|1@1+ (1,0) [0|1] "" Vector__XXX
 SG_ StatusBusySaving m14 : 33|1@1+ (1,0) [0|1] "" Vector__XXX
 SG_ DataLogTimeInterval m4 : 32|32@1- (1,0) [0|60000] "ms" Vector__XXX
 SG_ DataLogDistanceInterval m5 : 32|32@1- (1,0) [0|1000000] "mm" Vector__XXX
 SG_ AppRateVolumePerArea_Set m1 : 32|32@1- (0.01,0) [0|21474836.47] "mm³/m²" Vector__XXX
 SG_ AppRateVolumePerArea_Act m2 : 32|32@1- (0.01,0) [0|21474836.47] "mm³/m²" Vector__XXX
 SG_ AppRateVolumePerArea_Def m3 : 32|32@1- (0.01,0) [0|21474836.47] "mm³/m²" Vector__XXX
 SG_ AppRateVolumePerArea_Min m4 : 32|32@1- (0.01,0) [0|21474836.47] "mm³/m²" Vector__XXX
 SG_ AppRateVolumePerArea_Max m5 : 32|32@1- (0.01,0) [0|21474836.47] "mm³/m²" Vector__XXX
 SG_ AppRateMassPerArea_Set m6 : 32|32@1- (1,0) [0|2147483647] "mg/m²" Vector__XXX
 SG_ AppRateMassPerArea_Act m7 : 32|32@1- (1,0) [0|2147483647] "mg/m²" Vector__XXX
 SG_ AppRateMassPerArea_Def m8 : 32|32@1- (1,0) [0|2147483647] "mg/m²" Vector__XXX
 SG_ AppRateMassPerArea_Min m9 : 32|32@1- (1,0) [0|2147483647] "mg/m²" Vector__XXX
 SG_ AppRateMassPerArea_Max m10 : 32|32@1- (1,0) [0|2147483647] "mg/m²" Vector__XXX
 SG_ AppRateCountPerArea_Set m11 : 32|32@1- (0.001,0) [0|2147483.647] "1/m²" Vector__XXX
 SG_ AppRateCountPerArea_Act m12 : 32|32@1- (0.001,0) [0|2147483.647] "1/m²" Vector__XXX
 SG_ AppRateCountPerArea_Def m13 : 32|32@1- (0.001,0) [0|2147483.647] "1/m²" Vector__XXX
 SG_ AppRateCountPerArea_Min m14 : 32|32@1- (0.001,0) [0|2147483.647] "1/m²" Vector__XXX
 SG_ AppRateCountPerArea_Max m15 : 32|32@1- (0.001,0) [0|2147483.647] "1/m²" Vector__XXX
 SG_ SetAppRateDistance_Set m16 : 32|32@1- (1,0) [0|2147483647] "mm" Vector__XXX
 SG_ AppRateDistance_Act m17 : 32|32@1- (1,0) [0|2147483647] "mm" Vector__XXX
 SG_ AppRateDistance_Def m18 : 32|32@1- (1,0) [0|2147483647] "mm" Vector__XXX
 SG_ AppRateDistance_Min m19 : 32|32@1- (1,0) [0|2147483647] "mm" Vector__XXX
 SG_ AppRateDistance_Max m20 : 32|32@1- (1,0) [0|2147483647] "mm" Vector__XXX
 SG_ AppRateVolumePerVolume_Set m21 : 32|32@1- (1,0) [0|2147483647] "mm³/m³" Vector__XXX
 SG_ AppRateVolumePerVolume_Act m22 : 32|32@1- (1,0) [0|2147483647] "mm³/m³" Vector__XXX
 SG_ AppRateVolumePerVolume_Def m23 : 32|32@1- (1,0) [0|2147483647] "mm³/m³" Vector__XXX
 SG_ AppRateVolumePerVolume_Min m24 : 32|32@1- (1,0) [0|2147483647] "mm³/m³" Vector__XXX
 SG_ AppRateVolumePerVolume_Max m25 : 32|32@1- (1,0) [0|2147483647] "mm³/m³" Vector__XXX
 SG_ AppRateMassPerMass_Set m26 : 32|32@1- (1,0) [0|2147483647] "mg/kg" Vector__XXX
 SG_ AppRateMassPerMass_Act m27 : 32|32@1- (1,0) [0|2147483647] "mg/kg" Vector__XXX
 SG_ AppRateMassPerMass_Def m28 : 32|32@1- (1,0) [0|2147483647] "mg/kg" Vector__XXX
 SG_ AppRateMassPerMass_Min m29 : 32|32@1- (1,0) [0|2147483647] "mg/kg" Vector__XXX
 SG_ AppRateMassPerMass_Max m30 : 32|32@1- (1,0) [0|2147483647] "mg/kg" Vector__XXX
 SG_ AppRateVolumePerMass_Set m31 : 32|32@1- (1,0) [0|2147483647] "mm³/kg" Vector__XXX
 SG_ AppRateVolumePerMass_Act m32 : 32|32@1- (1,0) [0|2147483647] "mm³/kg" Vector__XXX
 SG_ AppRateVolumePerMass_Def m33 : 32|32@1- (1,0) [0|2147483647] "mm³/kg" Vector__XXX
 SG_ AppRateVolumePerMass_Min m34 : 32|32@1- (1,0) [0|2147483647] "mm³/kg" Vector__XXX
 SG_ AppRateVolumePerMass_Max m35 : 32|32@1- (1,0) [0|2147483647] "mm³/kg" Vector__XXX
 SG_ AppRateVolumePerTime_Set m36 : 32|32@1- (1,0) [0|2147483647] "mm³/s" Vector__XXX
 SG_ AppRateVolumePerTime_Act m37 : 32|32@1- (1,0) [0|2147483647] "mm³/s" Vector__XXX
 SG_ AppRateVolumePerTime_Def m38 : 32|32@1- (1,0) [0|2147483647] "mm³/s" Vector__XXX
 SG_ AppRateVolumePerTime_Min m39 : 32|32@1- (1,0) [0|2147483647] "mm³/s" Vector__XXX
 SG_ AppRateVolumePerTime_Max m40 : 32|32@1- (1,0) [0|2147483647] "mm³/s" Vector__XXX
 SG_ AppRateMassPerTime_Set m41 : 32|32@1- (1,0) [0|2147483647] "mg/s" Vector__XXX
 SG_ AppRateMassPerTime_Act m42 : 32|32@1- (1,0) [0|2147483647] "mg/s" Vector__XXX
 SG_ AppRateMassPerTime_Def m43 : 32|32@1- (1,0) [0|2147483647] "mg/s" Vector__XXX
 SG_ AppRateMassPerTime_Min m44 : 32|32@1- (1,0) [0|2147483647] "mg/s" Vector__XXX
 SG_ AppRateMassPerTime_Max m45 : 32|32@1- (1,0) [0|2147483647] "mg/s" Vector__XXX
 SG_ AppRateCountPerTime_Set m46 : 32|32@1- (0.001,0) [0|2147483.647] "1/s" Vector__XXX
 SG_ AppRateCountPerTime_Act m47 : 32|32@1- (0.001,0) [0|2147483.647] "1/s" Vector__XXX
 SG_ AppRateCountPerTime_Def m48 : 32|32@1- (0.001,0) [0|2147483.647] "1/s" Vector__XXX
 SG_ AppRateCountPerTime_Min m49 : 32|32@1- (0.001,0) [0|2147483.647] "1/s" Vector__XXX
 SG_ AppRateCountPerTime_Max m50 : 32|32@1- (0.001,0) [0|2147483.647] "1/s" Vector__XXX
 SG_ SetTillageDepth_Set m51 : 32|32@1- (1,0) [0|2147483647] "mm" Vector__XXX
 SG_ TillageDepth_Act m52 : 32|32@1- (1,0) [0|2147483647] "mm" Vector__XXX
 SG_ TillageDepth_Def m53 : 32|32@1- (1,0) [0|2147483647] "mm" Vector__XXX
 SG_ TillageDepth_Min m54 : 32|32@1- (1,0) [0|2147483647] "mm" Vector__XXX
 SG_ TillageDepth_Max m55 : 32|32@1- (1,0) [0|2147483647] "mm" Vector__XXX
 SG_ SeedingDeph_Set m56 : 32|32@1- (1,0) [0|2147483647] "mm" Vector__XXX
 SG_ SeedingDeph_Act m57 : 32|32@1- (1,0) [0|2147483647] "mm" Vector__XXX
 SG_ SeedingDeph_Def m58 : 32|32@1- (1,0) [0|2147483647] "mm" Vector__XXX
 SG_ SeedingDeph_Min m59 : 32|32@1- (1,0) [0|2147483647] "mm" Vector__XXX
 SG_ SeedingDeph_Max m60 : 32|32@1- (1,0) [0|2147483647] "mm" Vector__XXX
 SG_ WorkingHeight_Set m61 : 32|32@1- (1,0) [0|2147483647] "mm" Vector__XXX
 SG_ WorkingHeight_Act m62 : 32|32@1- (1,0) [0|2147483647] "mm" Vector__XXX
 SG_ WorkingHeight_Def m63 : 32|32@1- (1,0) [0|2147483647] "mm" Vector__XXX
 SG_ WorkingHeight_Min m64 : 32|32@1- (1,0) [0|2147483647] "mm" Vector__XXX
 SG_ WorkingHeight_Max m65 : 32|32@1- (1,0) [0|2147483647] "mm" Vector__XXX
 SG_ WorkingWidth_Set m66 : 32|32@1- (1,0) [0|2147483647] "mm" Vector__XXX
 SG_ WorkingWidth_Act m67 : 32|32@1- (1,0) [0|2147483647] "mm" Vector__XXX
 SG_ WorkingWidth_Def m68 : 32|32@1- (1,0) [0|2147483647] "mm" Vector__XXX
 SG_ WorkingWidth_Min m69 : 32|32@1- (1,0) [0|2147483647] "mm" Vector__XXX
 SG_ WorkingWidth_Max m70 : 32|32@1- (1,0) [0|2147483647] "mm" Vector__XXX
 SG_ ContentAsVolume_Set m71 : 32|32@1- (1,0) [0|2147483647] "ml" Vector__XXX
 SG_ ContentAsVolume_Act m72 : 32|32@1- (1,0) [0|2147483647] "ml" Vector__XXX
 SG_ ContentAsVolume_Max m73 : 32|32@1- (1,0) [0|2147483647] "ml" Vector__XXX
 SG_ ContentAsMass_Set m74 : 32|32@1- (1,0) [0|2147483647] "g" Vector__XXX
 SG_ ContentAsMass_Act m75 : 32|32@1- (1,0) [0|2147483647] "g" Vector__XXX
 SG_ ContentAsMass_Max m76 : 32|32@1- (1,0) [0|2147483647] "g" Vector__XXX
 SG_ ContentAsCount_Set m77 : 32|32@1- (1,0) [0|2147483647] "" Vector__XXX
 SG_ ContentAsCount_Act m78 : 32|32@1- (1,0) [0|2147483647] "" Vector__XXX
 SG_ ContentAsCount_Max m79 : 32|32@1- (1,0) [0|2147483647] "" Vector__XXX
 SG_ AccumulatedAppAsVolume m80 : 32|32@1- (1,0) [0|2147483647] "l" Vector__XXX
 SG_ AccumulatedAppAsMass m81 : 32|32@1- (1,0) [0|2147483647] "kg" Vector__XXX
 SG_ AccumulatedAppAsCount m82 : 32|32@1- (1,0) [0|2147483647] "" Vector__XXX
 SG_ YieldVolumePerArea m83 : 32|32@1- (1,0) [0|2147483647] "ml/m²" Vector__XXX
 SG_ YieldMassPerArea m84 : 32|32@1- (1,0) [0|2147483647] "mg/m²" Vector__XXX
 SG_ YieldCountPerArea m85 : 32|32@1- (0.001,0) [0|2147483.647] "1/m²" Vector__XXX
 SG_ YieldVolumePerTime m86 : 32|32@1- (1,0) [0|2147483647] "ml/s" Vector__XXX
 SG_ YieldMassPerTime m87 : 32|32@1- (1,0) [0|2147483647] "mg/s" Vector__XXX
 SG_ YieldCountPerTime m88 : 32|32@1- (0.001,0) [0|2147483.647] "1/s" Vector__XXX
 SG_ AccumulatedYieldAsVolume m89 : 32|32@1- (1,0) [0|2147483647] "ml" Vector__XXX
 SG_ AccumulatedYieldAsMass m90 : 32|32@1- (1,0) [0|2147483647] "g" Vector__XXX
 SG_ AccumulatedYieldAsCount m91 : 32|32@1- (1,0) [0|2147483647] "" Vector__XXX
 SG_ CropYieldLossVolumePerArea m92 : 32|32@1- (1,0) [0|2147483647] "ml/m²" Vector__XXX
 SG_ CropYieldLossMassPerArea m93 : 32|32@1- (1,0) [0|2147483647] "mg/m²" Vector__XXX
 SG_ CropYieldLossCountPerArea m94 : 32|32@1- (0.001,0) [0|2147483.647] "1/m²" Vector__XXX
 SG_ CropYieldLossVolumePerTime m95 : 32|32@1- (1,0) [0|2147483647] "ml/s" Vector__XXX
 SG_ CropYieldLossMassPerTime m96 : 32|32@1- (1,0) [0|2147483647] "mg/s" Vector__XXX
 SG_ CropYieldLossCountPerTime m97 : 32|32@1- (0.001,0) [0|2147483.647] "1/s" Vector__XXX
 SG_ CropYieldLoss m98 : 32|32@1- (1,0) [0|2147483647] "ppm" Vector__XXX
 SG_ MoistureInCropYield m99 : 32|32@1- (1,0) [0|2147483647] "ppm" Vector__XXX
 SG_ DirtMaterialInCropYield m100 : 32|32@1- (1,0) [0|2147483647] "ppm" Vector__XXX
 SG_ BaleWidth_Set m101 : 32|32@1- (1,0) [0|2147483647] "mm" Vector__XXX
 SG_ BaleWidth_Act m102 : 32|32@1- (1,0) [0|2147483647] "mm" Vector__XXX
 SG_ BaleWidth_Def m103 : 32|32@1- (1,0) [0|2147483647] "mm" Vector__XXX
 SG_ BaleWidth_Min m104 : 32|32@1- (1,0) [0|2147483647] "mm" Vector__XXX
 SG_ BaleWidth_Max m105 : 32|32@1- (1,0) [0|2147483647] "mm" Vector__XXX
 SG_ BaleHeight_Set m106 : 32|32@1- (1,0) [0|2147483647] "mm" Vector__XXX
 SG_ BaleHeight_Act m107 : 32|32@1- (1,0) [0|2147483647] "mm" Vector__XXX
 SG_ BaleHeight_Def m108 : 32|32@1- (1,0) [0|2147483647] "mm" Vector__XXX
 SG_ BaleHeight_Min m109 : 32|32@1- (1,0) [0|2147483647] "mm" Vector__XXX
 SG_ BaleHeight_Max m110 : 32|32@1- (1,0) [0|2147483647] "mm" Vector__XXX
 SG_ BaleSize_Set m111 : 32|32@1- (1,0) [0|2147483647] "mm" Vector__XXX
 SG_ BaleSize_Act m112 : 32|32@1- (1,0) [0|2147483647] "mm" Vector__XXX
 SG_ BaleSize_Def m113 : 32|32@1- (1,0) [0|2147483647] "mm" Vector__XXX
 SG_ BaleSize_Min m114 : 32|32@1- (1,0) [0|2147483647] "mm" Vector__XXX
 SG_ BaleSize_Max m115 : 32|32@1- (1,0) [0|2147483647] "mm" Vector__XXX
 SG_ AccumulatedArea m116 : 32|32@1- (1,0) [0|2147483647] "m²" Vector__XXX
 SG_ AccumulatedDistanceInWork m117 : 32|32@1- (1,0) [0|2147483647] "mm" Vector__XXX
 SG_ AccumulatedDistanceOutWork m118 : 32|32@1- (1,0) [0|2147483647] "mm" Vector__XXX
 SG_ AccumulatedTimeInWork m119 : 32|32@1- (1,0) [0|2147483647] "s" Vector__XXX
 SG_ AccumulatedTimeOutWork m120 : 32|32@1- (1,0) [0|2147483647] "s" Vector__XXX
 SG_ PrdoucDensityMassPerArea m121 : 32|32@1- (1,0) [0|2147483647] "g/l" Vector__XXX
 SG_ PrdoucDensityMassPerCount m122 : 32|32@1- (1,0) [0|2147483647] "mg/1000" Vector__XXX
 SG_ PrdoucDensityVolumePerCount m123 : 32|32@1- (1,0) [0|2147483647] "ml/1000" Vector__XXX
 SG_ AuxiliaryValveScalingExtend m124 : 32|32@1- (0.1,0) [-214748367.9|214748367.9] "%" Vector__XXX
 SG_ AuxiliaryValveScalingRetract m125 : 32|32@1- (0.1,0) [-214748367.9|214748367.9] "%" Vector__XXX
 SG_ AuxiliaryRampExtendUp m126 : 32|32@1- (1,0) [-2147483647|2147483647] "ms" Vector__XXX
 SG_ AuxiliaryValveRampExtendDown m127 : 32|32@1- (1,0) [-2147483647|2147483647] "ms" Vector__XXX
 SG_ AuxiliaryValveRampRetractUp m128 : 32|32@1- (1,0) [-2147483647|2147483647] "ms" Vector__XXX
 SG_ AuxiliaryValveRampRetractDown m129 : 32|32@1- (1,0) [-2147483647|2147483647] "ms" Vector__XXX
 SG_ AuxiliaryValveFloatThreshold m130 : 32|32@1- (0.1,0) [-214748367.9|214748367.9] "%" Vector__XXX
 SG_ AuxiliaryValveProgressivExtend m131 : 32|32@1- (1,0) [-2147483647|2147483647] "" Vector__XXX
 SG_ AuxiliaryValveProgressivRetract m132 : 32|32@1- (1,0) [-2147480000|2147480000] "" Vector__XXX
 SG_ AuxiliaryValveInvertPorts m133 : 32|32@1- (1,0) [-2147480000|2147480000] "" Vector__XXX
 SG_ DeviceElementOffsetX m134 : 32|32@1- (1,0) [-2147483647|2147483647] "mm" Vector__XXX
 SG_ DeviceElementOffsetY m135 : 32|32@1- (1,0) [-2147483647|2147483647] "mm" Vector__XXX
 SG_ DeviceElementOffsetZ m136 : 32|32@1- (1,0) [-2147483647|2147483647] "mm" Vector__XXX
 SG_ DeviceVolumeCapacity m137 : 32|32@1- (1,0) [0|2147483647] "ml" Vector__XXX
 SG_ DeviceMassCapacity m138 : 32|32@1- (1,0) [0|2147483647] "g" Vector__XXX
 SG_ DeviceCountCapacity m139 : 32|32@1- (1,0) [0|2147483647] "" Vector__XXX
 SG_ PercentageAppRateSetpoint m140 : 32|32@1- (1,0) [0|2147483647] "ppm" Vector__XXX
 SG_ WorkState m141 : 32|32@1- (1,0) [0|3] "" Vector__XXX
 SG_ SetpointTimeLatency m142 : 32|32@1- (1,0) [-2147483647|2147483647] "ms" Vector__XXX
 SG_ ActualValueTimeLatency m143 : 32|32@1- (1,0) [-2147483647|2147483647] "ms" Vector__XXX
 SG_ YawAngle m144 : 32|32@1- (0.001,0) [-180|180] "°" Vector__XXX
 SG_ RollAngle m145 : 32|32@1- (0.001,0) [-180|180] "°" Vector__XXX
 SG_ PitchAngle m146 : 32|32@1- (0.001,0) [-180|180] "°" Vector__XXX
 SG_ LogCount m147 : 32|32@1- (1,0) [0|2147483647] "" Vector__XXX
 SG_ TotalFuelConsumption m148 : 32|32@1- (1,0) [0|2147483647] "ml" Vector__XXX
 SG_ FuelConsumptionPerTime m149 : 32|32@1- (1,0) [0|2147483647] "mm³/s" Vector__XXX
 SG_ FuelConsumptionPerArea m150 : 32|32@1- (1,0) [0|2147483647] "mm³/ m²" Vector__XXX
 SG_ AreaPerTimeCapacity m151 : 32|32@1- (1,0) [0|2147483647] "mm²/s" Vector__XXX
 SG_ MinMassPerAreaAppRate m152 : 32|32@1- (0.01,0) [0|2147480000] "mm³/m³" Vector__XXX
 SG_ NDVI m153 : 32|32@1- (1,0) [-1|1] "" Vector__XXX
 SG_ PhysicalObjectLength m154 : 32|32@1- (1,0) [0|2147483647] "mm" Vector__XXX
 SG_ PhysicalObjectWidth m155 : 32|32@1- (1,0) [0|2147483647] "mm" Vector__XXX
 SG_ PhysicalObjectHeight m156 : 32|32@1- (1,0) [0|2147483647] "mm" Vector__XXX
 SG_ ConnectorType m157 : 32|32@1- (1,0) [0|7] "" Vector__XXX
 SG_ PrescriptionControlState m158 : 32|32@1- (1,0) [0|3] "" Vector__XXX
 SG_ NumberOfSubUnitsPerSection m159 : 32|32@1- (1,0) [0|2147483647] "Amount/Count" Vector__XXX
 SG_ SectionControlState m160 : 32|32@1- (1,0) [0|3] "" Vector__XXX
 SG_ CondensedWorkState1to16 m161 : 32|32@1- (1,0) [-2147483648|2147483647] "" Vector__XXX
 SG_ CondensedWorkState17to32 m162 : 32|32@1- (1,0) [-2147483648|2147483647] "" Vector__XXX
 SG_ CondensedWorkState33to48 m163 : 32|32@1- (1,0) [-2147483648|2147483647] "" Vector__XXX
 SG_ CondensedWorkState49to64 m164 : 32|32@1- (1,0) [-2147483648|2147483647] "" Vector__XXX
 SG_ CondensedWorkState65to80 m165 : 32|32@1- (1,0) [-2147483648|2147483647] "" Vector__XXX
 SG_ CondensedWorkState81to96 m166 : 32|32@1- (1,0) [-2147483648|2147483647] "" Vector__XXX
 SG_ CondensedWorkState97to112 m167 : 32|32@1- (1,0) [-2147483648|2147483647] "" Vector__XXX
 SG_ CondensedWorkState113to128 m168 : 32|32@1- (1,0) [-2147483648|2147483647] "" Vector__XXX
 SG_ CondensedWorkState129to144 m169 : 32|32@1- (1,0) [-2147483648|2147483647] "" Vector__XXX
 SG_ CondensedWorkState145to160 m170 : 32|32@1- (1,0) [-2147483648|2147483647] "" Vector__XXX
 SG_ CondensedWorkState161to176 m171 : 32|32@1- (1,0) [-2147483648|2147483647] "" Vector__XXX
 SG_ CondensedWorkState177to192 m172 : 32|32@1- (1,0) [-2147483648|2147483647] "" Vector__XXX
 SG_ CondensedWorkState193to208 m173 : 32|32@1- (1,0) [-2147483648|2147483647] "" Vector__XXX
 SG_ CondensedWorkState209to224 m174 : 32|32@1- (1,0) [-2147483648|2147483647] "" Vector__XXX
 SG_ CondensedWorkState225to240 m175 : 32|32@1- (1,0) [-2147483648|2147483647] "" Vector__XXX
 SG_ CondensedWorkState241to256 m176 : 32|32@1- (1,0) [-2147483648|2147483647] "" Vector__XXX
 SG_ ActualLengthOfCut m177 : 32|32@1- (0.001,0) [0|2147483647] "mm" Vector__XXX
 SG_ ElementTypeInstance m178 : 32|32@1- (1,0) [0|65533] "" Vector__XXX
 SG_ ActualCulturalPractice m179 : 32|32@1- (1,0) [0|2147483647] "" Vector__XXX
 SG_ DRP2GroundDistance m180 : 32|32@1- (1,0) [-2147483648|2147483647] "mm" Vector__XXX
 SG_ DryMassPerAreaYield m181 : 32|32@1- (1,0) [0|2147483647] "mg/m²" Vector__XXX
 SG_ DryMassPerTimeYield m182 : 32|32@1- (1,0) [0|2147483647] "mg/s" Vector__XXX
 SG_ YieldTotalDryMass m183 : 32|32@1- (1,0) [0|2147483647] "kg" Vector__XXX
 SG_ RefMoistureForDryMass m184 : 32|32@1- (1,0) [0|2147483647] "ppm" Vector__XXX
 SG_ SeedCottonMassPerAreaYield m185 : 32|32@1- (1,0) [0|2147483647] "mg/m²" Vector__XXX
 SG_ LintCottonMassPerAreaYield m186 : 32|32@1- (1,0) [0|2147483647] "mg/m²" Vector__XXX
 SG_ SeedCottonMassPerTimeYield m187 : 32|32@1- (1,0) [0|2147483647] "mg/s" Vector__XXX
 SG_ LintCottonMassPerTimeYield m188 : 32|32@1- (1,0) [0|2147483647] "mg/s" Vector__XXX
 SG_ YieldTotalSeedCottonMass m189 : 32|32@1- (1,0) [0|2147483647] "" Vector__XXX
 SG_ YieldTotalLintCottonMass m190 : 32|32@1- (1,0) [0|2147483647] "kg" Vector__XXX
 SG_ LintTurnoutPercentage m191 : 32|32@1- (1,0) [0|2147483647] "ppm" Vector__XXX
 SG_ AmbientTemperature m192 : 32|32@1- (1,0) [0|1000000] "mK" Vector__XXX
 SG_ SetpointProductPressure m193 : 32|32@1- (0.1,0) [-2147483648|2147483647] "Pa" Vector__XXX
 SG_ ActualProductPressure m194 : 32|32@1- (0.1,0) [-2147483648|2147483647] "Pa" Vector__XXX
 SG_ MinimumProductPressure m195 : 32|32@1- (0.1,0) [-2147483648|2147483647] "Pa" Vector__XXX
 SG_ MaximumProductPressure m196 : 32|32@1- (0.1,0) [-2147483648|2147483647] "Pa" Vector__XXX
 SG_ SetpointPumpOutputPressure m197 : 32|32@1- (0.1,0) [-2147483648|2147483647] "Pa" Vector__XXX
 SG_ ActualPumpOutputPressure m198 : 32|32@1- (0.1,0) [-2147483648|2147483647] "Pa" Vector__XXX
 SG_ MinimumPumpOutputPressure m199 : 32|32@1- (0.1,0) [-2147483648|2147483647] "Pa" Vector__XXX
 SG_ MaximumPumpOutputPressure m200 : 32|32@1- (0.1,0) [-2147483648|2147483647] "Pa" Vector__XXX
 SG_ SetpointTankAgitationPressure m201 : 32|32@1- (0.1,0) [-2147483648|2147483647] "Pa" Vector__XXX
 SG_ ActualTankAgitationPressure m202 : 32|32@1- (0.1,0) [-2147483648|2147483647] "Pa" Vector__XXX
 SG_ MinimumTankAgitationPressure m203 : 32|32@1- (0.1,0) [-2147483648|2147483647] "Pa" Vector__XXX
 SG_ MaximumTankAgitationPressure m204 : 32|32@1- (0.1,0) [-2147483648|2147483647] "Pa" Vector__XXX
 SG_ SCTurnOnTime_ m205 : 32|32@1- (1,0) [-2147483648|2147483647] "ms" Vector__XXX
 SG_ SCTurnOffTime m206 : 32|32@1- (1,0) [-2147483648|2147483647] "ms" Vector__XXX
 SG_ WindSpeed m207 : 32|32@1- (1,0) [0|100000000] "mm/s" Vector__XXX
 SG_ WindDirection m208 : 32|32@1- (1,0) [0|359] "°" Vector__XXX
 SG_ AirHumidity m209 : 32|32@1- (1,0) [0|100] "%" Vector__XXX
 SG_ SkyConditions m210 : 32|32@1- (1,0) [-2147483648|2147483647] "" Vector__XXX
 SG_ LastBaleFlakesPerBale m211 : 32|32@1- (1,0) [0|1000] "Amount/Count" Vector__XXX
 SG_ LastBaleAverageMoisture m212 : 32|32@1- (1,0) [0|100000000] "ppm" Vector__XXX
 SG_ LastBaleAverageStrokesPerFlake m213 : 32|32@1- (1,0) [0|1000] "Amount/Count" Vector__XXX
 SG_ LifetimeBaleCount m214 : 32|32@1- (1,0) [0|2147483647] "Amount/Count" Vector__XXX
 SG_ LifetimeWorkingHours m215 : 32|32@1- (0.05,0) [0|2147483647] "h" Vector__XXX
 SG_ ActualBaleHydraulicPressure m216 : 32|32@1- (1,0) [0|2147483647] "Pa" Vector__XXX
 SG_ LastBaleAverageHydraulicPressure m217 : 32|32@1- (1,0) [0|2147483647] "Pa" Vector__XXX
 SG_ SetpointBaleCompressionPlungerLo m218 : 32|32@1- (1,0) [0|2000] "" Vector__XXX
 SG_ ActualBaleCompressionPlungerLoad m219 : 32|32@1- (1,0) [0|2000] "" Vector__XXX
 SG_ LastBaleAverageBaleCompressionPl m220 : 32|32@1- (1,0) [0|2000] "" Vector__XXX
 SG_ LastBaleAppliedPreservative m221 : 32|32@1- (1,0) [0|2147483647] "ml" Vector__XXX
 SG_ LastBaleTagNumber m222 : 32|32@1- (1,0) [0|2147483647] "" Vector__XXX
 SG_ LastBaleMass m223 : 32|32@1- (1,0) [0|2147483647] "g" Vector__XXX
 SG_ DeltaT m224 : 32|32@1- (1,0) [0|1000000] "mK" Vector__XXX
 SG_ SetpointWorkingLength m225 : 32|32@1- (1,0) [-2147483648|2147483647] "mm" Vector__XXX
 SG_ ActualWorkingLength m226 : 32|32@1- (1,0) [-2147483648|2147483647] "mm" Vector__XXX
 SG_ MinimumWorkingLength m227 : 32|32@1- (1,0) [-2147483648|2147483647] "mm" Vector__XXX
 SG_ MaximumWorkingLength m228 : 32|32@1- (1,0) [-2147483648|2147483647] "mm" Vector__XXX
 SG_ ActualNetWeight m229 : 32|32@1- (1,0) [-2147483648|2147483647] "g" Vector__XXX
 SG_ NetWeightState m230 : 32|32@1- (1,0) [0|3] "" Vector__XXX
 SG_ SetpointNetWeight m231 : 32|32@1- (1,0) [-2147483648|2147483647] "g" Vector__XXX
 SG_ ActualGrossWeight m232 : 32|32@1- (1,0) [-2147483648|2147483647] "g" Vector__XXX
 SG_ GrossWeightState m233 : 32|32@1- (1,0) [0|3] "" Vector__XXX
 SG_ MinimumGrossWeight m234 : 32|32@1- (1,0) [-2147483648|2147483647] "g" Vector__XXX
 SG_ MaximumGrossWeight m235 : 32|32@1- (1,0) [-2147483648|2147483647] "g" Vector__XXX
 SG_ ThreshingEngagementTotalTime m236 : 32|32@1- (1,0) [0|2147483647] "s" Vector__XXX
 SG_ ActualHeaderWorkingHeightStatus m237 : 32|32@1- (1,0) [0|3] "" Vector__XXX
 SG_ ActualHeaderRotationalSpeedStatu m238 : 32|32@1- (1,0) [0|3] "" Vector__XXX
 SG_ YieldHoldStatus m239 : 32|32@1- (1,0) [0|3] "" Vector__XXX
 SG_ ActualUnLoadingSystemStatus m240 : 32|32@1- (1,0) [0|771] "" Vector__XXX
 SG_ CropTemperature m241 : 32|32@1- (1,0) [0|1000000] "mK" Vector__XXX
 SG_ SetpointSieveClearance m242 : 32|32@1- (1,0) [0|2147483647] "mm" Vector__XXX
 SG_ ActualSieveClearance m243 : 32|32@1- (1,0) [0|2147483647] "mm" Vector__XXX
 SG_ MinimumSieveClearance m244 : 32|32@1- (1,0) [0|2147483647] "mm" Vector__XXX
 SG_ MaximumSieveClearance m245 : 32|32@1- (1,0) [0|2147483647] "mm" Vector__XXX
 SG_ SetpointChafferClearance m246 : 32|32@1- (1,0) [0|2147483647] "mm" Vector__XXX
 SG_ ActualChafferClearance m247 : 32|32@1- (1,0) [0|2147483647] "mm" Vector__XXX
 SG_ MinimumChafferClearance m248 : 32|32@1- (1,0) [0|2147483647] "mm" Vector__XXX
 SG_ MaximumChafferClearance m249 : 32|32@1- (1,0) [0|2147483647] "mm" Vector__XXX
 SG_ SetpointConcaveClearance m250 : 32|32@1- (1,0) [0|2147483647] "mm" Vector__XXX
 SG_ ActualConcaveClearance m251 : 32|32@1- (1,0) [0|2147483647] "mm" Vector__XXX
 SG_ MinimumConcaveClearance m252 : 32|32@1- (1,0) [0|2147483647] "mm" Vector__XXX
 SG_ MaximumConcaveClearance m253 : 32|32@1- (1,0) [0|2147483647] "mm" Vector__XXX
 SG_ SetpointSeparationFanRotationalS m254 : 32|32@1- (0.001,0) [0|2147483647] "1/s" Vector__XXX
 SG_ ActualSeparationFanRotationalSpe m255 : 32|32@1- (0.001,0) [0|2147483647] "1/s" Vector__XXX
 SG_ MinimumSeparationFanRotationalSp m256 : 32|32@1- (0.001,0) [0|2147483647] "1/s" Vector__XXX
 SG_ MaximumSeparationFanRotationalSp m257 : 32|32@1- (0.001,0) [0|2147483647] "1/s" Vector__XXX
 SG_ HydraulicOilTemperature m258 : 32|32@1- (1,0) [0|2000000] "mK" Vector__XXX
 SG_ YieldLagIgnoreTime m259 : 32|32@1- (1,0) [0|2147483647] "ms" Vector__XXX
 SG_ YieldLeadIgnoreTime m260 : 32|32@1- (1,0) [0|2147483647] "ms" Vector__XXX
 SG_ AverageYieldMassPerTime m261 : 32|32@1- (1,0) [0|2147483647] "mg/s" Vector__XXX
 SG_ AverageCropMoisture m262 : 32|32@1- (1,0) [0|2147483647] "ppm" Vector__XXX
 SG_ AverageYieldMassPerArea m263 : 32|32@1- (1,0) [0|2147483647] "mg/m²" Vector__XXX
 SG_ ConnectorPivotXOffset m264 : 32|32@1- (1,0) [-2147483648|2147483647] "mm" Vector__XXX
 SG_ RemainingArea m265 : 32|32@1- (1,0) [0|2147483647] "m²" Vector__XXX
 SG_ LifetimeApplicationTotalMass m266 : 32|32@1- (1,0) [0|2147483647] "kg" Vector__XXX
 SG_ LifetimeApplicationTotalCount m267 : 32|32@1- (1,0) [0|2147483647] "" Vector__XXX
 SG_ LifetimeYieldTotalVolume m268 : 32|32@1- (1,0) [0|2147483647] "L" Vector__XXX
 SG_ LifetimeYieldTotalMass m269 : 32|32@1- (1,0) [0|2147483647] "kg" Vector__XXX
 SG_ LifetimeYieldTotalCount m270 : 32|32@1- (1,0) [0|2147483647] "" Vector__XXX
 SG_ LifetimeTotalArea m271 : 32|32@1- (1,0) [0|2147483647] "m²" Vector__XXX
 SG_ LifetimeTotalDistance m272 : 32|32@1- (1,0) [0|2147483647] "m" Vector__XXX
 SG_ LifetimeIneffectiveTotalDistance m273 : 32|32@1- (1,0) [0|2147483647] "m" Vector__XXX
 SG_ LifetimeEffectiveTotalTime m274 : 32|32@1- (1,0) [0|2147483647] "s" Vector__XXX
 SG_ LifetimeIneffectiveTotalTime m275 : 32|32@1- (1,0) [0|2147483647] "s" Vector__XXX
 SG_ LifetimeFuelConsumption m276 : 32|32@1- (0.5,0) [0|2147483647] "L" Vector__XXX
 SG_ PeerControlCommand m9M : 32|4@1+ (1,0) [0|5] "" Vector__XXX
 SG_ DDI m2M : 16|16@1+ (1,0) [0|65535] "" Vector__XXX
 SG_ TechnicalDataMsgType m0M : 4|4@1+ (1,0) [0|15] "" Vector__XXX
 SG_ DeviceDescriptionMsgType m1M : 4|4@1+ (1,0) [0|15] "" Vector__XXX
 SG_ Command M : 0|4@1+ (1,0) [0|15] "" Vector__XXX

CM_ SG_ 2362179326 ActualCanopyHeight "Actual height of the canopy above ground.";
CM_ SG_ 2362179326 GNSSInstallationType "Provide additional information about the type and location of the GPS receiver 
with reference to the overall system.";
CM_ SG_ 2362179326 LastBaleLifetimeCount "The Lifetime Bale Count of the bale that leaves the machine.
The value shall be equal to the Lifetime Bale Count that was reported
when this bale is knotted.";
CM_ SG_ 2362179326 ActualTramlineCondensedWorkState "Combination of the Actual States of individual Tramline Valves number 1 to 16 
into a single Actual Tramline State of their parent DeviceElement.";
CM_ SG_ 2362179326 SetpointTramlineCondensedWorkSta "Combination of the Setpoint Tramline Valve Work States 
of individual Tramline Valves number 1 to 16 
into a single Setpoint Tramline Condensed Work State of their parent DeviceElement.";
CM_ SG_ 2362179326 TramlineOverdosingRate "Overdosing Rate for the rows adjacent to the Tramline Track.";
CM_ SG_ 2362179326 TramlineControlState "Specifies the actual state of Tramline Control.";
CM_ SG_ 2362179326 GNSSQuality "GNSS Quality Identifier to inform the implement about the used Position Status.";
CM_ SG_ 2362179326 GuidanceLineDeviation "Deviation of the Device-Reference-Point (DRP) to the actual
guidance line, in driving direction.";
CM_ SG_ 2362179326 GuidanceLineSwathWidth "The Swath Width is the Distance between two adjacent Guidance 
Lines in a Guidance Pattern.";
CM_ SG_ 2362179326 TrackNumberToLeft "This DDI defines a unique number of the Guidance Track to left
hand side in direction of Implement orientation.";
CM_ SG_ 2362179326 TrackNumberToRight "This DDI defines a unique number of the Guidance Track to right
hand side in direction of Implement orientation.";
CM_ SG_ 2362179326 ActualTrackNumber "This DDI defines a unique number of the Guidance Track the
Implement is currently located on.";
CM_ SG_ 2362179326 UniqueABGuidanceReferenceLineID "This DDI defines a unique ID to identify which Guidance Reference
Line is the base for the Tramline calculation.";
CM_ SG_ 2362179326 TramlineSequenceNumber "This DDI defines a group of DDIs which belong together.";
CM_ SG_ 2362179326 SetpointTramlineControlLevel "This DDI defines the Tramline Control capability of the Task
Controller that is used with the appropriate Implement.";
CM_ SG_ 2362179326 TramlineControlLevel "This DDI defines the Tramline Control capability of the Implement.";
CM_ SG_ 2362179326 MaxEngineTorque "The maximum value of the engine torque.";
CM_ SG_ 2362179326 MinEngineTorque "The minimum value of the engine torque.";
CM_ SG_ 2362179326 ActualEngineTorque "The current torque of the engine.";
CM_ SG_ 2362179326 SetpointEngineTorque "The setpoint of the engine torque.";
CM_ SG_ 2362179326 LastEventPartnerIDDeviceClass "This DDI should tell the Device Class of the “Partner” Device.";
CM_ SG_ 2362179326 LastEventPartnerIDManufacturerID "The Partner ID has to tell its Manufacturer, and the Manufacturer
Numbers from SAE J1939 / ISO 11783 shall be used. ";
CM_ SG_ 2362179326 LastEventPartnerIdType "Defines The Type of the Partner ID Device.";
CM_ SG_ 2362179326 LastEventPartnerID_Byte13to16 "Last Event Partner ID as a decimal number of 128bit length.
This DDI should include the Byte 13-16 of the Last Event Partner ID. ";
CM_ SG_ 2362179326 LastEventPartnerID_Byte9to12 "Last Event Partner ID as a decimal number of 128bit length.
This DDI should include the Byte 9-12 of the Last Event Partner ID. ";
CM_ SG_ 2362179326 LastEventPartnerID_Byte5to8 "Last Event Partner ID as a decimal number of 128bit length.
This DDI should include the Byte 5-8 of the Last Event Partner ID. ";
CM_ SG_ 2362179326 LastEventPartnerID_Byte1to4 "Last Event Partner ID as a decimal number of 128bit length.
This DDI should include the Byte 1-4 of the Last Event Partner ID. ";
CM_ SG_ 2362179326 LifetimeEngineHours "The total time, when the engine was running over the whole lifetime of the machine.";
CM_ SG_ 2362179326 TotalEngineHours "The total time the engine was running when the task was active.";
CM_ SG_ 2362179326 FuelPercentageLevel "The actual level of the machine fuel tank in percent.";
CM_ SG_ 2362179326 MaxFuelTankContent "This value describes the maximum ammount of fuel that can be filled into the machines Fuel tank. ";
CM_ SG_ 2362179326 MaxDieselExhaustFluidTankContent "This value describes the maximum ammount of Diesel Exhaust fluid,
that can be filled into the tank of the machine";
CM_ SG_ 2362179326 DieselExhaustFluidTankPercentage "The actual level of the Diesel Exhaust Fluid Tank in percent.";
CM_ SG_ 2362179326 MaxEngineSpeed "The maximum of the rotational speed of the engine.";
CM_ SG_ 2362179326 MinEngineSpeed "The minimum of the rotational speed of the engine.";
CM_ SG_ 2362179326 ActualEngineSpeed "Actual rotational speed of the engine.";
CM_ SG_ 2362179326 SetpointEngineSpeed "The setpoint of the rotational speed of the engine.";
CM_ SG_ 2362179326 LastBaleNumberOfSubbales "Number of smaller bales included in the latest produced bale.";
CM_ SG_ 2362179326 SetpointNumberOfSubbales "Number of smaller bales that shall be included in one bigger bale.";
CM_ SG_ 2362179326 MaxFlakeSize "Maximum size of the flake that can be produced by the chamber.";
CM_ SG_ 2362179326 MinFlakeSize "Minimum size of the flake that can be produced by the chamber.";
CM_ SG_ 2362179326 SetpointFlakeSize "Setpoint size of the flake to be produced by the chamber.";
CM_ SG_ 2362179326 MaxBaleHydraulicPressure "The maximum value of the hydraulic pressure applied to the sides of
the bale in the bale compression chamber.";
CM_ SG_ 2362179326 MinBaleHydraulicPressure "The minimum value of the hydraulic pressure applied to the sides of
the bale in the bale compression chamber.";
CM_ SG_ 2362179326 SetpointBaleHydraulicPressure "The setpoint value of the hydraulic pressure applied to the sides of
the bale in the bale compression chamber.";
CM_ SG_ 2362179326 MaxLengthOfCut "Maximum length of cut for harvested material, e.g. Forage Harvester or Tree Harvester.";
CM_ SG_ 2362179326 MinLengthOfCut "Minimum length of cut for harvested material, e.g. Forage Harvester or Tree Harvester.";
CM_ SG_ 2362179326 SetpointLengthOfCut "Setpoint length of cut for harvested material, e.g. Forage Harvester or Tree Harvester.";
CM_ SG_ 2362179326 ActualPercentageContent "Actual Device Element Content specified as percent.";
CM_ SG_ 2362179326 ActualRelativeConnectorAngle "The value describes the actual angle of the longitudinal axis of the
implement relative to the longitudinal axis of the tractor.";
CM_ SG_ 2362179326 LifetimeHaulCounter "The number of haul cycles done by a machine over its entire lifetime.";
CM_ SG_ 2362179326 HaulCounter "Each Time a Device Element is filled and emptied this is called a haul cycle. 
This counter counts the cycles.";
CM_ SG_ 2362179326 LastUnloadedCount "Last unloaded Count value specified as count";
CM_ SG_ 2362179326 LastLoadedCount "Last loaded Count value specified as count";
CM_ SG_ 2362179326 LifetimeUnloadedTotalCount "Entire Unloaded Total Count of the device lifetime.";
CM_ SG_ 2362179326 LifetimeLoadedTotalCount "Entire Loaded Total Count of the device lifetime.";
CM_ SG_ 2362179326 UnloadedTotalCount "Accumulated Unloaded specified as count";
CM_ SG_ 2362179326 LoadedTotalCount "Accumulated Loads specified as count";
CM_ SG_ 2362179326 LastUnloadedVolume "Last unloaded Volume value specified as volume";
CM_ SG_ 2362179326 LastLoadedVolume "Last loaded Volume value specified as volume";
CM_ SG_ 2362179326 LifetimeUnloadedTotalVolume "Entire unloaded Volume of the device lifetime.";
CM_ SG_ 2362179326 LifetimeLoadedTotalVolume "Entire loaded Volume of the device lifetime.";
CM_ SG_ 2362179326 UnloadedTotalVolume "Accumulated Unloaded Volume specified as volume";
CM_ SG_ 2362179326 LoadedTotalVolume "Accumulated Loaded Volume specified as volume";
CM_ SG_ 2362179326 MaxAppRateOfDryMatter "Maximum application rate of dry matter expressed as percentage";
CM_ SG_ 2362179326 MinAppRateOfDryMatter "Minimum application rate of dry matter expressed as percentage";
CM_ SG_ 2362179326 ActualAppRateOfDryMatter "Actual application rate of dry matter expressed as percentage";
CM_ SG_ 2362179326 SetpointAppRateOfDryMatter "Setpoint application rate of dry matter expressed as percentage";
CM_ SG_ 2362179326 MaxAppRateOfPotassium "Maximum application rate of potassium specified as a mass per area";
CM_ SG_ 2362179326 MinAppRateOfPotassium "Minimum application rate of potassium specified as a mass per area";
CM_ SG_ 2362179326 ActualAppRateOfPotassium "Actual application rate of potassium specified as a mass per area";
CM_ SG_ 2362179326 SetpointAppRateOfPotassium "Setpoint application rate of potassium specified as a mass per area";
CM_ SG_ 2362179326 MaxAppRateOfPhosphor "Maximum application rate of phosphor specified as a mass per area";
CM_ SG_ 2362179326 MinAppRateOfPhosphor "Minimum application rate of phosphor specified as a mass per area";
CM_ SG_ 2362179326 ActualAppRateOfPhosphor "Actual application rate of phosphor specified as a mass per area";
CM_ SG_ 2362179326 SetpointAppRateOfPhosphor "Setpoint application rate of phosphor specified as a mass per area";
CM_ SG_ 2362179326 MaxAppRateOfAmmonium "Maximum application rate of Ammonium specified as a mass per area";
CM_ SG_ 2362179326 MinAppRateOfAmmonium "Minimum application rate of Ammonium specified as a mass per area";
CM_ SG_ 2362179326 ActualAppRateOfAmmonium "Actual application rate of Ammonium specified as a mass per area";
CM_ SG_ 2362179326 SetpointAppRateOfAmmonium "Setpoint application rate of Ammonium specified as a mass per area";
CM_ SG_ 2362179326 MaxAppRateOfNitrogen "Maximum application rate of nitrogen specified as a mass per area";
CM_ SG_ 2362179326 MinAppRateOfNitrogen "Minimum application rate of nitrogen specified as a mass per area";
CM_ SG_ 2362179326 ActualAppRateOfNitrogen "Actual application rate of nitrogen specified as a mass per area";
CM_ SG_ 2362179326 SetpointAppRateOfNitrogen "Setpoint application rate of nitrogen specified as a mass per area";
CM_ SG_ 2362179326 LifetimeUnloadedTotalMass "Entire Unloaded Total Mass of the device lifetime.";
CM_ SG_ 2362179326 LifetimeLoadedTotalMass "Entire Yield Total Mass of the device lifetime.";
CM_ SG_ 2362179326 UnloadedTotalMass "Accumulated Unloads specified as mass, not corrected for the
reference moisture percentage DDI 184";
CM_ SG_ 2362179326 LoadedTotalMass "Accumulated Loads specified as mass, not corrected for the
reference moisture percentage DDI 184.";
CM_ SG_ 2362179326 ActualDownforceAsForce "This value represents the actual downforce to produce the downforce
(or upforce) for an operation messured in newton.";
CM_ SG_ 2362179326 SetpointDownforceAsForce "This value represents the system pressure to produce the downforce
(or upforce) for an operation messured in newton;";
CM_ SG_ 2362179326 SetpointMaxAllowedSeedSpacingDev "Setpoint Maximum Allowed Seed Spacing Deviation";
CM_ SG_ 2362179326 AvgCoeffOfVariationOfSeedSpacing "Average Coefficient of Variation of Seed Spacing Percentage
calculated from measured seed spacing using ISO 7256-1 algorithm.
The value is the average for a Task.";
CM_ SG_ 2362179326 ActCoeffOfVariationOfSeedSpacing "Actual Coefficient of Variation of Seed Spacing Percentage
calculated from measured seed spacing using ISO 7256-1 algorithm";
CM_ SG_ 2362179326 AverageSeedSpacingDeviation_Copy "Average Seed Spacing Deviation from setpoint seed spacing.
The value is the average for a Task.";
CM_ SG_ 2362179326 ActualSeedSpacingDeviation "Actual Seed Spacing Deviation from setpoint seed spacing.";
CM_ SG_ 2362179326 AverageSeedMultiplePercentage "Average Seed Multiple Percentage calculated from measured seed
spacing using ISO 7256-1 'Multiples Index' algorithm. 
The value is the average for a Task.";
CM_ SG_ 2362179326 ActualSeedMultiplePercentage "Actual Seed Multiple Percentage calculated from measured seed
spacing using ISO 7256-1 'Multiples Index' algorithm.";
CM_ SG_ 2362179326 AverageSeedSkipPercentage "Average Seed Skip Percentage calculated from measured seed
spacing using ISO 7256-1 'Miss Index' algorithm. 
The value is the average for a Task.";
CM_ SG_ 2362179326 ActualSeedSkipPercentage "Actual Seed Skip Percentage calculated from measured seed 
spacing using ISO 7256-1 'Miss Index' algorithm";
CM_ SG_ 2362179326 AverageSeedSingulationPercentage "Average Seed Singulation Percentage calculated from measured
seed spacing using ISO 7256-1 'Quality of Feed Index' algorithm.
The value is the average for a Task.";
CM_ SG_ 2362179326 ActualSeedSingulationPercentage "Actual Seed Singulation Percentage calculated from measured seed
spacing using ISO 7256-1 'Quality of Feed Index' algorithm";
CM_ SG_ 2362179326 LifetimeAvgDieselExhFluidConsump "Average Diesel Exhaust Fluid Consumption per Area over the entire lifetime of the device.";
CM_ SG_ 2362179326 LifetimeAvgDieselExhFluidCo_0000 "Average Diesel Exhaust Fluid Consumption per Time over the entire lifetime of the device.";
CM_ SG_ 2362179326 LifetimeDieselExhaustFluidConsum "Accumulated Diesel Exhaust Fluid Consumption over the entire lifetime of the device.";
CM_ SG_ 2362179326 InstantDieselExhaustFluidConsump "Diesel Exhaust Fluid consumption per area.";
CM_ SG_ 2362179326 InstantDieselExhaustFluidCo_0000 "Diesel Exhaust Fluid consumption per time.";
CM_ SG_ 2362179326 TotalDieselExhaustFluidConsumpti "Accumulated Diesel Exhaust Fluid Consumption as a Task Total.";
CM_ SG_ 2362179326 AverageCropContamination "Average amount of dirt or foreign  in a harvested crop (Parts per million).";
CM_ SG_ 2362179326 AverageProteinContent "Average Protein content of a harvested crops (Parts per million).";
CM_ SG_ 2362179326 ActualProteinContent "Actual Protein content of a harvested crops (Parts per million).";
CM_ SG_ 2362179326 ActualApplicationOfDryMatter "Actual application of Dry Matter in kilogram [kg]. Dry matter measured at Zero percent of moisture.";
CM_ SG_ 2362179326 ActualApplicationOfPotassium "Actual application of Potassium [K2] specified as gram [g]";
CM_ SG_ 2362179326 ActualApplicationOfPhosphor "Actual application of Phosphor [P2O5] specified as milligram per liter [mg/l]";
CM_ SG_ 2362179326 ActualApplicationOfAmmonium "Actual application of Ammonium [NH4] specified as milligram per liter [mg/l]";
CM_ SG_ 2362179326 ActualApplicationOfNitrogen "Actual application of Nitrogen [N2] specified as milligram per liter [mg/l]";
CM_ SG_ 2362179326 SpeedSource "The Speed Source that the device uses to report actual speed and to
process the setpoint, minimum and maximum speeds.";
CM_ SG_ 2362179326 ActualDieselExhaustFluidTankCont "The actualcontent of the diesel exhaust fluid tank";
CM_ SG_ 2362179326 ActualFuelTankContent "The actual content of the fuel tank.
This value can be used to see the refilling of the fuel tank or the theft of fuel.";
CM_ SG_ 2362179326 MaximumRevolutionsPerTime "Maximum Revolutions specified as count per time";
CM_ SG_ 2362179326 MinimumRevolutionsPerTime "Minimum Revolutions specified as count per time";
CM_ SG_ 2362179326 DefaultRevolutionsPerTime "Default Revolutions specified as count per time";
CM_ SG_ 2362179326 ActualRevolutionsPerTime "Actual Revolutions specified as count per time";
CM_ SG_ 2362179326 SetpointRevolutionsAsCountPerTim "Setpoint Revolutions specified as count per time";
CM_ SG_ 2362179326 TotalRevolutionsInCompleteRevolu "Accumulated Revolutions specified as completed integer revolutions";
CM_ SG_ 2362179326 TotalRevolutionsInFractionalRevo "Accumulated Revolutions specified with fractional revolutions";
CM_ SG_ 2362179326 ActualAtmosphericPressure "The Actual Atmospheric Pressure is the air pressure currently measured by the weather station.";
CM_ SG_ 2362179326 MSLAtmosphericPressure "The atmospheric pressure MSL (Mean Sea Level) is the air pressure related to mean sea level.";
CM_ SG_ 2362179326 ApparentWindSpeed "The apparent wind is the wind which is measured on a moving vehicle.
It is the result of two motions: the actual true wind and the motion of the vehicle.";
CM_ SG_ 2362179326 ApparentWindDirection "The apparent wind is the wind which is measured on a moving vehicle. 
It is the result of two motions: the actual true wind and the motion of the vehicle. ";
CM_ SG_ 2362179326 CondensedSectionOverrideState241 "Each child device elements override state is represented by 2 bits and defined as:
00 = section is not overridden,
01 = section is overridden,
10 = reserved,
11 = undefined / not installed.";
CM_ SG_ 2362179326 CondensedSectionOverrideState225 "Each child device elements override state is represented by 2 bits and defined as:
00 = section is not overridden,
01 = section is overridden,
10 = reserved,
11 = undefined / not installed.";
CM_ SG_ 2362179326 CondensedSectionOverrideState209 "Each child device elements override state is represented by 2 bits and defined as:
00 = section is not overridden,
01 = section is overridden,
10 = reserved,
11 = undefined / not installed.";
CM_ SG_ 2362179326 CondensedSectionOverrideState193 "Each child device elements override state is represented by 2 bits and defined as:
00 = section is not overridden,
01 = section is overridden,
10 = reserved,
11 = undefined / not installed.";
CM_ SG_ 2362179326 CondensedSectionOverrideState177 "Each child device elements override state is represented by 2 bits and defined as:
00 = section is not overridden,
01 = section is overridden,
10 = reserved,
11 = undefined / not installed.";
CM_ SG_ 2362179326 CondensedSectionOverrideState161 "Each child device elements override state is represented by 2 bits and defined as:
00 = section is not overridden,
01 = section is overridden,
10 = reserved,
11 = undefined / not installed.";
CM_ SG_ 2362179326 CondensedSectionOverrideState145 "Each child device elements override state is represented by 2 bits and defined as:
00 = section is not overridden,
01 = section is overridden,
10 = reserved,
11 = undefined / not installed.";
CM_ SG_ 2362179326 CondensedSectionOverrideState129 "Each child device elements override state is represented by 2 bits and defined as:
00 = section is not overridden,
01 = section is overridden,
10 = reserved,
11 = undefined / not installed.";
CM_ SG_ 2362179326 CondensedSectionOverrideState113 "Each child device elements override state is represented by 2 bits and defined as:
00 = section is not overridden,
01 = section is overridden,
10 = reserved,
11 = undefined / not installed.";
CM_ SG_ 2362179326 CondensedSectionOverrideState97t "Each child device elements override state is represented by 2 bits and defined as:
00 = section is not overridden,
01 = section is overridden,
10 = reserved,
11 = undefined / not installed.";
CM_ SG_ 2362179326 CondensedSectionOverrideState81t "Each child device elements override state is represented by 2 bits and defined as:
00 = section is not overridden,
01 = section is overridden,
10 = reserved,
11 = undefined / not installed.";
CM_ SG_ 2362179326 CondensedSectionOverrideState65t "Each child device elements override state is represented by 2 bits and defined as:
00 = section is not overridden,
01 = section is overridden,
10 = reserved,
11 = undefined / not installed.";
CM_ SG_ 2362179326 CondensedSectionOverrideState49t "Each child device elements override state is represented by 2 bits and defined as:
00 = section is not overridden,
01 = section is overridden,
10 = reserved,
11 = undefined / not installed.";
CM_ SG_ 2362179326 CondensedSectionOverrideState33t "Each child device elements override state is represented by 2 bits and defined as:
00 = section is not overridden,
01 = section is overridden,
10 = reserved,
11 = undefined / not installed.";
CM_ SG_ 2362179326 CondensedSectionOverrideState17t "Each child device elements override state is represented by 2 bits and defined as:
00 = section is not overridden,
01 = section is overridden,
10 = reserved,
11 = undefined / not installed.";
CM_ SG_ 2362179326 CondensedSectionOverrideState01t "Each child device elements override state is represented by 2 bits and defined as:
00 = section is not overridden,
01 = section is overridden,
10 = reserved,
11 = undefined / not installed.";
CM_ SG_ 2362179326 ActualDownforcePressure "This value represents the actual system pressure to produce the
downforce (or upforce) for an operation messured in Pa (Pascal);
In case of an negative value the system pressure would  produce Upforce.";
CM_ SG_ 2362179326 SetpointDownforcePressure "This value represents the system pressure to produce the downforce
(or upforce) for an operation messured in Pa (Pascal);
In case of an negative value the system pressure would  produce Upforce.";
CM_ SG_ 2362179326 ActualFlakeSize "Actual size of the flake that is currently produced by the chamber.";
CM_ SG_ 2362179326 LastBaleDryMass "The dry mass of the bale that has most recently been produced.
This is the bale mass corrected for the average moisture of this bale (DDI 212).";
CM_ SG_ 2362179326 TotalBaleLength "Gives the total baled meters during a task.
This is calculated as the sum of the lengths of all knotted bales (square baler).";
CM_ SG_ 2362179326 LastBaleDensity "The bale density of the most recently produced bale.";
CM_ SG_ 2362179326 LastBaleSize "The bale size of the most recently produced bale.
Bale Size as length for a square baler or diameter for a round baler.";
CM_ SG_ 2362179326 AverageDryYieldMassPerArea "Average Yield expressed as mass per unit area, corrected for the reference moisture percentage DDI 184.
This value is the average for a Task and may be reported as a total.";
CM_ SG_ 2362179326 AverageDryYieldMassPerTime "Average Yield expressed as mass per unit time, corrected for the reference moisture percentage DDI 184.
This value is the average for a Task and may be reported as a total.";
CM_ SG_ 2362179326 TotalApplicationOfDryMatter "Accumulated application of dry matter  in kilogram [kg]. 
Dry matter measured at zero percent of moisture].
This total is a counter of a device element";
CM_ SG_ 2362179326 TotalApplicationOfPotassium "Accumulated application of potassium (K2) specified as gram [g].
This total is a counter of a device element";
CM_ SG_ 2362179326 TotalApplicationOfPhosphor "Accumulated application of phosphor (P2O5) specified as gram [g].
This total is a counter of a device element";
CM_ SG_ 2362179326 TotalApplicationOfAmmonium "Accumulated application of ammonium [NH4]  specified as gram [g].
This total is a counter of a device element";
CM_ SG_ 2362179326 TotalApplicationofNitrogen "Accumulated application of nitrogen [N2] specified as gram [g].
This total is a counter of a device element";
CM_ SG_ 2362179326 ApplicationTotalMass "Accumulated Application specified as mass in gram [g]
.
Comment: is a counter of a device elemen.";
CM_ SG_ 2362179326 ApplicationTotalVolume "Accumulated Application specified as volume in milliliter [ml]
.
Comment: is a counter of a device element.";
CM_ SG_ 2362179326 FunctionType "The Function Type DDE can be used to define the operation or functionality performed 
by the device element of type Function defined within the DDOP. 
The values to be used are defined in the attached document.";
CM_ SG_ 2362179326 NozzleDriftReduction "The Nozzle Drift Reduction classification value of the spraying equipment as percentage.";
CM_ SG_ 2362179326 MaximumSwathingWidth "This is the maximum with of the swath the raker can create.";
CM_ SG_ 2362179326 MinimumSwathingWidth "This is the minimum swath width the raker can create.";
CM_ SG_ 2362179326 ActualSwathingWidth "This is the width of the swath currently created by a raker.";
CM_ SG_ 2362179326 SetpointSwathingWidth "This is the setpoint swathing width of the swath created by a raker.";
CM_ SG_ 2362179326 MaximumGrainKernelCrackerGap "The maximum gap (distance) of the grain kernel cracker drums in a chopper.";
CM_ SG_ 2362179326 MinimumGrainKernelCrackerGap "The minimum gap (distance) of the grain kernel cracker drums in a chopper.";
CM_ SG_ 2362179326 ActualGrainKernelCrackerGap "The actual gap (distance) of the grain kernel cracker drums in a chopper";
CM_ SG_ 2362179326 SetpointGrainKernelCrackerGap "The setpoint gap (distance) of the grain kernel cracker drums in a chopper.";
CM_ SG_ 2362179326 EffectiveUnloadingTime "The total time needed in the current task to unload a product crop.";
CM_ SG_ 2362179326 EffectiveLoadingTime "The total time needed in the current task to load a product such as crop.";
CM_ SG_ 2362179326 LiftimeRearPTOHours "The hours the Rear PTO of the machine was running for the lifetime of the machine";
CM_ SG_ 2362179326 LifetimeFrontPTOHours "The hours the Front PTO of the machine was running for the lifetime of the machine.";
CM_ SG_ 2362179326 RearPTOHours "The hours the Rear PTO of the machine was running for the current Task";
CM_ SG_ 2362179326 FrontPTOHours "The hours the Front PTO of the machine was running for the current Task";
CM_ SG_ 2362179326 OperatingHoursSinceLastSharpenin "This value describes the working hours since the last sharpening of the cutting device.";
CM_ SG_ 2362179326 MaximumCuttingDrumSpeed "The maximum speed of the cutting drum of a chopper.

Comment: This is a value recommented by the manufacturer of the machine as the maximum speed the machine is able to offer.";
CM_ SG_ 2362179326 ActualCuttingDrumSpeed "The actual speed of the cutting drum of a chopper";
CM_ SG_ 2362179326 SetpointCuttingDrumSpeed "The setpoint speed of the cutting drum of a chopper.";
CM_ SG_ 2362179326 MaximumHeaderSpeed "The maximum rotational speed of the header attachment of a chopper, mower or combine.

Comment: 
This is a value recommented by the manufacturer of the machine as the maximum speed the machine is able to offer";
CM_ SG_ 2362179326 MinimumHeaderSpeed "The minimum rotational speed of the header attachment of a chopper, mower or combine";
CM_ SG_ 2362179326 ActualHeaderSpeed "The actual rotational speed of the header attachment of a chopper, mower or combine";
CM_ SG_ 2362179326 SetpointHeaderSpeed "The setpoint rotational speed of the header attachment of a chopper, mower or combine";
CM_ SG_ 2362179326 NumberOfSection "Number of sections across all booms for section control";
CM_ SG_ 2362179326 NumberOfBooms "Number of booms for section control";
CM_ SG_ 2362179326 OriginCommand "Process Data Command that this PDACK message is transmitted for";
CM_ SG_ 2362179326 DestinationElementNumber "Device Element Number";
CM_ SG_ 2362179326 DataLogTimeInterval "Time interval for data log in ms, 0 stops measurement, 100 ms is minimum time interval.";
CM_ SG_ 2362179326 DataLogDistanceInterval "Distance interval for data log in mm, 0 stops measurement.";
CM_ SG_ 2362179326 AppRateVolumePerArea_Set "Setpoint Application Rate specified as volume per area";
CM_ SG_ 2362179326 AppRateVolumePerArea_Act "Actual Application Rate specified as volume per area";
CM_ SG_ 2362179326 AppRateVolumePerArea_Def "Default Application Rate specified as volume per area";
CM_ SG_ 2362179326 AppRateVolumePerArea_Min "Minimum Application Rate specified as volume per area";
CM_ SG_ 2362179326 AppRateVolumePerArea_Max "Maximum Application Rate specified as volume per area";
CM_ SG_ 2362179326 AppRateMassPerArea_Set "Setpoint Application Rate specified as mass per area";
CM_ SG_ 2362179326 AppRateMassPerArea_Act "Actual Application Rate specified as mass per area";
CM_ SG_ 2362179326 AppRateMassPerArea_Def "Default Application Rate specified as mass per area";
CM_ SG_ 2362179326 AppRateMassPerArea_Min "Minimum Application Rate specified as mass per area";
CM_ SG_ 2362179326 AppRateMassPerArea_Max "Maximum Application Rate specified as mass per area";
CM_ SG_ 2362179326 AppRateCountPerArea_Set "Setpoint Application Rate specified as count per area";
CM_ SG_ 2362179326 AppRateCountPerArea_Act "Actual Application Rate specified as count per area";
CM_ SG_ 2362179326 AppRateCountPerArea_Def "Default Application Rate specified as count per area";
CM_ SG_ 2362179326 AppRateCountPerArea_Min "Minimum Application Rate specified as count per area";
CM_ SG_ 2362179326 AppRateCountPerArea_Max "Maximum Application Rate specified as count per area";
CM_ SG_ 2362179326 SetAppRateDistance_Set "Setpoint Application Rate specified as distance";
CM_ SG_ 2362179326 AppRateDistance_Act "Actual Application Rate specified as distance";
CM_ SG_ 2362179326 AppRateDistance_Def "Default Application Rate specified as distance";
CM_ SG_ 2362179326 AppRateDistance_Min "Minimum Application Rate specified as distance";
CM_ SG_ 2362179326 AppRateDistance_Max "Maximum Application Rate specified as distance";
CM_ SG_ 2362179326 AppRateVolumePerVolume_Set "Setpoint Application Rate specified as volume per volume";
CM_ SG_ 2362179326 AppRateVolumePerVolume_Act "Actual Application Rate specified as volume per volume";
CM_ SG_ 2362179326 AppRateVolumePerVolume_Def "Default Application Rate specified as volume per volume";
CM_ SG_ 2362179326 AppRateVolumePerVolume_Min "Minimum Application Rate specified as volume per volume";
CM_ SG_ 2362179326 AppRateVolumePerVolume_Max "Maximum Application Rate specified as volume per volume";
CM_ SG_ 2362179326 AppRateMassPerMass_Set "Setpoint Application Rate specified as mass per mass";
CM_ SG_ 2362179326 AppRateMassPerMass_Act "Actual Application Rate specified as mass per mass";
CM_ SG_ 2362179326 AppRateMassPerMass_Def "Default Application Rate specified as mass per mass";
CM_ SG_ 2362179326 AppRateMassPerMass_Min "Minimum Application Rate specified as mass per mass";
CM_ SG_ 2362179326 AppRateMassPerMass_Max "Maximum Application Rate specified as mass per mass";
CM_ SG_ 2362179326 AppRateVolumePerMass_Set "Setpoint Application Rate specified as volume per mass";
CM_ SG_ 2362179326 AppRateVolumePerMass_Act "Actual Application Rate specified as volume per mass";
CM_ SG_ 2362179326 AppRateVolumePerMass_Def "Default Application Rate specified as volume per mass";
CM_ SG_ 2362179326 AppRateVolumePerMass_Min "Minimum Application Rate specified as volume per mass";
CM_ SG_ 2362179326 AppRateVolumePerMass_Max "Maximum Application Rate specified as volume per mass";
CM_ SG_ 2362179326 AppRateVolumePerTime_Set "Setpoint Application Rate specified as volume per time";
CM_ SG_ 2362179326 AppRateVolumePerTime_Act "Actual Application Rate specified as volume per time";
CM_ SG_ 2362179326 AppRateVolumePerTime_Def "Default Application Rate specified as volume per time";
CM_ SG_ 2362179326 AppRateVolumePerTime_Min "Minimum Application Rate specified as volume per time";
CM_ SG_ 2362179326 AppRateVolumePerTime_Max "Maximum Application Rate specified as volume per time";
CM_ SG_ 2362179326 AppRateMassPerTime_Set "Setpoint Application Rate specified as mass per time";
CM_ SG_ 2362179326 AppRateMassPerTime_Act "Actual Application Rate specified as mass per time";
CM_ SG_ 2362179326 AppRateMassPerTime_Def "Defaut Application Rate specified as mass per time";
CM_ SG_ 2362179326 AppRateMassPerTime_Min "Minimum Application Rate specified as mass per time";
CM_ SG_ 2362179326 AppRateMassPerTime_Max "Maximum Application Rate specified as mass per time";
CM_ SG_ 2362179326 AppRateCountPerTime_Set "Setpoint Application Rate specified as count per time";
CM_ SG_ 2362179326 AppRateCountPerTime_Act "Actual Application Rate specified as count per time";
CM_ SG_ 2362179326 AppRateCountPerTime_Def "Default Application Rate specified as count per time";
CM_ SG_ 2362179326 AppRateCountPerTime_Min "Minimum Application Rate specified as count per time";
CM_ SG_ 2362179326 AppRateCountPerTime_Max "Maximum Application Rate specified as count per time";
CM_ SG_ 2362179326 SetTillageDepth_Set "Setpoint Tillage Depth of Machine Element below soil surface, value increases with depth";
CM_ SG_ 2362179326 TillageDepth_Act "Actual Tillage Depth of Machine Element below soil surface, value increases with depth";
CM_ SG_ 2362179326 TillageDepth_Def "Default Tillage Depth of Machine Element below soil surface, value increases with depth";
CM_ SG_ 2362179326 TillageDepth_Min "Minimum Tillage Depth of Machine Element below soil surface, value increases with depth";
CM_ SG_ 2362179326 TillageDepth_Max "Maximum Tillage Depth of Machine Element below soil surface, value increases with depth";
CM_ SG_ 2362179326 SeedingDeph_Set "Setpoint Seeding Depth of Machine Element below soil surface, value increases with depth";
CM_ SG_ 2362179326 SeedingDeph_Act "Setpoint Seeding Depth of Machine Element below soil surface, value increases with depth";
CM_ SG_ 2362179326 SeedingDeph_Def "Setpoint Seeding Depth of Machine Element below soil surface, value increases with depth";
CM_ SG_ 2362179326 SeedingDeph_Min "Setpoint Seeding Depth of Machine Element below soil surface, value increases with depth";
CM_ SG_ 2362179326 SeedingDeph_Max "Setpoint Seeding Depth of Machine Element below soil surface, value increases with depth";
CM_ SG_ 2362179326 WorkingHeight_Set "Setpoint Working Height of Machine Element above crop or soil";
CM_ SG_ 2362179326 WorkingHeight_Act "Actual Working Height of Machine Element above crop or soil";
CM_ SG_ 2362179326 WorkingHeight_Def "Default Working Height of Machine Element above crop or soil";
CM_ SG_ 2362179326 WorkingHeight_Min "Minimum Working Height of Machine Element above crop or soil";
CM_ SG_ 2362179326 WorkingHeight_Max "Maximum Working Height of Machine Element above crop or soil";
CM_ SG_ 2362179326 WorkingWidth_Set "Setpoint Working Width of Machine Element";
CM_ SG_ 2362179326 WorkingWidth_Act "Actual Working Width of Machine Element";
CM_ SG_ 2362179326 WorkingWidth_Def "Default Working Width of Machine Element";
CM_ SG_ 2362179326 WorkingWidth_Min "Minimum Working Width of Machine Element";
CM_ SG_ 2362179326 WorkingWidth_Max "Maximum Working Width of Machine Element";
CM_ SG_ 2362179326 ContentAsVolume_Set "Setpoint Machine Element Content specified as volume";
CM_ SG_ 2362179326 ContentAsVolume_Act "Actual Machine Element Content specified as volume";
CM_ SG_ 2362179326 ContentAsVolume_Max "Maximum Machine Element Content specified as volume";
CM_ SG_ 2362179326 ContentAsMass_Set "Setpoint Machine Element Content specified as mass";
CM_ SG_ 2362179326 ContentAsMass_Act "Actual Machine Element Content specified as mass";
CM_ SG_ 2362179326 ContentAsMass_Max "Maximum Machine Element Content specified as mass";
CM_ SG_ 2362179326 ContentAsCount_Set "Setpoint Machine Element Content specified as count";
CM_ SG_ 2362179326 ContentAsCount_Act "Actual Machine Element Content specified as count";
CM_ SG_ 2362179326 ContentAsCount_Max "Maximum Machine Element Content specified as count";
CM_ SG_ 2362179326 AccumulatedAppAsVolume "Accumulated Application specified as volume";
CM_ SG_ 2362179326 AccumulatedAppAsMass "Accumulated Application specified as mass";
CM_ SG_ 2362179326 AccumulatedAppAsCount "Accumulated Application specified as count";
CM_ SG_ 2362179326 YieldVolumePerArea "Yield as volume per area";
CM_ SG_ 2362179326 YieldMassPerArea "Yield as mass per area";
CM_ SG_ 2362179326 YieldCountPerArea "Yield as count per area";
CM_ SG_ 2362179326 YieldVolumePerTime "Yield as volume per time";
CM_ SG_ 2362179326 YieldMassPerTime "Yield as mass per time";
CM_ SG_ 2362179326 YieldCountPerTime "Yield as count per time";
CM_ SG_ 2362179326 AccumulatedYieldAsVolume "Accumulated Yield specified as volume";
CM_ SG_ 2362179326 AccumulatedYieldAsMass "Accumulated Yield specified as mass";
CM_ SG_ 2362179326 AccumulatedYieldAsCount "Accumulated Yield specified as count";
CM_ SG_ 2362179326 CropYieldLossVolumePerArea "Crop yield loss as volume per area";
CM_ SG_ 2362179326 CropYieldLossMassPerArea "Crop yield loss as mass per area";
CM_ SG_ 2362179326 CropYieldLossCountPerArea "Crop yield loss as count per area";
CM_ SG_ 2362179326 CropYieldLossVolumePerTime "Crop yield loss as volume per time";
CM_ SG_ 2362179326 CropYieldLossMassPerTime "Crop yield loss as mass per time";
CM_ SG_ 2362179326 CropYieldLossCountPerTime "Crop yield loss as count per time";
CM_ SG_ 2362179326 CropYieldLoss "Crop yield loss";
CM_ SG_ 2362179326 MoistureInCropYield "Moisture in crop yield";
CM_ SG_ 2362179326 DirtMaterialInCropYield "Dirt or foreign material in crop yield";
CM_ SG_ 2362179326 BaleWidth_Set "Setpoint Bale Width for square baler or round baler";
CM_ SG_ 2362179326 BaleWidth_Act "Actual Bale Width for square baler or round baler";
CM_ SG_ 2362179326 BaleWidth_Def "Default Bale Width for square baler or round baler";
CM_ SG_ 2362179326 BaleWidth_Min "Minimum Bale Width for square baler or round baler";
CM_ SG_ 2362179326 BaleWidth_Max "Maximum Bale Width for square baler or round baler";
CM_ SG_ 2362179326 BaleHeight_Set "Setpoint Bale Height is only applicable to square baler";
CM_ SG_ 2362179326 BaleHeight_Act "Actual Bale Height is only applicable to square baler";
CM_ SG_ 2362179326 BaleHeight_Def "Default Bale Height is only applicable to square baler";
CM_ SG_ 2362179326 BaleHeight_Min "Minimum Bale Height is only applicable to square baler";
CM_ SG_ 2362179326 BaleHeight_Max "Maximum Bale Height is only applicable to square baler";
CM_ SG_ 2362179326 BaleSize_Set "Setpoint Bale Size as length for a square baler or diameter for a round baler";
CM_ SG_ 2362179326 BaleSize_Act "Actual Bale Size as length for a square baler or diameter for a round baler";
CM_ SG_ 2362179326 BaleSize_Def "Default Bale Size as length for a square baler or diameter for a round baler";
CM_ SG_ 2362179326 BaleSize_Min "Minimum Bale Size as length for a square baler or diameter for a round baler";
CM_ SG_ 2362179326 BaleSize_Max "Maximum Bale Size as length for a square baler or diameter for a round baler";
CM_ SG_ 2362179326 AccumulatedArea "Accumulated Area";
CM_ SG_ 2362179326 AccumulatedDistanceInWork "Accumulated Distance in working position";
CM_ SG_ 2362179326 AccumulatedDistanceOutWork "Accumulated Distance out of working position";
CM_ SG_ 2362179326 AccumulatedTimeInWork "Accumulated Time in working position";
CM_ SG_ 2362179326 AccumulatedTimeOutWork "Accumulated Time out of working position";
CM_ SG_ 2362179326 PrdoucDensityMassPerArea "Product Density as mass per volume";
CM_ SG_ 2362179326 PrdoucDensityMassPerCount "Product Density as mass per count";
CM_ SG_ 2362179326 PrdoucDensityVolumePerCount "Product Density as volume per count";
CM_ SG_ 2362179326 AuxiliaryValveScalingExtend "Factor to apply to AuxValveCommand PortFlowCommand.";
CM_ SG_ 2362179326 AuxiliaryValveScalingRetract "Factor to apply to AuxValveCommand PortFlowCommand.";
CM_ SG_ 2362179326 AuxiliaryRampExtendUp "The valve will apply a ramp to the Auxiliary ValveCommand
PortFlowCommand, to limit the acceleration or deceleration of flow.";
CM_ SG_ 2362179326 AuxiliaryValveRampExtendDown "The valve will apply a ramp to the Auxiliary ValveCommand
PortFlowCommand, to limit the acceleration or deceleration of flow.";
CM_ SG_ 2362179326 AuxiliaryValveRampRetractUp "The valve will apply a ramp to theAuxiliary ValveCommand
PortFlowCommand, to limit the acceleration or deceleration of flow.";
CM_ SG_ 2362179326 AuxiliaryValveRampRetractDown "The valve will apply a ramp to the Auxiliary ValveCommand
PortFlowCommand, to limit the acceleration or deceleration of flow.";
CM_ SG_ 2362179326 AuxiliaryValveFloatThreshold "Safety function. Current output of valve must be above threshold before
float command is allowed.";
CM_ SG_ 2362179326 AuxiliaryValveProgressivExtend "Define non-linear releationship between command and flow by 2nd
degree polynomium.";
CM_ SG_ 2362179326 AuxiliaryValveProgressivRetract "Define non-linear releationship between command and flow by 2nd
degree polynomium.";
CM_ SG_ 2362179326 AuxiliaryValveInvertPorts "Command valve to swap extend and retract ports, easier than redoing
plumbing on valve.";
CM_ SG_ 2362179326 DeviceElementOffsetX "X direction offset of a DeviceElement relative to a Device.";
CM_ SG_ 2362179326 DeviceElementOffsetY "Y direction offset of a DeviceElement relative to  Device.";
CM_ SG_ 2362179326 DeviceElementOffsetZ "Z direction offset of a DeviceElement relative to  Device.";
CM_ SG_ 2362179326 DeviceVolumeCapacity "DeviceElement Volume Capacity, dimension of a DeviceElement.";
CM_ SG_ 2362179326 DeviceMassCapacity "DeviceElement Mass Capacity, dimension of a DeviceElement.";
CM_ SG_ 2362179326 DeviceCountCapacity "DeviceElement Count Capacity, dimension of a DeviceElement";
CM_ SG_ 2362179326 PercentageAppRateSetpoint "Application Rate expressed as percentage";
CM_ SG_ 2362179326 SetpointTimeLatency "Temporal Latency valid for the setpoint values of a Device Element";
CM_ SG_ 2362179326 ActualValueTimeLatency "Temporal Latency valid for the actual value of a Device Element";
CM_ SG_ 2362179326 YawAngle "Pivot / Yaw Angle of a DeviceElement";
CM_ SG_ 2362179326 RollAngle "Roll Angle of a DeviceElement";
CM_ SG_ 2362179326 PitchAngle "Pitch Angle of a DeviceElement";
CM_ SG_ 2362179326 LogCount "Log Counter, may be used to control data log record generation on a
Task Controller";
CM_ SG_ 2362179326 TotalFuelConsumption "Accumulated Fuel Consumption as Counter";
CM_ SG_ 2362179326 FuelConsumptionPerTime "Fuel consumption per time";
CM_ SG_ 2362179326 FuelConsumptionPerArea "Fuel consumption per area";
CM_ SG_ 2362179326 AreaPerTimeCapacity "Area per time capacity";
CM_ SG_ 2362179326 MinMassPerAreaAppRate "Minimum Application Rate specified as mass per area";
CM_ SG_ 2362179326 NDVI "Actual Normalized Difference Vegetative Index (NDVI)";
CM_ SG_ 2362179326 PhysicalObjectLength "Length of device element (dimension along the X-axis)";
CM_ SG_ 2362179326 PhysicalObjectWidth "Width of device element (dimension along the Y-axis)";
CM_ SG_ 2362179326 PhysicalObjectHeight "Height of device element (dimension along the Z-axis)";
CM_ SG_ 2362179326 ConnectorType "Specification of the type of coupler.";
CM_ SG_ 2362179326 PrescriptionControlState "Defines and synchronise the actual state of the prescription system";
CM_ SG_ 2362179326 NumberOfSubUnitsPerSection "Specifies the number of sub-units for a section 
(e.g. number of nozzles per sprayer section 
or number of planter row units per metering device)";
CM_ SG_ 2362179326 SectionControlState "Specifies the actual state of section control";
CM_ SG_ 2362179326 CondensedWorkState1to16 "Combination of the work states of individual sections or units (e.g. nozzles) 
number 1 to 16 into a single work state of their parent device element";
CM_ SG_ 2362179326 CondensedWorkState17to32 "Combination of the work states of individual sections or units (e.g. nozzles) 
number 17 to 32 into a single work state of their parent device element";
CM_ SG_ 2362179326 CondensedWorkState33to48 "Combination of the work states of individual sections or units (e.g. nozzles) 
number 33 to 48 into a single work state of their parent device element";
CM_ SG_ 2362179326 CondensedWorkState49to64 "Combination of the work states of individual sections or units (e.g. nozzles) 
number 49 to 64 into a single work state of their parent device element";
CM_ SG_ 2362179326 CondensedWorkState65to80 "Combination of the work states of individual sections or units (e.g. nozzles) 
number 65 to 80 into a single work state of their parent device element";
CM_ SG_ 2362179326 CondensedWorkState81to96 "Combination of the work states of individual sections or units (e.g. nozzles) 
number 81 to 96 into a single work state of their parent device element";
CM_ SG_ 2362179326 CondensedWorkState97to112 "Combination of the work states of individual sections or units (e.g. nozzles) 
number 97 to 112 into a single work state of their parent device element";
CM_ SG_ 2362179326 CondensedWorkState113to128 "Combination of the work states of individual sections or units (e.g. nozzles) 
number 113 to 128 into a single work state of their parent device element";
CM_ SG_ 2362179326 CondensedWorkState129to144 "Combination of the work states of individual sections or units (e.g. nozzles) 
number 129 to 144 into a single work state of their parent device element";
CM_ SG_ 2362179326 CondensedWorkState145to160 "Combination of the work states of individual sections or units (e.g. nozzles) 
number 145 to 160 into a single work state of their parent device element";
CM_ SG_ 2362179326 CondensedWorkState161to176 "Combination of the work states of individual sections or units (e.g. nozzles) 
number 161 to 176 into a single work state of their parent device element";
CM_ SG_ 2362179326 CondensedWorkState177to192 "Combination of the work states of individual sections or units (e.g. nozzles) 
number 177 to 192 into a single work state of their parent device element";
CM_ SG_ 2362179326 CondensedWorkState193to208 "Combination of the work states of individual sections or units (e.g. nozzles) 
number 193 to 208 into a single work state of their parent device element";
CM_ SG_ 2362179326 CondensedWorkState209to224 "Combination of the work states of individual sections or units (e.g. nozzles) 
number 209 to 224 into a single work state of their parent device element";
CM_ SG_ 2362179326 CondensedWorkState225to240 "Combination of the work states of individual sections or units (e.g. nozzles) 
number 225 to 240 into a single work state of their parent device element";
CM_ SG_ 2362179326 CondensedWorkState241to256 "Combination of the work states of individual sections or units (e.g. nozzles) 
number 241 to 256 into a single work state of their parent device element";
CM_ SG_ 2362179326 ActualLengthOfCut "Actual length of cut for harvested material, e.g. Forage Harvester or Tree Harvester";
CM_ SG_ 2362179326 ElementTypeInstance "This DDI is used to enumerate and identify multiple device elements (DET) 
of the same type within one Device Description object pool";
CM_ SG_ 2362179326 ActualCulturalPractice "This DDI is used to define the current cultural practice which is performed 
by an individual device operation. For instance a planter/seeder 
could provide a sowing and a fertilizing operation at the same time.";
CM_ SG_ 2362179326 DRP2GroundDistance "This DDI is used to specify the distance from the Device Reference Point (DRP) 
down to the ground surface. The DRP to Ground DDI shall be attached 
only to the Device Element (DET) with element number zero.";
CM_ SG_ 2362179326 DryMassPerAreaYield "Yield as dry mass per area. The definition of dry mass 
is the mass with a reference moisture specified by DDI 184.";
CM_ SG_ 2362179326 DryMassPerTimeYield "Yield as dry mass per time. The definition of dry mass 
is the mass with a reference moisture specified by DDI 184.";
CM_ SG_ 2362179326 YieldTotalDryMass "Accumulated Yield specified as dry mass. 
The definition of dry mass is the mass 
with a reference moisture specified by DDI 184.";
CM_ SG_ 2362179326 RefMoistureForDryMass "Moisture percentage used for the dry mass DDIs 181, 182 and 183.";
CM_ SG_ 2362179326 SeedCottonMassPerAreaYield "Seed cotton yield as mass per area, not corrected for a possibly included lint percantage.";
CM_ SG_ 2362179326 LintCottonMassPerAreaYield "Lint cotton yield as mass per area.";
CM_ SG_ 2362179326 SeedCottonMassPerTimeYield "Seed cotton yield as mass per time, not corrected for a possibly included lint percantage.";
CM_ SG_ 2362179326 LintCottonMassPerTimeYield "Lint cotton yield as mass per time.";
CM_ SG_ 2362179326 YieldTotalSeedCottonMass "Accumulated yield specified as seed cotton mass, not corrected for a possibly included lint percantage.";
CM_ SG_ 2362179326 YieldTotalLintCottonMass "Accumulated yield specified as lint cotton mass.";
CM_ SG_ 2362179326 LintTurnoutPercentage "Percent of lint in the seed cotton.";
CM_ SG_ 2362179326 AmbientTemperature "Ambient temperature measured by a machine. Unit is milli-Kelvin (mK).";
CM_ SG_ 2362179326 SetpointProductPressure "Setpoint Product Pressure to adjust the pressure of the product flow system at the point of dispensing.";
CM_ SG_ 2362179326 ActualProductPressure "Actual Product Pressure is the measured pressure in the product flow system at the point of dispensing.";
CM_ SG_ 2362179326 MinimumProductPressure "Minimun Product Pressure in the product flow system at the point of dispensing. ";
CM_ SG_ 2362179326 MaximumProductPressure "Maximum Product Pressure in the product flow system at the point of dispensing.";
CM_ SG_ 2362179326 SetpointPumpOutputPressure "Setpoint Pump Output Pressure to adjust the  pressure at the output of the solution pump.";
CM_ SG_ 2362179326 ActualPumpOutputPressure "Actual Pump Output Pressure measured at the output of the solution pump.";
CM_ SG_ 2362179326 MinimumPumpOutputPressure "Minimum Pump Output Pressure for the output pressure of the solution pump.";
CM_ SG_ 2362179326 MaximumPumpOutputPressure "Maximum Pump Output Pressure for the output pressure of the solution pump.";
CM_ SG_ 2362179326 SetpointTankAgitationPressure "Setpoint Tank Agitation Pressure to adjust the pressure for a stir system in a tank.";
CM_ SG_ 2362179326 ActualTankAgitationPressure "Actual Tank Agitation Pressure measured by the tank stir system.";
CM_ SG_ 2362179326 MinimumTankAgitationPressure "Minimun Tank Agitation Pressure for a stir system in a tank.";
CM_ SG_ 2362179326 MaximumTankAgitationPressure "Maximun Tank Agitation Pressure for a stir system in a tank.";
CM_ SG_ 2362179326 SCTurnOnTime_ "The Section Control Turn On Time defines the overall time lapse 
between the moment the TC sends a turn on section command 
to the working set and the moment this section 
is physically turned on and the product is applied.";
CM_ SG_ 2362179326 SCTurnOffTime "The Section Control Turn Off Time defines the overall time lapse 
between the moment the TC sends a turn off section command 
to the working set and the moment this section is physically turned off.";
CM_ SG_ 2362179326 WindSpeed "Wind speed measured in the treated field 
at the beginning of operations 
or on the application implement during operations.";
CM_ SG_ 2362179326 WindDirection "Wind direction measured in the treated field 
at the beginning of operations 
or on the application implement during operations.";
CM_ SG_ 2362179326 AirHumidity "Ambient humidty measured by a weather station 
in a treated field or on the application implement.";
CM_ SG_ 2362179326 SkyConditions "This DDE is used to define the current sky conditions during operation.";
CM_ SG_ 2362179326 LastBaleFlakesPerBale "The number of flakes in the most recently produced bale.";
CM_ SG_ 2362179326 LastBaleAverageMoisture "The average moisture in the most recently produced bale.";
CM_ SG_ 2362179326 LastBaleAverageStrokesPerFlake "The number of baler plunger compression strokes per flake 
that has entered the bale compression chamber. 
This value is the average valid for the most recently produced bale.";
CM_ SG_ 2362179326 LifetimeBaleCount "The number of bales produced by a machine over its entire lifetime.";
CM_ SG_ 2362179326 LifetimeWorkingHours "The number of working hours of a device element over its entire lifetime.";
CM_ SG_ 2362179326 ActualBaleHydraulicPressure "The actual value of the hydraulic pressure applied 
to the sides of the bale in the bale compression chamber.";
CM_ SG_ 2362179326 LastBaleAverageHydraulicPressure "The average actual value of the hydraulic pressure applied 
to the sides of the bale in the bale compression chamber.";
CM_ SG_ 2362179326 SetpointBaleCompressionPlungerLo "The setpoint bale compression plunger load as a unitless number.";
CM_ SG_ 2362179326 ActualBaleCompressionPlungerLoad "The actual bale compression plunger load as a unitless number.";
CM_ SG_ 2362179326 LastBaleAverageBaleCompressionPl "The average bale compression plunger load for the most recently produced bale.";
CM_ SG_ 2362179326 LastBaleAppliedPreservative "The total preservative applied to the most recently produced bale.";
CM_ SG_ 2362179326 LastBaleTagNumber "The Last Bale Tag Number as a decimal number in the range of 0 to 4294967295.";
CM_ SG_ 2362179326 LastBaleMass "The mass of the bale that has most recently been produced.";
CM_ SG_ 2362179326 DeltaT "The difference between dry bulb temperature and wet bulb temperature measured 
by a weather station in a treated field or on the application equipment.";
CM_ SG_ 2362179326 SetpointWorkingLength "This is the desired working length of the device element during operation.";
CM_ SG_ 2362179326 ActualWorkingLength "Actual Working Length of a Device Element.";
CM_ SG_ 2362179326 MinimumWorkingLength "This is the minimum working length of the device element during operation.";
CM_ SG_ 2362179326 MaximumWorkingLength "This is the maximum working length of the device element during operation.";
CM_ SG_ 2362179326 ActualNetWeight "The Actual Net Weight is the current measured mass by a weighing system.";
CM_ SG_ 2362179326 NetWeightState "The Net Weight State indicates whether the current 
Actual Net Weight value is a reliable value or not.";
CM_ SG_ 2362179326 SetpointNetWeight "The Setpoint Net Weight value is used to prompt 
the weighing system to perform a tare procedure.";
CM_ SG_ 2362179326 ActualGrossWeight "The Actual Gross Weight is the overall 
measured mass by a weighing system.";
CM_ SG_ 2362179326 GrossWeightState "The Gross Weight State indicates whether the current 
Actual Gross Weight value is a reliable value or not.";
CM_ SG_ 2362179326 MinimumGrossWeight "The Minimum Gross Weight may represent the minimum value 
of the effective range of the weighing system.";
CM_ SG_ 2362179326 MaximumGrossWeight "Maximum Gross Weight may represent the maximum value 
of the effective range of the weighing system.";
CM_ SG_ 2362179326 ThreshingEngagementTotalTime "Accumulated time while the threshing mechanism is engaged";
CM_ SG_ 2362179326 ActualHeaderWorkingHeightStatus "Actual status of the header being above or below 
the threshold height for the in-work state.";
CM_ SG_ 2362179326 ActualHeaderRotationalSpeedStatu "Actual status of the header rotational speed 
being above or below the threshold for in-work state.";
CM_ SG_ 2362179326 YieldHoldStatus "Status indicator for the yield measurement system. ";
CM_ SG_ 2362179326 ActualUnLoadingSystemStatus "Actual status of the Unloading and/or Loading system.";
CM_ SG_ 2362179326 CropTemperature "Temperature of harvested crop";
CM_ SG_ 2362179326 SetpointSieveClearance "Setpoint separation distance between Sieve elements";
CM_ SG_ 2362179326 ActualSieveClearance "Actual separation distance between Sieve elements";
CM_ SG_ 2362179326 MinimumSieveClearance "Minimal separation distance between Sieve elements";
CM_ SG_ 2362179326 MaximumSieveClearance "Maximum separation distance between Sieve elements.";
CM_ SG_ 2362179326 SetpointChafferClearance "Setpoint separation distance between Chaffer elements.";
CM_ SG_ 2362179326 ActualChafferClearance "Actual separation distance between Chaffer elements.";
CM_ SG_ 2362179326 MinimumChafferClearance "Minimum separation distance between Chaffer elements.";
CM_ SG_ 2362179326 MaximumChafferClearance "Maximum separation distance between Chaffer elements.";
CM_ SG_ 2362179326 SetpointConcaveClearance "Setpoint separation distance between Concave elements.";
CM_ SG_ 2362179326 ActualConcaveClearance "Actual separation distance between Concave elements.";
CM_ SG_ 2362179326 MinimumConcaveClearance "Minimum separation distance between Concave elements.";
CM_ SG_ 2362179326 MaximumConcaveClearance "Maximum separation distance between Concave elements.";
CM_ SG_ 2362179326 SetpointSeparationFanRotationalS "Setpoint rotational speed of the fan used 
for separating product material from non product material.";
CM_ SG_ 2362179326 ActualSeparationFanRotationalSpe "Actual rotational speed of the fan used 
for separating product material from non product material.";
CM_ SG_ 2362179326 MinimumSeparationFanRotationalSp "Minimum rotational speed of the fan used 
for separating product material from non product material.";
CM_ SG_ 2362179326 MaximumSeparationFanRotationalSp "Maximum rotational speed of the fan used 
for separating product material from non product material.";
CM_ SG_ 2362179326 HydraulicOilTemperature "Temperature of fluid in the hydraulic system.";
CM_ SG_ 2362179326 YieldLagIgnoreTime "Amount of time to ignore yield data, 
starting at the transition from the in-work to the out-of-work state. 
During this time, the yield sensor provides 
inconsistent or unreliable crop flow data.";
CM_ SG_ 2362179326 YieldLeadIgnoreTime "Amount of time to ignore yield data, 
starting at the transition from the out-of-work to the in-work state. 
During this time, the yield sensor provides 
inconsistent or unreliable crop flow data.";
CM_ SG_ 2362179326 AverageYieldMassPerTime "Average Yield expressed as mass per unit time, 
not corrected for the reference moisture percentage DDI 184. 
This value is the average for a Task and may be reported as a total.";
CM_ SG_ 2362179326 AverageCropMoisture "Average Moisture of the harvested crop. 
This value is the average for a Task and may be reported as a total.";
CM_ SG_ 2362179326 AverageYieldMassPerArea "This Average Yield Mass Per Area is the mass that includes the average crop moisture (DDI 262) i";
CM_ SG_ 2362179326 ConnectorPivotXOffset "X direction offset of a connector pivot point relative to DRP";
CM_ SG_ 2362179326 RemainingArea "Remaining Area of a field";
CM_ SG_ 2362179326 LifetimeApplicationTotalMass "Entire Application Total Count of the device lifetime";
CM_ SG_ 2362179326 LifetimeApplicationTotalCount "Entire Application Total Count of the device lifetime";
CM_ SG_ 2362179326 LifetimeYieldTotalVolume "Entire Yield Total Volume of the device lifetime";
CM_ SG_ 2362179326 LifetimeYieldTotalMass "Entire Yield Total Mass of the device lifetime";
CM_ SG_ 2362179326 LifetimeYieldTotalCount "Entire Yield Total Count of the device lifetime";
CM_ SG_ 2362179326 LifetimeTotalArea "Entire Total Area of the device lifetime";
CM_ SG_ 2362179326 LifetimeTotalDistance "Entire Total Area of the device lifetime";
CM_ SG_ 2362179326 LifetimeIneffectiveTotalDistance "Entire Ineffective Total Distance of the device lifetime";
CM_ SG_ 2362179326 LifetimeEffectiveTotalTime "Entire Ineffective Total Distance of the device lifetime";
CM_ SG_ 2362179326 LifetimeIneffectiveTotalTime "Entire Ineffective Total Time of the device lifetime";
CM_ SG_ 2362179326 LifetimeFuelConsumption "Entire Fuel Consumption of the device lifetime";
BA_DEF_ SG_  "DDI" INT 0 65535;
BA_DEF_ BO_  "SingleFrame" INT 0 1;
BA_DEF_ BO_  "VFrameFormat" ENUM  "StandardCAN","ExtendedCAN","reserved","J1939PG","vector_leerstring";
BA_DEF_ BO_  "GenMsgSendType" ENUM  "cyclic","NotUsed","IfActive","NotUsed","NotUsed","NotUsed","NotUsed","NotUsed","noMsgSendType","vector_leerstring";
BA_DEF_ BO_  "GenMsgCycleTime" INT 0 3600000;
BA_DEF_ BO_  "GenMsgRequestable" INT 0 1;
BA_DEF_ BO_  "GenMsgCycleTimeFast" INT 0 3600000;
BA_DEF_ SG_  "SPN" INT 0 524287;
BA_DEF_ SG_  "GenSigSendType" ENUM  "Cyclic","OnWrite","OnWriteWithRepetition","OnChange","OnChangeWithRepetition","IfActive","IfActiveWithRepetition","NoSigSendType";
BA_DEF_ SG_  "SigType" ENUM  "Default","Range","RangeSigned","ASCII","Discrete","Control","ReferencePGN","DTC","StringDelimiter","StringLength","StringLengthControl","MessageCounter","MessageChecksum";
BA_DEF_ SG_  "GenSigStartValue" INT -2147483648 2147483647;
BA_DEF_ SG_  "SystemSignalLongSymbol" STRING ;
BA_DEF_DEF_  "DDI" 0;
BA_DEF_DEF_  "SingleFrame" 1;
BA_DEF_DEF_  "VFrameFormat" "J1939PG";
BA_DEF_DEF_  "GenMsgSendType" "noMsgSendType";
BA_DEF_DEF_  "GenMsgCycleTime" 0;
BA_DEF_DEF_  "GenMsgRequestable" 1;
BA_DEF_DEF_  "GenMsgCycleTimeFast" 0;
BA_DEF_DEF_  "SPN" 0;
BA_DEF_DEF_  "GenSigSendType" "NoSigSendType";
BA_DEF_DEF_  "SigType" "Default";
BA_DEF_DEF_  "GenSigStartValue" 0;
BA_DEF_DEF_  "SystemSignalLongSymbol" "";
BA_ "DDI" SG_ 2362179326 ActualCanopyHeight 520;
BA_ "DDI" SG_ 2362179326 GNSSInstallationType 521;
BA_ "DDI" SG_ 2362179326 LastBaleLifetimeCount 519;
BA_ "DDI" SG_ 2362179326 ActualTramlineCondensedWorkState 518;
BA_ "SystemSignalLongSymbol" SG_ 2362179326 ActualTramlineCondensedWorkState "ActualTramlineCondensedWorkState1to16";
BA_ "DDI" SG_ 2362179326 SetpointTramlineCondensedWorkSta 517;
BA_ "SystemSignalLongSymbol" SG_ 2362179326 SetpointTramlineCondensedWorkSta "SetpointTramlineCondensedWorkState1to16";
BA_ "DDI" SG_ 2362179326 TramlineOverdosingRate 516;
BA_ "DDI" SG_ 2362179326 TramlineControlState 515;
BA_ "DDI" SG_ 2362179326 GNSSQuality 514;
BA_ "DDI" SG_ 2362179326 GuidanceLineDeviation 513;
BA_ "DDI" SG_ 2362179326 GuidanceLineSwathWidth 512;
BA_ "DDI" SG_ 2362179326 TrackNumberToLeft 511;
BA_ "DDI" SG_ 2362179326 TrackNumberToRight 510;
BA_ "DDI" SG_ 2362179326 ActualTrackNumber 509;
BA_ "DDI" SG_ 2362179326 UniqueABGuidanceReferenceLineID 508;
BA_ "DDI" SG_ 2362179326 TramlineSequenceNumber 507;
BA_ "DDI" SG_ 2362179326 SetpointTramlineControlLevel 506;
BA_ "DDI" SG_ 2362179326 TramlineControlLevel 505;
BA_ "DDI" SG_ 2362179326 MaxEngineTorque 504;
BA_ "DDI" SG_ 2362179326 MinEngineTorque 503;
BA_ "DDI" SG_ 2362179326 ActualEngineTorque 502;
BA_ "DDI" SG_ 2362179326 SetpointEngineTorque 501;
BA_ "DDI" SG_ 2362179326 LastEventPartnerIDDeviceClass 500;
BA_ "DDI" SG_ 2362179326 LastEventPartnerIDManufacturerID 499;
BA_ "SystemSignalLongSymbol" SG_ 2362179326 LastEventPartnerIDManufacturerID "LastEventPartnerIDManufacturerIDCode";
BA_ "DDI" SG_ 2362179326 LastEventPartnerIdType 498;
BA_ "DDI" SG_ 2362179326 LastEventPartnerID_Byte13to16 497;
BA_ "DDI" SG_ 2362179326 LastEventPartnerID_Byte9to12 496;
BA_ "DDI" SG_ 2362179326 LastEventPartnerID_Byte5to8 495;
BA_ "DDI" SG_ 2362179326 LastEventPartnerID_Byte1to4 494;
BA_ "DDI" SG_ 2362179326 LifetimeEngineHours 493;
BA_ "DDI" SG_ 2362179326 TotalEngineHours 492;
BA_ "DDI" SG_ 2362179326 FuelPercentageLevel 491;
BA_ "DDI" SG_ 2362179326 MaxFuelTankContent 490;
BA_ "DDI" SG_ 2362179326 MaxDieselExhaustFluidTankContent 489;
BA_ "DDI" SG_ 2362179326 DieselExhaustFluidTankPercentage 488;
BA_ "SystemSignalLongSymbol" SG_ 2362179326 DieselExhaustFluidTankPercentage "DieselExhaustFluidTankPercentageLevel";
BA_ "DDI" SG_ 2362179326 MaxEngineSpeed 486;
BA_ "DDI" SG_ 2362179326 MinEngineSpeed 485;
BA_ "DDI" SG_ 2362179326 ActualEngineSpeed 484;
BA_ "DDI" SG_ 2362179326 SetpointEngineSpeed 483;
BA_ "DDI" SG_ 2362179326 LastBaleNumberOfSubbales 482;
BA_ "DDI" SG_ 2362179326 SetpointNumberOfSubbales 481;
BA_ "DDI" SG_ 2362179326 MaxFlakeSize 480;
BA_ "DDI" SG_ 2362179326 MinFlakeSize 479;
BA_ "DDI" SG_ 2362179326 SetpointFlakeSize 478;
BA_ "DDI" SG_ 2362179326 MaxBaleHydraulicPressure 477;
BA_ "DDI" SG_ 2362179326 MinBaleHydraulicPressure 476;
BA_ "DDI" SG_ 2362179326 SetpointBaleHydraulicPressure 475;
BA_ "DDI" SG_ 2362179326 MaxLengthOfCut 474;
BA_ "DDI" SG_ 2362179326 MinLengthOfCut 473;
BA_ "DDI" SG_ 2362179326 SetpointLengthOfCut 472;
BA_ "DDI" SG_ 2362179326 ActualPercentageContent 467;
BA_ "DDI" SG_ 2362179326 ActualRelativeConnectorAngle 466;
BA_ "DDI" SG_ 2362179326 LifetimeHaulCounter 465;
BA_ "DDI" SG_ 2362179326 HaulCounter 464;
BA_ "DDI" SG_ 2362179326 LastUnloadedCount 463;
BA_ "DDI" SG_ 2362179326 LastLoadedCount 462;
BA_ "DDI" SG_ 2362179326 LifetimeUnloadedTotalCount 461;
BA_ "DDI" SG_ 2362179326 LifetimeLoadedTotalCount 460;
BA_ "DDI" SG_ 2362179326 UnloadedTotalCount 459;
BA_ "DDI" SG_ 2362179326 LoadedTotalCount 458;
BA_ "DDI" SG_ 2362179326 LastUnloadedVolume 457;
BA_ "DDI" SG_ 2362179326 LastLoadedVolume 456;
BA_ "DDI" SG_ 2362179326 LifetimeUnloadedTotalVolume 455;
BA_ "DDI" SG_ 2362179326 LifetimeLoadedTotalVolume 454;
BA_ "DDI" SG_ 2362179326 UnloadedTotalVolume 453;
BA_ "DDI" SG_ 2362179326 LoadedTotalVolume 452;
BA_ "DDI" SG_ 2362179326 MaxAppRateOfDryMatter 451;
BA_ "DDI" SG_ 2362179326 MinAppRateOfDryMatter 450;
BA_ "DDI" SG_ 2362179326 ActualAppRateOfDryMatter 449;
BA_ "DDI" SG_ 2362179326 SetpointAppRateOfDryMatter 448;
BA_ "DDI" SG_ 2362179326 MaxAppRateOfPotassium 447;
BA_ "DDI" SG_ 2362179326 MinAppRateOfPotassium 446;
BA_ "DDI" SG_ 2362179326 ActualAppRateOfPotassium 445;
BA_ "DDI" SG_ 2362179326 SetpointAppRateOfPotassium 444;
BA_ "DDI" SG_ 2362179326 MaxAppRateOfPhosphor 443;
BA_ "DDI" SG_ 2362179326 MinAppRateOfPhosphor 442;
BA_ "DDI" SG_ 2362179326 ActualAppRateOfPhosphor 441;
BA_ "DDI" SG_ 2362179326 SetpointAppRateOfPhosphor 440;
BA_ "DDI" SG_ 2362179326 MaxAppRateOfAmmonium 439;
BA_ "DDI" SG_ 2362179326 MinAppRateOfAmmonium 438;
BA_ "DDI" SG_ 2362179326 ActualAppRateOfAmmonium 437;
BA_ "DDI" SG_ 2362179326 SetpointAppRateOfAmmonium 436;
BA_ "DDI" SG_ 2362179326 MaxAppRateOfNitrogen 435;
BA_ "DDI" SG_ 2362179326 MinAppRateOfNitrogen 434;
BA_ "DDI" SG_ 2362179326 ActualAppRateOfNitrogen 433;
BA_ "DDI" SG_ 2362179326 SetpointAppRateOfNitrogen 432;
BA_ "DDI" SG_ 2362179326 LifetimeUnloadedTotalMass 431;
BA_ "DDI" SG_ 2362179326 LifetimeLoadedTotalMass 430;
BA_ "DDI" SG_ 2362179326 UnloadedTotalMass 429;
BA_ "DDI" SG_ 2362179326 LoadedTotalMass 428;
BA_ "DDI" SG_ 2362179326 ActualDownforceAsForce 427;
BA_ "DDI" SG_ 2362179326 SetpointDownforceAsForce 426;
BA_ "DDI" SG_ 2362179326 SetpointMaxAllowedSeedSpacingDev 425;
BA_ "SystemSignalLongSymbol" SG_ 2362179326 SetpointMaxAllowedSeedSpacingDev "SetpointMaxAllowedSeedSpacingDeviation";
BA_ "DDI" SG_ 2362179326 AvgCoeffOfVariationOfSeedSpacing 424;
BA_ "SystemSignalLongSymbol" SG_ 2362179326 AvgCoeffOfVariationOfSeedSpacing "AvgCoeffOfVariationOfSeedSpacingPercentage";
BA_ "DDI" SG_ 2362179326 ActCoeffOfVariationOfSeedSpacing 423;
BA_ "SystemSignalLongSymbol" SG_ 2362179326 ActCoeffOfVariationOfSeedSpacing "ActCoeffOfVariationOfSeedSpacingPercentage";
BA_ "DDI" SG_ 2362179326 AverageSeedSpacingDeviation_Copy 422;
BA_ "SystemSignalLongSymbol" SG_ 2362179326 AverageSeedSpacingDeviation_Copy "AverageSeedSpacingDeviation_Copy_1";
BA_ "DDI" SG_ 2362179326 ActualSeedSpacingDeviation 421;
BA_ "DDI" SG_ 2362179326 AverageSeedMultiplePercentage 420;
BA_ "DDI" SG_ 2362179326 ActualSeedMultiplePercentage 419;
BA_ "DDI" SG_ 2362179326 AverageSeedSkipPercentage 418;
BA_ "DDI" SG_ 2362179326 ActualSeedSkipPercentage 417;
BA_ "DDI" SG_ 2362179326 AverageSeedSingulationPercentage 416;
BA_ "DDI" SG_ 2362179326 ActualSeedSingulationPercentage 415;
BA_ "DDI" SG_ 2362179326 LifetimeAvgDieselExhFluidConsump 414;
BA_ "SystemSignalLongSymbol" SG_ 2362179326 LifetimeAvgDieselExhFluidConsump "LifetimeAvgDieselExhFluidConsumpPerArea";
BA_ "DDI" SG_ 2362179326 LifetimeAvgDieselExhFluidCo_0000 413;
BA_ "SystemSignalLongSymbol" SG_ 2362179326 LifetimeAvgDieselExhFluidCo_0000 "LifetimeAvgDieselExhFluidConsumpPerTime";
BA_ "SPN" SG_ 2362179326 LifetimeDieselExhaustFluidConsum 5963;
BA_ "DDI" SG_ 2362179326 LifetimeDieselExhaustFluidConsum 412;
BA_ "SystemSignalLongSymbol" SG_ 2362179326 LifetimeDieselExhaustFluidConsum "LifetimeDieselExhaustFluidConsumption";
BA_ "DDI" SG_ 2362179326 InstantDieselExhaustFluidConsump 411;
BA_ "SystemSignalLongSymbol" SG_ 2362179326 InstantDieselExhaustFluidConsump "InstantDieselExhaustFluidConsumpPerArea";
BA_ "DDI" SG_ 2362179326 InstantDieselExhaustFluidCo_0000 410;
BA_ "SystemSignalLongSymbol" SG_ 2362179326 InstantDieselExhaustFluidCo_0000 "InstantDieselExhaustFluidConsumpPerTime";
BA_ "DDI" SG_ 2362179326 TotalDieselExhaustFluidConsumpti 409;
BA_ "SystemSignalLongSymbol" SG_ 2362179326 TotalDieselExhaustFluidConsumpti "TotalDieselExhaustFluidConsumption";
BA_ "DDI" SG_ 2362179326 AverageCropContamination 408;
BA_ "DDI" SG_ 2362179326 AverageProteinContent 407;
BA_ "DDI" SG_ 2362179326 ActualProteinContent 406;
BA_ "DDI" SG_ 2362179326 ActualApplicationOfDryMatter 405;
BA_ "DDI" SG_ 2362179326 ActualApplicationOfPotassium 404;
BA_ "DDI" SG_ 2362179326 ActualApplicationOfPhosphor 403;
BA_ "DDI" SG_ 2362179326 ActualApplicationOfAmmonium 402;
BA_ "DDI" SG_ 2362179326 ActualApplicationOfNitrogen 401;
BA_ "DDI" SG_ 2362179326 SpeedSource 400;
BA_ "DDI" SG_ 2362179326 MaximumSpeed 399;
BA_ "DDI" SG_ 2362179326 MinimumSpeed 398;
BA_ "DDI" SG_ 2362179326 ActualSpeed 397;
BA_ "DDI" SG_ 2362179326 SetpointSpeed 396;
BA_ "DDI" SG_ 2362179326 ActualDieselExhaustFluidTankCont 395;
BA_ "SystemSignalLongSymbol" SG_ 2362179326 ActualDieselExhaustFluidTankCont "ActualDieselExhaustFluidTankContent";
BA_ "DDI" SG_ 2362179326 ActualFuelTankContent 394;
BA_ "DDI" SG_ 2362179326 MaximumRevolutionsPerTime 393;
BA_ "DDI" SG_ 2362179326 MinimumRevolutionsPerTime 392;
BA_ "DDI" SG_ 2362179326 DefaultRevolutionsPerTime 391;
BA_ "DDI" SG_ 2362179326 ActualRevolutionsPerTime 390;
BA_ "DDI" SG_ 2362179326 SetpointRevolutionsAsCountPerTim 389;
BA_ "SystemSignalLongSymbol" SG_ 2362179326 SetpointRevolutionsAsCountPerTim "SetpointRevolutionsAsCountPerTime";
BA_ "DDI" SG_ 2362179326 TotalRevolutionsInCompleteRevolu 388;
BA_ "SystemSignalLongSymbol" SG_ 2362179326 TotalRevolutionsInCompleteRevolu "TotalRevolutionsInCompleteRevolutions";
BA_ "DDI" SG_ 2362179326 TotalRevolutionsInFractionalRevo 387;
BA_ "SystemSignalLongSymbol" SG_ 2362179326 TotalRevolutionsInFractionalRevo "TotalRevolutionsInFractionalRevolutions";
BA_ "DDI" SG_ 2362179326 ActualAtmosphericPressure 386;
BA_ "DDI" SG_ 2362179326 MSLAtmosphericPressure 385;
BA_ "DDI" SG_ 2362179326 ApparentWindSpeed 384;
BA_ "DDI" SG_ 2362179326 ApparentWindDirection 383;
BA_ "DDI" SG_ 2362179326 CondensedSectionOverrideState241 382;
BA_ "SystemSignalLongSymbol" SG_ 2362179326 CondensedSectionOverrideState241 "CondensedSectionOverrideState241to256";
BA_ "DDI" SG_ 2362179326 CondensedSectionOverrideState225 381;
BA_ "SystemSignalLongSymbol" SG_ 2362179326 CondensedSectionOverrideState225 "CondensedSectionOverrideState225to240";
BA_ "DDI" SG_ 2362179326 CondensedSectionOverrideState209 380;
BA_ "SystemSignalLongSymbol" SG_ 2362179326 CondensedSectionOverrideState209 "CondensedSectionOverrideState209to224";
BA_ "DDI" SG_ 2362179326 CondensedSectionOverrideState193 379;
BA_ "SystemSignalLongSymbol" SG_ 2362179326 CondensedSectionOverrideState193 "CondensedSectionOverrideState193to208";
BA_ "DDI" SG_ 2362179326 CondensedSectionOverrideState177 378;
BA_ "SystemSignalLongSymbol" SG_ 2362179326 CondensedSectionOverrideState177 "CondensedSectionOverrideState177to192";
BA_ "DDI" SG_ 2362179326 CondensedSectionOverrideState161 377;
BA_ "SystemSignalLongSymbol" SG_ 2362179326 CondensedSectionOverrideState161 "CondensedSectionOverrideState161to176";
BA_ "DDI" SG_ 2362179326 CondensedSectionOverrideState145 376;
BA_ "SystemSignalLongSymbol" SG_ 2362179326 CondensedSectionOverrideState145 "CondensedSectionOverrideState145to160";
BA_ "DDI" SG_ 2362179326 CondensedSectionOverrideState129 375;
BA_ "SystemSignalLongSymbol" SG_ 2362179326 CondensedSectionOverrideState129 "CondensedSectionOverrideState129to144";
BA_ "DDI" SG_ 2362179326 CondensedSectionOverrideState113 374;
BA_ "SystemSignalLongSymbol" SG_ 2362179326 CondensedSectionOverrideState113 "CondensedSectionOverrideState113to128";
BA_ "DDI" SG_ 2362179326 CondensedSectionOverrideState97t 373;
BA_ "SystemSignalLongSymbol" SG_ 2362179326 CondensedSectionOverrideState97t "CondensedSectionOverrideState97to112";
BA_ "DDI" SG_ 2362179326 CondensedSectionOverrideState81t 372;
BA_ "SystemSignalLongSymbol" SG_ 2362179326 CondensedSectionOverrideState81t "CondensedSectionOverrideState81to96";
BA_ "DDI" SG_ 2362179326 CondensedSectionOverrideState65t 371;
BA_ "SystemSignalLongSymbol" SG_ 2362179326 CondensedSectionOverrideState65t "CondensedSectionOverrideState65to80";
BA_ "DDI" SG_ 2362179326 CondensedSectionOverrideState49t 370;
BA_ "SystemSignalLongSymbol" SG_ 2362179326 CondensedSectionOverrideState49t "CondensedSectionOverrideState49to64";
BA_ "DDI" SG_ 2362179326 CondensedSectionOverrideState33t 369;
BA_ "SystemSignalLongSymbol" SG_ 2362179326 CondensedSectionOverrideState33t "CondensedSectionOverrideState33to48";
BA_ "DDI" SG_ 2362179326 CondensedSectionOverrideState17t 368;
BA_ "SystemSignalLongSymbol" SG_ 2362179326 CondensedSectionOverrideState17t "CondensedSectionOverrideState17to32";
BA_ "DDI" SG_ 2362179326 CondensedSectionOverrideState01t 367;
BA_ "SystemSignalLongSymbol" SG_ 2362179326 CondensedSectionOverrideState01t "CondensedSectionOverrideState01to16";
BA_ "DDI" SG_ 2362179326 ActualDownforcePressure 366;
BA_ "DDI" SG_ 2362179326 SetpointDownforcePressure 365;
BA_ "DDI" SG_ 2362179326 ActualFlakeSize 364;
BA_ "DDI" SG_ 2362179326 LastBaleDryMass 363;
BA_ "DDI" SG_ 2362179326 TotalBaleLength 362;
BA_ "DDI" SG_ 2362179326 LastBaleDensity 361;
BA_ "DDI" SG_ 2362179326 LastBaleSize 360;
BA_ "DDI" SG_ 2362179326 AverageDryYieldMassPerArea 359;
BA_ "DDI" SG_ 2362179326 AverageDryYieldMassPerTime 358;
BA_ "DDI" SG_ 2362179326 TotalApplicationOfDryMatter 357;
BA_ "DDI" SG_ 2362179326 TotalApplicationOfPotassium 356;
BA_ "DDI" SG_ 2362179326 TotalApplicationOfPhosphor 355;
BA_ "DDI" SG_ 2362179326 TotalApplicationOfAmmonium 354;
BA_ "DDI" SG_ 2362179326 TotalApplicationofNitrogen 353;
BA_ "DDI" SG_ 2362179326 ApplicationTotalMass 352;
BA_ "DDI" SG_ 2362179326 ApplicationTotalVolume 351;
BA_ "DDI" SG_ 2362179326 FunctionType 350;
BA_ "DDI" SG_ 2362179326 NozzleDriftReduction 349;
BA_ "DDI" SG_ 2362179326 MaximumSwathingWidth 348;
BA_ "DDI" SG_ 2362179326 MinimumSwathingWidth 347;
BA_ "DDI" SG_ 2362179326 ActualSwathingWidth 346;
BA_ "DDI" SG_ 2362179326 SetpointSwathingWidth 345;
BA_ "DDI" SG_ 2362179326 MaximumGrainKernelCrackerGap 344;
BA_ "DDI" SG_ 2362179326 MinimumGrainKernelCrackerGap 343;
BA_ "DDI" SG_ 2362179326 ActualGrainKernelCrackerGap 342;
BA_ "DDI" SG_ 2362179326 SetpointGrainKernelCrackerGap 341;
BA_ "DDI" SG_ 2362179326 EffectiveUnloadingTime 340;
BA_ "DDI" SG_ 2362179326 EffectiveLoadingTime 339;
BA_ "DDI" SG_ 2362179326 LiftimeRearPTOHours 338;
BA_ "DDI" SG_ 2362179326 LifetimeFrontPTOHours 337;
BA_ "DDI" SG_ 2362179326 RearPTOHours 336;
BA_ "DDI" SG_ 2362179326 FrontPTOHours 335;
BA_ "DDI" SG_ 2362179326 OperatingHoursSinceLastSharpenin 334;
BA_ "SystemSignalLongSymbol" SG_ 2362179326 OperatingHoursSinceLastSharpenin "OperatingHoursSinceLastSharpening";
BA_ "DDI" SG_ 2362179326 MaximumCuttingDrumSpeed 333;
BA_ "DDI" SG_ 2362179326 ActualCuttingDrumSpeed 331;
BA_ "DDI" SG_ 2362179326 SetpointCuttingDrumSpeed 330;
BA_ "DDI" SG_ 2362179326 MaximumHeaderSpeed 329;
BA_ "DDI" SG_ 2362179326 MinimumHeaderSpeed 328;
BA_ "DDI" SG_ 2362179326 ActualHeaderSpeed 327;
BA_ "DDI" SG_ 2362179326 SetpointHeaderSpeed 326;
BA_ "DDI" SG_ 2362179326 LifetimeApplicationTotalVolume 325;
BA_ "DDI" SG_ 2362179326 ChopperEngagementTotalTime 324;
BA_ "DDI" SG_ 2362179326 UnloadIdentificationNumber 323;
BA_ "DDI" SG_ 2362179326 LoadIdentificationNumber 322;
BA_ "SPN" SG_ 2362179326 ArbitraryAddressCapable 2844;
BA_ "SPN" SG_ 2362179326 IndustryGroup 2846;
BA_ "SPN" SG_ 2362179326 VehicleSystemInstance 2843;
BA_ "SPN" SG_ 2362179326 Function 2841;
BA_ "SPN" SG_ 2362179326 FunctionInstance 2839;
BA_ "SPN" SG_ 2362179326 ECUInstance 2840;
BA_ "SigType" SG_ 2362179326 ManufacturerCode 1;
BA_ "SPN" SG_ 2362179326 ManufacturerCode 2838;
BA_ "SigType" SG_ 2362179326 TemperatureUnits 4;
BA_ "SigType" SG_ 2362179326 PressureUnits 4;
BA_ "SigType" SG_ 2362179326 ForceUnits 4;
BA_ "SPN" SG_ 2362179326 IdentityNumber 2837;
BA_ "SigType" SG_ 2362179326 UnitsSystem 4;
BA_ "SPN" SG_ 2362179326 DistanceUnitCmd 2414;
BA_ "SigType" SG_ 2362179326 DistanceUnitCmd 4;
BA_ "SPN" SG_ 2362179326 AreaUnitCmd 2415;
BA_ "SigType" SG_ 2362179326 AreaUnitCmd 4;
BA_ "SPN" SG_ 2362179326 VolumeUnitCmd 2416;
BA_ "SigType" SG_ 2362179326 VolumeUnitCmd 4;
BA_ "SPN" SG_ 2362179326 MassUnitCmd 2417;
BA_ "SigType" SG_ 2362179326 MassUnitCmd 4;
BA_ "GenSigStartValue" SG_ 2362179326 NumberOfBooms 255;
BA_ "DDI" SG_ 2362179326 AppRateVolumePerArea_Set 1;
BA_ "DDI" SG_ 2362179326 AppRateVolumePerArea_Act 2;
BA_ "DDI" SG_ 2362179326 AppRateVolumePerArea_Def 3;
BA_ "DDI" SG_ 2362179326 AppRateVolumePerArea_Min 4;
BA_ "DDI" SG_ 2362179326 AppRateVolumePerArea_Max 5;
BA_ "DDI" SG_ 2362179326 AppRateMassPerArea_Set 6;
BA_ "DDI" SG_ 2362179326 AppRateMassPerArea_Act 7;
BA_ "DDI" SG_ 2362179326 AppRateMassPerArea_Def 8;
BA_ "DDI" SG_ 2362179326 AppRateMassPerArea_Min 9;
BA_ "DDI" SG_ 2362179326 AppRateMassPerArea_Max 10;
BA_ "DDI" SG_ 2362179326 AppRateCountPerArea_Set 11;
BA_ "DDI" SG_ 2362179326 AppRateCountPerArea_Act 12;
BA_ "DDI" SG_ 2362179326 AppRateCountPerArea_Def 13;
BA_ "DDI" SG_ 2362179326 AppRateCountPerArea_Min 14;
BA_ "DDI" SG_ 2362179326 AppRateCountPerArea_Max 15;
BA_ "DDI" SG_ 2362179326 SetAppRateDistance_Set 16;
BA_ "DDI" SG_ 2362179326 AppRateDistance_Act 17;
BA_ "DDI" SG_ 2362179326 AppRateDistance_Def 18;
BA_ "DDI" SG_ 2362179326 AppRateDistance_Min 19;
BA_ "DDI" SG_ 2362179326 AppRateDistance_Max 20;
BA_ "DDI" SG_ 2362179326 AppRateVolumePerVolume_Set 21;
BA_ "DDI" SG_ 2362179326 AppRateVolumePerVolume_Act 22;
BA_ "DDI" SG_ 2362179326 AppRateVolumePerVolume_Def 23;
BA_ "DDI" SG_ 2362179326 AppRateVolumePerVolume_Min 24;
BA_ "DDI" SG_ 2362179326 AppRateVolumePerVolume_Max 25;
BA_ "DDI" SG_ 2362179326 AppRateMassPerMass_Set 26;
BA_ "DDI" SG_ 2362179326 AppRateMassPerMass_Act 27;
BA_ "DDI" SG_ 2362179326 AppRateMassPerMass_Def 28;
BA_ "DDI" SG_ 2362179326 AppRateMassPerMass_Min 29;
BA_ "DDI" SG_ 2362179326 AppRateMassPerMass_Max 30;
BA_ "DDI" SG_ 2362179326 AppRateVolumePerMass_Set 31;
BA_ "DDI" SG_ 2362179326 AppRateVolumePerMass_Act 32;
BA_ "DDI" SG_ 2362179326 AppRateVolumePerMass_Def 33;
BA_ "DDI" SG_ 2362179326 AppRateVolumePerMass_Min 34;
BA_ "DDI" SG_ 2362179326 AppRateVolumePerMass_Max 35;
BA_ "DDI" SG_ 2362179326 AppRateVolumePerTime_Set 36;
BA_ "DDI" SG_ 2362179326 AppRateVolumePerTime_Act 37;
BA_ "DDI" SG_ 2362179326 AppRateVolumePerTime_Def 38;
BA_ "DDI" SG_ 2362179326 AppRateVolumePerTime_Min 39;
BA_ "DDI" SG_ 2362179326 AppRateVolumePerTime_Max 40;
BA_ "DDI" SG_ 2362179326 AppRateMassPerTime_Set 41;
BA_ "DDI" SG_ 2362179326 AppRateMassPerTime_Act 42;
BA_ "DDI" SG_ 2362179326 AppRateMassPerTime_Def 43;
BA_ "DDI" SG_ 2362179326 AppRateMassPerTime_Min 44;
BA_ "DDI" SG_ 2362179326 AppRateMassPerTime_Max 45;
BA_ "DDI" SG_ 2362179326 AppRateCountPerTime_Set 46;
BA_ "DDI" SG_ 2362179326 AppRateCountPerTime_Act 47;
BA_ "DDI" SG_ 2362179326 AppRateCountPerTime_Def 48;
BA_ "DDI" SG_ 2362179326 AppRateCountPerTime_Min 49;
BA_ "DDI" SG_ 2362179326 AppRateCountPerTime_Max 50;
BA_ "DDI" SG_ 2362179326 SetTillageDepth_Set 51;
BA_ "DDI" SG_ 2362179326 TillageDepth_Act 52;
BA_ "DDI" SG_ 2362179326 TillageDepth_Def 53;
BA_ "DDI" SG_ 2362179326 TillageDepth_Min 54;
BA_ "DDI" SG_ 2362179326 TillageDepth_Max 55;
BA_ "DDI" SG_ 2362179326 SeedingDeph_Set 56;
BA_ "DDI" SG_ 2362179326 SeedingDeph_Act 57;
BA_ "DDI" SG_ 2362179326 SeedingDeph_Def 58;
BA_ "DDI" SG_ 2362179326 SeedingDeph_Min 59;
BA_ "DDI" SG_ 2362179326 SeedingDeph_Max 60;
BA_ "DDI" SG_ 2362179326 WorkingHeight_Set 61;
BA_ "DDI" SG_ 2362179326 WorkingHeight_Act 62;
BA_ "DDI" SG_ 2362179326 WorkingHeight_Def 63;
BA_ "DDI" SG_ 2362179326 WorkingHeight_Min 64;
BA_ "DDI" SG_ 2362179326 WorkingHeight_Max 65;
BA_ "DDI" SG_ 2362179326 WorkingWidth_Set 66;
BA_ "DDI" SG_ 2362179326 WorkingWidth_Act 67;
BA_ "DDI" SG_ 2362179326 WorkingWidth_Def 68;
BA_ "DDI" SG_ 2362179326 WorkingWidth_Min 69;
BA_ "DDI" SG_ 2362179326 WorkingWidth_Max 70;
BA_ "DDI" SG_ 2362179326 ContentAsVolume_Set 71;
BA_ "DDI" SG_ 2362179326 ContentAsVolume_Act 72;
BA_ "DDI" SG_ 2362179326 ContentAsVolume_Max 73;
BA_ "DDI" SG_ 2362179326 ContentAsMass_Set 74;
BA_ "DDI" SG_ 2362179326 ContentAsMass_Act 75;
BA_ "DDI" SG_ 2362179326 ContentAsMass_Max 76;
BA_ "DDI" SG_ 2362179326 ContentAsCount_Set 77;
BA_ "DDI" SG_ 2362179326 ContentAsCount_Act 78;
BA_ "DDI" SG_ 2362179326 ContentAsCount_Max 79;
BA_ "DDI" SG_ 2362179326 AccumulatedAppAsVolume 80;
BA_ "DDI" SG_ 2362179326 AccumulatedAppAsMass 81;
BA_ "DDI" SG_ 2362179326 AccumulatedAppAsCount 82;
BA_ "DDI" SG_ 2362179326 YieldVolumePerArea 83;
BA_ "DDI" SG_ 2362179326 YieldMassPerArea 84;
BA_ "DDI" SG_ 2362179326 YieldCountPerArea 85;
BA_ "DDI" SG_ 2362179326 YieldVolumePerTime 86;
BA_ "DDI" SG_ 2362179326 YieldMassPerTime 87;
BA_ "DDI" SG_ 2362179326 YieldCountPerTime 88;
BA_ "DDI" SG_ 2362179326 AccumulatedYieldAsVolume 89;
BA_ "DDI" SG_ 2362179326 AccumulatedYieldAsMass 90;
BA_ "DDI" SG_ 2362179326 AccumulatedYieldAsCount 91;
BA_ "DDI" SG_ 2362179326 CropYieldLossVolumePerArea 92;
BA_ "DDI" SG_ 2362179326 CropYieldLossMassPerArea 93;
BA_ "DDI" SG_ 2362179326 CropYieldLossCountPerArea 94;
BA_ "DDI" SG_ 2362179326 CropYieldLossVolumePerTime 95;
BA_ "DDI" SG_ 2362179326 CropYieldLossMassPerTime 96;
BA_ "DDI" SG_ 2362179326 CropYieldLossCountPerTime 97;
BA_ "DDI" SG_ 2362179326 CropYieldLoss 98;
BA_ "DDI" SG_ 2362179326 MoistureInCropYield 99;
BA_ "DDI" SG_ 2362179326 DirtMaterialInCropYield 100;
BA_ "DDI" SG_ 2362179326 BaleWidth_Set 101;
BA_ "DDI" SG_ 2362179326 BaleWidth_Act 102;
BA_ "DDI" SG_ 2362179326 BaleWidth_Def 103;
BA_ "DDI" SG_ 2362179326 BaleWidth_Min 104;
BA_ "DDI" SG_ 2362179326 BaleWidth_Max 105;
BA_ "DDI" SG_ 2362179326 BaleHeight_Set 106;
BA_ "DDI" SG_ 2362179326 BaleHeight_Act 107;
BA_ "DDI" SG_ 2362179326 BaleHeight_Def 108;
BA_ "DDI" SG_ 2362179326 BaleHeight_Min 109;
BA_ "DDI" SG_ 2362179326 BaleHeight_Max 110;
BA_ "DDI" SG_ 2362179326 BaleSize_Set 111;
BA_ "DDI" SG_ 2362179326 BaleSize_Act 112;
BA_ "DDI" SG_ 2362179326 BaleSize_Def 113;
BA_ "DDI" SG_ 2362179326 BaleSize_Min 114;
BA_ "DDI" SG_ 2362179326 BaleSize_Max 115;
BA_ "DDI" SG_ 2362179326 AccumulatedArea 116;
BA_ "DDI" SG_ 2362179326 AccumulatedDistanceInWork 117;
BA_ "DDI" SG_ 2362179326 AccumulatedDistanceOutWork 118;
BA_ "DDI" SG_ 2362179326 AccumulatedTimeInWork 119;
BA_ "DDI" SG_ 2362179326 AccumulatedTimeOutWork 120;
BA_ "DDI" SG_ 2362179326 PrdoucDensityMassPerArea 121;
BA_ "DDI" SG_ 2362179326 PrdoucDensityMassPerCount 122;
BA_ "DDI" SG_ 2362179326 PrdoucDensityVolumePerCount 123;
BA_ "DDI" SG_ 2362179326 AuxiliaryValveScalingExtend 124;
BA_ "DDI" SG_ 2362179326 AuxiliaryValveScalingRetract 125;
BA_ "DDI" SG_ 2362179326 AuxiliaryRampExtendUp 126;
BA_ "DDI" SG_ 2362179326 AuxiliaryValveRampExtendDown 127;
BA_ "DDI" SG_ 2362179326 AuxiliaryValveRampRetractUp 128;
BA_ "DDI" SG_ 2362179326 AuxiliaryValveRampRetractDown 129;
BA_ "DDI" SG_ 2362179326 AuxiliaryValveFloatThreshold 130;
BA_ "DDI" SG_ 2362179326 AuxiliaryValveProgressivExtend 131;
BA_ "DDI" SG_ 2362179326 AuxiliaryValveProgressivRetract 132;
BA_ "DDI" SG_ 2362179326 AuxiliaryValveInvertPorts 133;
BA_ "DDI" SG_ 2362179326 DeviceElementOffsetX 134;
BA_ "DDI" SG_ 2362179326 DeviceElementOffsetY 135;
BA_ "DDI" SG_ 2362179326 DeviceElementOffsetZ 136;
BA_ "DDI" SG_ 2362179326 DeviceVolumeCapacity 137;
BA_ "DDI" SG_ 2362179326 DeviceMassCapacity 138;
BA_ "DDI" SG_ 2362179326 DeviceCountCapacity 139;
BA_ "DDI" SG_ 2362179326 PercentageAppRateSetpoint 140;
BA_ "DDI" SG_ 2362179326 WorkState 141;
BA_ "DDI" SG_ 2362179326 SetpointTimeLatency 142;
BA_ "DDI" SG_ 2362179326 ActualValueTimeLatency 143;
BA_ "DDI" SG_ 2362179326 YawAngle 144;
BA_ "DDI" SG_ 2362179326 RollAngle 145;
BA_ "DDI" SG_ 2362179326 PitchAngle 146;
BA_ "DDI" SG_ 2362179326 LogCount 147;
BA_ "DDI" SG_ 2362179326 TotalFuelConsumption 148;
BA_ "DDI" SG_ 2362179326 FuelConsumptionPerTime 149;
BA_ "DDI" SG_ 2362179326 FuelConsumptionPerArea 150;
BA_ "DDI" SG_ 2362179326 AreaPerTimeCapacity 151;
BA_ "DDI" SG_ 2362179326 MinMassPerAreaAppRate 152;
BA_ "DDI" SG_ 2362179326 NDVI 153;
BA_ "DDI" SG_ 2362179326 PhysicalObjectLength 154;
BA_ "DDI" SG_ 2362179326 PhysicalObjectWidth 155;
BA_ "DDI" SG_ 2362179326 PhysicalObjectHeight 156;
BA_ "DDI" SG_ 2362179326 ConnectorType 157;
BA_ "DDI" SG_ 2362179326 PrescriptionControlState 158;
BA_ "DDI" SG_ 2362179326 NumberOfSubUnitsPerSection 159;
BA_ "DDI" SG_ 2362179326 SectionControlState 160;
BA_ "DDI" SG_ 2362179326 CondensedWorkState1to16 161;
BA_ "DDI" SG_ 2362179326 CondensedWorkState17to32 162;
BA_ "DDI" SG_ 2362179326 CondensedWorkState33to48 163;
BA_ "DDI" SG_ 2362179326 CondensedWorkState49to64 164;
BA_ "DDI" SG_ 2362179326 CondensedWorkState65to80 165;
BA_ "DDI" SG_ 2362179326 CondensedWorkState81to96 166;
BA_ "DDI" SG_ 2362179326 CondensedWorkState97to112 167;
BA_ "DDI" SG_ 2362179326 CondensedWorkState113to128 168;
BA_ "DDI" SG_ 2362179326 CondensedWorkState129to144 169;
BA_ "DDI" SG_ 2362179326 CondensedWorkState145to160 170;
BA_ "DDI" SG_ 2362179326 CondensedWorkState161to176 171;
BA_ "DDI" SG_ 2362179326 CondensedWorkState177to192 172;
BA_ "DDI" SG_ 2362179326 CondensedWorkState193to208 173;
BA_ "DDI" SG_ 2362179326 CondensedWorkState209to224 174;
BA_ "DDI" SG_ 2362179326 CondensedWorkState225to240 175;
BA_ "DDI" SG_ 2362179326 CondensedWorkState241to256 176;
BA_ "DDI" SG_ 2362179326 ActualLengthOfCut 177;
BA_ "DDI" SG_ 2362179326 ElementTypeInstance 178;
BA_ "DDI" SG_ 2362179326 ActualCulturalPractice 179;
BA_ "DDI" SG_ 2362179326 DRP2GroundDistance 180;
BA_ "DDI" SG_ 2362179326 DryMassPerAreaYield 181;
BA_ "DDI" SG_ 2362179326 DryMassPerTimeYield 182;
BA_ "DDI" SG_ 2362179326 YieldTotalDryMass 183;
BA_ "DDI" SG_ 2362179326 RefMoistureForDryMass 184;
BA_ "DDI" SG_ 2362179326 SeedCottonMassPerAreaYield 185;
BA_ "DDI" SG_ 2362179326 LintCottonMassPerAreaYield 186;
BA_ "DDI" SG_ 2362179326 SeedCottonMassPerTimeYield 187;
BA_ "DDI" SG_ 2362179326 LintCottonMassPerTimeYield 188;
BA_ "DDI" SG_ 2362179326 YieldTotalSeedCottonMass 189;
BA_ "DDI" SG_ 2362179326 YieldTotalLintCottonMass 190;
BA_ "DDI" SG_ 2362179326 LintTurnoutPercentage 191;
BA_ "DDI" SG_ 2362179326 AmbientTemperature 192;
BA_ "DDI" SG_ 2362179326 SetpointProductPressure 193;
BA_ "DDI" SG_ 2362179326 ActualProductPressure 194;
BA_ "DDI" SG_ 2362179326 MinimumProductPressure 195;
BA_ "DDI" SG_ 2362179326 MaximumProductPressure 196;
BA_ "DDI" SG_ 2362179326 SetpointPumpOutputPressure 197;
BA_ "DDI" SG_ 2362179326 ActualPumpOutputPressure 198;
BA_ "DDI" SG_ 2362179326 MinimumPumpOutputPressure 199;
BA_ "DDI" SG_ 2362179326 MaximumPumpOutputPressure 200;
BA_ "DDI" SG_ 2362179326 SetpointTankAgitationPressure 201;
BA_ "DDI" SG_ 2362179326 ActualTankAgitationPressure 202;
BA_ "DDI" SG_ 2362179326 MinimumTankAgitationPressure 203;
BA_ "DDI" SG_ 2362179326 MaximumTankAgitationPressure 204;
BA_ "DDI" SG_ 2362179326 SCTurnOnTime_ 205;
BA_ "DDI" SG_ 2362179326 SCTurnOffTime 206;
BA_ "DDI" SG_ 2362179326 WindSpeed 207;
BA_ "DDI" SG_ 2362179326 WindDirection 208;
BA_ "DDI" SG_ 2362179326 AirHumidity 209;
BA_ "DDI" SG_ 2362179326 SkyConditions 210;
BA_ "DDI" SG_ 2362179326 LastBaleFlakesPerBale 211;
BA_ "DDI" SG_ 2362179326 LastBaleAverageMoisture 212;
BA_ "DDI" SG_ 2362179326 LastBaleAverageStrokesPerFlake 213;
BA_ "DDI" SG_ 2362179326 LifetimeBaleCount 214;
BA_ "DDI" SG_ 2362179326 LifetimeWorkingHours 215;
BA_ "DDI" SG_ 2362179326 ActualBaleHydraulicPressure 216;
BA_ "DDI" SG_ 2362179326 LastBaleAverageHydraulicPressure 217;
BA_ "DDI" SG_ 2362179326 SetpointBaleCompressionPlungerLo 218;
BA_ "SystemSignalLongSymbol" SG_ 2362179326 SetpointBaleCompressionPlungerLo "SetpointBaleCompressionPlungerLoad";
BA_ "DDI" SG_ 2362179326 ActualBaleCompressionPlungerLoad 219;
BA_ "DDI" SG_ 2362179326 LastBaleAverageBaleCompressionPl 220;
BA_ "SystemSignalLongSymbol" SG_ 2362179326 LastBaleAverageBaleCompressionPl "LastBaleAverageBaleCompressionPlungerLoad";
BA_ "DDI" SG_ 2362179326 LastBaleAppliedPreservative 221;
BA_ "DDI" SG_ 2362179326 LastBaleTagNumber 222;
BA_ "DDI" SG_ 2362179326 LastBaleMass 223;
BA_ "DDI" SG_ 2362179326 DeltaT 224;
BA_ "DDI" SG_ 2362179326 SetpointWorkingLength 225;
BA_ "DDI" SG_ 2362179326 ActualWorkingLength 226;
BA_ "DDI" SG_ 2362179326 MinimumWorkingLength 227;
BA_ "DDI" SG_ 2362179326 MaximumWorkingLength 228;
BA_ "DDI" SG_ 2362179326 ActualNetWeight 229;
BA_ "DDI" SG_ 2362179326 NetWeightState 230;
BA_ "DDI" SG_ 2362179326 SetpointNetWeight 231;
BA_ "DDI" SG_ 2362179326 ActualGrossWeight 232;
BA_ "DDI" SG_ 2362179326 GrossWeightState 233;
BA_ "DDI" SG_ 2362179326 MinimumGrossWeight 234;
BA_ "DDI" SG_ 2362179326 MaximumGrossWeight 235;
BA_ "DDI" SG_ 2362179326 ThreshingEngagementTotalTime 236;
BA_ "DDI" SG_ 2362179326 ActualHeaderWorkingHeightStatus 237;
BA_ "DDI" SG_ 2362179326 ActualHeaderRotationalSpeedStatu 238;
BA_ "SystemSignalLongSymbol" SG_ 2362179326 ActualHeaderRotationalSpeedStatu "ActualHeaderRotationalSpeedStatus";
BA_ "DDI" SG_ 2362179326 YieldHoldStatus 239;
BA_ "DDI" SG_ 2362179326 ActualUnLoadingSystemStatus 240;
BA_ "DDI" SG_ 2362179326 CropTemperature 241;
BA_ "DDI" SG_ 2362179326 SetpointSieveClearance 242;
BA_ "DDI" SG_ 2362179326 ActualSieveClearance 243;
BA_ "DDI" SG_ 2362179326 MinimumSieveClearance 244;
BA_ "DDI" SG_ 2362179326 MaximumSieveClearance 245;
BA_ "DDI" SG_ 2362179326 SetpointChafferClearance 246;
BA_ "DDI" SG_ 2362179326 ActualChafferClearance 247;
BA_ "DDI" SG_ 2362179326 MinimumChafferClearance 248;
BA_ "DDI" SG_ 2362179326 MaximumChafferClearance 249;
BA_ "DDI" SG_ 2362179326 SetpointConcaveClearance 250;
BA_ "DDI" SG_ 2362179326 ActualConcaveClearance 251;
BA_ "DDI" SG_ 2362179326 MinimumConcaveClearance 252;
BA_ "DDI" SG_ 2362179326 MaximumConcaveClearance 253;
BA_ "DDI" SG_ 2362179326 SetpointSeparationFanRotationalS 254;
BA_ "SystemSignalLongSymbol" SG_ 2362179326 SetpointSeparationFanRotationalS "SetpointSeparationFanRotationalSpeed";
BA_ "DDI" SG_ 2362179326 ActualSeparationFanRotationalSpe 255;
BA_ "SystemSignalLongSymbol" SG_ 2362179326 ActualSeparationFanRotationalSpe "ActualSeparationFanRotationalSpeed";
BA_ "DDI" SG_ 2362179326 MinimumSeparationFanRotationalSp 256;
BA_ "SystemSignalLongSymbol" SG_ 2362179326 MinimumSeparationFanRotationalSp "MinimumSeparationFanRotationalSpeed";
BA_ "DDI" SG_ 2362179326 MaximumSeparationFanRotationalSp 257;
BA_ "SystemSignalLongSymbol" SG_ 2362179326 MaximumSeparationFanRotationalSp "MaximumSeparationFanRotationalSpeed";
BA_ "DDI" SG_ 2362179326 HydraulicOilTemperature 258;
BA_ "DDI" SG_ 2362179326 YieldLagIgnoreTime 259;
BA_ "DDI" SG_ 2362179326 YieldLeadIgnoreTime 260;
BA_ "DDI" SG_ 2362179326 AverageYieldMassPerTime 261;
BA_ "DDI" SG_ 2362179326 AverageCropMoisture 262;
BA_ "DDI" SG_ 2362179326 AverageYieldMassPerArea 263;
BA_ "DDI" SG_ 2362179326 ConnectorPivotXOffset 264;
BA_ "DDI" SG_ 2362179326 RemainingArea 265;
BA_ "DDI" SG_ 2362179326 LifetimeApplicationTotalMass 266;
BA_ "DDI" SG_ 2362179326 LifetimeApplicationTotalCount 267;
BA_ "DDI" SG_ 2362179326 LifetimeYieldTotalVolume 268;
BA_ "DDI" SG_ 2362179326 LifetimeYieldTotalMass 269;
BA_ "DDI" SG_ 2362179326 LifetimeYieldTotalCount 270;
BA_ "DDI" SG_ 2362179326 LifetimeTotalArea 271;
BA_ "DDI" SG_ 2362179326 LifetimeTotalDistance 272;
BA_ "DDI" SG_ 2362179326 LifetimeIneffectiveTotalDistance 273;
BA_ "DDI" SG_ 2362179326 LifetimeEffectiveTotalTime 274;
BA_ "DDI" SG_ 2362179326 LifetimeIneffectiveTotalTime 275;
BA_ "DDI" SG_ 2362179326 LifetimeFuelConsumption 276;
VAL_ 2362179326 GNSSInstallationType 5 "Display integrated antenna" 4 "Second Implement antenna" 3 "First Implement antenna" 2 "Tractor universal antenna (removable)" 1 "Tractor integrated antenna" 0 "Unknown " ;
VAL_ 2362179326 TramlineControlState 3 "undefined/not supported" 2 "error" 1 "automatic/on" 0 "manual/off" ;
VAL_ 2362179326 LastEventPartnerIDDeviceClass 26 "Feeder / Mixer" 25 "Slurry Applicators" 24 "Utility Vehicles" 23 "Mulchers" 22 "Timber Processing Machines" 21 "Timber loaders" 20 "Forwarders" 19 "Timber Harvesters" 17 "Sensor System" 16 "Skidder" 15 "Municipal Work / Earth Work" 14 "Special Crops" 13 "Powered Auxilary Units" 12 "Farmyard Work / Farm Yard Operations" 11 "Transport / Trailers (including Truck Trailers and Trucks)" 10 "Irrigation" 9 "Forage Harvester" 8 "Root Harvester" 7 "Harvesters (= Combine)" 6 "Sprayers" 5 "Fertilizer" 4 "Planters /Seeders" 3 "Secondary Soil Tillage" 2 "Primary Soil Tillage" 1 "Tractor" 0 "Non-specific System" ;
VAL_ 2362179326 LastEventPartnerIdType 1013 "13,56 MHz NFC according ISO 15693" 1012 "2,45 GHz RFID according ISO 18000-4" 1011 "868 MHz RFID according ISO 18000-6" 1010 "433 MHz RFID according ISO 18000-7" 1009 "13,56 MHz NFC according ISO 22536" 1008 "13,56 MHz RFID according ISO 18000-3" 1007 "135 kHz RFID according ISO 18000-2" 1006 "2,4 GHz Google URIBeacon" 1005 "2,4 GHz Radius Networks AltBeacon" 1004 "2,4 GHz Google Eddystone Beacon" 1003 "2,4 GHz Apple iBeacon" 1002 "Manually User Input" 1001 "Manufacturer Proprietary Solution" 1 "ISO 11783 Standardized Identification Device" 0 "Not Available" ;
VAL_ 2362179326 SpeedSource 7 "Machine measured speed" 6 "Machine Selected speed" 5 "Simulated speed" 4 "Blended speed" 3 "Navigation-based speed" 2 "Ground-based speed" 1 "Wheel-based speed" 0 "Unknown" ;
VAL_ 2362179326 IndustryGroup 7 "NotAvailable" 5 "Reserved" 4 "Marine" 3 "Construction" 2 "AgriculturalAndForestry" 1 "OnHighway" 0 "Global" ;
VAL_ 2362179326 VehicleSystem2 0 "Non-specific System" 127 "Not Available" 1 "Tractor" 2 "Tillage" 3 "Secondary Tillage" 4 "Planters/Seeders" 5 "Fertilizers" 6 "Sprayers" 7 "Harvesters" 8 "Root Harvesters" 9 "Forage" 10 "Irrigation" 11 "Transport/Trailer" 12 "Farm Yard Operations" 13 "Powered Auxiliary Device" 14 "Special Crops" 15 "Earth Work" 16 "Skidder" 17 "Sensor Systems" 19 "Timber Harvesters" 20 "Forwarders" 21 "Timber loaders" 22 "Timber Processing Machines" 23 "Mulchers" 24 "Utility Vehicles" 25 "Slurry Applicators" ;
VAL_ 2362179326 Function 43 "Transmission Display" 44 "Exhaust Emission Control" 45 "Vehicle Dynamic Stability Control" 46 "Oil Sensor Unit" 47 "Information System Controller" 48 "Ramp Control" 49 "Clutch/Converter Control" 50 "Auxiliary Heater" 51 "Forward-Looking Collision Warning System" 52 "Chassis Controller" 53 "Alternator/Charging System" 54 "Communications Unit, Cellular" 55 "Communications Unit, Satellite" 56 "Communications Unit, Radio" 57 "Steering Column Unit" 58 "Fan Drive Control" 59 "Starter" 60 "Cab Display" 61 "File Server/Printer" 62 "On-Board Diagnostic Unit" 63 "Engine Valve Controller" 64 "Endurance Braking" 65 "Gas Flow Measurement" 66 "I/O Controller" 67 "Electrical System Controller" 68 "Aftertreatment system gas measurement" 69 "Engine Emission Aftertreatement System" 70 "Auxiliary Regeneration Device" 71 "Transfer Case Control" 72 "Coolant Valve Controller" 73 "Rollover Detection Control" 74 "Lubrication System" 75 "Supplemental Fan" 76 "Temperature Sensor" 77 "Fuel Properties Sensor" 78 "Fire Suppression System" 79 "Power Systems Manager" 80 "Electric Powertrain" 81 "Hydraulic Powertrain" 82 "File Server" 83 "Printer" 84 "Start Aid Device" 85 "Engine Injection Control Module" 86 "Reserved" 87 "Reserved" 88 "Reserved" 89 "Reserved" 90 "Reserved" 91 "Reserved" 92 "Reserved" 93 "Reserved" 94 "Reserved" 95 "Reserved" 96 "Reserved" 97 "Reserved" 98 "Reserved" 99 "Reserved" 100 "Reserved" 0 "Engine" 1 "Auxiliary Power Unit (APU)" 2 "Electric Propulsion Control" 3 "Transmission" 4 "Battery Pack Monitor" 5 "Shift Control/Console" 6 "Power TakeOff - (Main or Rear)" 7 "Axle - Steering" 8 "Axle - Drive" 9 "Brakes - System Controller" 10 "Brakes - Steer Axle" 11 "Brakes - Drive Axle" 12 "Retarder - Engine" 13 "Retarder - Driveline" 14 "Cruise Control" 15 "Fuel System" 16 "Steering Controller" 17 "Suspension - Steer Axle" 18 "Suspension - Drive Axle" 19 "Instrument Cluster" 20 "Trip Recorder" 21 "Cab Climate Control" 22 "Aerodynamic Control" 23 "Vehicle Navigation" 24 "Vehicle Security" 25 "Network Interconnect ECU" 26 "Body Controller" 27 "Power TakeOff (Secondary or Front)" 28 "Off Vehicle Gateway" 29 "Virtual Terminal (in cab)" 30 "Management Computer" 31 "Propulsion Battery Charger" 32 "Headway Controller" 33 "System Monitor" 34 "Hydraulic Pump Controller" 35 "Suspension - System Controller" 36 "Pneumatic - System Controller" 37 "Cab Controller" 38 "Tire Pressure Control" 39 "Ignition Control Module" 40 "Seat Control" 41 "Lighting - Operator Controls" 42 "Water Pump Control" 101 "Reserved" 102 "Reserved" 103 "Reserved" 104 "Reserved" 105 "Reserved" 106 "Reserved" 107 "Reserved" 108 "Reserved" 109 "Reserved" 110 "Reserved" 111 "Reserved" 112 "Reserved" 113 "Reserved" 114 "Reserved" 115 "Reserved" 116 "Reserved" 117 "Reserved" 118 "Reserved" 119 "Reserved" 120 "Reserved" 121 "Reserved" 122 "Reserved" 123 "Reserved" 124 "Reserved" 125 "Reserved" 126 "Reserved" 127 "Reserved" 255 "Not Available" ;
VAL_ 2362179326 ManufacturerCode 1863 "Thomas G. Faria Co." 1862 "Sanshin" 1861 "Vector North America " 1860 "MMP" 1859 "Kvasar AB" 1858 "Litton" 1857 "Simrad" 1856 "Trimble" 1855 "Furuno USA" 1854 "Northstar Technologies" 1853 "Japan Radio Co" 1852 "Navionics" 1851 "RayMarine" 1850 "Teleflex" 786 "Johnson Matthey Battery Systems" 785 "Fischer Panda GmbH" 784 "CM Automotive Systems, Inc." 783 "Loup Electronics Inc." 782 "AVR bvba" 781 "Poly-Planar LLC" 780 "AVID Technology Ltd" 779 "RLC Electronic Systems" 778 "Seakeeper Inc." 777 "Ocean Signal Ltd" 776 "HMI Systems LLC" 775 "ZIEHL-ABEGG Automotive GmbH" 774 "Taisho Corporation" 773 "Clarion Corporation of America" 772 "Blink Marine" 771 "Shaw Development, LLC" 770 "MONOSEM" 769 "Trombetta" 768 "Flores Automation, LLC" 767 "Alliance Wireless Technologies Inc." 766 "Epec Oy" 765 "GIGAVAC" 764 "Bednar FMT s.r.o." 763 "AT-Systems BVBA" 762 "ROJ s.r.l." 761 "MITA OLEODINAMICA S.p.A." 760 "Bernecker + Rainer Industrie Elektronik GmbH" 759 "Hydro-Gear" 758 "Banner Engineering Corp." 757 "IMPCO Technologies" 756 "Maschio Gaspardo S.P.A." 755 "Firefly Integrations" 754 "Parker Hannifin Corp., Automation Group" 753 "AIROD Technologies" 752 "Deep Sea Electronics Plc" 751 "Pacific Track" 750 "Joskin SA" 749 "Chart Inc." 748 "ISOTTA" 747 "Agratronix" 746 "SureFire Ag Systems, Inc." 745 "Cidra Corporate Services Inc." 744 "Woosung Engineering Co., Ltd." 743 "Daemyung Elevator Co., Ltd." 742 "EROAD" 741 "Carling Technologies" 740 "e-Traction" 739 "LXNAV d.o.o." 738 "Blue Ink Technologies" 737 "Balluff GmbH" 736 "Terex Aerial Work Platforms - Genie" 735 "AEM Performance Electronics" 734 "REAPsystems" 733 "Intendia S.L." 732 "Gefran S.p.A." 731 "Modine Manufacturing Company" 730 "BERTHOUD AGRICOLE" 729 "Liebherr" 728 "Streumaster / Panien" 727 "Dhoot Transmission Pvt Ltd." 726 "MIDORI PRECISIONS" 725 "Hitachi Construction Machinery Co., Ltd." 724 "Electronic Applications, Inc." 723 "Jabil Inc." 722 "Contelec AG" 721 "Hypro" 720 "WITZ Corporation" 719 "Cojali S. L." 718 "Micronet Inc" 717 "Yacht Devices Ltd" 716 "Eaton Control & Power Conversion Division (CPCD)" 715 "Autonnic Research Ltd" 714 "Kobashi Kogyo Co., Ltd." 713 "US Hybrid Corporation" 712 "LOR Manufacturing Company Inc." 711 "DAS Co., LTD" 710 "Greentronics Ltd." 709 "Marquardt GmbH" 708 "Lars Thrane A/S" 707 "Rochester Gauges Inc" 706 "Shanghai Diesel Engine Corporation Limited" 705 "SVAB Hydraulik AB" 704 "JL Audio, Inc." 703 "Hydro Tab Marine Engineering" 702 "Weichai Power Co., Ltd." 701 "BigRoad Inc." 700 "K-Tec Earthmovers Inc." 699 "Harman International Industries" 698 "Scorpion Technologies Ltd." 697 "Ålö AB" 696 "DRS Network & Imaging Systems, LLC (DRS Technologies)" 695 "Weldon Technologies" 694 "GasTOPS Ltd." 693 "Agility Fuel Solutions (formerly Agility Fuel Systems)" 692 "Tanhay Corporation" 691 "Digitroll Agricultural Electronics" 690 "LINAK A/S" 689 "Aarcomm Systems Inc" 688 "Rockford Corp" 687 "Flight Systems, Inc." 686 "Taigene Electric Machinery Corp." 685 "ANEDO Ltd." 684 "KEB" 683 "Fosen Elektro" 682 "Eckelmann AG" 681 "BEDIA Motorentechnik GmbH & Co. KG" 680 "AMVAC Chemical Corporation" 679 "Cimco Marine AB" 678 "KeepTruckin, Inc." 677 "DSA Daten- und Systemtechnik GmbH" 676 "Danfoss IXA A/S" 675 "Kawasaki Motors Corp., USA" 674 "Yara International ASA" 673 "Caruelle Nicolas" 672 "OPTIMA Concept" 671 "Innovative Controls Inc." 670 "STEMCO LP" 669 "Quantum Fuel Systems Technologies Worldwide, Inc" 668 "MacDon Industries Ltd." 667 "Bartec" 666 "Schaeffler Technologies AG & Co., KG" 665 "Gebr. Bode GmbH & Co. KG" 664 "Level Developments Ltd" 663 "Delta Systems, Inc" 662 "Kissling Elektrotechnik GmbH" 661 "SPAL Automotive S.r.l." 660 "Auto-Gaz Centrum" 659 "Data Panel Corp." 658 "Shenzhen Jiuzhou Himunication Technology Co., Ltd" 657 "Terzo Power Systems" 656 "PRO SOLUS do Brasil" 655 "Genge & Thoma AG" 654 "Kohler Power Systems, Detroit Engine Development Center (DEDC)" 653 "AEV, spol. s r. o." 652 "MicroControl GmbH & Co. KG" 651 "Takakita Co, Ltd." 650 "Seiko Epson Corp." 649 "Control-Q BV" 648 "OJSC Ekran" 647 "Siloking" 646 "Veenhuis Machines BV" 645 "esd electronic system design gmbh" 644 "KUS USA" 643 "Bogballe A/S" 642 "Moog / Aspen Motion Technologies" 641 "Diverse Yacht Services" 640 "Power Solutions International" 639 "Startec s.r.l." 638 "KVH Industries, Inc." 637 "Bavaria Yachtbau GmbH" 636 "Divelbiss Corporation" 635 "Argo Tractors S.p.A." 634 "Rocky Research" 633 "TORC Robotics" 632 "Pepperl+Fuchs GmbH" 631 "Reltima" 630 "SmartDrive Systems Inc." 629 "Agri Info Design, Ltd." 524 "Vomax Instrumentation Pty. Ltd." 523 "Reggio Emilia Innovazione" 522 "Nebraska Tractor Test Laboratory" 521 "Clever Devices Ltd." 520 "Trapeze" 519 "Peeters Landbouwmachines b.v." 518 "Transas USA Inc." 517 "Noland Engineering" 516 "AVAT Automation GmbH" 515 "GINAF Trucks Nederland B.V." 514 "DISTek Integration, Inc." 513 "FarmscanAg" 512 "Inpower LLC" 511 "Sulky" 510 "Marinesoft Co. Ltd" 509 "MOTORTECH GmbH" 508 "Transtech Innovations" 507 "ISOBUS Test Center" 506 "IHI STAR Machinery Corporation" 505 "Yetter Farm Equipment" 504 "Vesper Marine" 503 "Naviop S.R.L." 502 "Attwood Corporation" 501 "Agrotronix S.A." 500 "Oxbo International Corporation" 499 "LCJ Capteurs" 498 "Innovative Design Solutions, Inc." 497 "SENTRON Sistemas Embarcados" 496 "W. Gessmann GmbH" 495 "HOLMER Maschinenbau GmbH" 494 "Synerject" 493 "Watcheye" 492 "Inergy Automotive Systems" 491 "Penny and Giles Ltd" 490 "QuikQ" 489 "Appareo Systems, LLC" 488 "The Charles Machine Works, Inc." 487 "DSE Test Solutions A/S" 486 "Westport Innovations Inc." 485 "MATT automotive" 484 "Headsight Inc." 483 "Valeo" 482 "Tricon Electronics" 481 "Chetco Digital Instruments" 480 "EnerDel, Inc." 479 "Vapor Bus International" 478 "OceanSat BV" 477 "OilQuick AB" 476 "Hummingbird Marine Electronics" 475 "GME" 474 "Persen Technologies Inc." 473 "Boss Industries, Inc." 472 "Tenneco Inc." 471 "Sea Cross Marine AB" 628 "Falck Schmidt Defence Systems" 627 "Radio Ocean" 626 "AVL DiTEST GmbH" 625 "Global MRV Inc." 624 "Blackbox Machine Control Pty Ltd" 623 "Xirgo Technologies" 622 "Floyd Bell Inc" 621 "Hagie Manufacturing Company" 620 "Sevcon Ltd." 619 "Right Weigh Load Scales" 618 "Evrard SA" 617 "Zero Emission Vehicles" 616 "SMART-TEC s.r.o." 615 "Networkfleet, Verizon Telematics" 614 "ARLT Technologies GmbH" 613 "HKS Co., Ltd." 612 "Samwon IT" 611 "Esterline" 610 "Trail Tech" 609 "Walvoil S.p.A." 608 "Gale Banks Engineering" 607 "Knappco/Civacon" 606 "Intellian Technologies" 605 "Aventics GmbH" 604 "Indexator Rototilt Systems AB" 603 "Kereval" 602 "Nomad Digital Ltd." 601 "Navitas Systems" 600 "Aquatic AV" 599 "Spudnik Equipment Co, LLC" 598 "ABB Turbo Systems Ltd" 597 "Hydac Filter Systems GmbH" 596 "Brunelco Electronic Innovators B.V." 595 "CustomWare" 594 "Kongsberg Automotive" 593 "Sensata Technologies" 592 "tecsis GmbH" 591 "United States Coast Guard" 590 "ARGO-HYTOS GMBH" 589 "MICO, Inc." 588 "Vignal Systems" 587 "JCA Electronics" 586 "Suzuki Motor Corp" 585 "Industrial Electronic Controls" 584 "CarMedialab GmbH" 583 "Yachtcontrol" 582 "Innovative Software Engineering" 581 "Väderstad - Verken AB" 580 "San Jose Technology, Inc." 579 "KVH Industries, Inc." 578 "advanSea" 577 "Denchi Power Ltd  (formerly ABSL Power Solutions Limited)" 576 "Vectia" 575 "Lytx" 574 "Vishay Precision Group" 573 "Orolia Ltd" 572 "Fasse Valves" 571 "Marinecraft Co., Ltd." 570 "frenzel + berg electronic GmbH & Co. KG" 569 "LORD MicroStrain Sensing Systems" 568 "Makersan Ltd. Co." 567 "Lithiumstart LLC" 566 "Geode Technology, Inc." 565 "Micro-Trak Systems, Inc." 564 "Auto Power Electronic" 563 "LOHR Sistemas Eletronicos LTDA" 562 "Bombardier Transportation GmbH" 561 "b-plus GmbH" 560 "Iowa State University, Agricultural and Biosystems Engineering" 559 "Four Peaks Navigation" 558 "Davis Instruments Corp." 557 "Rockson Automation GmbH" 556 "Doosan Infracore Norway" 555 "Sasaki Corporation" 554 "iris-GmbH infrared & intelligent sensors" 553 "KIB Electronics" 552 "Matsuyama Plow Mfg Co, Ltd" 551 "Wexler CSD Ltd." 550 "SUN-A Corporation" 549 "ROAD Deutschland GmbH" 548 "TM4 Inc." 547 "Thomson Linear LLC" 546 "Maruyama Mfg Co, Inc." 545 "GS Hydraulics" 544 "Au Group Electronics" 543 "BAUER Maschinen GmbH" 542 "Dinamica Generale s.p.a." 541 "Total Fire Systems, Inc." 540 "Dinex A/S" 539 "Mobileview" 538 "Crop Ventures, Inc." 537 "Schrader Electronics Ltd." 536 "SSI Technologies" 535 "MOTORPAL, a.s." 534 "Webasto Thermo & Comfort SE" 533 "Doran Manufacturing, LLC" 532 "Onwa Marine Electronics Co Ltd." 531 "Genge & Thoma AG" 530 "NMEA" 529 "National Instruments Korea" 528 "Hoganas AB, Electric Drive Systems" 527 "GKN Walterscheid GmbH" 526 "LOFA Industries, Inc" 525 "Rust Sales INC" 470 "SI-TEX Marine Electronics" 469 "RA Consulting GmbH" 468 "Tyco Fire Protection Products" 467 "Lely Industries N.V." 466 "Veethree Electronics and Marine LLC" 465 "Ashcroft Inc" 464 "Leach International Corporation" 463 "PROBOTIQ" 462 "IHI Shibaura Machinery Corporation" 461 "HAWE Hydraulik SE" 460 "San Giorgio S.E.I.N." 459 "Alltek Marine Electronics Corp" 458 "Control Solutions, Inc." 457 "RUSELPROM-ElectricDrive Ltd" 456 "General Kinetics" 455 "ADZ NAGANO GmbH" 454 "NGK Spark Plug Co. Ltd" 453 "Cooper Bussmann" 452 "WIKA Alexander Wiegand SE & Co. KG" 451 "Parker Hannifin Corp" 450 "Dycor Technologies Ltd." 449 "Polaris Industries Inc" 448 "Stanadyne Corporation, Electronics Systems" 447 "Great Plains Mfg." 446 "CertTech, L.L.C." 445 "KAT MECHATRONIC, Electronic Product Division" 444 "ITT Power Solutions" 443 "SignalQuest, Inc." 442 "Horsch Maschinen GmbH" 441 "PTG Reifendruckregelsysteme GmbH" 440 "Cummins Power Generation" 439 "Hyundai Heavy Industries" 438 "Comar Systems Ltd" 437 "Digital Yacht Limited" 436 "Kinze Manufacturing" 435 "Zunhammer GmbH" 434 "Stored Energy Systems" 433 "Rowe Electronics" 432 "S&A Systems, Inc." 431 "Tohatsu Corporation" 430 "Auteq Telematica S.A." 429 "Rota Engineering Ltd." 425 "Methode Electronics Inc, MDI" 424 "Odyne LLC" 423 "BSM Wireless, Inc." 422 "True Heading AB" 421 "Vertex Standard Co, Ltd" 420 "Vermeer Corporation, ACS Group" 419 "Fusion Electronics Ltd" 418 "Intellistick Inc" 417 "KZValve" 416 "Kubota Corporation" 415 "Valid Manufacturing Ltd." 414 "Cattron Group International" 413 "Datapross Nijbroek bv" 412 "WebTech Wireless Inc." 411 "Hy-Drive Technologies Ltd." 410 "COBO S.p.A. Divisione 3B6" 409 "Transfluid S.r.L." 408 "Corvus Energy Ltd." 407 "Comtech Mobile Datacom" 406 "Vecima Networks Inc." 405 "Wema System AS" 404 "Com Nav Marine Ltd" 403 "Trackwell ADS, Inc." 402 "Simma Software, Inc." 401 "Torqeedo GmbH" 400 "Livorsi Marine" 399 "ISEKI & Co., Ltd." 398 "Hilite International" 397 "Sanyo-kiki Co Ltd." 396 "Beyond Measure" 395 "GENTEC S.R.L." 394 "Capi 2 Nederland BV" 393 "Harvest Tec, Inc" 392 "Tianyuan Technology Co Ltd." 391 "Electronic Design for Industry, Inc" 390 "Partech Inc." 389 "Benchmark Electronics, Minnesota Division" 388 "Innomatix, LLC" 387 "Orscheln Products, LLC" 386 "JLG Automation BVBA" 385 "Johnson Outdoor Marine Electronics" 384 "Camano Light" 383 "MCL Industries" 382 "National Agriculture and Food Research Organization" 381 "B & G" 380 "Suntech International Ltd." 379 "Yamabiko Corporation" 378 "Glendinning Marine Products" 377 "ifm electronic gmbh" 376 "Quake Global" 375 "Williams Controls Inc." 374 "Northern Lights, Inc." 373 "Electronic Design Inc." 372 "Delphi" 371 "Heinzmann GmbH & Co. KG" 370 "Rolls-Royce Marine AS" 369 "Power Torque Engineering Ltd" 368 "HANSENHOF_electronic" 367 "Fliegl Agrartechnik" 366 "Viewnyx Corp." 365 "Digi-Star, LLC" 364 "OEM Controls Inc." 363 "BEI Duncan" 362 "Poettinger Landtechnik GmbH (formerly Alois Poettinger Maschinenfabrik GmbH)" 361 "InMach" 360 "HJS Emission Technology GmbH & Co KG   (formerly HJS Fahrzeugtechnik GmbH & Co KG)" 359 "Ludwig Bergmann GmbH" 358 "Victron Energy BV" 357 "Hardi International A/S" 356 "Fischer Panda Generators, Inc" 355 "Mastervolt International B.V." 354 "Junkkari OY" 353 "Hegemon Electronics, Inc." 352 "SAME DEUTZ-FAHR GROUP S.p.A." 351 "Thrane & Thrane" 350 "Noris Marine Systems GmbH & Co KG" 349 "Suonentieto" 348 "Amazonen Werke H. Dreyer" 347 "Honeywell" 346 "Control Solutions" 345 "Korean Maritime University" 344 "Parvus Corporation" 343 "Baumer Group" 342 "THOMAS MAGNETE GmbH" 341 "Boning GmbH & Co" 340 "Continental AG" 339 "Competence Center ISOBUS e.V." 338 "GRAF-SYTECO" 337 "Carraro S.p.A." 336 "APE s.r.o." 335 "Evo Electric Ltd" 334 "Takata-Petri AG" 333 "Hadley Products Corporation" 332 "HWH Corporation" 331 "Horton, Inc." 330 "Kidde Aerospace and Defense" 329 "Deif A/S" 328 "Qwerty Electronik AB" 327 "Sonceboz SA" 326 "Akron Brass Company" 325 "ASM Automation Sensorik Messtechnik GmbH" 324 "Snap-on Diagnostics" 323 "Mobileye Vision Technologies Ltd." 322 "MICHENKA s.r.o." 321 "Ultra Electronics, Electrics" 320 "Miedema Landbouwwerktuigenfabriek B.V." 319 "Cadec Global" 318 "SAT Plan" 317 "Navtronics Bvba" 263 "IMMI" 262 "HydraForce, Inc" 261 "Red Dot Corporation" 260 "Reichhardt GmbH Steuerungstechnik" 259 "Jetter AG" 258 "ARAG" 257 "Honda Motor Co., Ltd" 256 "Tyco Electronics AMP" 255 "MEAS France" 254 "GE Sensing" 253 "Mobile Control Systems" 252 "Sensor-Technik Wiedemann GmbH" 251 "German Agricultural Society, Test Center (DLG)" 250 "Kuhn Group" 249 "Schaltbau GmbH" 248 "Cooper Standard Automotive Active Systems Group" 247 "ePULSE" 246 "Class 1, Inc" 245 "Capstan Ag Systems, Inc." 244 "Techno-Matic" 243 "eRide, Inc." 242 "Kokusandenki Co. Ltd" 241 "Schneider Automation SAS" 240 "Vanair Mfg" 239 "May & Scofield Ltd" 238 "ZF Friedrichshafen AG" 237 "Agtron Enterprises Inc" 236 "NORAC Systems International Inc" 235 "SailorMade Marine Telemetry - Tetra Technology Ltd." 234 "Mondial electronic GmbH" 233 "Yacht Monitoring Solutions Inc." 232 "TSD Integrated Controls" 231 "Topcon Positioning Systems, Inc." 230 "Saucon Technologies" 229 "Garmin International Inc." 228 "Unused (formerly ZF Marine Electronics)" 227 "Lykketronic A/S" 226 "Monaco Coach Corporation" 225 "SKF" 224 "EMMI Network, S.L." 223 "Vaueo Retarder Co., Ltd." 222 "Generac Power Systems, Inc." 221 "SiE" 220 "Beede Electrical Instrument Company, Inc" 219 "Cat OEM Solutions" 218 "Gits Manufacturing Company" 217 "RM Michaelides Software & Elektronik GmbH" 216 "Paneltronics Inc." 215 "Aetna Engineering/Fireboy-Xintex" 214 "MC elettronica Srl" 164 "MTU Friedrichshafen GmbH (formerly DaimlerChrysler Off-Highway)" 163 "BRP Inc." 162 "Axiomatic Technologies" 161 "Offshore Systems (UK) Ltd" 160 "Nido" 159 "NTech Industries Inc" 158 "Firestone Industrial Products Company" 157 "ISSPRO Inc." 156 "ITT Industries - Cannon" 155 "Vetronix Corporation" 154 "Westerbeke Corporation" 153 "Woodward, Industrial Controls Division" 152 "elobau GmbH & Co. KG" 151 "Raven Industries, Inc." 150 "Fleetguard" 149 "Holset" 148 "Blue Water Data, Inc." 147 "Nautibus electronic GmbH" 146 "Maxima Technologies" 145 "MurCal Controls" 144 "Mercury Marine" 143 "W. Gmeiner GmbH & Co." 142 "TRW Automotive (Commercial Steering Systems)" 141 "Thales Navigation Ltd." 140 "Lowrance Electronics, Inc." 139 "Caterpillar Trimble Control Technologies (CTCT), LLC" 138 "Georg Fritzmeier GmbH & Co. KG" 137 "Maretron" 136 "Komatsu Ltd" 135 "Airmar Technology Corporation" 134 "Iris Technology Ltd" 133 "Bucher Schoerling GmbH" 132 "Mulag-Fahrzeugwerk" 131 "ITT Industries" 130 "Nido - Universal Machines B.V." 129 "OMNEX Control Systems Inc." 128 "Gerhard Duecker GmbH & Co. KG" 127 "Holland USA" 126 "Driver Tech" 125 "Nevada Automotive Test Center" 124 "Hydac Electronic" 123 "Basler Electric" 122 "FG Wilson (Engineering) Limited" 121 "HED (Hydro Electronic Devices, Inc.)" 120 "RDS Technology Ltd" 119 "IntegriNautics  " 118 "Intron GmbH" 117 "HUSCO International" 116 "BEELINE Technologies" 115 "NACCO Materials Handling Group, Inc." 114 "EControls, Inc." 113 "Stress-Tek, Inc." 112 "MECALAC" 111 "Maschinenfabrik Bernard Krone GmbH" 110 "EPIQ Sensor-Nite" 109 "TeeJet Technologies Denmark (formerly LH Technologies ApS)" 108 "WTK-Elecktronik GmbH" 107 "Grimme Landmaschinen GmbH & Co. KG" 106 "BAE Systems Controls, Inc." 105 "Kiepe Elektrik GmbH & Co. KG" 104 "CLAAS KGaA mbH (formerly CLAAS Selbstfahrende Erntemaschinen GmbH)" 103 "CLAAS E-Systems KGaA mbH & Co. KG (formerly CLAAS Agrosystems GmbH & Co. KG)" 102 "AGCO (formerly AGCO GmbH & Co.)" 101 "Sensoria" 100 "VDO Technik AG" 99 "International Transmissions Ltd (ITL)" 98 "Mueller-Elektronik GmbH & Co" 97 "Ag Leader Technology, Inc." 96 "Mech@tronic IT GmbH" 95 "Pacific Insight Electronics Corp." 94 "CNH Industrial N.V. (formerly CNH Global N.V.)" 93 "Perkins Engines Company Ltd." 92 "Ag-Chem Equipment Co., Inc." 91 "BSG Bodensee Steuergeraete GmbH" 90 "Knorr-Bremse SfN GmbH" 89 "Kverneland Group, Electronics Division" 88 "Satloc Precision GPS" 87 "J.C. Bamford Excavators Ltd (JCB)" 86 "C. E. Niehoff & Company" 85 "Kohler Co" 84 "New Holland UK Limited" 83 "Bendix VORAD Technologies (formerly Eaton VORAD Technologies)" 82 "Bobcat/Ingersoll-Rand (formerly Melroe/Ingersoll-Rand)" 81 "Fire Research Corp." 80 "Twin Disc, Inc." 79 "Daimler Benz AG - Engine Division (PBM)" 78 "Frank W. Murphy Manufacturing, Inc" 77 "Deere Power Systems Group" 76 "unused (formerly Deere & Co, Construction Division)" 75 "Deere & Co, Agricultural Division" 74 "Eaton Axle-Brake Division" 73 "LeTourneau, Inc." 72 "Sisu Corporation" 71 "Vansco Electronics Ltd." 70 "Flex-coil Limited" 69 "Trimble Navigation" 316 "ITT Flow Control" 315 "Icom Incorporated" 314 "CSM GmbH" 313 "Ilmor Engineering, Inc." 312 "Lectronix, Inc." 311 "Patrick Power Products" 310 "TECNORD srl" 309 "Krauss-Maffei Wegmann GmbH & Co. KG" 308 "Cyntrx" 307 "MAS Technologies" 306 "Sleipner Motor AB" 305 "NovAtel Inc" 304 "EmpirBus AB" 303 "CTS Corporation" 302 "Nissin Kogyo Co., LTD" 301 "Parker Hannifin (UK) Ltd FDE group" 300 "Systron Donner Automotive" 299 "Rauch" 298 "Holley Performance" 297 "Zonar Systems Inc" 296 "micro dynamics GmbH" 295 "BEP Marine" 294 "Grayhill Inc." 293 "Spyder Controls Corp." 292 "IKUSI - Angel Iglesias S.A." 291 "Groeneveld Transport Efficiency BV" 290 "Kuebler GmbH" 289 "Watlow" 288 "Mitsubishi FUSO Truck & Bus Corp." 287 "NTech Industries, Inc" 286 "Coelmo srl" 285 "Sea Recovery Corp" 284 "Mobile Tech Chile" 283 "CWF Hamilton & Co Ltd" 282 "Medallion Instrumentation Systems" 281 "Precision Governors LLC" 280 "Leica Geosystems Pty Ltd" 279 "Geometris LP" 278 "Takata Electronics" 277 "LHP Telematics" 276 "Aqua-Hot Heating Systems" 275 "Navico Egersund AS" 274 "LTW Technology Co., LTD" 273 "Active Research Limited" 272 "Gross Mechanical Laboratories, Inc" 271 "Cole Hersee" 270 "Tennant" 269 "Saft America Inc.,  Space & Defense Division" 268 "Accurate Technologies" 267 "Red Lion Controls, Inc" 266 "International Thermal Research Ltd" 265 "MTS Sensor Technologie GmbH" 264 "Autolync" 213 "CNH Belgium N.V." 212 "Sure Power Industries, Inc" 211 "DNA Group" 210 "Iteris, Inc." 209 "Bell Equip. Co. SA (PTY) LTD" 208 "Drew Technologies, Inc" 207 "Otto Engineering" 206 "port GmbH" 205 "SmarTire Systems Inc" 204 "The Morey Corporation" 203 "MILtronik GmbH" 202 "Curtis Instruments, Inc" 201 "Disenos y Tecnologia S.A." 200 "MGM Brakes" 199 "Actia Corp" 198 "Mystic Valley Communications" 197 "Mechron Power Systems" 196 "LEMKEN GmbH & Co KG" 195 "General Engine Products" 194 "TriMark Corporation" 193 "Jeppesen Marine" 192 "Floscan" 191 "XRS Corporation (formerly XATA Corporation)" 190 "Hella KGaA Hueck & Co" 189 "QUALCOMM" 188 "EMP Corp" 187 "Air-Weigh" 186 "Altronic, Inc" 185 "Beede Electrical Instrument Company" 184 "EIA Electronics" 183 "KDS Controls, Inc" 182 "Vehicle Systems Engineering B.V." 181 "Coretronics, Inc." 180 "Smart Power Systems" 179 "TeeJet Technologies Springfield (formerly Midwest Technologies Illinois, LLC)" 178 "Continental Automotive GmbH (formerly Siemens VDO Automotive AG)" 177 "Diagnostic Systems Associates" 176 "Moritz Aerospace" 175 "Veris Technologies, Inc." 174 "AB Volvo Penta" 173 "Ryeso, Inc." 172 "Yanmar Co., Ltd. (formerly Yanmar Marine USA)" 171 "Wachendorff Elektronik GmbH & Co. KG" 170 "Computronics Corporation Ltd." 169 "Marlin Technologies Inc." 168 "Xantrex" 167 "JLG Industries Inc" 166 "John Deere Electronic Solutions (formerly Phoenix International)" 165 "CPAC Systems AB" 68 "Scania" 67 "John Deere Coffeyville Works (formerly Funk Manufacturing Company)" 66 "John Deere Construction Equipment Division" 65 "MAN Nutzfahrzeuge AG" 64 "Unused (formerly SpectraPrecision Laserplane, then SpectraPhysics)" 63 "ZF Industries Inc." 62 "Wabco" 61 "Volvo Truck Corp." 60 "Volvo Trucks North America Inc." 59 "VES Inc." 58 "SPX Corporation, OTC Div" 57 "Danfoss  (formerly Sauer Sundstrand Co, then Sauer-Danfoss Co)" 56 "SAIC" 55 "Ryder System Inc." 54 "Meritor Wabco" 53 "Continental Automotive Systems US, Inc. (formerly Rockwell Land Transportation)" 52 "Meritor Automotive, Inc. (formerly Rockwell Automotive)" 51 "Robert Bosch GmbH" 50 "Robert Bosch Corp" 49 "RE America Inc." 48 "Pollak Alphabet" 47 "Phillips Semiconductor" 46 "Noregon Systems, Inc  (formerly Parasoft Computing Solutions)" 45 "PACCAR" 44 "Nippondenso Co. Ltd." 43 "International Truck and Engine Corporation - Vehicle Electronics (formerly Navistar Intl Trans Corp.)" 42 "International Truck and Engine Corporation - Engine Electronics  (formerly Navistar Intl Trans Co., Engine Electronics)" 41 "Motorola Inc." 40 "Motorola AIEG Inc." 39 "Microfirm Inc." 38 "Micro Processor Systems Inc." 37 "Mack Trucks Inc." 36 "Lucas Ind." 35 "Kenworth Truck Co." 34 "Kelsey Hayes Co." 33 "John Deere" 32 "Jacobs Vehicle Systems" 31 "J Pollak Corp" 30 "Isuzu Motors Ltd" 29 "Hino Motors Ltd." 28 "Grote Ind. Inc." 27 "GMC" 26 "General Motors Corp, Service Technology Grp" 25 "Daimler Trucks North America LLC (formerly Freightliner LLC)" 24 "Ford Motor Co., Vehicle Controls" 23 "Ford Motor Co., Heavy Truck" 22 "Ford Motor Co., Electronic Concepts & Systems" 21 "Echlin Inc., Midland Brake Inc." 20 "Eaton Ltd" 19 "Eaton Corp. Trucking Info Services" 18 "Eaton Corp, Transmission Div." 17 "Eaton Corp, Corp Res & Dev" 16 "Eaton Corp" 15 "DICKEY-john Corporation" 14 "Detroit Diesel Corporation" 13 "Delco Electronics" 12 "Deere & Company, Precision Farming" 11 "Dearborn Group Inc." 10 "Cummins Inc (formerly Cummins Engine Co)" 9 "Chrysler Corp." 8 "Caterpillar Inc." 7 "Case Corp." 6 "Berifors Electronics AB" 5 "AMP Inc." 4 "Ametek-Dixson" 3 "Ametek, US Gauge Division" 2 "Allison Transmission, Inc." 1 "Bendix Commercial Vehicle Systems LLC (formerly Allied Signal Inc.)" 0 "Reserved" ;
VAL_ 2362179326 TemperatureUnits 3 "NoAction" 2 "Reserved" 1 "Imperial" 0 "Metric" ;
VAL_ 2362179326 PressureUnits 3 "NoAction" 2 "Reserved" 1 "Imperial" 0 "Metric" ;
VAL_ 2362179326 ErrorCodeObjPool4 0 "NoError" 1 "ObjectPoolWasDeleted" ;
VAL_ 2362179326 ErrorCodeObjPool3 0 "NoError" 1 "GeneralError" ;
VAL_ 2362179326 ForceUnits 3 "NoAction" 2 "Reserved" 1 "Imperial" 0 "Metric" ;
VAL_ 2362179326 ErrorCodeObjPool2 0 "NoError" 1 "UnknownObjectReference" ;
VAL_ 2362179326 UnitsSystem 3 "NoAction" 2 "US" 1 "Imperial" 0 "Metric" ;
VAL_ 2362179326 ErrorCodeObjPool1 0 "NoError" 1 "MethodOrAttributeNotSupported" ;
VAL_ 2362179326 DistanceUnitCmd 3 "NoAction" 1 "Imperial" 0 "Metric" ;
VAL_ 2362179326 AreaUnitCmd 3 "NoAction" 1 "Imperial" 0 "Metric" ;
VAL_ 2362179326 VolumeUnitCmd 3 "NoAction" 2 "US" 1 "Imperial" 0 "Metric" ;
VAL_ 2362179326 MassUnitCmd 3 "NoAction" 2 "TonsPounds" 1 "Imperial" 0 "Metric" ;
VAL_ 2362179326 OriginCommand 15 "NotApplicable" 14 "TaskControllerStatus" 13 "PDACK" 8 "ChangeThreshold" 7 "MaxWithinThreshold" 6 "MinWithinThreshold" 5 "DistanceInterval" 4 "TimeInterval" 3 "ValueCommand" 2 "RequestValue" 1 "DeviceDescription" 0 "TechnicalData" 9 "PeerControlAssignment" 10 "SetValueAndAcknowledge" ;
VAL_ 2362179326 ErrorCodeProcessData8 1 "ProcessDataValueIsOutsideOperationalRange " 0 "NoError" ;
VAL_ 2362179326 ErrorCodeProcessData7 1 "ProcessDataValueNotConformToDDI " 0 "NoError" ;
VAL_ 2362179326 ErrorCodeProcessData6 1 "InvalidIntervalOrThreshold" 0 "NoError" ;
VAL_ 2362179326 ErrorCodeProcessData5 1 "ProcessDataNotSetable" 0 "NoError" ;
VAL_ 2362179326 ErrorCodeProcessData4 1 "TriggerMethodNotSupported" 0 "NoError" ;
VAL_ 2362179326 ErrorCodeProcessData3 1 "DDINotSupportedByElement" 0 "NoError" ;
VAL_ 2362179326 ErrorCodeProcessData2 1 "InvalidElementNumber" 0 "NoError" ;
VAL_ 2362179326 DataLogTimeInterval 0 "Stop measurement" ;
VAL_ 2362179326 DataLogDistanceInterval 0 "Stop measurement" ;
SG_MUL_VAL_ 2362179326 ActualCanopyHeight DDI 520-520;
SG_MUL_VAL_ 2362179326 GNSSInstallationType DDI 521-521;
SG_MUL_VAL_ 2362179326 LastBaleLifetimeCount DDI 519-519;
SG_MUL_VAL_ 2362179326 ActualTramlineCondensedWorkState DDI 518-518;
SG_MUL_VAL_ 2362179326 SetpointTramlineCondensedWorkSta DDI 517-517;
SG_MUL_VAL_ 2362179326 TramlineOverdosingRate DDI 516-516;
SG_MUL_VAL_ 2362179326 TramlineControlState DDI 515-515;
SG_MUL_VAL_ 2362179326 GNSSQuality DDI 514-514;
SG_MUL_VAL_ 2362179326 GuidanceLineDeviation DDI 513-513;
SG_MUL_VAL_ 2362179326 GuidanceLineSwathWidth DDI 512-512;
SG_MUL_VAL_ 2362179326 TrackNumberToLeft DDI 511-511;
SG_MUL_VAL_ 2362179326 TrackNumberToRight DDI 510-510;
SG_MUL_VAL_ 2362179326 ActualTrackNumber DDI 509-509;
SG_MUL_VAL_ 2362179326 UniqueABGuidanceReferenceLineID DDI 508-508;
SG_MUL_VAL_ 2362179326 TramlineSequenceNumber DDI 507-507;
SG_MUL_VAL_ 2362179326 SetpointTramlineControlLevel DDI 506-506;
SG_MUL_VAL_ 2362179326 TramlineControlLevel DDI 505-505;
SG_MUL_VAL_ 2362179326 MaxEngineTorque DDI 504-504;
SG_MUL_VAL_ 2362179326 MinEngineTorque DDI 503-503;
SG_MUL_VAL_ 2362179326 ActualEngineTorque DDI 502-502;
SG_MUL_VAL_ 2362179326 SetpointEngineTorque DDI 501-501;
SG_MUL_VAL_ 2362179326 LastEventPartnerIDDeviceClass DDI 500-500;
SG_MUL_VAL_ 2362179326 LastEventPartnerIDManufacturerID DDI 499-499;
SG_MUL_VAL_ 2362179326 LastEventPartnerIdType DDI 498-498;
SG_MUL_VAL_ 2362179326 LastEventPartnerID_Byte13to16 DDI 497-497;
SG_MUL_VAL_ 2362179326 LastEventPartnerID_Byte9to12 DDI 496-496;
SG_MUL_VAL_ 2362179326 LastEventPartnerID_Byte5to8 DDI 495-495;
SG_MUL_VAL_ 2362179326 LastEventPartnerID_Byte1to4 DDI 494-494;
SG_MUL_VAL_ 2362179326 LifetimeEngineHours DDI 493-493;
SG_MUL_VAL_ 2362179326 TotalEngineHours DDI 492-492;
SG_MUL_VAL_ 2362179326 FuelPercentageLevel DDI 491-491;
SG_MUL_VAL_ 2362179326 MaxFuelTankContent DDI 490-490;
SG_MUL_VAL_ 2362179326 MaxDieselExhaustFluidTankContent DDI 489-489;
SG_MUL_VAL_ 2362179326 DieselExhaustFluidTankPercentage DDI 488-488;
SG_MUL_VAL_ 2362179326 MaxEngineSpeed DDI 486-486;
SG_MUL_VAL_ 2362179326 MinEngineSpeed DDI 485-485;
SG_MUL_VAL_ 2362179326 ActualEngineSpeed DDI 484-484;
SG_MUL_VAL_ 2362179326 SetpointEngineSpeed DDI 483-483;
SG_MUL_VAL_ 2362179326 LastBaleNumberOfSubbales DDI 482-482;
SG_MUL_VAL_ 2362179326 SetpointNumberOfSubbales DDI 481-481;
SG_MUL_VAL_ 2362179326 MaxFlakeSize DDI 480-480;
SG_MUL_VAL_ 2362179326 MinFlakeSize DDI 479-479;
SG_MUL_VAL_ 2362179326 SetpointFlakeSize DDI 478-478;
SG_MUL_VAL_ 2362179326 MaxBaleHydraulicPressure DDI 477-477;
SG_MUL_VAL_ 2362179326 MinBaleHydraulicPressure DDI 476-476;
SG_MUL_VAL_ 2362179326 SetpointBaleHydraulicPressure DDI 475-475;
SG_MUL_VAL_ 2362179326 MaxLengthOfCut DDI 474-474;
SG_MUL_VAL_ 2362179326 MinLengthOfCut DDI 473-473;
SG_MUL_VAL_ 2362179326 SetpointLengthOfCut DDI 472-472;
SG_MUL_VAL_ 2362179326 ActualPercentageContent DDI 467-467;
SG_MUL_VAL_ 2362179326 ActualRelativeConnectorAngle DDI 466-466;
SG_MUL_VAL_ 2362179326 LifetimeHaulCounter DDI 465-465;
SG_MUL_VAL_ 2362179326 HaulCounter DDI 464-464;
SG_MUL_VAL_ 2362179326 LastUnloadedCount DDI 463-463;
SG_MUL_VAL_ 2362179326 LastLoadedCount DDI 462-462;
SG_MUL_VAL_ 2362179326 LifetimeUnloadedTotalCount DDI 461-461;
SG_MUL_VAL_ 2362179326 LifetimeLoadedTotalCount DDI 460-460;
SG_MUL_VAL_ 2362179326 UnloadedTotalCount DDI 459-459;
SG_MUL_VAL_ 2362179326 LoadedTotalCount DDI 458-458;
SG_MUL_VAL_ 2362179326 LastUnloadedVolume DDI 457-457;
SG_MUL_VAL_ 2362179326 LastLoadedVolume DDI 456-456;
SG_MUL_VAL_ 2362179326 LifetimeUnloadedTotalVolume DDI 455-455;
SG_MUL_VAL_ 2362179326 LifetimeLoadedTotalVolume DDI 454-454;
SG_MUL_VAL_ 2362179326 UnloadedTotalVolume DDI 453-453;
SG_MUL_VAL_ 2362179326 LoadedTotalVolume DDI 452-452;
SG_MUL_VAL_ 2362179326 MaxAppRateOfDryMatter DDI 451-451;
SG_MUL_VAL_ 2362179326 MinAppRateOfDryMatter DDI 450-450;
SG_MUL_VAL_ 2362179326 ActualAppRateOfDryMatter DDI 449-449;
SG_MUL_VAL_ 2362179326 SetpointAppRateOfDryMatter DDI 448-448;
SG_MUL_VAL_ 2362179326 MaxAppRateOfPotassium DDI 447-447;
SG_MUL_VAL_ 2362179326 MinAppRateOfPotassium DDI 446-446;
SG_MUL_VAL_ 2362179326 ActualAppRateOfPotassium DDI 445-445;
SG_MUL_VAL_ 2362179326 SetpointAppRateOfPotassium DDI 444-444;
SG_MUL_VAL_ 2362179326 MaxAppRateOfPhosphor DDI 443-443;
SG_MUL_VAL_ 2362179326 MinAppRateOfPhosphor DDI 442-442;
SG_MUL_VAL_ 2362179326 ActualAppRateOfPhosphor DDI 441-441;
SG_MUL_VAL_ 2362179326 SetpointAppRateOfPhosphor DDI 440-440;
SG_MUL_VAL_ 2362179326 MaxAppRateOfAmmonium DDI 439-439;
SG_MUL_VAL_ 2362179326 MinAppRateOfAmmonium DDI 438-438;
SG_MUL_VAL_ 2362179326 ActualAppRateOfAmmonium DDI 437-437;
SG_MUL_VAL_ 2362179326 SetpointAppRateOfAmmonium DDI 436-436;
SG_MUL_VAL_ 2362179326 MaxAppRateOfNitrogen DDI 435-435;
SG_MUL_VAL_ 2362179326 MinAppRateOfNitrogen DDI 434-434;
SG_MUL_VAL_ 2362179326 ActualAppRateOfNitrogen DDI 433-433;
SG_MUL_VAL_ 2362179326 SetpointAppRateOfNitrogen DDI 432-432;
SG_MUL_VAL_ 2362179326 LifetimeUnloadedTotalMass DDI 431-431;
SG_MUL_VAL_ 2362179326 LifetimeLoadedTotalMass DDI 430-430;
SG_MUL_VAL_ 2362179326 UnloadedTotalMass DDI 429-429;
SG_MUL_VAL_ 2362179326 LoadedTotalMass DDI 428-428;
SG_MUL_VAL_ 2362179326 ActualDownforceAsForce DDI 427-427;
SG_MUL_VAL_ 2362179326 SetpointDownforceAsForce DDI 426-426;
SG_MUL_VAL_ 2362179326 SetpointMaxAllowedSeedSpacingDev DDI 425-425;
SG_MUL_VAL_ 2362179326 AvgCoeffOfVariationOfSeedSpacing DDI 424-424;
SG_MUL_VAL_ 2362179326 ActCoeffOfVariationOfSeedSpacing DDI 423-423;
SG_MUL_VAL_ 2362179326 AverageSeedSpacingDeviation_Copy DDI 422-422;
SG_MUL_VAL_ 2362179326 ActualSeedSpacingDeviation DDI 421-421;
SG_MUL_VAL_ 2362179326 AverageSeedMultiplePercentage DDI 420-420;
SG_MUL_VAL_ 2362179326 ActualSeedMultiplePercentage DDI 419-419;
SG_MUL_VAL_ 2362179326 AverageSeedSkipPercentage DDI 418-418;
SG_MUL_VAL_ 2362179326 ActualSeedSkipPercentage DDI 417-417;
SG_MUL_VAL_ 2362179326 AverageSeedSingulationPercentage DDI 416-416;
SG_MUL_VAL_ 2362179326 ActualSeedSingulationPercentage DDI 415-415;
SG_MUL_VAL_ 2362179326 LifetimeAvgDieselExhFluidConsump DDI 414-414;
SG_MUL_VAL_ 2362179326 LifetimeAvgDieselExhFluidCo_0000 DDI 413-413;
SG_MUL_VAL_ 2362179326 LifetimeDieselExhaustFluidConsum DDI 412-412;
SG_MUL_VAL_ 2362179326 InstantDieselExhaustFluidConsump DDI 411-411;
SG_MUL_VAL_ 2362179326 InstantDieselExhaustFluidCo_0000 DDI 410-410;
SG_MUL_VAL_ 2362179326 TotalDieselExhaustFluidConsumpti DDI 409-409;
SG_MUL_VAL_ 2362179326 AverageCropContamination DDI 408-408;
SG_MUL_VAL_ 2362179326 AverageProteinContent DDI 407-407;
SG_MUL_VAL_ 2362179326 ActualProteinContent DDI 406-406;
SG_MUL_VAL_ 2362179326 ActualApplicationOfDryMatter DDI 405-405;
SG_MUL_VAL_ 2362179326 ActualApplicationOfPotassium DDI 404-404;
SG_MUL_VAL_ 2362179326 ActualApplicationOfPhosphor DDI 403-403;
SG_MUL_VAL_ 2362179326 ActualApplicationOfAmmonium DDI 402-402;
SG_MUL_VAL_ 2362179326 ActualApplicationOfNitrogen DDI 401-401;
SG_MUL_VAL_ 2362179326 SpeedSource DDI 400-400;
SG_MUL_VAL_ 2362179326 MaximumSpeed DDI 399-399;
SG_MUL_VAL_ 2362179326 MinimumSpeed DDI 398-398;
SG_MUL_VAL_ 2362179326 ActualSpeed DDI 397-397;
SG_MUL_VAL_ 2362179326 SetpointSpeed DDI 396-396;
SG_MUL_VAL_ 2362179326 ActualDieselExhaustFluidTankCont DDI 395-395;
SG_MUL_VAL_ 2362179326 ActualFuelTankContent DDI 394-394;
SG_MUL_VAL_ 2362179326 MaximumRevolutionsPerTime DDI 393-393;
SG_MUL_VAL_ 2362179326 MinimumRevolutionsPerTime DDI 392-392;
SG_MUL_VAL_ 2362179326 DefaultRevolutionsPerTime DDI 391-391;
SG_MUL_VAL_ 2362179326 ActualRevolutionsPerTime DDI 390-390;
SG_MUL_VAL_ 2362179326 SetpointRevolutionsAsCountPerTim DDI 389-389;
SG_MUL_VAL_ 2362179326 TotalRevolutionsInCompleteRevolu DDI 388-388;
SG_MUL_VAL_ 2362179326 TotalRevolutionsInFractionalRevo DDI 387-387;
SG_MUL_VAL_ 2362179326 ActualAtmosphericPressure DDI 386-386;
SG_MUL_VAL_ 2362179326 MSLAtmosphericPressure DDI 385-385;
SG_MUL_VAL_ 2362179326 ApparentWindSpeed DDI 384-384;
SG_MUL_VAL_ 2362179326 ApparentWindDirection DDI 383-383;
SG_MUL_VAL_ 2362179326 CondensedSectionOverrideState241 DDI 382-382;
SG_MUL_VAL_ 2362179326 CondensedSectionOverrideState225 DDI 381-381;
SG_MUL_VAL_ 2362179326 CondensedSectionOverrideState209 DDI 380-380;
SG_MUL_VAL_ 2362179326 CondensedSectionOverrideState193 DDI 379-379;
SG_MUL_VAL_ 2362179326 CondensedSectionOverrideState177 DDI 378-378;
SG_MUL_VAL_ 2362179326 CondensedSectionOverrideState161 DDI 377-377;
SG_MUL_VAL_ 2362179326 CondensedSectionOverrideState145 DDI 376-376;
SG_MUL_VAL_ 2362179326 CondensedSectionOverrideState129 DDI 375-375;
SG_MUL_VAL_ 2362179326 CondensedSectionOverrideState113 DDI 374-374;
SG_MUL_VAL_ 2362179326 CondensedSectionOverrideState97t DDI 373-373;
SG_MUL_VAL_ 2362179326 CondensedSectionOverrideState81t DDI 372-372;
SG_MUL_VAL_ 2362179326 CondensedSectionOverrideState65t DDI 371-371;
SG_MUL_VAL_ 2362179326 CondensedSectionOverrideState49t DDI 370-370;
SG_MUL_VAL_ 2362179326 CondensedSectionOverrideState33t DDI 369-369;
SG_MUL_VAL_ 2362179326 CondensedSectionOverrideState17t DDI 368-368;
SG_MUL_VAL_ 2362179326 CondensedSectionOverrideState01t DDI 367-367;
SG_MUL_VAL_ 2362179326 ActualDownforcePressure DDI 366-366;
SG_MUL_VAL_ 2362179326 SetpointDownforcePressure DDI 365-365;
SG_MUL_VAL_ 2362179326 ActualFlakeSize DDI 364-364;
SG_MUL_VAL_ 2362179326 LastBaleDryMass DDI 363-363;
SG_MUL_VAL_ 2362179326 TotalBaleLength DDI 362-362;
SG_MUL_VAL_ 2362179326 LastBaleDensity DDI 361-361;
SG_MUL_VAL_ 2362179326 LastBaleSize DDI 360-360;
SG_MUL_VAL_ 2362179326 AverageDryYieldMassPerArea DDI 359-359;
SG_MUL_VAL_ 2362179326 AverageDryYieldMassPerTime DDI 358-358;
SG_MUL_VAL_ 2362179326 TotalApplicationOfDryMatter DDI 357-357;
SG_MUL_VAL_ 2362179326 TotalApplicationOfPotassium DDI 356-356;
SG_MUL_VAL_ 2362179326 TotalApplicationOfPhosphor DDI 355-355;
SG_MUL_VAL_ 2362179326 TotalApplicationOfAmmonium DDI 354-354;
SG_MUL_VAL_ 2362179326 TotalApplicationofNitrogen DDI 353-353;
SG_MUL_VAL_ 2362179326 ApplicationTotalMass DDI 352-352;
SG_MUL_VAL_ 2362179326 ApplicationTotalVolume DDI 351-351;
SG_MUL_VAL_ 2362179326 FunctionType DDI 350-350;
SG_MUL_VAL_ 2362179326 NozzleDriftReduction DDI 349-349;
SG_MUL_VAL_ 2362179326 MaximumSwathingWidth DDI 348-348;
SG_MUL_VAL_ 2362179326 MinimumSwathingWidth DDI 347-347;
SG_MUL_VAL_ 2362179326 ActualSwathingWidth DDI 346-346;
SG_MUL_VAL_ 2362179326 SetpointSwathingWidth DDI 345-345;
SG_MUL_VAL_ 2362179326 MaximumGrainKernelCrackerGap DDI 344-344;
SG_MUL_VAL_ 2362179326 MinimumGrainKernelCrackerGap DDI 343-343;
SG_MUL_VAL_ 2362179326 ActualGrainKernelCrackerGap DDI 342-342;
SG_MUL_VAL_ 2362179326 SetpointGrainKernelCrackerGap DDI 341-341;
SG_MUL_VAL_ 2362179326 EffectiveUnloadingTime DDI 340-340;
SG_MUL_VAL_ 2362179326 EffectiveLoadingTime DDI 339-339;
SG_MUL_VAL_ 2362179326 LiftimeRearPTOHours DDI 338-338;
SG_MUL_VAL_ 2362179326 LifetimeFrontPTOHours DDI 337-337;
SG_MUL_VAL_ 2362179326 RearPTOHours DDI 336-336;
SG_MUL_VAL_ 2362179326 FrontPTOHours DDI 335-335;
SG_MUL_VAL_ 2362179326 OperatingHoursSinceLastSharpenin DDI 334-334;
SG_MUL_VAL_ 2362179326 MaximumCuttingDrumSpeed DDI 333-333;
SG_MUL_VAL_ 2362179326 ActualCuttingDrumSpeed DDI 331-331;
SG_MUL_VAL_ 2362179326 SetpointCuttingDrumSpeed DDI 330-330;
SG_MUL_VAL_ 2362179326 MaximumHeaderSpeed DDI 329-329;
SG_MUL_VAL_ 2362179326 MinimumHeaderSpeed DDI 328-328;
SG_MUL_VAL_ 2362179326 ActualHeaderSpeed DDI 327-327;
SG_MUL_VAL_ 2362179326 SetpointHeaderSpeed DDI 326-326;
SG_MUL_VAL_ 2362179326 LifetimeApplicationTotalVolume DDI 325-325;
SG_MUL_VAL_ 2362179326 ChopperEngagementTotalTime DDI 324-324;
SG_MUL_VAL_ 2362179326 UnloadIdentificationNumber DDI 323-323;
SG_MUL_VAL_ 2362179326 LoadIdentificationNumber DDI 322-322;
SG_MUL_VAL_ 2362179326 ArbitraryAddressCapable PeerControlCommand 0-0, 1-1, 3-3, 4-4, 6-21;
SG_MUL_VAL_ 2362179326 IndustryGroup PeerControlCommand 0-0, 1-1, 3-3, 4-4, 6-21;
SG_MUL_VAL_ 2362179326 VehicleSystemInstance PeerControlCommand 0-0, 1-1, 3-3, 4-4, 6-21;
SG_MUL_VAL_ 2362179326 VehicleSystem2 PeerControlCommand 0-0, 1-1, 3-3, 4-4, 6-21;
SG_MUL_VAL_ 2362179326 Function PeerControlCommand 0-0, 1-1, 3-3, 4-4, 6-21;
SG_MUL_VAL_ 2362179326 FunctionInstance PeerControlCommand 0-0, 1-1, 3-3, 4-4, 6-21;
SG_MUL_VAL_ 2362179326 ECUInstance PeerControlCommand 0-0, 1-1, 3-3, 4-4, 6-21;
SG_MUL_VAL_ 2362179326 ManufacturerCode PeerControlCommand 0-0, 1-1, 3-3, 4-4, 6-21;
SG_MUL_VAL_ 2362179326 TemperatureUnits DeviceDescriptionMsgType 2-2, 3-3;
SG_MUL_VAL_ 2362179326 PressureUnits DeviceDescriptionMsgType 2-2, 3-3;
SG_MUL_VAL_ 2362179326 ErrorCodeObjPool4 DeviceDescriptionMsgType 9-9;
SG_MUL_VAL_ 2362179326 ErrorCodeObjPool3 DeviceDescriptionMsgType 9-9;
SG_MUL_VAL_ 2362179326 ForceUnits DeviceDescriptionMsgType 2-2, 3-3;
SG_MUL_VAL_ 2362179326 ErrorCodeObjPool2 DeviceDescriptionMsgType 9-9;
SG_MUL_VAL_ 2362179326 IdentityNumber PeerControlCommand 0-0, 1-1, 3-3, 4-4, 6-21;
SG_MUL_VAL_ 2362179326 NumberOfSection TechnicalDataMsgType 1-1;
SG_MUL_VAL_ 2362179326 ExecutedCommand Command 14-14;
SG_MUL_VAL_ 2362179326 UnitsSystem DeviceDescriptionMsgType 2-2, 3-3;
SG_MUL_VAL_ 2362179326 ErrorCodeObjPool1 DeviceDescriptionMsgType 9-9;
SG_MUL_VAL_ 2362179326 DistanceUnitCmd DeviceDescriptionMsgType 2-2, 3-3;
SG_MUL_VAL_ 2362179326 AreaUnitCmd DeviceDescriptionMsgType 2-2, 3-3;
SG_MUL_VAL_ 2362179326 VolumeUnitCmd DeviceDescriptionMsgType 2-2, 3-3;
SG_MUL_VAL_ 2362179326 SourceAddressWSM Command 14-14;
SG_MUL_VAL_ 2362179326 MassUnitCmd DeviceDescriptionMsgType 2-2, 3-3;
SG_MUL_VAL_ 2362179326 NumberOfBooms TechnicalDataMsgType 1-1;
SG_MUL_VAL_ 2362179326 OriginCommand Command 13-13;
SG_MUL_VAL_ 2362179326 ErrorCodeProcessData8 Command 13-13;
SG_MUL_VAL_ 2362179326 ErrorCodeProcessData7 Command 13-13;
SG_MUL_VAL_ 2362179326 ErrorCodeProcessData6 Command 13-13;
SG_MUL_VAL_ 2362179326 DestinationElementNumber PeerControlCommand 3-3, 4-4;
SG_MUL_VAL_ 2362179326 ErrorCodeProcessData5 Command 13-13;
SG_MUL_VAL_ 2362179326 ErrorCodeProcessData4 Command 13-13;
SG_MUL_VAL_ 2362179326 StatusBusyExecuting Command 14-14;
SG_MUL_VAL_ 2362179326 ErrorCodeProcessData3 Command 13-13;
SG_MUL_VAL_ 2362179326 StatusBusyReading Command 14-14;
SG_MUL_VAL_ 2362179326 ErrorCodeProcessData2 Command 13-13;
SG_MUL_VAL_ 2362179326 StatusBusySaving Command 14-14;
SG_MUL_VAL_ 2362179326 DataLogTimeInterval Command 4-4;
SG_MUL_VAL_ 2362179326 DataLogDistanceInterval Command 5-5;
SG_MUL_VAL_ 2362179326 AppRateVolumePerArea_Set DDI 1-1;
SG_MUL_VAL_ 2362179326 AppRateVolumePerArea_Act DDI 2-2;
SG_MUL_VAL_ 2362179326 AppRateVolumePerArea_Def DDI 3-3;
SG_MUL_VAL_ 2362179326 AppRateVolumePerArea_Min DDI 4-4;
SG_MUL_VAL_ 2362179326 AppRateVolumePerArea_Max DDI 5-5;
SG_MUL_VAL_ 2362179326 AppRateMassPerArea_Set DDI 6-6;
SG_MUL_VAL_ 2362179326 AppRateMassPerArea_Act DDI 7-7;
SG_MUL_VAL_ 2362179326 AppRateMassPerArea_Def DDI 8-8;
SG_MUL_VAL_ 2362179326 AppRateMassPerArea_Min DDI 9-9;
SG_MUL_VAL_ 2362179326 AppRateMassPerArea_Max DDI 10-10;
SG_MUL_VAL_ 2362179326 AppRateCountPerArea_Set DDI 11-11;
SG_MUL_VAL_ 2362179326 AppRateCountPerArea_Act DDI 12-12;
SG_MUL_VAL_ 2362179326 AppRateCountPerArea_Def DDI 13-13;
SG_MUL_VAL_ 2362179326 AppRateCountPerArea_Min DDI 14-14;
SG_MUL_VAL_ 2362179326 AppRateCountPerArea_Max DDI 15-15;
SG_MUL_VAL_ 2362179326 SetAppRateDistance_Set DDI 16-16;
SG_MUL_VAL_ 2362179326 AppRateDistance_Act DDI 17-17;
SG_MUL_VAL_ 2362179326 AppRateDistance_Def DDI 18-18;
SG_MUL_VAL_ 2362179326 AppRateDistance_Min DDI 19-19;
SG_MUL_VAL_ 2362179326 AppRateDistance_Max DDI 20-20;
SG_MUL_VAL_ 2362179326 AppRateVolumePerVolume_Set DDI 21-21;
SG_MUL_VAL_ 2362179326 AppRateVolumePerVolume_Act DDI 22-22;
SG_MUL_VAL_ 2362179326 AppRateVolumePerVolume_Def DDI 23-23;
SG_MUL_VAL_ 2362179326 AppRateVolumePerVolume_Min DDI 24-24;
SG_MUL_VAL_ 2362179326 AppRateVolumePerVolume_Max DDI 25-25;
SG_MUL_VAL_ 2362179326 AppRateMassPerMass_Set DDI 26-26;
SG_MUL_VAL_ 2362179326 AppRateMassPerMass_Act DDI 27-27;
SG_MUL_VAL_ 2362179326 AppRateMassPerMass_Def DDI 28-28;
SG_MUL_VAL_ 2362179326 AppRateMassPerMass_Min DDI 29-29;
SG_MUL_VAL_ 2362179326 AppRateMassPerMass_Max DDI 30-30;
SG_MUL_VAL_ 2362179326 AppRateVolumePerMass_Set DDI 31-31;
SG_MUL_VAL_ 2362179326 AppRateVolumePerMass_Act DDI 32-32;
SG_MUL_VAL_ 2362179326 AppRateVolumePerMass_Def DDI 33-33;
SG_MUL_VAL_ 2362179326 AppRateVolumePerMass_Min DDI 34-34;
SG_MUL_VAL_ 2362179326 AppRateVolumePerMass_Max DDI 35-35;
SG_MUL_VAL_ 2362179326 AppRateVolumePerTime_Set DDI 36-36;
SG_MUL_VAL_ 2362179326 AppRateVolumePerTime_Act DDI 37-37;
SG_MUL_VAL_ 2362179326 AppRateVolumePerTime_Def DDI 38-38;
SG_MUL_VAL_ 2362179326 AppRateVolumePerTime_Min DDI 39-39;
SG_MUL_VAL_ 2362179326 AppRateVolumePerTime_Max DDI 40-40;
SG_MUL_VAL_ 2362179326 AppRateMassPerTime_Set DDI 41-41;
SG_MUL_VAL_ 2362179326 AppRateMassPerTime_Act DDI 42-42;
SG_MUL_VAL_ 2362179326 AppRateMassPerTime_Def DDI 43-43;
SG_MUL_VAL_ 2362179326 AppRateMassPerTime_Min DDI 44-44;
SG_MUL_VAL_ 2362179326 AppRateMassPerTime_Max DDI 45-45;
SG_MUL_VAL_ 2362179326 AppRateCountPerTime_Set DDI 46-46;
SG_MUL_VAL_ 2362179326 AppRateCountPerTime_Act DDI 47-47;
SG_MUL_VAL_ 2362179326 AppRateCountPerTime_Def DDI 48-48;
SG_MUL_VAL_ 2362179326 AppRateCountPerTime_Min DDI 49-49;
SG_MUL_VAL_ 2362179326 AppRateCountPerTime_Max DDI 50-50;
SG_MUL_VAL_ 2362179326 SetTillageDepth_Set DDI 51-51;
SG_MUL_VAL_ 2362179326 TillageDepth_Act DDI 52-52;
SG_MUL_VAL_ 2362179326 TillageDepth_Def DDI 53-53;
SG_MUL_VAL_ 2362179326 TillageDepth_Min DDI 54-54;
SG_MUL_VAL_ 2362179326 TillageDepth_Max DDI 55-55;
SG_MUL_VAL_ 2362179326 SeedingDeph_Set DDI 56-56;
SG_MUL_VAL_ 2362179326 SeedingDeph_Act DDI 57-57;
SG_MUL_VAL_ 2362179326 SeedingDeph_Def DDI 58-58;
SG_MUL_VAL_ 2362179326 SeedingDeph_Min DDI 59-59;
SG_MUL_VAL_ 2362179326 SeedingDeph_Max DDI 60-60;
SG_MUL_VAL_ 2362179326 WorkingHeight_Set DDI 61-61;
SG_MUL_VAL_ 2362179326 WorkingHeight_Act DDI 62-62;
SG_MUL_VAL_ 2362179326 WorkingHeight_Def DDI 63-63;
SG_MUL_VAL_ 2362179326 WorkingHeight_Min DDI 64-64;
SG_MUL_VAL_ 2362179326 WorkingHeight_Max DDI 65-65;
SG_MUL_VAL_ 2362179326 WorkingWidth_Set DDI 66-66;
SG_MUL_VAL_ 2362179326 WorkingWidth_Act DDI 67-67;
SG_MUL_VAL_ 2362179326 WorkingWidth_Def DDI 68-68;
SG_MUL_VAL_ 2362179326 WorkingWidth_Min DDI 69-69;
SG_MUL_VAL_ 2362179326 WorkingWidth_Max DDI 70-70;
SG_MUL_VAL_ 2362179326 ContentAsVolume_Set DDI 71-71;
SG_MUL_VAL_ 2362179326 ContentAsVolume_Act DDI 72-72;
SG_MUL_VAL_ 2362179326 ContentAsVolume_Max DDI 73-73;
SG_MUL_VAL_ 2362179326 ContentAsMass_Set DDI 74-74;
SG_MUL_VAL_ 2362179326 ContentAsMass_Act DDI 75-75;
SG_MUL_VAL_ 2362179326 ContentAsMass_Max DDI 76-76;
SG_MUL_VAL_ 2362179326 ContentAsCount_Set DDI 77-77;
SG_MUL_VAL_ 2362179326 ContentAsCount_Act DDI 78-78;
SG_MUL_VAL_ 2362179326 ContentAsCount_Max DDI 79-79;
SG_MUL_VAL_ 2362179326 AccumulatedAppAsVolume DDI 80-80;
SG_MUL_VAL_ 2362179326 AccumulatedAppAsMass DDI 81-81;
SG_MUL_VAL_ 2362179326 AccumulatedAppAsCount DDI 82-82;
SG_MUL_VAL_ 2362179326 YieldVolumePerArea DDI 83-83;
SG_MUL_VAL_ 2362179326 YieldMassPerArea DDI 84-84;
SG_MUL_VAL_ 2362179326 YieldCountPerArea DDI 85-85;
SG_MUL_VAL_ 2362179326 YieldVolumePerTime DDI 86-86;
SG_MUL_VAL_ 2362179326 YieldMassPerTime DDI 87-87;
SG_MUL_VAL_ 2362179326 YieldCountPerTime DDI 88-88;
SG_MUL_VAL_ 2362179326 AccumulatedYieldAsVolume DDI 89-89;
SG_MUL_VAL_ 2362179326 AccumulatedYieldAsMass DDI 90-90;
SG_MUL_VAL_ 2362179326 AccumulatedYieldAsCount DDI 91-91;
SG_MUL_VAL_ 2362179326 CropYieldLossVolumePerArea DDI 92-92;
SG_MUL_VAL_ 2362179326 CropYieldLossMassPerArea DDI 93-93;
SG_MUL_VAL_ 2362179326 CropYieldLossCountPerArea DDI 94-94;
SG_MUL_VAL_ 2362179326 CropYieldLossVolumePerTime DDI 95-95;
SG_MUL_VAL_ 2362179326 CropYieldLossMassPerTime DDI 96-96;
SG_MUL_VAL_ 2362179326 CropYieldLossCountPerTime DDI 97-97;
SG_MUL_VAL_ 2362179326 CropYieldLoss DDI 98-98;
SG_MUL_VAL_ 2362179326 MoistureInCropYield DDI 99-99;
SG_MUL_VAL_ 2362179326 DirtMaterialInCropYield DDI 100-100;
SG_MUL_VAL_ 2362179326 BaleWidth_Set DDI 101-101;
SG_MUL_VAL_ 2362179326 BaleWidth_Act DDI 102-102;
SG_MUL_VAL_ 2362179326 BaleWidth_Def DDI 103-103;
SG_MUL_VAL_ 2362179326 BaleWidth_Min DDI 104-104;
SG_MUL_VAL_ 2362179326 BaleWidth_Max DDI 105-105;
SG_MUL_VAL_ 2362179326 BaleHeight_Set DDI 106-106;
SG_MUL_VAL_ 2362179326 BaleHeight_Act DDI 107-107;
SG_MUL_VAL_ 2362179326 BaleHeight_Def DDI 108-108;
SG_MUL_VAL_ 2362179326 BaleHeight_Min DDI 109-109;
SG_MUL_VAL_ 2362179326 BaleHeight_Max DDI 110-110;
SG_MUL_VAL_ 2362179326 BaleSize_Set DDI 111-111;
SG_MUL_VAL_ 2362179326 BaleSize_Act DDI 112-112;
SG_MUL_VAL_ 2362179326 BaleSize_Def DDI 113-113;
SG_MUL_VAL_ 2362179326 BaleSize_Min DDI 114-114;
SG_MUL_VAL_ 2362179326 BaleSize_Max DDI 115-115;
SG_MUL_VAL_ 2362179326 AccumulatedArea DDI 116-116;
SG_MUL_VAL_ 2362179326 AccumulatedDistanceInWork DDI 117-117;
SG_MUL_VAL_ 2362179326 AccumulatedDistanceOutWork DDI 118-118;
SG_MUL_VAL_ 2362179326 AccumulatedTimeInWork DDI 119-119;
SG_MUL_VAL_ 2362179326 AccumulatedTimeOutWork DDI 120-120;
SG_MUL_VAL_ 2362179326 PrdoucDensityMassPerArea DDI 121-121;
SG_MUL_VAL_ 2362179326 PrdoucDensityMassPerCount DDI 122-122;
SG_MUL_VAL_ 2362179326 PrdoucDensityVolumePerCount DDI 123-123;
SG_MUL_VAL_ 2362179326 AuxiliaryValveScalingExtend DDI 124-124;
SG_MUL_VAL_ 2362179326 AuxiliaryValveScalingRetract DDI 125-125;
SG_MUL_VAL_ 2362179326 AuxiliaryRampExtendUp DDI 126-126;
SG_MUL_VAL_ 2362179326 AuxiliaryValveRampExtendDown DDI 127-127;
SG_MUL_VAL_ 2362179326 AuxiliaryValveRampRetractUp DDI 128-128;
SG_MUL_VAL_ 2362179326 AuxiliaryValveRampRetractDown DDI 129-129;
SG_MUL_VAL_ 2362179326 AuxiliaryValveFloatThreshold DDI 130-130;
SG_MUL_VAL_ 2362179326 AuxiliaryValveProgressivExtend DDI 131-131;
SG_MUL_VAL_ 2362179326 AuxiliaryValveProgressivRetract DDI 132-132;
SG_MUL_VAL_ 2362179326 AuxiliaryValveInvertPorts DDI 133-133;
SG_MUL_VAL_ 2362179326 DeviceElementOffsetX DDI 134-134;
SG_MUL_VAL_ 2362179326 DeviceElementOffsetY DDI 135-135;
SG_MUL_VAL_ 2362179326 DeviceElementOffsetZ DDI 136-136;
SG_MUL_VAL_ 2362179326 DeviceVolumeCapacity DDI 137-137;
SG_MUL_VAL_ 2362179326 DeviceMassCapacity DDI 138-138;
SG_MUL_VAL_ 2362179326 DeviceCountCapacity DDI 139-139;
SG_MUL_VAL_ 2362179326 PercentageAppRateSetpoint DDI 140-140;
SG_MUL_VAL_ 2362179326 WorkState DDI 141-141;
SG_MUL_VAL_ 2362179326 SetpointTimeLatency DDI 142-142;
SG_MUL_VAL_ 2362179326 ActualValueTimeLatency DDI 143-143;
SG_MUL_VAL_ 2362179326 YawAngle DDI 144-144;
SG_MUL_VAL_ 2362179326 RollAngle DDI 145-145;
SG_MUL_VAL_ 2362179326 PitchAngle DDI 146-146;
SG_MUL_VAL_ 2362179326 LogCount DDI 147-147;
SG_MUL_VAL_ 2362179326 TotalFuelConsumption DDI 148-148;
SG_MUL_VAL_ 2362179326 FuelConsumptionPerTime DDI 149-149;
SG_MUL_VAL_ 2362179326 FuelConsumptionPerArea DDI 150-150;
SG_MUL_VAL_ 2362179326 AreaPerTimeCapacity DDI 151-151;
SG_MUL_VAL_ 2362179326 MinMassPerAreaAppRate DDI 152-152;
SG_MUL_VAL_ 2362179326 NDVI DDI 153-153;
SG_MUL_VAL_ 2362179326 PhysicalObjectLength DDI 154-154;
SG_MUL_VAL_ 2362179326 PhysicalObjectWidth DDI 155-155;
SG_MUL_VAL_ 2362179326 PhysicalObjectHeight DDI 156-156;
SG_MUL_VAL_ 2362179326 ConnectorType DDI 157-157;
SG_MUL_VAL_ 2362179326 PrescriptionControlState DDI 158-158;
SG_MUL_VAL_ 2362179326 NumberOfSubUnitsPerSection DDI 159-159;
SG_MUL_VAL_ 2362179326 SectionControlState DDI 160-160;
SG_MUL_VAL_ 2362179326 CondensedWorkState1to16 DDI 161-161;
SG_MUL_VAL_ 2362179326 CondensedWorkState17to32 DDI 162-162;
SG_MUL_VAL_ 2362179326 CondensedWorkState33to48 DDI 163-163;
SG_MUL_VAL_ 2362179326 CondensedWorkState49to64 DDI 164-164;
SG_MUL_VAL_ 2362179326 CondensedWorkState65to80 DDI 165-165;
SG_MUL_VAL_ 2362179326 CondensedWorkState81to96 DDI 166-166;
SG_MUL_VAL_ 2362179326 CondensedWorkState97to112 DDI 167-167;
SG_MUL_VAL_ 2362179326 CondensedWorkState113to128 DDI 168-168;
SG_MUL_VAL_ 2362179326 CondensedWorkState129to144 DDI 169-169;
SG_MUL_VAL_ 2362179326 CondensedWorkState145to160 DDI 170-170;
SG_MUL_VAL_ 2362179326 CondensedWorkState161to176 DDI 171-171;
SG_MUL_VAL_ 2362179326 CondensedWorkState177to192 DDI 172-172;
SG_MUL_VAL_ 2362179326 CondensedWorkState193to208 DDI 173-173;
SG_MUL_VAL_ 2362179326 CondensedWorkState209to224 DDI 174-174;
SG_MUL_VAL_ 2362179326 CondensedWorkState225to240 DDI 175-175;
SG_MUL_VAL_ 2362179326 CondensedWorkState241to256 DDI 176-176;
SG_MUL_VAL_ 2362179326 ActualLengthOfCut DDI 177-177;
SG_MUL_VAL_ 2362179326 ElementTypeInstance DDI 178-178;
SG_MUL_VAL_ 2362179326 ActualCulturalPractice DDI 179-179;
SG_MUL_VAL_ 2362179326 DRP2GroundDistance DDI 180-180;
SG_MUL_VAL_ 2362179326 DryMassPerAreaYield DDI 181-181;
SG_MUL_VAL_ 2362179326 DryMassPerTimeYield DDI 182-182;
SG_MUL_VAL_ 2362179326 YieldTotalDryMass DDI 183-183;
SG_MUL_VAL_ 2362179326 RefMoistureForDryMass DDI 184-184;
SG_MUL_VAL_ 2362179326 SeedCottonMassPerAreaYield DDI 185-185;
SG_MUL_VAL_ 2362179326 LintCottonMassPerAreaYield DDI 186-186;
SG_MUL_VAL_ 2362179326 SeedCottonMassPerTimeYield DDI 187-187;
SG_MUL_VAL_ 2362179326 LintCottonMassPerTimeYield DDI 188-188;
SG_MUL_VAL_ 2362179326 YieldTotalSeedCottonMass DDI 189-189;
SG_MUL_VAL_ 2362179326 YieldTotalLintCottonMass DDI 190-190;
SG_MUL_VAL_ 2362179326 LintTurnoutPercentage DDI 191-191;
SG_MUL_VAL_ 2362179326 AmbientTemperature DDI 192-192;
SG_MUL_VAL_ 2362179326 SetpointProductPressure DDI 193-193;
SG_MUL_VAL_ 2362179326 ActualProductPressure DDI 194-194;
SG_MUL_VAL_ 2362179326 MinimumProductPressure DDI 195-195;
SG_MUL_VAL_ 2362179326 MaximumProductPressure DDI 196-196;
SG_MUL_VAL_ 2362179326 SetpointPumpOutputPressure DDI 197-197;
SG_MUL_VAL_ 2362179326 ActualPumpOutputPressure DDI 198-198;
SG_MUL_VAL_ 2362179326 MinimumPumpOutputPressure DDI 199-199;
SG_MUL_VAL_ 2362179326 MaximumPumpOutputPressure DDI 200-200;
SG_MUL_VAL_ 2362179326 SetpointTankAgitationPressure DDI 201-201;
SG_MUL_VAL_ 2362179326 ActualTankAgitationPressure DDI 202-202;
SG_MUL_VAL_ 2362179326 MinimumTankAgitationPressure DDI 203-203;
SG_MUL_VAL_ 2362179326 MaximumTankAgitationPressure DDI 204-204;
SG_MUL_VAL_ 2362179326 SCTurnOnTime_ DDI 205-205;
SG_MUL_VAL_ 2362179326 SCTurnOffTime DDI 206-206;
SG_MUL_VAL_ 2362179326 WindSpeed DDI 207-207;
SG_MUL_VAL_ 2362179326 WindDirection DDI 208-208;
SG_MUL_VAL_ 2362179326 AirHumidity DDI 209-209;
SG_MUL_VAL_ 2362179326 SkyConditions DDI 210-210;
SG_MUL_VAL_ 2362179326 LastBaleFlakesPerBale DDI 211-211;
SG_MUL_VAL_ 2362179326 LastBaleAverageMoisture DDI 212-212;
SG_MUL_VAL_ 2362179326 LastBaleAverageStrokesPerFlake DDI 213-213;
SG_MUL_VAL_ 2362179326 LifetimeBaleCount DDI 214-214;
SG_MUL_VAL_ 2362179326 LifetimeWorkingHours DDI 215-215;
SG_MUL_VAL_ 2362179326 ActualBaleHydraulicPressure DDI 216-216;
SG_MUL_VAL_ 2362179326 LastBaleAverageHydraulicPressure DDI 217-217;
SG_MUL_VAL_ 2362179326 SetpointBaleCompressionPlungerLo DDI 218-218;
SG_MUL_VAL_ 2362179326 ActualBaleCompressionPlungerLoad DDI 219-219;
SG_MUL_VAL_ 2362179326 LastBaleAverageBaleCompressionPl DDI 220-220;
SG_MUL_VAL_ 2362179326 LastBaleAppliedPreservative DDI 221-221;
SG_MUL_VAL_ 2362179326 LastBaleTagNumber DDI 222-222;
SG_MUL_VAL_ 2362179326 LastBaleMass DDI 223-223;
SG_MUL_VAL_ 2362179326 DeltaT DDI 224-224;
SG_MUL_VAL_ 2362179326 SetpointWorkingLength DDI 225-225;
SG_MUL_VAL_ 2362179326 ActualWorkingLength DDI 226-226;
SG_MUL_VAL_ 2362179326 MinimumWorkingLength DDI 227-227;
SG_MUL_VAL_ 2362179326 MaximumWorkingLength DDI 228-228;
SG_MUL_VAL_ 2362179326 ActualNetWeight DDI 229-229;
SG_MUL_VAL_ 2362179326 NetWeightState DDI 230-230;
SG_MUL_VAL_ 2362179326 SetpointNetWeight DDI 231-231;
SG_MUL_VAL_ 2362179326 ActualGrossWeight DDI 232-232;
SG_MUL_VAL_ 2362179326 GrossWeightState DDI 233-233;
SG_MUL_VAL_ 2362179326 MinimumGrossWeight DDI 234-234;
SG_MUL_VAL_ 2362179326 MaximumGrossWeight DDI 235-235;
SG_MUL_VAL_ 2362179326 ThreshingEngagementTotalTime DDI 236-236;
SG_MUL_VAL_ 2362179326 ActualHeaderWorkingHeightStatus DDI 237-237;
SG_MUL_VAL_ 2362179326 ActualHeaderRotationalSpeedStatu DDI 238-238;
SG_MUL_VAL_ 2362179326 YieldHoldStatus DDI 239-239;
SG_MUL_VAL_ 2362179326 ActualUnLoadingSystemStatus DDI 240-240;
SG_MUL_VAL_ 2362179326 CropTemperature DDI 241-241;
SG_MUL_VAL_ 2362179326 SetpointSieveClearance DDI 242-242;
SG_MUL_VAL_ 2362179326 ActualSieveClearance DDI 243-243;
SG_MUL_VAL_ 2362179326 MinimumSieveClearance DDI 244-244;
SG_MUL_VAL_ 2362179326 MaximumSieveClearance DDI 245-245;
SG_MUL_VAL_ 2362179326 SetpointChafferClearance DDI 246-246;
SG_MUL_VAL_ 2362179326 ActualChafferClearance DDI 247-247;
SG_MUL_VAL_ 2362179326 MinimumChafferClearance DDI 248-248;
SG_MUL_VAL_ 2362179326 MaximumChafferClearance DDI 249-249;
SG_MUL_VAL_ 2362179326 SetpointConcaveClearance DDI 250-250;
SG_MUL_VAL_ 2362179326 ActualConcaveClearance DDI 251-251;
SG_MUL_VAL_ 2362179326 MinimumConcaveClearance DDI 252-252;
SG_MUL_VAL_ 2362179326 MaximumConcaveClearance DDI 253-253;
SG_MUL_VAL_ 2362179326 SetpointSeparationFanRotationalS DDI 254-254;
SG_MUL_VAL_ 2362179326 ActualSeparationFanRotationalSpe DDI 255-255;
SG_MUL_VAL_ 2362179326 MinimumSeparationFanRotationalSp DDI 256-256;
SG_MUL_VAL_ 2362179326 MaximumSeparationFanRotationalSp DDI 257-257;
SG_MUL_VAL_ 2362179326 HydraulicOilTemperature DDI 258-258;
SG_MUL_VAL_ 2362179326 YieldLagIgnoreTime DDI 259-259;
SG_MUL_VAL_ 2362179326 YieldLeadIgnoreTime DDI 260-260;
SG_MUL_VAL_ 2362179326 AverageYieldMassPerTime DDI 261-261;
SG_MUL_VAL_ 2362179326 AverageCropMoisture DDI 262-262;
SG_MUL_VAL_ 2362179326 AverageYieldMassPerArea DDI 263-263;
SG_MUL_VAL_ 2362179326 ConnectorPivotXOffset DDI 264-264;
SG_MUL_VAL_ 2362179326 RemainingArea DDI 265-265;
SG_MUL_VAL_ 2362179326 LifetimeApplicationTotalMass DDI 266-266;
SG_MUL_VAL_ 2362179326 LifetimeApplicationTotalCount DDI 267-267;
SG_MUL_VAL_ 2362179326 LifetimeYieldTotalVolume DDI 268-268;
SG_MUL_VAL_ 2362179326 LifetimeYieldTotalMass DDI 269-269;
SG_MUL_VAL_ 2362179326 LifetimeYieldTotalCount DDI 270-270;
SG_MUL_VAL_ 2362179326 LifetimeTotalArea DDI 271-271;
SG_MUL_VAL_ 2362179326 LifetimeTotalDistance DDI 272-272;
SG_MUL_VAL_ 2362179326 LifetimeIneffectiveTotalDistance DDI 273-273;
SG_MUL_VAL_ 2362179326 LifetimeEffectiveTotalTime DDI 274-274;
SG_MUL_VAL_ 2362179326 LifetimeIneffectiveTotalTime DDI 275-275;
SG_MUL_VAL_ 2362179326 LifetimeFuelConsumption DDI 276-276;
