VERSION ""

NS_ :

BS_:

BU_: TPMS EBS
VAL_TABLE_ FMI 31 "ConditionExists" 19 "Received network data in error" 18 "Below normal (moderatels severe)" 17 "Below normal (least severe)" 16 "Above normal (moderately severe)" 15 "Above normal (least severe)" 14 "Special intstructions" 13 "Out of calibration" 12 "Bad intelligent device" 11 "Root cause not known" 10 "Abnormal rate of change" 9 "Abnormal update rate" 8 "Abnormal frequency" 7 "Mechanical system not responding" 6 "Current above normal" 5 "Current below normal" 4 "Voltage below normal" 3 "Voltage above normal" 2 "Data erratic" 1 "Below normal (most severe)" 0 "Above normal (most severe)" ;

BO_ 3221225472 VECTOR__INDEPENDENT_SIG_MSG: 0 Vector__XXX
 SG_ TireTemp : 0|16@1+ (0.03125,-273) [-273|1735] "deg" Vector__XXX
 SG_ TirePress : 0|8@1+ (4,0) [0|1000] "kPa" Vector__XXX
 SG_ SPN5 : 0|16@1+ (1,0) [0|65536] "" Vector__XXX
 SG_ SPN4 : 0|16@1+ (1,0) [0|65536] "" Vector__XXX
 SG_ SPN3 : 0|16@1+ (1,0) [0|65536] "" Vector__XXX
 SG_ SPN2 : 0|16@1+ (1,0) [0|65536] "" Vector__XXX
 SG_ FailureModeIdentifier5 : 0|5@1+ (1,0) [0|0] "" Vector__XXX
 SG_ FailureModeIdentifier4 : 0|5@1+ (1,0) [0|0] "" Vector__XXX
 SG_ FlashRedStopLamp : 0|2@1+ (1,0) [0|3] "" Vector__XXX
 SG_ FlashProtectLamp : 0|2@1+ (1,0) [0|3] "" Vector__XXX
 SG_ FlashMalfuncIndicatorLamp : 0|2@1+ (1,0) [0|3] "" Vector__XXX
 SG_ FlashAmberWarningLamp : 0|2@1+ (1,0) [0|3] "" Vector__XXX
 SG_ FailureModeIdentifier3 : 0|5@1+ (1,0) [0|0] "" Vector__XXX
 SG_ FailureModeIdentifier2 : 0|5@1+ (1,0) [0|0] "" Vector__XXX
 SG_ SPNConversionMethod5 : 0|1@1+ (1,0) [0|1] "" Vector__XXX
 SG_ SPNConversionMethod4 : 0|1@1+ (1,0) [0|1] "" Vector__XXX
 SG_ SPNConversionMethod3 : 0|1@1+ (1,0) [0|1] "" Vector__XXX
 SG_ SPNConversionMethod2 : 0|1@1+ (1,0) [0|1] "" Vector__XXX
 SG_ OccurenceCount5 : 0|7@1+ (1,0) [0|126] "" Vector__XXX
 SG_ OccurenceCount4 : 0|7@1+ (1,0) [0|126] "" Vector__XXX
 SG_ OccurenceCount3 : 0|7@1+ (1,0) [0|126] "" Vector__XXX
 SG_ OccurenceCount2 : 0|7@1+ (1,0) [0|126] "" Vector__XXX
 SG_ OccurenceCount1 : 0|7@1+ (1,0) [0|126] "" Vector__XXX
 SG_ SPNConversionMethod1 : 0|1@1+ (1,0) [0|1] "" Vector__XXX
 SG_ FailureModeIdentifier1 : 0|5@1+ (1,0) [0|0] "" Vector__XXX
 SG_ SPN1 : 0|16@1+ (1,0) [0|65536] "" Vector__XXX
 SG_ MalfunctionIndicatorLampStatus : 0|2@1+ (1,0) [0|3] "" Vector__XXX
 SG_ RedStopLampState : 0|2@1+ (1,0) [0|3] "" Vector__XXX
 SG_ AmberWarningLampStatus : 0|2@1+ (1,0) [0|3] "" Vector__XXX
 SG_ ProtectLampStatus : 0|2@1+ (1,0) [0|3] "" Vector__XXX
 SG_ SPN5High : 0|3@1+ (1,0) [0|7] "" Vector__XXX
 SG_ SPN4High : 0|3@1+ (1,0) [0|7] "" Vector__XXX
 SG_ SPN3High : 0|3@1+ (1,0) [0|7] "" Vector__XXX
 SG_ SPN2High : 0|3@1+ (1,0) [0|7] "" Vector__XXX
 SG_ SPN1High : 0|3@1+ (1,0) [0|7] "" Vector__XXX
 SG_ OccurenceCount1 : 0|7@1+ (1,0) [0|126] "" Vector__XXX
 SG_ SPNConversionMethod1 : 0|1@1+ (1,0) [0|1] "" Vector__XXX
 SG_ FailureModeIdentifier1 : 0|5@1+ (1,0) [0|0] "" Vector__XXX
 SG_ SPN1 : 0|16@1+ (1,0) [0|65536] "" Vector__XXX
 SG_ SPN1High : 0|3@1+ (1,0) [0|7] "" Vector__XXX
 SG_ OccurenceCount1 : 0|7@1+ (1,0) [0|126] "" Vector__XXX
 SG_ SPNConversionMethod1 : 0|1@1+ (1,0) [0|1] "" Vector__XXX
 SG_ FailureModeIdentifier1 : 0|5@1+ (1,0) [0|0] "" Vector__XXX
 SG_ SPN1 : 0|16@1+ (1,0) [0|65536] "" Vector__XXX
 SG_ SPN1High : 0|3@1+ (1,0) [0|7] "" Vector__XXX
 SG_ SPN5 : 0|16@1+ (1,0) [0|65536] "" Vector__XXX
 SG_ SPN4 : 0|16@1+ (1,0) [0|65536] "" Vector__XXX
 SG_ SPN3 : 0|16@1+ (1,0) [0|65536] "" Vector__XXX
 SG_ SPN2 : 0|16@1+ (1,0) [0|65536] "" Vector__XXX
 SG_ FailureModeIdentifier5 : 0|5@1+ (1,0) [0|0] "" Vector__XXX
 SG_ FailureModeIdentifier4 : 0|5@1+ (1,0) [0|0] "" Vector__XXX
 SG_ OccurenceCount1 : 0|7@1+ (1,0) [0|126] "" Vector__XXX
 SG_ SPNConversionMethod1 : 0|1@1+ (1,0) [0|1] "" Vector__XXX
 SG_ FailureModeIdentifier1 : 0|5@1+ (1,0) [0|0] "" Vector__XXX
 SG_ SPN1 : 0|16@1+ (1,0) [0|65536] "" Vector__XXX
 SG_ MalfunctionIndicatorLampStatus : 0|2@1+ (1,0) [0|3] "" Vector__XXX
 SG_ RedStopLampState : 0|2@1+ (1,0) [0|3] "" Vector__XXX
 SG_ AmberWarningLampStatus : 0|2@1+ (1,0) [0|3] "" Vector__XXX
 SG_ ProtectLampStatus : 0|2@1+ (1,0) [0|3] "" Vector__XXX
 SG_ FailureModeIdentifier3 : 0|5@1+ (1,0) [0|0] "" Vector__XXX
 SG_ FlashRedStopLamp : 0|2@1+ (1,0) [0|3] "" Vector__XXX
 SG_ FlashProtectLamp : 0|2@1+ (1,0) [0|3] "" Vector__XXX
 SG_ FlashMalfuncIndicatorLamp : 0|2@1+ (1,0) [0|3] "" Vector__XXX
 SG_ FlashAmberWarningLamp : 0|2@1+ (1,0) [0|3] "" Vector__XXX
 SG_ FailureModeIdentifier2 : 0|5@1+ (1,0) [0|0] "" Vector__XXX
 SG_ SPNConversionMethod5 : 0|1@1+ (1,0) [0|1] "" Vector__XXX
 SG_ SPNConversionMethod4 : 0|1@1+ (1,0) [0|1] "" Vector__XXX
 SG_ SPNConversionMethod3 : 0|1@1+ (1,0) [0|1] "" Vector__XXX
 SG_ SPNConversionMethod2 : 0|1@1+ (1,0) [0|1] "" Vector__XXX
 SG_ OccurenceCount5 : 0|7@1+ (1,0) [0|126] "" Vector__XXX
 SG_ OccurenceCount4 : 0|7@1+ (1,0) [0|126] "" Vector__XXX
 SG_ OccurenceCount3 : 0|7@1+ (1,0) [0|126] "" Vector__XXX
 SG_ OccurenceCount2 : 0|7@1+ (1,0) [0|126] "" Vector__XXX
 SG_ SPN5High : 0|3@1+ (1,0) [0|7] "" Vector__XXX
 SG_ SPN4High : 0|3@1+ (1,0) [0|7] "" Vector__XXX
 SG_ SPN3High : 0|3@1+ (1,0) [0|7] "" Vector__XXX
 SG_ SPN2High : 0|3@1+ (1,0) [0|7] "" Vector__XXX
 SG_ SPN1High : 0|3@1+ (1,0) [0|7] "" Vector__XXX
 SG_ SPN5 : 0|16@1+ (1,0) [0|65536] "" Vector__XXX
 SG_ SPN4 : 0|16@1+ (1,0) [0|65536] "" Vector__XXX
 SG_ SPN3 : 0|16@1+ (1,0) [0|65536] "" Vector__XXX
 SG_ SPN2 : 0|16@1+ (1,0) [0|65536] "" Vector__XXX
 SG_ FlashRedStopLamp : 0|2@1+ (1,0) [0|3] "" Vector__XXX
 SG_ FlashProtectLamp : 0|2@1+ (1,0) [0|3] "" Vector__XXX
 SG_ FailureModeIdentifier5 : 0|5@1+ (1,0) [0|0] "" Vector__XXX
 SG_ FailureModeIdentifier4 : 0|5@1+ (1,0) [0|0] "" Vector__XXX
 SG_ FailureModeIdentifier3 : 0|5@1+ (1,0) [0|0] "" Vector__XXX
 SG_ OccurenceCount1 : 0|7@1+ (1,0) [0|126] "" Vector__XXX
 SG_ SPNConversionMethod1 : 0|1@1+ (1,0) [0|1] "" Vector__XXX
 SG_ FailureModeIdentifier1 : 0|5@1+ (1,0) [0|0] "" Vector__XXX
 SG_ MalfunctionIndicatorLampStatus : 0|2@1+ (1,0) [0|3] "" Vector__XXX
 SG_ RedStopLampState : 0|2@1+ (1,0) [0|3] "" Vector__XXX
 SG_ AmberWarningLampStatus : 0|2@1+ (1,0) [0|3] "" Vector__XXX
 SG_ ProtectLampStatus : 0|2@1+ (1,0) [0|3] "" Vector__XXX
 SG_ FlashMalfuncIndicatorLamp : 0|2@1+ (1,0) [0|3] "" Vector__XXX
 SG_ FlashAmberWarningLamp : 0|2@1+ (1,0) [0|3] "" Vector__XXX
 SG_ FailureModeIdentifier2 : 0|5@1+ (1,0) [0|0] "" Vector__XXX
 SG_ SPNConversionMethod5 : 0|1@1+ (1,0) [0|1] "" Vector__XXX
 SG_ SPNConversionMethod4 : 0|1@1+ (1,0) [0|1] "" Vector__XXX
 SG_ SPNConversionMethod3 : 0|1@1+ (1,0) [0|1] "" Vector__XXX
 SG_ SPNConversionMethod2 : 0|1@1+ (1,0) [0|1] "" Vector__XXX
 SG_ OccurenceCount5 : 0|7@1+ (1,0) [0|126] "" Vector__XXX
 SG_ OccurenceCount4 : 0|7@1+ (1,0) [0|126] "" Vector__XXX
 SG_ OccurenceCount3 : 0|7@1+ (1,0) [0|126] "" Vector__XXX
 SG_ OccurenceCount2 : 0|7@1+ (1,0) [0|126] "" Vector__XXX
 SG_ SPN5High : 0|3@1+ (1,0) [0|7] "" Vector__XXX
 SG_ SPN4High : 0|3@1+ (1,0) [0|7] "" Vector__XXX
 SG_ SPN3High : 0|3@1+ (1,0) [0|7] "" Vector__XXX
 SG_ SPN2High : 0|3@1+ (1,0) [0|7] "" Vector__XXX
 SG_ SPN1High : 0|3@1+ (1,0) [0|7] "" Vector__XXX
 SG_ SPN5 : 0|16@1+ (1,0) [0|65536] "" Vector__XXX
 SG_ SPN4 : 0|16@1+ (1,0) [0|65536] "" Vector__XXX
 SG_ SPN3 : 0|16@1+ (1,0) [0|65536] "" Vector__XXX
 SG_ SPN2 : 0|16@1+ (1,0) [0|65536] "" Vector__XXX
 SG_ FailureModeIdentifier5 : 0|5@1+ (1,0) [0|0] "" Vector__XXX
 SG_ FailureModeIdentifier4 : 0|5@1+ (1,0) [0|0] "" Vector__XXX
 SG_ FailureModeIdentifier3 : 0|5@1+ (1,0) [0|0] "" Vector__XXX
 SG_ OccurenceCount1 : 0|7@1+ (1,0) [0|126] "" Vector__XXX
 SG_ SPNConversionMethod1 : 0|1@1+ (1,0) [0|1] "" Vector__XXX
 SG_ FailureModeIdentifier1 : 0|5@1+ (1,0) [0|0] "" Vector__XXX
 SG_ SPN1 : 0|16@1+ (1,0) [0|65536] "" Vector__XXX
 SG_ FailureModeIdentifier2 : 0|5@1+ (1,0) [0|0] "" Vector__XXX
 SG_ SPNConversionMethod5 : 0|1@1+ (1,0) [0|1] "" Vector__XXX
 SG_ SPNConversionMethod4 : 0|1@1+ (1,0) [0|1] "" Vector__XXX
 SG_ SPNConversionMethod3 : 0|1@1+ (1,0) [0|1] "" Vector__XXX
 SG_ SPNConversionMethod2 : 0|1@1+ (1,0) [0|1] "" Vector__XXX
 SG_ OccurenceCount5 : 0|7@1+ (1,0) [0|126] "" Vector__XXX
 SG_ OccurenceCount4 : 0|7@1+ (1,0) [0|126] "" Vector__XXX
 SG_ OccurenceCount3 : 0|7@1+ (1,0) [0|126] "" Vector__XXX
 SG_ OccurenceCount2 : 0|7@1+ (1,0) [0|126] "" Vector__XXX
 SG_ SPN5High : 0|3@1+ (1,0) [0|7] "" Vector__XXX
 SG_ SPN4High : 0|3@1+ (1,0) [0|7] "" Vector__XXX
 SG_ SPN3High : 0|3@1+ (1,0) [0|7] "" Vector__XXX
 SG_ SPN2High : 0|3@1+ (1,0) [0|7] "" Vector__XXX
 SG_ SPN1High : 0|3@1+ (1,0) [0|7] "" Vector__XXX
 SG_ TransCurrentRange : 0|16@1+ (1,0) [0|255] "" Vector__XXX
 SG_ TransRqedRange : 0|16@1+ (1,0) [0|255] "" Vector__XXX
 SG_ TransCurrentGear : 0|8@1+ (1,-125) [-125|125] "" Vector__XXX
 SG_ TransActualGearRatio : 0|16@1+ (0.001,0) [0|64.255] "" Vector__XXX
 SG_ TransSelectedGear : 0|8@1+ (1,-125) [-125|125] "" Vector__XXX
 SG_ SrcAddrssOfCtrllngDvcFrTrnsCtrl : 0|8@1+ (1,0) [0|255] "" Vector__XXX
 SG_ TransInputShaftSpeed : 0|16@1+ (0.125,0) [0|8031.875] "rpm" Vector__XXX
 SG_ ProgressiveShiftDisable : 0|2@1+ (1,0) [0|3] "" Vector__XXX
 SG_ EngMomentaryOverspeedEnable : 0|2@1+ (1,0) [0|3] "" Vector__XXX
 SG_ PercentClutchSlip : 0|8@1+ (0.4,0) [0|100] "%" Vector__XXX
 SG_ TransOutputShaftSpeed : 0|16@1+ (0.125,0) [0|8031.875] "rpm" Vector__XXX
 SG_ TransShiftInProcess : 0|2@1+ (1,0) [0|3] "" Vector__XXX
 SG_ TorqueConverterLockupEngaged : 0|2@1+ (1,0) [0|3] "" Vector__XXX
 SG_ TransDrivelineEngaged : 0|2@1+ (1,0) [0|3] "" Vector__XXX
 SG_ ExhaustGasMass : 0|16@1+ (2,0) [0|128510] "kg" Vector__XXX
 SG_ AftrTrtmntIntakeDewPointMessage : 0|2@1+ (1,0) [0|3] "" Vector__XXX
 SG_ AftrTrtmntExhustDewPointMessage : 0|2@1+ (1,0) [0|3] "" Vector__XXX
 SG_ EstEngPrsticLossesPercentTorque : 0|8@1+ (1,-125) [-125|125] "%" Vector__XXX
 SG_ EngsDsrdOprtngSpdAsymmtryAdjstmn : 0|8@1+ (1,0) [0|250] "" Vector__XXX
 SG_ EngsDesiredOperatingSpeed : 0|16@1+ (0.125,0) [0|8031.875] "rpm" Vector__XXX
 SG_ NominalFrictionPercentTorque : 0|8@1+ (1,-125) [-125|125] "%" Vector__XXX
 SG_ ActMaxAvailEngPercentTorque : 0|8@1+ (0.4,0) [0|100] "%" Vector__XXX
 SG_ AccelPedalPos2 : 0|8@1+ (0.4,0) [0|100] "%" Vector__XXX
 SG_ VhclAccelerationRateLimitStatus : 0|2@1+ (1,0) [0|3] "" Vector__XXX
 SG_ EngPercentLoadAtCurrentSpeed : 0|8@1+ (1,0) [0|250] "%" Vector__XXX
 SG_ AccelPedal2LowIdleSwitch : 0|2@1+ (1,0) [0|3] "" Vector__XXX
 SG_ RoadSpeedLimitStatus : 0|2@1+ (1,0) [0|3] "" Vector__XXX
 SG_ AccelPedalKickdownSwitch : 0|2@1+ (1,0) [0|3] "" Vector__XXX
 SG_ AccelPedal1LowIdleSwitch : 0|2@1+ (1,0) [0|3] "" Vector__XXX
 SG_ RemoteAccelPedalPos : 0|8@1+ (0.4,0) [0|100] "%" Vector__XXX
 SG_ AccelPedalPos1 : 0|8@1+ (0.4,0) [0|100] "%" Vector__XXX
 SG_ EngDemandPercentTorque : 0|8@1+ (1,-125) [-125|125] "%" Vector__XXX
 SG_ EngStarterMode : 0|4@1+ (1,0) [0|15] "" Vector__XXX
 SG_ SrcAddrssOfCtrllngDvcForEngCtrl : 0|8@1+ (1,0) [0|255] "" Vector__XXX
 SG_ EngSpeed : 0|16@1+ (0.125,0) [0|8031.875] "rpm" Vector__XXX
 SG_ ActualEngPercentTorque : 0|8@1+ (1,-125) [-125|125] "%" Vector__XXX
 SG_ DriversDemandEngPercentTorque : 0|8@1+ (1,-125) [-125|125] "%" Vector__XXX
 SG_ EngTorqueMode : 0|4@1+ (1,0) [0|15] "" Vector__XXX
 SG_ SupportTSC1CtrlPurposeGroup4Of4 : 0|8@1+ (1,0) [0|255] "" Vector__XXX
 SG_ SupportVariableRateTSC1Message : 0|8@1+ (1,0) [0|255] "" Vector__XXX
 SG_ SupportTSC1CtrlPurposeGroup3Of4 : 0|8@1+ (1,0) [0|255] "" Vector__XXX
 SG_ SupportTSC1CtrlPurposeGroup2Of4 : 0|8@1+ (1,0) [0|255] "" Vector__XXX
 SG_ SupportTSC1CtrlPurposeGroup1Of4 : 0|8@1+ (1,0) [0|255] "" Vector__XXX
 SG_ EngDefaultTorqueLimit : 0|16@1+ (1,0) [0|64255] "Nm" Vector__XXX
 SG_ EngMomentOfInertia : 0|16@1+ (0.004,0) [0|257.02] "kg-m²" Vector__XXX
 SG_ EngExRngRqdSpdCtrlRngUpperLimit : 0|16@1+ (0.125,0) [0|8031.875] "rpm" Vector__XXX
 SG_ EngRqdTorqueCtrlRangeUpperLimit : 0|8@1+ (1,-125) [-125|125] "%" Vector__XXX
 SG_ EngRqdTorqueCtrlRangeLowerLimit : 0|8@1+ (1,-125) [-125|125] "%" Vector__XXX
 SG_ EngRqedSpeedCtrlRangeUpperLimit : 0|8@1+ (10,0) [0|2500] "rpm" Vector__XXX
 SG_ EngRqedSpeedCtrlRangeLowerLimit : 0|8@1+ (10,0) [0|2500] "rpm" Vector__XXX
 SG_ EngMxMomentaryOverrideTimeLimit : 0|8@1+ (0.1,0) [0|25] "s" Vector__XXX
 SG_ EngMxMmntaryOverrideSpeedPoint7 : 0|16@1+ (0.125,0) [0|8031.875] "rpm" Vector__XXX
 SG_ EngReferenceTorque : 0|16@1+ (1,0) [0|64255] "Nm" Vector__XXX
 SG_ EngSpeedAtHighIdlePoint6 : 0|16@1+ (0.125,0) [0|8031.875] "rpm" Vector__XXX
 SG_ EngGainOfEndspeedGovernor : 0|16@1+ (0.00078125,0) [0|50.2] "%/rpm" Vector__XXX
 SG_ EngPercentTorqueAtPoint5 : 0|8@1+ (1,-125) [-125|125] "%" Vector__XXX
 SG_ EngSpeedAtPoint5 : 0|16@1+ (0.125,0) [0|8031.875] "rpm" Vector__XXX
 SG_ EngPercentTorqueAtPoint4 : 0|8@1+ (1,-125) [-125|125] "%" Vector__XXX
 SG_ EngSpeedAtPoint4 : 0|16@1+ (0.125,0) [0|8031.875] "rpm" Vector__XXX
 SG_ EngPercentTorqueAtPoint3 : 0|8@1+ (1,-125) [-125|125] "%" Vector__XXX
 SG_ EngSpeedAtPoint3 : 0|16@1+ (0.125,0) [0|8031.875] "rpm" Vector__XXX
 SG_ EngPercentTorqueAtPoint2 : 0|8@1+ (1,-125) [-125|125] "%" Vector__XXX
 SG_ EngSpeedAtPoint2 : 0|16@1+ (0.125,0) [0|8031.875] "rpm" Vector__XXX
 SG_ EngPercentTorqueAtIdlePoint1 : 0|8@1+ (1,-125) [-125|125] "%" Vector__XXX
 SG_ EngSpeedAtIdlePoint1 : 0|16@1+ (0.125,0) [0|8031.875] "rpm" Vector__XXX
 SG_ EngShutdownOverrideSwitch : 0|2@1+ (1,0) [0|3] "" Vector__XXX
 SG_ EngTestModeSwitch : 0|2@1+ (1,0) [0|3] "" Vector__XXX
 SG_ EngIdleDecrementSwitch : 0|2@1+ (1,0) [0|3] "" Vector__XXX
 SG_ EngIdleIncrementSwitch : 0|2@1+ (1,0) [0|3] "" Vector__XXX
 SG_ CruiseCtrlStates : 0|3@1+ (1,0) [0|7] "" Vector__XXX
 SG_ PTOState : 0|5@1+ (1,0) [0|31] "" Vector__XXX
 SG_ CruiseCtrlSetSpeed : 0|8@1+ (1,0) [0|250] "km/h" Vector__XXX
 SG_ CruiseCtrlAccelerateSwitch : 0|2@1+ (1,0) [0|3] "" Vector__XXX
 SG_ CruiseCtrlResumeSwitch : 0|2@1+ (1,0) [0|3] "" Vector__XXX
 SG_ CruiseCtrlCoastSwitch : 0|2@1+ (1,0) [0|3] "" Vector__XXX
 SG_ CruiseCtrlSetSwitch : 0|2@1+ (1,0) [0|3] "" Vector__XXX
 SG_ ClutchSwitch : 0|2@1+ (1,0) [0|3] "" Vector__XXX
 SG_ BrakeSwitch : 0|2@1+ (1,0) [0|3] "" Vector__XXX
 SG_ CruiseCtrlEnableSwitch : 0|2@1+ (1,0) [0|3] "" Vector__XXX
 SG_ CruiseCtrlActive : 0|2@1+ (1,0) [0|3] "" Vector__XXX
 SG_ WheelBasedVehicleSpeed : 0|16@1+ (0.00390625,0) [0|250.996] "km/h" Vector__XXX
 SG_ CruiseCtrlPauseSwitch : 0|2@1+ (1,0) [0|3] "" Vector__XXX
 SG_ ParkingBrakeSwitch : 0|2@1+ (1,0) [0|3] "" Vector__XXX
 SG_ TwoSpeedAxleSwitch : 0|2@1+ (1,0) [0|3] "" Vector__XXX
 SG_ ECUType : 0|8@1+ (1,0) [0|255] "" Vector__XXX
 SG_ ECUSerialNumber : 0|8@1+ (1,0) [0|255] "" Vector__XXX
 SG_ ECUPartNumber : 0|8@1+ (1,0) [0|255] "" Vector__XXX
 SG_ ECULocation : 0|8@1+ (1,0) [0|255] "" Vector__XXX
 SG_ SoftwareID3 : 0|8@1+ (1,0) [0|255] "" Vector__XXX
 SG_ SoftwareID2 : 0|8@1+ (1,0) [0|255] "" Vector__XXX
 SG_ SoftwareID1 : 0|8@1+ (1,0) [0|255] "" Vector__XXX
 SG_ NmbrOfSftwrIdentificationFields : 0|8@1+ (1,0) [0|250] "steps" Vector__XXX
 SG_ ECUType : 0|8@1+ (1,0) [0|255] "" Vector__XXX
 SG_ ECUSerialNumber : 0|8@1+ (1,0) [0|255] "" Vector__XXX
 SG_ ECUPartNumber : 0|8@1+ (1,0) [0|255] "" Vector__XXX
 SG_ ECULocation : 0|8@1+ (1,0) [0|255] "" Vector__XXX
 SG_ TrnsShftSlctorDisplayModeSwitch : 0|2@1+ (1,0) [0|3] "" Vector__XXX
 SG_ TransMode4 : 0|2@1+ (1,0) [0|3] "" Vector__XXX
 SG_ TransMode3 : 0|2@1+ (1,0) [0|3] "" Vector__XXX
 SG_ TransMode2 : 0|2@1+ (1,0) [0|3] "" Vector__XXX
 SG_ TransMode1 : 0|2@1+ (1,0) [0|3] "" Vector__XXX
 SG_ DisengageDiffLockRqCentralRear : 0|2@1+ (1,0) [0|3] "" Vector__XXX
 SG_ DisengageDiffLockRqCentralFront : 0|2@1+ (1,0) [0|3] "" Vector__XXX
 SG_ DisengageDiffLockRqCentral : 0|2@1+ (1,0) [0|3] "" Vector__XXX
 SG_ DisengageDiffLockRqRearAxle2 : 0|2@1+ (1,0) [0|3] "" Vector__XXX
 SG_ DisengageDiffLockRqRearAxle1 : 0|2@1+ (1,0) [0|3] "" Vector__XXX
 SG_ DisengageDiffLockRqFrontAxle2 : 0|2@1+ (1,0) [0|3] "" Vector__XXX
 SG_ DisengageDiffLockRqFrontAxle1 : 0|2@1+ (1,0) [0|3] "" Vector__XXX
 SG_ TransRqedGear : 0|8@1+ (1,-125) [-125|125] "" Vector__XXX
 SG_ RqedPercentClutchSlip : 0|8@1+ (0.4,0) [0|100] "%" Vector__XXX
 SG_ DisengageDrivelineRq : 0|2@1+ (1,0) [0|3] "" Vector__XXX
 SG_ TorqueConverterLockupDisableRq : 0|2@1+ (1,0) [0|3] "" Vector__XXX
 SG_ TransGearShiftInhibitRq : 0|2@1+ (1,0) [0|3] "" Vector__XXX
 SG_ ControlPurpose : 0|5@1+ (1,0) [0|31] "" Vector__XXX
 SG_ TransmissionRate : 0|3@1+ (1,0) [0|7] "" Vector__XXX
 SG_ EngRqedTorque_TorqueLimit : 0|8@1+ (1,-125) [-125|125] "%" Vector__XXX
 SG_ EngRqedSpeed_SpeedLimit : 0|16@1+ (0.125,0) [0|8031.875] "rpm" Vector__XXX
 SG_ OverrideCtrlModePriority : 0|2@1+ (1,0) [0|3] "" Vector__XXX
 SG_ EngRqedSpeedCtrlConditions : 0|2@1+ (1,0) [0|3] "" Vector__XXX
 SG_ EngOverrideCtrlMode : 0|2@1+ (1,0) [0|3] "" Vector__XXX
 SG_ LocalHourOffset : 0|8@1+ (1,-125) [-125|125] "hr" Vector__XXX
 SG_ LocalMinuteOffset : 0|8@1+ (1,-125) [-125|125] "mins" Vector__XXX
 SG_ Year : 0|8@1+ (1,1985) [1985|2235] "years" Vector__XXX
 SG_ Day : 0|8@1+ (0.25,0) [0|62.5] "days" Vector__XXX
 SG_ Month : 0|8@1+ (1,0) [0|250] "months" Vector__XXX
 SG_ Hours : 0|8@1+ (1,0) [0|250] "hr" Vector__XXX
 SG_ Minutes : 0|8@1+ (1,0) [0|250] "mins" Vector__XXX
 SG_ Seconds : 0|8@1+ (0.25,0) [0|62.5] "s" Vector__XXX
 SG_ ControlPurpose : 0|5@1+ (1,0) [0|31] "" Vector__XXX
 SG_ TransmissionRate : 0|3@1+ (1,0) [0|7] "" Vector__XXX
 SG_ EngRqedTorque_TorqueLimit : 0|8@1+ (1,-125) [-125|125] "%" Vector__XXX
 SG_ EngRqedSpeed_SpeedLimit : 0|16@1+ (0.125,0) [0|8031.875] "rpm" Vector__XXX
 SG_ OverrideCtrlModePriority : 0|2@1+ (1,0) [0|3] "" Vector__XXX
 SG_ EngRqedSpeedCtrlConditions : 0|2@1+ (1,0) [0|3] "" Vector__XXX
 SG_ EngOverrideCtrlMode : 0|2@1+ (1,0) [0|3] "" Vector__XXX
 SG_ PercentTorqueAtPeakTorquePoint5 : 0|8@1+ (1,-125) [-125|125] "%" Vector__XXX
 SG_ ReferenceRetarderTorque : 0|16@1+ (1,0) [0|64255] "Nm" Vector__XXX
 SG_ RetarderSpeedAtPeakTorquePoint5 : 0|16@1+ (0.125,0) [0|8031.875] "rpm" Vector__XXX
 SG_ PercentTorqueAtPoint4 : 0|8@1+ (1,-125) [-125|125] "%" Vector__XXX
 SG_ RetarderSpeedAtPoint4 : 0|16@1+ (0.125,0) [0|8031.875] "rpm" Vector__XXX
 SG_ PercentTorqueAtPoint3 : 0|8@1+ (1,-125) [-125|125] "%" Vector__XXX
 SG_ RetarderSpeedAtPoint3 : 0|16@1+ (0.125,0) [0|8031.875] "rpm" Vector__XXX
 SG_ PercentTorqueAtMaxSpeedPoint2 : 0|8@1+ (1,-125) [-125|125] "%" Vector__XXX
 SG_ MaxRetarderSpeedPoint2 : 0|16@1+ (0.125,0) [0|8031.875] "rpm" Vector__XXX
 SG_ PercentTorqueAtIdlePoint1 : 0|8@1+ (1,-125) [-125|125] "%" Vector__XXX
 SG_ RetarderSpeedAtIdlePoint1 : 0|16@1+ (0.125,0) [0|8031.875] "rpm" Vector__XXX
 SG_ RetarderCtrlMethod : 0|8@1+ (1,0) [0|250] "steps" Vector__XXX
 SG_ RetarderLocation : 0|4@1+ (1,0) [0|15] "" Vector__XXX
 SG_ RetarderType : 0|4@1+ (1,0) [0|15] "" Vector__XXX
 SG_ RetarderSelectionNonEng : 0|8@1+ (0.4,0) [0|100] "%" Vector__XXX
 SG_ ActlMxAvlblRtarderPercentTorque : 0|8@1+ (1,-125) [-125|125] "%" Vector__XXX
 SG_ DrvrsDmandRetarderPercentTorque : 0|8@1+ (1,-125) [-125|125] "%" Vector__XXX
 SG_ SrcAddrssOfCtrllngDvcFrRtrdrCtrl : 0|8@1+ (1,0) [0|255] "" Vector__XXX
 SG_ RetarderRqingBrakeLight : 0|2@1+ (1,0) [0|3] "" Vector__XXX
 SG_ EngCoolantLoadIncrease : 0|2@1+ (1,0) [0|3] "" Vector__XXX
 SG_ IntendedRetarderPercentTorque : 0|8@1+ (1,-125) [-125|125] "%" Vector__XXX
 SG_ ActualRetarderPercentTorque : 0|8@1+ (1,-125) [-125|125] "%" Vector__XXX
 SG_ RetarderEnableShiftAssistSwitch : 0|2@1+ (1,0) [0|3] "" Vector__XXX
 SG_ RetarderEnableBrakeAssistSwitch : 0|2@1+ (1,0) [0|3] "" Vector__XXX
 SG_ RetarderTorqueMode : 0|4@1+ (1,0) [0|15] "" Vector__XXX
 SG_ ControlPurpose : 0|5@1+ (1,0) [0|31] "" Vector__XXX
 SG_ TransmissionRate : 0|3@1+ (1,0) [0|7] "" Vector__XXX
 SG_ EngRqedTorque_TorqueLimit : 0|8@1+ (1,-125) [-125|125] "%" Vector__XXX
 SG_ EngRqedSpeed_SpeedLimit : 0|16@1+ (0.125,0) [0|8031.875] "rpm" Vector__XXX
 SG_ OverrideCtrlModePriority : 0|2@1+ (1,0) [0|3] "" Vector__XXX
 SG_ EngRqedSpeedCtrlConditions : 0|2@1+ (1,0) [0|3] "" Vector__XXX
 SG_ EngOverrideCtrlMode : 0|2@1+ (1,0) [0|3] "" Vector__XXX
 SG_ ControlPurpose : 0|5@1+ (1,0) [0|31] "" Vector__XXX
 SG_ TransmissionRate : 0|3@1+ (1,0) [0|7] "" Vector__XXX
 SG_ EngRqedTorque_TorqueLimit : 0|8@1+ (1,-125) [-125|125] "%" Vector__XXX
 SG_ EngRqedSpeed_SpeedLimit : 0|16@1+ (0.125,0) [0|8031.875] "rpm" Vector__XXX
 SG_ OverrideCtrlModePriority : 0|2@1+ (1,0) [0|3] "" Vector__XXX
 SG_ EngRqedSpeedCtrlConditions : 0|2@1+ (1,0) [0|3] "" Vector__XXX
 SG_ EngOverrideCtrlMode : 0|2@1+ (1,0) [0|3] "" Vector__XXX
 SG_ ControlPurpose : 0|5@1+ (1,0) [0|31] "" Vector__XXX
 SG_ TransmissionRate : 0|3@1+ (1,0) [0|7] "" Vector__XXX
 SG_ EngRqedTorque_TorqueLimit : 0|8@1+ (1,-125) [-125|125] "%" Vector__XXX
 SG_ EngRqedSpeed_SpeedLimit : 0|16@1+ (0.125,0) [0|8031.875] "rpm" Vector__XXX
 SG_ OverrideCtrlModePriority : 0|2@1+ (1,0) [0|3] "" Vector__XXX
 SG_ EngRqedSpeedCtrlConditions : 0|2@1+ (1,0) [0|3] "" Vector__XXX
 SG_ EngOverrideCtrlMode : 0|2@1+ (1,0) [0|3] "" Vector__XXX
 SG_ ControlPurpose : 0|5@1+ (1,0) [0|31] "" Vector__XXX
 SG_ TransmissionRate : 0|3@1+ (1,0) [0|7] "" Vector__XXX
 SG_ EngRqedTorque_TorqueLimit : 0|8@1+ (1,-125) [-125|125] "%" Vector__XXX
 SG_ EngRqedSpeed_SpeedLimit : 0|16@1+ (0.125,0) [0|8031.875] "rpm" Vector__XXX
 SG_ OverrideCtrlModePriority : 0|2@1+ (1,0) [0|3] "" Vector__XXX
 SG_ EngRqedSpeedCtrlConditions : 0|2@1+ (1,0) [0|3] "" Vector__XXX
 SG_ EngOverrideCtrlMode : 0|2@1+ (1,0) [0|3] "" Vector__XXX
 SG_ ControlPurpose : 0|5@1+ (1,0) [0|31] "" Vector__XXX
 SG_ TransmissionRate : 0|3@1+ (1,0) [0|7] "" Vector__XXX
 SG_ EngRqedTorque_TorqueLimit : 0|8@1+ (1,-125) [-125|125] "%" Vector__XXX
 SG_ EngRqedSpeed_SpeedLimit : 0|16@1+ (0.125,0) [0|8031.875] "rpm" Vector__XXX
 SG_ OverrideCtrlModePriority : 0|2@1+ (1,0) [0|3] "" Vector__XXX
 SG_ EngRqedSpeedCtrlConditions : 0|2@1+ (1,0) [0|3] "" Vector__XXX
 SG_ EngOverrideCtrlMode : 0|2@1+ (1,0) [0|3] "" Vector__XXX
 SG_ EngCoolantFilterDiffPress : 0|8@1+ (0.5,0) [0|125] "kPa" Vector__XXX
 SG_ EngExhaustGasTemp : 0|16@1+ (0.03125,-273) [-273|1735] "deg" Vector__XXX
 SG_ EngAirFilter1DiffPress : 0|8@1+ (0.05,0) [0|12.5] "kPa" Vector__XXX
 SG_ EngAirInletPress : 0|8@1+ (2,0) [0|500] "kPa" Vector__XXX
 SG_ EngIntakeManifold1Temp : 0|8@1+ (1,-40) [-40|210] "deg" Vector__XXX
 SG_ EngTurboBoostPress : 0|8@1+ (2,0) [0|500] "kPa" Vector__XXX
 SG_ EngParticulateTrapInletPress : 0|8@1+ (0.5,0) [0|125] "kPa" Vector__XXX
 SG_ EngTotalRevolutions : 0|32@1+ (1000,0) [0|4211081215000] "r" Vector__XXX
 SG_ EngTotalHoursOfOperation : 0|32@1+ (0.05,0) [0|210554060.75] "hr" Vector__XXX
 SG_ CargoWeight : 0|16@1+ (2,0) [0|128510] "kg" Vector__XXX
 SG_ TrailerWeight : 0|16@1+ (2,0) [0|128510] "kg" Vector__XXX
 SG_ AxleWeight : 0|16@1+ (0.5,0) [0|32127.5] "kg" Vector__XXX
 SG_ AxleLocation : 0|8@1+ (1,0) [0|255] "" Vector__XXX
 SG_ VehicleIdentificationNumber : 0|8@1+ (1,0) [0|255] "" Vector__XXX
 SG_ HighResolutionTripDistance : 0|32@1+ (5,0) [0|21055406] "km" Vector__XXX
 SG_ HghRslutionTotalVehicleDistance : 0|32@1+ (5,0) [0|21055406] "km" Vector__XXX
 SG_ LongitudinalAcceleration : 0|8@1+ (0.1,-12.5) [-12.5|12.5] "m/s²" Vector__XXX
 SG_ LateralAcceleration : 0|16@1+ (0.000488281,-15.687) [-15.687|15.687] "m/s²" Vector__XXX
 SG_ YawRate : 0|16@1+ (0.00012207,-3.92) [-3.92|3.92] "rad/s" Vector__XXX
 SG_ SteerWheelAngleSensorType : 0|2@1+ (1,0) [0|3] "" Vector__XXX
 SG_ SteerWheelTurnCounter : 0|6@1+ (1,-32) [-32|29] "turns" Vector__XXX
 SG_ SteerWheelAngle : 0|16@1+ (0.000976563,-31.374) [-31.374|31.374] "rad" Vector__XXX
 SG_ YCBrakeCtrlActive : 0|2@1+ (1,0) [0|3] "" Vector__XXX
 SG_ YCEngCtrlActive : 0|2@1+ (1,0) [0|3] "" Vector__XXX
 SG_ ROPBrakeCtrlActive : 0|2@1+ (1,0) [0|3] "" Vector__XXX
 SG_ ROPEngCtrlActive : 0|2@1+ (1,0) [0|3] "" Vector__XXX
 SG_ VDCBrakeLightRq : 0|2@1+ (1,0) [0|3] "" Vector__XXX
 SG_ VDCFullyOperational : 0|2@1+ (1,0) [0|3] "" Vector__XXX
 SG_ VDCInformationSignal : 0|2@1+ (1,0) [0|3] "" Vector__XXX
 SG_ TotalVehicleDistance : 0|32@1+ (0.125,0) [0|526385151.9] "km" Vector__XXX
 SG_ TripDistance : 0|32@1+ (0.125,0) [0|526385151.9] "km" Vector__XXX
 SG_ ReferenceTirePressSetting : 0|8@1+ (8,0) [0|2000] "kPa" Vector__XXX
 SG_ TireLocation : 0|8@1+ (1,0) [0|255] "" Vector__XXX
 SG_ ReferenceTirePress : 0|8@1+ (8,0) [0|2000] "kPa" Vector__XXX
 SG_ TireLocation : 0|8@1+ (1,0) [0|255] "" Vector__XXX
 SG_ TireTemp_21 : 0|16@1+ (0.03125,-273) [-273|1735] "deg" Vector__XXX
 SG_ TireTemp_20 : 0|16@1+ (0.03125,-273) [-273|1735] "deg" Vector__XXX
 SG_ TireTemp_11 : 0|16@1+ (0.03125,-273) [-273|1735] "deg" Vector__XXX
 SG_ TireTemp_10 : 0|16@1+ (0.03125,-273) [-273|1735] "deg" Vector__XXX
 SG_ TireTemp_01 : 0|16@1+ (0.03125,-273) [-273|1735] "deg" Vector__XXX
 SG_ TireTemp_00 : 0|16@1+ (0.03125,-273) [-273|1735] "deg" Vector__XXX
 SG_ TirePressThresholdDetection_21 : 0|3@1+ (1,0) [0|7] "" Vector__XXX
 SG_ TirePressThresholdDetection_20 : 0|3@1+ (1,0) [0|7] "" Vector__XXX
 SG_ TirePressThresholdDetection_11 : 0|3@1+ (1,0) [0|7] "" Vector__XXX
 SG_ TirePressThresholdDetection_10 : 0|3@1+ (1,0) [0|7] "" Vector__XXX
 SG_ TirePressThresholdDetection_01 : 0|3@1+ (1,0) [0|7] "" Vector__XXX
 SG_ TirePressThresholdDetection_00 : 0|3@1+ (1,0) [0|7] "" Vector__XXX
 SG_ TirePress_21 : 0|8@1+ (4,0) [0|1000] "kPa" Vector__XXX
 SG_ TirePress_20 : 0|8@1+ (4,0) [0|1000] "kPa" Vector__XXX
 SG_ TirePress_11 : 0|8@1+ (4,0) [0|1000] "kPa" Vector__XXX
 SG_ TirePress_10 : 0|8@1+ (4,0) [0|1000] "kPa" Vector__XXX
 SG_ TirePress_01 : 0|8@1+ (4,0) [0|1000] "kPa" Vector__XXX
 SG_ TirePress_00 : 0|8@1+ (4,0) [0|1000] "kPa" Vector__XXX
 SG_ TireAirLeakageRate_21 : 0|16@1+ (0.1,0) [0|6425.5] "Pa/s" Vector__XXX
 SG_ TireAirLeakageRate_20 : 0|16@1+ (0.1,0) [0|6425.5] "Pa/s" Vector__XXX
 SG_ TireAirLeakageRate_11 : 0|16@1+ (0.1,0) [0|6425.5] "Pa/s" Vector__XXX
 SG_ TireAirLeakageRate_10 : 0|16@1+ (0.1,0) [0|6425.5] "Pa/s" Vector__XXX
 SG_ TireAirLeakageRate_01 : 0|16@1+ (0.1,0) [0|6425.5] "Pa/s" Vector__XXX
 SG_ TireAirLeakageRate_00 : 0|16@1+ (0.1,0) [0|6425.5] "Pa/s" Vector__XXX
 SG_ CTIWheelSensorStatus_21 : 0|2@1+ (1,0) [0|3] "" Vector__XXX
 SG_ CTIWheelSensorStatus_20 : 0|2@1+ (1,0) [0|3] "" Vector__XXX
 SG_ CTIWheelSensorStatus_11 : 0|2@1+ (1,0) [0|3] "" Vector__XXX
 SG_ CTIWheelSensorStatus_10 : 0|2@1+ (1,0) [0|3] "" Vector__XXX
 SG_ CTIWheelSensorStatus_01 : 0|2@1+ (1,0) [0|3] "" Vector__XXX
 SG_ CTIWheelSensorStatus_00 : 0|2@1+ (1,0) [0|3] "" Vector__XXX
 SG_ CTIWheelEndElectricalFault_21 : 0|2@1+ (1,0) [0|3] "" Vector__XXX
 SG_ CTIWheelEndElectricalFault_20 : 0|2@1+ (1,0) [0|3] "" Vector__XXX
 SG_ CTIWheelEndElectricalFault_11 : 0|2@1+ (1,0) [0|3] "" Vector__XXX
 SG_ CTIWheelEndElectricalFault_10 : 0|2@1+ (1,0) [0|3] "" Vector__XXX
 SG_ CTIWheelEndElectricalFault_01 : 0|2@1+ (1,0) [0|3] "" Vector__XXX
 SG_ CTIWheelEndElectricalFault_00 : 0|2@1+ (1,0) [0|3] "" Vector__XXX
 SG_ CTITireStatus_21 : 0|2@1+ (1,0) [0|3] "" Vector__XXX
 SG_ CTITireStatus_20 : 0|2@1+ (1,0) [0|3] "" Vector__XXX
 SG_ CTITireStatus_11 : 0|2@1+ (1,0) [0|3] "" Vector__XXX
 SG_ CTITireStatus_10 : 0|2@1+ (1,0) [0|3] "" Vector__XXX
 SG_ CTITireStatus_01 : 0|2@1+ (1,0) [0|3] "" Vector__XXX
 SG_ CTITireStatus_00 : 0|2@1+ (1,0) [0|3] "" Vector__XXX
 SG_ TireLocation : 0|8@1+ (1,0) [0|255] "" Vector__XXX
 SG_ LocalHourOffset : 0|8@1+ (1,-125) [-125|125] "hr" Vector__XXX
 SG_ LocalMinuteOffset : 0|8@1+ (1,-125) [-125|125] "mins" Vector__XXX
 SG_ Year : 0|8@1+ (1,1985) [1985|2235] "years" Vector__XXX
 SG_ Day : 0|8@1+ (0.25,0) [0|62.5] "days" Vector__XXX
 SG_ Month : 0|8@1+ (1,0) [0|250] "months" Vector__XXX
 SG_ Hours : 0|8@1+ (1,0) [0|250] "hr" Vector__XXX
 SG_ Minutes : 0|8@1+ (1,0) [0|250] "mins" Vector__XXX
 SG_ Seconds : 0|8@1+ (0.25,0) [0|62.5] "s" Vector__XXX
 SG_ TachographVehicleSpeed : 0|16@1+ (0.00390625,0) [0|250.996] "km/h" Vector__XXX
 SG_ TachographOutputShaftSpeed : 0|16@1+ (0.125,0) [0|8031.875] "rpm" Vector__XXX
 SG_ DirectionIndicator : 0|2@1+ (1,0) [0|3] "" Vector__XXX
 SG_ TachographPerformance : 0|2@1+ (1,0) [0|3] "" Vector__XXX
 SG_ HandlingInformation : 0|2@1+ (1,0) [0|3] "" Vector__XXX
 SG_ SystemEvent : 0|2@1+ (1,0) [0|3] "" Vector__XXX
 SG_ DriverCardDriver2 : 0|2@1+ (1,0) [0|3] "" Vector__XXX
 SG_ Driver2TimeRelatedStates : 0|4@1+ (1,0) [0|15] "" Vector__XXX
 SG_ Overspeed : 0|2@1+ (1,0) [0|3] "" Vector__XXX
 SG_ DriverCardDriver1 : 0|2@1+ (1,0) [0|3] "" Vector__XXX
 SG_ Driver1TimeRelatedStates : 0|4@1+ (1,0) [0|15] "" Vector__XXX
 SG_ DriveRecognize : 0|2@1+ (1,0) [0|3] "" Vector__XXX
 SG_ Driver2WorkingState : 0|3@1+ (1,0) [0|7] "" Vector__XXX
 SG_ Driver1WorkingState : 0|3@1+ (1,0) [0|7] "" Vector__XXX
 SG_ TransTorqueLimit : 0|16@1+ (1,0) [0|64255] "Nm" Vector__XXX
 SG_ TransGearRatio : 0|16@1+ (0.001,0) [0|64.255] "" Vector__XXX
 SG_ NumberOfForwardGearRatios : 0|8@1+ (1,0) [0|250] "" Vector__XXX
 SG_ NumberOfReverseGearRatios : 0|8@1+ (1,0) [0|250] "" Vector__XXX
 SG_ EngTurboOilLevelSwitch : 0|2@1+ (1,0) [0|3] "" Vector__XXX
 SG_ EngTurbo1Speed : 0|16@1+ (4,0) [0|257020] "rpm" Vector__XXX
 SG_ EngTurboLubeOilPress1 : 0|8@1+ (4,0) [0|1000] "kPa" Vector__XXX
 SG_ AirSuspensionSupplyPressRq : 0|8@1+ (8,0) [0|2000] "kPa" Vector__XXX
 SG_ AuxEquipmentSupplyPressRq : 0|8@1+ (8,0) [0|2000] "kPa" Vector__XXX
 SG_ ServiceBrakeAirPressRqCircuit2 : 0|8@1+ (8,0) [0|2000] "kPa" Vector__XXX
 SG_ ServiceBrakeAirPressRqCircuit1 : 0|8@1+ (8,0) [0|2000] "kPa" Vector__XXX
 SG_ ParkingAnd_OrTrailerAirPressRq : 0|8@1+ (8,0) [0|2000] "kPa" Vector__XXX
 SG_ PneumaticSupplyPressRq : 0|8@1+ (8,0) [0|2000] "kPa" Vector__XXX
 SG_ SoftwareID3 : 0|8@1+ (1,0) [0|255] "" Vector__XXX
 SG_ SoftwareID2 : 0|8@1+ (1,0) [0|255] "" Vector__XXX
 SG_ SoftwareID1 : 0|8@1+ (1,0) [0|255] "" Vector__XXX
 SG_ NmbrOfSftwrIdentificationFields : 0|8@1+ (1,0) [0|250] "steps" Vector__XXX
 SG_ EngOverspeedTest : 0|2@1+ (1,0) [0|3] "" Vector__XXX
 SG_ EngAirShutoffCmdStatus : 0|2@1+ (1,0) [0|3] "" Vector__XXX
 SG_ EngAlarmOutputCmdStatus : 0|2@1+ (1,0) [0|3] "" Vector__XXX
 SG_ EngAlarmAcknowledge : 0|2@1+ (1,0) [0|3] "" Vector__XXX
 SG_ EngProtectionSystemConfig : 0|2@1+ (1,0) [0|3] "" Vector__XXX
 SG_ EngProtectionSystemTimerState : 0|2@1+ (1,0) [0|3] "" Vector__XXX
 SG_ EngPrtectionSystemTimerOverride : 0|2@1+ (1,0) [0|3] "" Vector__XXX
 SG_ EngPrtctnSystmApprchingShutdown : 0|2@1+ (1,0) [0|3] "" Vector__XXX
 SG_ EngPrtctionSystemHasShutdownEng : 0|2@1+ (1,0) [0|3] "" Vector__XXX
 SG_ EngWaitToStartLamp : 0|2@1+ (1,0) [0|3] "" Vector__XXX
 SG_ RefrigerantHighPressSwitch : 0|2@1+ (1,0) [0|3] "" Vector__XXX
 SG_ RefrigerantLowPressSwitch : 0|2@1+ (1,0) [0|3] "" Vector__XXX
 SG_ A_CHighPressFanSwitch : 0|2@1+ (1,0) [0|3] "" Vector__XXX
 SG_ EngIdleShutdownTimerFunction : 0|2@1+ (1,0) [0|3] "" Vector__XXX
 SG_ EngIdleShutdownTimerState : 0|2@1+ (1,0) [0|3] "" Vector__XXX
 SG_ EngIdleShutdownTimerOverride : 0|2@1+ (1,0) [0|3] "" Vector__XXX
 SG_ EngIdleShutdownDriverAlertMode : 0|2@1+ (1,0) [0|3] "" Vector__XXX
 SG_ EngIdleShutdownHasShutdownEng : 0|2@1+ (1,0) [0|3] "" Vector__XXX
 SG_ ServiceComponentIdentificationB : 0|8@1+ (1,0) [0|250] "ID" Vector__XXX
 SG_ ServiceComponentIdentificationA : 0|8@1+ (1,0) [0|250] "ID" Vector__XXX
 SG_ SrvceDelay_OperationalTimeBased : 0|16@1+ (1,-31873) [-31873|32128] "hr" Vector__XXX
 SG_ ServiceDelay_CalendarTimeBased : 0|8@1+ (1,-125) [-125|125] "weeks" Vector__XXX
 SG_ ServiceDistance : 0|16@1+ (5,-159365) [-159365|160640] "km" Vector__XXX
 SG_ ServiceComponentIdentification : 0|8@1+ (1,0) [0|250] "ID" Vector__XXX
 SG_ HydRetarderOilTemp : 0|8@1+ (1,-40) [-40|210] "deg" Vector__XXX
 SG_ HydRetarderPress : 0|8@1+ (16,0) [0|4000] "kPa" Vector__XXX
 SG_ EngBuildHoursReset : 0|2@1+ (1,0) [0|3] "" Vector__XXX
 SG_ ServiceComponentIdentification : 0|8@1+ (1,0) [0|250] "ID" Vector__XXX
 SG_ TripGroup2Proprietary : 0|2@1+ (1,0) [0|3] "" Vector__XXX
 SG_ TripGroup1 : 0|2@1+ (1,0) [0|3] "" Vector__XXX
 SG_ PercentTorqueAtPeakTorquePoint5 : 0|8@1+ (1,-125) [-125|125] "%" Vector__XXX
 SG_ ReferenceRetarderTorque : 0|16@1+ (1,0) [0|64255] "Nm" Vector__XXX
 SG_ RetarderSpeedAtPeakTorquePoint5 : 0|16@1+ (0.125,0) [0|8031.875] "rpm" Vector__XXX
 SG_ PercentTorqueAtPoint4 : 0|8@1+ (1,-125) [-125|125] "%" Vector__XXX
 SG_ RetarderSpeedAtPoint4 : 0|16@1+ (0.125,0) [0|8031.875] "rpm" Vector__XXX
 SG_ PercentTorqueAtPoint3 : 0|8@1+ (1,-125) [-125|125] "%" Vector__XXX
 SG_ RetarderSpeedAtPoint3 : 0|16@1+ (0.125,0) [0|8031.875] "rpm" Vector__XXX
 SG_ PercentTorqueAtMaxSpeedPoint2 : 0|8@1+ (1,-125) [-125|125] "%" Vector__XXX
 SG_ MaxRetarderSpeedPoint2 : 0|16@1+ (0.125,0) [0|8031.875] "rpm" Vector__XXX
 SG_ PercentTorqueAtIdlePoint1 : 0|8@1+ (1,-125) [-125|125] "%" Vector__XXX
 SG_ RetarderSpeedAtIdlePoint1 : 0|16@1+ (0.125,0) [0|8031.875] "rpm" Vector__XXX
 SG_ RetarderCtrlMethod : 0|8@1+ (1,0) [0|250] "steps" Vector__XXX
 SG_ RetarderLocation : 0|4@1+ (1,0) [0|15] "" Vector__XXX
 SG_ RetarderType : 0|4@1+ (1,0) [0|15] "" Vector__XXX
 SG_ OperatorPTOMemorySelectSwitch : 0|2@1+ (1,0) [0|3] "" Vector__XXX
 SG_ EngPTOAccelerateSwitch : 0|2@1+ (1,0) [0|3] "" Vector__XXX
 SG_ EngPTOResumeSwitch : 0|2@1+ (1,0) [0|3] "" Vector__XXX
 SG_ EngPTOCoast_DecelerateSwitch : 0|2@1+ (1,0) [0|3] "" Vector__XXX
 SG_ EngPTOSetSwitch : 0|2@1+ (1,0) [0|3] "" Vector__XXX
 SG_ EngRmtPTOVriableSpeedCtrlSwitch : 0|2@1+ (1,0) [0|3] "" Vector__XXX
 SG_ EngRmtPTOPrprgrmmdSpdCtrlSwitch : 0|2@1+ (1,0) [0|3] "" Vector__XXX
 SG_ EngPTOEnableSwitch : 0|2@1+ (1,0) [0|3] "" Vector__XXX
 SG_ PowerTakeoffSetSpeed : 0|16@1+ (0.125,0) [0|8031.875] "rpm" Vector__XXX
 SG_ PowerTakeoffSpeed : 0|16@1+ (0.125,0) [0|8031.875] "rpm" Vector__XXX
 SG_ PowerTakeoffOilTemp : 0|8@1+ (1,-40) [-40|210] "deg" Vector__XXX
 SG_ RmtPTOPrprgrmmdSpeedCtrlSwitch2 : 0|2@1+ (1,0) [0|3] "" Vector__XXX
 SG_ AuxInputIgnoreSwitch : 0|2@1+ (1,0) [0|3] "" Vector__XXX
 SG_ EngAverageFuelEconomy : 0|16@1+ (0.001953125,0) [0|125.5] "km/L" Vector__XXX
 SG_ EngInstantaneousFuelEconomy : 0|16@1+ (0.001953125,0) [0|125.5] "km/L" Vector__XXX
 SG_ EngFuelRate : 0|16@1+ (0.05,0) [0|3212.75] "L/h" Vector__XXX
 SG_ EngThrottlePos : 0|8@1+ (0.4,0) [0|100] "%" Vector__XXX
 SG_ EngTotalFuelUsed : 0|32@1+ (0.5,0) [0|2105540607.5] "L" Vector__XXX
 SG_ EngTripFuel : 0|32@1+ (0.5,0) [0|2105540607.5] "L" Vector__XXX
 SG_ FanSpeed : 0|16@1+ (0.125,0) [0|8031.875] "rpm" Vector__XXX
 SG_ FanDriveState : 0|4@1+ (1,0) [0|15] "" Vector__XXX
 SG_ EstPercentFanSpeed : 0|8@1+ (0.4,0) [0|100] "%" Vector__XXX
 SG_ TransRqedGearFeedback : 0|8@1+ (1,-125) [-125|125] "" Vector__XXX
 SG_ TransMode1Indicator : 0|2@1+ (1,0) [0|3] "" Vector__XXX
 SG_ TransMode2Indicator : 0|2@1+ (1,0) [0|3] "" Vector__XXX
 SG_ TransMode3Indicator : 0|2@1+ (1,0) [0|3] "" Vector__XXX
 SG_ TransMode4Indicator : 0|2@1+ (1,0) [0|3] "" Vector__XXX
 SG_ TransShiftInhibitIndicator : 0|2@1+ (1,0) [0|3] "" Vector__XXX
 SG_ TransEngCrankEnable : 0|2@1+ (1,0) [0|3] "" Vector__XXX
 SG_ ActiveShiftConsoleIndicator : 0|2@1+ (1,0) [0|3] "" Vector__XXX
 SG_ TransReadyForBrakeRelease : 0|2@1+ (1,0) [0|3] "" Vector__XXX
 SG_ TransRqedRangeDisplayFlashState : 0|2@1+ (1,0) [0|3] "" Vector__XXX
 SG_ TransRqedRangeDisplayBlankState : 0|2@1+ (1,0) [0|3] "" Vector__XXX
 SG_ EngExhaustGasRecirculationTemp : 0|16@1+ (0.03125,-273) [-273|1735] "deg" Vector__XXX
 SG_ EngExhstGsRcirculationDiffPress : 0|16@1+ (0.0078125,-250) [-250|251.99] "kPa" Vector__XXX
 SG_ EngECUTemp : 0|16@1+ (0.03125,-273) [-273|1735] "deg" Vector__XXX
 SG_ EngOilTemp2 : 0|16@1+ (0.03125,-273) [-273|1735] "deg" Vector__XXX
 SG_ EngIntercoolerThermostatOpening : 0|8@1+ (0.4,0) [0|100] "%" Vector__XXX
 SG_ EngIntercoolerTemp : 0|8@1+ (1,-40) [-40|210] "deg" Vector__XXX
 SG_ EngTurboOilTemp : 0|16@1+ (0.03125,-273) [-273|1735] "deg" Vector__XXX
 SG_ EngOilTemp1 : 0|16@1+ (0.03125,-273) [-273|1735] "deg" Vector__XXX
 SG_ EngFuelTemp : 0|8@1+ (1,-40) [-40|210] "deg" Vector__XXX
 SG_ EngCoolantTemp : 0|8@1+ (1,-40) [-40|210] "deg" Vector__XXX
 SG_ RetarderSelectionNonEng : 0|8@1+ (0.4,0) [0|100] "%" Vector__XXX
 SG_ ActlMxAvlblRtarderPercentTorque : 0|8@1+ (1,-125) [-125|125] "%" Vector__XXX
 SG_ DrvrsDmandRetarderPercentTorque : 0|8@1+ (1,-125) [-125|125] "%" Vector__XXX
 SG_ SrcAddrssOfCtrllngDvcFrRtrdrCtrl : 0|8@1+ (1,0) [0|255] "" Vector__XXX
 SG_ RetarderRqingBrakeLight : 0|2@1+ (1,0) [0|3] "" Vector__XXX
 SG_ EngCoolantLoadIncrease : 0|2@1+ (1,0) [0|3] "" Vector__XXX
 SG_ IntendedRetarderPercentTorque : 0|8@1+ (1,-125) [-125|125] "%" Vector__XXX
 SG_ ActualRetarderPercentTorque : 0|8@1+ (1,-125) [-125|125] "%" Vector__XXX
 SG_ RetarderEnableShiftAssistSwitch : 0|2@1+ (1,0) [0|3] "" Vector__XXX
 SG_ RetarderEnableBrakeAssistSwitch : 0|2@1+ (1,0) [0|3] "" Vector__XXX
 SG_ RetarderTorqueMode : 0|4@1+ (1,0) [0|15] "" Vector__XXX
 SG_ EngExhstGsOxygnSnsrClsdLpOprton : 0|2@1+ (1,0) [0|3] "" Vector__XXX
 SG_ EngExhstGsOxygnSnsrFlngCrrction : 0|8@1+ (1,-125) [-125|125] "%" Vector__XXX
 SG_ EngActualExhaustOxygen : 0|16@1+ (0.0025,0) [0|160.6375] "%" Vector__XXX
 SG_ EngDesiredExhaustOxygen : 0|16@1+ (0.0025,0) [0|160.6375] "%" Vector__XXX
 SG_ EngDesiredRatedExhaustOxygen : 0|16@1+ (0.0025,0) [0|160.6375] "%" Vector__XXX
 SG_ EngCoolantLevel : 0|8@1+ (0.4,0) [0|100] "%" Vector__XXX
 SG_ EngCoolantPress : 0|8@1+ (2,0) [0|500] "kPa" Vector__XXX
 SG_ EngCrankcasePress : 0|16@1+ (0.0078125,-250) [-250|251.99] "kPa" Vector__XXX
 SG_ EngOilPress : 0|8@1+ (4,0) [0|1000] "kPa" Vector__XXX
 SG_ EngOilLevel : 0|8@1+ (0.4,0) [0|100] "%" Vector__XXX
 SG_ EngExCrankcaseBlowbyPress : 0|8@1+ (0.05,0) [0|12.5] "kPa" Vector__XXX
 SG_ EngFuelDeliveryPress : 0|8@1+ (4,0) [0|1000] "kPa" Vector__XXX
 SG_ ECUType : 0|8@1+ (1,0) [0|255] "" Vector__XXX
 SG_ ECUSerialNumber : 0|8@1+ (1,0) [0|255] "" Vector__XXX
 SG_ ECUPartNumber : 0|8@1+ (1,0) [0|255] "" Vector__XXX
 SG_ ECULocation : 0|8@1+ (1,0) [0|255] "" Vector__XXX
 SG_ XBRAccelerationLimit : 0|8@1+ (0.1,-12.5) [-12.5|12.5] "m/s²" Vector__XXX
 SG_ XBRActiveCtrlMode : 0|4@1+ (1,0) [0|15] "" Vector__XXX
 SG_ XBRSystemState : 0|2@1+ (1,0) [0|3] "" Vector__XXX
 SG_ FoundationBrakeUse : 0|2@1+ (1,0) [0|3] "" Vector__XXX
 SG_ HillHolderMode : 0|3@1+ (1,0) [0|7] "" Vector__XXX
 SG_ HaltBrakeMode : 0|3@1+ (1,0) [0|7] "" Vector__XXX
 SG_ BrkLnngRmnngRearAxle3RightWheel : 0|8@1+ (0.4,0) [0|100] "%" Vector__XXX
 SG_ BrkLnngRmningRearAxle3LeftWheel : 0|8@1+ (0.4,0) [0|100] "%" Vector__XXX
 SG_ BrkLnngRmnngRearAxle2RightWheel : 0|8@1+ (0.4,0) [0|100] "%" Vector__XXX
 SG_ BrkLnngRmningRearAxle2LeftWheel : 0|8@1+ (0.4,0) [0|100] "%" Vector__XXX
 SG_ BrkLnngRmnngRearAxle1RightWheel : 0|8@1+ (0.4,0) [0|100] "%" Vector__XXX
 SG_ BrkLnngRmningRearAxle1LeftWheel : 0|8@1+ (0.4,0) [0|100] "%" Vector__XXX
 SG_ BrkLnngRmnngFrontAxleRightWheel : 0|8@1+ (0.4,0) [0|100] "%" Vector__XXX
 SG_ BrkLnngRmningFrontAxleLeftWheel : 0|8@1+ (0.4,0) [0|100] "%" Vector__XXX
 SG_ BrkAppPrssHghRngRrAxl3RghtWheel : 0|8@1+ (5,0) [0|1250] "kPa" Vector__XXX
 SG_ BrkAppPrssHghRngRrAxl3LeftWheel : 0|8@1+ (5,0) [0|1250] "kPa" Vector__XXX
 SG_ BrkAppPrssHghRngRrAxl2RghtWheel : 0|8@1+ (5,0) [0|1250] "kPa" Vector__XXX
 SG_ BrkAppPrssHghRngRrAxl2LeftWheel : 0|8@1+ (5,0) [0|1250] "kPa" Vector__XXX
 SG_ BrkAppPrssHghRngRrAxl1RghtWheel : 0|8@1+ (5,0) [0|1250] "kPa" Vector__XXX
 SG_ BrkAppPrssHghRngRrAxl1LeftWheel : 0|8@1+ (5,0) [0|1250] "kPa" Vector__XXX
 SG_ BrkAppPrssHghRngFrntAxlRghtWhel : 0|8@1+ (5,0) [0|1250] "kPa" Vector__XXX
 SG_ BrkAppPrssHghRngFrntAxlLftWheel : 0|8@1+ (5,0) [0|1250] "kPa" Vector__XXX
 SG_ RlativeSpeedRearAxle2RightWheel : 0|8@1+ (0.0625,-7.8125) [-7.8125|7.8125] "km/h" Vector__XXX
 SG_ RelativeSpeedRearAxle2LeftWheel : 0|8@1+ (0.0625,-7.8125) [-7.8125|7.8125] "km/h" Vector__XXX
 SG_ RlativeSpeedRearAxle1RightWheel : 0|8@1+ (0.0625,-7.8125) [-7.8125|7.8125] "km/h" Vector__XXX
 SG_ RelativeSpeedRearAxle1LeftWheel : 0|8@1+ (0.0625,-7.8125) [-7.8125|7.8125] "km/h" Vector__XXX
 SG_ RlativeSpeedFrontAxleRightWheel : 0|8@1+ (0.0625,-7.8125) [-7.8125|7.8125] "km/h" Vector__XXX
 SG_ RelativeSpeedFrontAxleLeftWheel : 0|8@1+ (0.0625,-7.8125) [-7.8125|7.8125] "km/h" Vector__XXX
 SG_ FrontAxleSpeed : 0|16@1+ (0.00390625,0) [0|250.996] "km/h" Vector__XXX
 SG_ SrcAddrssOfCtrllngDvcFrBrkCntrl : 0|8@1+ (1,0) [0|255] "" Vector__XXX
 SG_ BrakePedalPos : 0|8@1+ (0.4,0) [0|100] "%" Vector__XXX
 SG_ TrctrMntdTrilerABSWarningSignal : 0|2@1+ (1,0) [0|3] "" Vector__XXX
 SG_ TrailerABSStatus : 0|2@1+ (1,0) [0|3] "" Vector__XXX
 SG_ HaltBrakeSwitch : 0|2@1+ (1,0) [0|3] "" Vector__XXX
 SG_ ATC_ASRInformationSignal : 0|2@1+ (1,0) [0|3] "" Vector__XXX
 SG_ ABS_EBSAmberWarningSignal : 0|2@1+ (1,0) [0|3] "" Vector__XXX
 SG_ EBSRedWarningSignal : 0|2@1+ (1,0) [0|3] "" Vector__XXX
 SG_ ABSFullyOperational : 0|2@1+ (1,0) [0|3] "" Vector__XXX
 SG_ EngRetarderSelection : 0|8@1+ (0.4,0) [0|100] "%" Vector__XXX
 SG_ RemoteAccelEnableSwitch : 0|2@1+ (1,0) [0|3] "" Vector__XXX
 SG_ EngAuxEngShutdownSwitch : 0|2@1+ (1,0) [0|3] "" Vector__XXX
 SG_ EngDerateSwitch : 0|2@1+ (1,0) [0|3] "" Vector__XXX
 SG_ AccelInterlockSwitch : 0|2@1+ (1,0) [0|3] "" Vector__XXX
 SG_ TractionCtrlOverrideSwitch : 0|2@1+ (1,0) [0|3] "" Vector__XXX
 SG_ ASRHillHolderSwitch : 0|2@1+ (1,0) [0|3] "" Vector__XXX
 SG_ ASROffroadSwitch : 0|2@1+ (1,0) [0|3] "" Vector__XXX
 SG_ ABSOffroadSwitch : 0|2@1+ (1,0) [0|3] "" Vector__XXX
 SG_ EBSBrakeSwitch : 0|2@1+ (1,0) [0|3] "" Vector__XXX
 SG_ AntiLockBrakingActive : 0|2@1+ (1,0) [0|3] "" Vector__XXX
 SG_ ASRBrakeCtrlActive : 0|2@1+ (1,0) [0|3] "" Vector__XXX
 SG_ ASREngCtrlActive : 0|2@1+ (1,0) [0|3] "" Vector__XXX
 SG_ Driver2 : 0|8@1+ (1,0) [0|255] "" Vector__XXX
 SG_ Driver1 : 0|8@1+ (1,0) [0|255] "" Vector__XXX
 SG_ CargoAmbientTemp : 0|16@1+ (0.03125,-273) [-273|1735] "deg" Vector__XXX
 SG_ EngOilFilterDiffPress : 0|8@1+ (0.5,0) [0|125] "kPa" Vector__XXX
 SG_ EngFuelFilterDiffPress : 0|8@1+ (2,0) [0|500] "kPa" Vector__XXX
 SG_ FuelLevel : 0|8@1+ (0.4,0) [0|100] "%" Vector__XXX
 SG_ WasherFluidLevel : 0|8@1+ (0.4,0) [0|100] "%" Vector__XXX
 SG_ SelectedMaxVehicleSpeedLimit : 0|8@1+ (1,0) [0|250] "" Vector__XXX
 SG_ RqCabZoneHeating : 0|2@1+ (1,0) [0|3] "" Vector__XXX
 SG_ RqEngZoneHeating : 0|2@1+ (1,0) [0|3] "" Vector__XXX
 SG_ AuxHeaterModeRq : 0|4@1+ (1,0) [0|15] "" Vector__XXX
 SG_ EngAutomaticStartEnableSwitch : 0|2@1+ (1,0) [0|3] "" Vector__XXX
 SG_ AtmaticGearShiftingEnableSwitch : 0|2@1+ (1,0) [0|3] "" Vector__XXX
 SG_ VhclLmtngSpdGvernorEnableSwitch : 0|2@1+ (1,0) [0|3] "" Vector__XXX
 SG_ VhclLmtngSpdGvrnrIncrmentSwitch : 0|2@1+ (1,0) [0|3] "" Vector__XXX
 SG_ VhclLmtngSpdGvrnrDcrementSwitch : 0|2@1+ (1,0) [0|3] "" Vector__XXX
 SG_ SeatBeltSwitch : 0|2@1+ (1,0) [0|3] "" Vector__XXX
 SG_ OperatorSeatDirectionSwitch : 0|2@1+ (1,0) [0|3] "" Vector__XXX
 SG_ BatteryMainSwitchHoldRq : 0|2@1+ (1,0) [0|3] "" Vector__XXX
 SG_ AuxHeaterCoolantPumpRq : 0|2@1+ (1,0) [0|3] "" Vector__XXX
 SG_ CabInteriorTempCmd : 0|16@1+ (0.03125,-273) [-273|1735] "deg" Vector__XXX
 SG_ FlashRedStopLamp : 0|2@1+ (1,0) [0|3] "" Vector__XXX
 SG_ FlashProtectLamp : 0|2@1+ (1,0) [0|3] "" Vector__XXX
 SG_ FlashMalfuncIndicatorLamp : 0|2@1+ (1,0) [0|3] "" Vector__XXX
 SG_ FlashAmberWarningLamp : 0|2@1+ (1,0) [0|3] "" Vector__XXX
 SG_ MalfunctionIndicatorLampStatus : 0|2@1+ (1,0) [0|3] "" Vector__XXX
 SG_ AmberWarningLampStatus : 0|2@1+ (1,0) [0|3] "" Vector__XXX
 SG_ RedStopLampState : 0|2@1+ (1,0) [0|3] "" Vector__XXX
 SG_ ProtectLampStatus : 0|2@1+ (1,0) [0|3] "" Vector__XXX
 SG_ FlashRedStopLamp : 0|2@1+ (1,0) [0|3] "" Vector__XXX
 SG_ FlashProtectLamp : 0|2@1+ (1,0) [0|3] "" Vector__XXX
 SG_ MalfunctionIndicatorLampStatus : 0|2@1+ (1,0) [0|3] "" Vector__XXX
 SG_ RedStopLampState : 0|2@1+ (1,0) [0|3] "" Vector__XXX
 SG_ AmberWarningLampStatus : 0|2@1+ (1,0) [0|3] "" Vector__XXX
 SG_ ProtectLampStatus : 0|2@1+ (1,0) [0|3] "" Vector__XXX
 SG_ FlashMalfuncIndicatorLamp : 0|2@1+ (1,0) [0|3] "" Vector__XXX
 SG_ FlashAmberWarningLamp : 0|2@1+ (1,0) [0|3] "" Vector__XXX
 SG_ SPN1 : 0|16@1+ (1,0) [0|65536] "" Vector__XXX
 SG_ MalfunctionIndicatorLampStatus : 0|2@1+ (1,0) [0|3] "" Vector__XXX
 SG_ RedStopLampState : 0|2@1+ (1,0) [0|3] "" Vector__XXX
 SG_ AmberWarningLampStatus : 0|2@1+ (1,0) [0|3] "" Vector__XXX
 SG_ ProtectLampStatus : 0|2@1+ (1,0) [0|3] "" Vector__XXX
 SG_ FlashRedStopLamp : 0|2@1+ (1,0) [0|3] "" Vector__XXX
 SG_ FlashProtectLamp : 0|2@1+ (1,0) [0|3] "" Vector__XXX
 SG_ FlashMalfuncIndicatorLamp : 0|2@1+ (1,0) [0|3] "" Vector__XXX
 SG_ FlashAmberWarningLamp : 0|2@1+ (1,0) [0|3] "" Vector__XXX
 SG_ EngSpeed : 0|16@1+ (0.125,0) [0|8031.875] "RPM" Vector__XXX
 SG_ EngTorqueMode : 0|4@1+ (1,0) [0|15] "" Vector__XXX
 SG_ EngTurboBoostPress : 0|8@1+ (2,0) [0|500] "kPa" Vector__XXX
 SG_ WheelBasedVehicleSpeed : 0|16@1+ (0.00390625,0) [0|250.996] "km/h" Vector__XXX
 SG_ EngPercentLoadAtCurrentSpeed : 0|8@1+ (1,0) [0|250] "%" Vector__XXX
 SG_ FlashRedStopLamp : 0|2@1+ (1,0) [0|3] "" Vector__XXX
 SG_ FlashProtectLamp : 0|2@1+ (1,0) [0|3] "" Vector__XXX
 SG_ FlashMalfuncIndicatorLamp : 0|2@1+ (1,0) [0|3] "" Vector__XXX
 SG_ MalfunctionIndicatorLampStatus : 0|2@1+ (1,0) [0|3] "" Vector__XXX
 SG_ RedStopLampState : 0|2@1+ (1,0) [0|3] "" Vector__XXX
 SG_ AmberWarningLampStatus : 0|2@1+ (1,0) [0|3] "" Vector__XXX
 SG_ ProtectLampStatus : 0|2@1+ (1,0) [0|3] "" Vector__XXX

CM_ BU_ TPMS "Tire Pressure Monitoring System";
CM_ BU_ EBS "Electronic Brake System";
CM_ BO_ 3221225472 "This is a message for not used signals, created by Vector CANdb++ DBC OLE DB Provider.";
CM_ SG_ 3221225472 TireTemp "Temperature at the surface of the tire sidewall. (SP242)";
CM_ SG_ 3221225472 TirePress "Pressure at which air is contained in cavity formed by tire and rim. (SP241)";
CM_ SG_ 3221225472 SPN5 "SPN #5 (Conversion Version 4)SPN #5 (Conversion Version 4)SPN #5 (Conversion Version 4)SPN #5 (Conversion Version 4)";
CM_ SG_ 3221225472 SPN4 "SPN #4 (Conversion Version 4)SPN #4 (Conversion Version 4)SPN #4 (Conversion Version 4)SPN #4 (Conversion Version 4)";
CM_ SG_ 3221225472 SPN3 "SPN #3 (Conversion Version 4)SPN #3 (Conversion Version 4)SPN #3 (Conversion Version 4)SPN #3 (Conversion Version 4)";
CM_ SG_ 3221225472 SPN2 "SPN #2 (Conversion Version 4)SPN #2 (Conversion Version 4)SPN #2 (Conversion Version 4)SPN #2 (Conversion Version 4)";
CM_ SG_ 3221225472 FailureModeIdentifier5 "The FMI defines the type of failure detected in the subsystem identified by an SPN.The FMI defines the type of failure detected in the subsystem identified by an SPN.The FMI defines the type of failure detected in the subsystem identified by an SPN.The FMI defines the type of failure detected in the subsystem identified by an SPN.";
CM_ SG_ 3221225472 FailureModeIdentifier4 "The FMI defines the type of failure detected in the subsystem identified by an SPN.The FMI defines the type of failure detected in the subsystem identified by an SPN.The FMI defines the type of failure detected in the subsystem identified by an SPN.The FMI defines the type of failure detected in the subsystem identified by an SPN.";
CM_ SG_ 3221225472 FlashRedStopLamp "This parameter provides the capability to flash the RSL (SPN 3039).This parameter provides the capability to flash the RSL (SPN 3039).This parameter provides the capability to flash the RSL (SPN 3039).This parameter provides the capability to flash the RSL (SPN 3039).This parameter provides the capability to flash the RSL (SPN 3039).This parameter provides the capability to flash the RSL (SPN 3039).This parameter provides the capability to flash the RSL (SPN 3039).";
CM_ SG_ 3221225472 FlashProtectLamp "This parameter provides the capability to flash the engine protect lamp (SPN 3041).This parameter provides the capability to flash the engine protect lamp (SPN 3041).This parameter provides the capability to flash the engine protect lamp (SPN 3041).This parameter provides the capability to flash the engine protect lamp (SPN 3041).This parameter provides the capability to flash the engine protect lamp (SPN 3041).This parameter provides the capability to flash the engine protect lamp (SPN 3041).This parameter provides the capability to flash the engine protect lamp (SPN 3041).";
CM_ SG_ 3221225472 FlashMalfuncIndicatorLamp "This parameter provides the capability to flash the MIL (SPN 3038).This parameter provides the capability to flash the MIL (SPN 3038).This parameter provides the capability to flash the MIL (SPN 3038).This parameter provides the capability to flash the MIL (SPN 3038).This parameter provides the capability to flash the MIL (SPN 3038).This parameter provides the capability to flash the MIL (SPN 3038).This parameter provides the capability to flash the MIL (SPN 3038).";
CM_ SG_ 3221225472 FlashAmberWarningLamp "This parameter provides the capability to flash the AWL (SPN 3040). This parameter provides the capability to flash the AWL (SPN 3040). This parameter provides the capability to flash the AWL (SPN 3040). This parameter provides the capability to flash the AWL (SPN 3040). This parameter provides the capability to flash the AWL (SPN 3040). This parameter provides the capability to flash the AWL (SPN 3040). ";
CM_ SG_ 3221225472 FailureModeIdentifier3 "The FMI defines the type of failure detected in the subsystem identified by an SPN.The FMI defines the type of failure detected in the subsystem identified by an SPN.The FMI defines the type of failure detected in the subsystem identified by an SPN.The FMI defines the type of failure detected in the subsystem identified by an SPN.";
CM_ SG_ 3221225472 FailureModeIdentifier2 "The FMI defines the type of failure detected in the subsystem identified by an SPN.The FMI defines the type of failure detected in the subsystem identified by an SPN.The FMI defines the type of failure detected in the subsystem identified by an SPN.The FMI defines the type of failure detected in the subsystem identified by an SPN.";
CM_ SG_ 3221225472 OccurenceCount5 "The 7 bit occurence count field contains the number of times a fault has gone from active to previously active.The 7 bit occurence count field contains the number of times a fault has gone from active to previously active.The 7 bit occurence count field contains the number of times a fault has gone from active to previously active.The 7 bit occurence count field contains the number of times a fault has gone from active to previously active.";
CM_ SG_ 3221225472 OccurenceCount4 "The 7 bit occurence count field contains the number of times a fault has gone from active to previously active.The 7 bit occurence count field contains the number of times a fault has gone from active to previously active.The 7 bit occurence count field contains the number of times a fault has gone from active to previously active.The 7 bit occurence count field contains the number of times a fault has gone from active to previously active.";
CM_ SG_ 3221225472 OccurenceCount3 "The 7 bit occurence count field contains the number of times a fault has gone from active to previously active.The 7 bit occurence count field contains the number of times a fault has gone from active to previously active.The 7 bit occurence count field contains the number of times a fault has gone from active to previously active.The 7 bit occurence count field contains the number of times a fault has gone from active to previously active.";
CM_ SG_ 3221225472 OccurenceCount2 "The 7 bit occurence count field contains the number of times a fault has gone from active to previously active.The 7 bit occurence count field contains the number of times a fault has gone from active to previously active.The 7 bit occurence count field contains the number of times a fault has gone from active to previously active.The 7 bit occurence count field contains the number of times a fault has gone from active to previously active.";
CM_ SG_ 3221225472 OccurenceCount1 "The 7 bit occurence count field contains the number of times a fault has gone from active to previously active.The 7 bit occurence count field contains the number of times a fault has gone from active to previously active.The 7 bit occurence count field contains the number of times a fault has gone from active to previously active.The 7 bit occurence count field contains the number of times a fault has gone from active to previously active.The 7 bit occurence count field contains the number of times a fault has gone from active to previously active.The 7 bit occurence count field contains the number of times a fault has gone from active to previously active.";
CM_ SG_ 3221225472 FailureModeIdentifier1 "The FMI defines the type of failure detected in the subsystem identified by an SPN.The FMI defines the type of failure detected in the subsystem identified by an SPN.The FMI defines the type of failure detected in the subsystem identified by an SPN.The FMI defines the type of failure detected in the subsystem identified by an SPN.The FMI defines the type of failure detected in the subsystem identified by an SPN.The FMI defines the type of failure detected in the subsystem identified by an SPN.";
CM_ SG_ 3221225472 SPN1 "SPN #1 (Conversion Version 4)SPN #1 (Conversion Version 4)SPN #1 (Conversion Version 4)SPN #1 (Conversion Version 4)SPN #1 (Conversion Version 4)SPN #1 (Conversion Version 4)";
CM_ SG_ 3221225472 MalfunctionIndicatorLampStatus "A lamp used to relay only emissions-related trouble code information.A lamp used to relay only emissions-related trouble code information.A lamp used to relay only emissions-related trouble code information.A lamp used to relay only emissions-related trouble code information.A lamp used to relay only emissions-related trouble code information.A lamp used to relay only emissions-related trouble code information.A lamp used to relay only emissions-related trouble code information.";
CM_ SG_ 3221225472 RedStopLampState "This lamp is uesed to relay trouble code information that is of a severe enought condition that it warrants stopping the vehicle.This lamp is uesed to relay trouble code information that is of a severe enought condition that it warrants stopping the vehicle.This lamp is uesed to relay trouble code information that is of a severe enought condition that it warrants stopping the vehicle.This lamp is uesed to relay trouble code information that is of a severe enought condition that it warrants stopping the vehicle.This lamp is uesed to relay trouble code information that is of a severe enought condition that it warrants stopping the vehicle.This lamp is uesed to relay trouble code information that is of a severe enought condition that it warrants stopping the vehicle.This lamp is uesed to relay trouble code information that is of a severe enought condition that it warrants stopping the vehicle.";
CM_ SG_ 3221225472 AmberWarningLampStatus "This lamp is used to relay trouble code information that is reporting a problem with the vehicle system but the vehicle need
not be immediately stopped.This lamp is used to relay trouble code information that is reporting a problem with the vehicle system but the vehicle need
not be immediately stopped.This lamp is used to relay trouble code information that is reporting a problem with the vehicle system but the vehicle need
not be immediately stopped.This lamp is used to relay trouble code information that is reporting a problem with the vehicle system but the vehicle need
not be immediately stopped.This lamp is used to relay trouble code information that is reporting a problem with the vehicle system but the vehicle need
not be immediately stopped.This lamp is used to relay trouble code information that is reporting a problem with the vehicle system but the vehicle need
not be immediately stopped.This lamp is used to relay trouble code information that is reporting a problem with the vehicle system b";
CM_ SG_ 3221225472 ProtectLampStatus "This lamp is used to relay trouble code informatio that is reporting a problem with a vehicle system that is most
probably not electronic subsystem related.This lamp is used to relay trouble code informatio that is reporting a problem with a vehicle system that is most
probably not electronic subsystem related.This lamp is used to relay trouble code informatio that is reporting a problem with a vehicle system that is most
probably not electronic subsystem related.This lamp is used to relay trouble code informatio that is reporting a problem with a vehicle system that is most
probably not electronic subsystem related.This lamp is used to relay trouble code informatio that is reporting a problem with a vehicle system that is most
probably not electronic subsystem related.This lamp is used to relay trouble code informatio that is reporting a problem with a vehicle system that is most
probably not electronic subsystem related.This lamp is used to relay trouble code informatio that is reporting a problem wi";
CM_ SG_ 3221225472 SPN5High "SPN #5 (Conversion Version 4)SPN #5 (Conversion Version 4)SPN #5 (Conversion Version 4)SPN #5 (Conversion Version 4)";
CM_ SG_ 3221225472 SPN4High "SPN #4 (Conversion Version 4)SPN #4 (Conversion Version 4)SPN #4 (Conversion Version 4)SPN #4 (Conversion Version 4)";
CM_ SG_ 3221225472 SPN3High "SPN #3 (Conversion Version 4)SPN #3 (Conversion Version 4)SPN #3 (Conversion Version 4)SPN #3 (Conversion Version 4)";
CM_ SG_ 3221225472 SPN2High "SPN #2 (Conversion Version 4)SPN #2 (Conversion Version 4)SPN #2 (Conversion Version 4)SPN #2 (Conversion Version 4)";
CM_ SG_ 3221225472 SPN1High "SPN #1 (Conversion Version 4)SPN #1 (Conversion Version 4)SPN #1 (Conversion Version 4)SPN #1 (Conversion Version 4)SPN #1 (Conversion Version 4)SPN #1 (Conversion Version 4)";
CM_ SG_ 3221225472 TransCurrentRange "Range currently being commanded by the transmission control system.";
CM_ SG_ 3221225472 TransRqedRange "Range selected by the operator.";
CM_ SG_ 3221225472 TransActualGearRatio "Actual ratio of input shaft speed to output shaft speed.";
CM_ SG_ 3221225472 SrcAddrssOfCtrllngDvcFrTrnsCtrl "The source address of the SAE J1939 device currently controlling the transmission.";
CM_ SG_ 3221225472 TransInputShaftSpeed "Rotational velocity of the primary shaft transferring power into the transmission.";
CM_ SG_ 3221225472 ProgressiveShiftDisable "Command signal used to indicate that progressive shifting by the engine should be disallowed.";
CM_ SG_ 3221225472 PercentClutchSlip "Parameter which represents the ratio of input shaft speed to current engine speed (in percent).";
CM_ SG_ 3221225472 TransOutputShaftSpeed "Calculated speed of the transmission output shaft.";
CM_ SG_ 3221225472 TransShiftInProcess "Indicates that the transmission is in process of shifting from the current gear to the selected gear.";
CM_ SG_ 3221225472 TorqueConverterLockupEngaged "State signal which indicates whether the torque converter lockup is engaged.";
CM_ SG_ 3221225472 ExhaustGasMass "Measured/calculated exhaust gas mass upstream of the after-treatment system.";
CM_ SG_ 3221225472 EngsDesiredOperatingSpeed "An indication by the engine of the optimal operating speed of the engine for the current existing conditions.";
CM_ SG_ 3221225472 ActMaxAvailEngPercentTorque "This is the maximum amount of torque that the engine can immediately deliver as a percentage of the reference engine torque.";
CM_ SG_ 3221225472 VhclAccelerationRateLimitStatus "Status (active or not active) of the system used to limit maximum forward vehicle acceleration.";
CM_ SG_ 3221225472 AccelPedal2LowIdleSwitch "Switch signal which indicates the state of the accelerator pedal 2 low idle switch.";
CM_ SG_ 3221225472 RoadSpeedLimitStatus "Status (active or not active) of the system used to limit maximum vehicle velocity.";
CM_ SG_ 3221225472 AccelPedalKickdownSwitch "Switch signal which indicates whether the accelerator pedal kickdown switch is opened or closed.";
CM_ SG_ 3221225472 AccelPedal1LowIdleSwitch "Switch signal which indicates the state of the accelerator pedal 1 low idle switch.";
CM_ SG_ 3221225472 EngStarterMode "There are several phases in a starting action and different reasons why a start cannot take place.";
CM_ SG_ 3221225472 SrcAddrssOfCtrllngDvcForEngCtrl "The source address of the SAE J1939 device currently controlling the engine.";
CM_ SG_ 3221225472 EngSpeed "Actual engine speed which is calculated over a minimum crankshaft angle of 720 degrees divided by the number of cylinders.Actual engine speed which is calculated over a minimum crankshaft angle of 720 degrees divided by the number of cylinders.";
CM_ SG_ 3221225472 ActualEngPercentTorque "The calculated output torque of the engine.";
CM_ SG_ 3221225472 DriversDemandEngPercentTorque "The requested torque output of the engine by the driver.";
CM_ SG_ 3221225472 EngTorqueMode "State signal which indicates which engine torque mode is currently generating, limiting, or controlling the torque.State signal which indicates which engine torque mode is currently generating, limiting, or controlling the torque.";
CM_ SG_ 3221225472 SupportTSC1CtrlPurposeGroup4Of4 "This parameter indicates which TSC1 control purposes are supported in group 4 of 4.";
CM_ SG_ 3221225472 SupportTSC1CtrlPurposeGroup3Of4 "This parameter indicates which TSC1 control purposes are supported in group 3 of 4.";
CM_ SG_ 3221225472 SupportTSC1CtrlPurposeGroup2Of4 "This parameter indicates which TSC1 control purposes are supported in group 2 of 4.";
CM_ SG_ 3221225472 SupportTSC1CtrlPurposeGroup1Of4 "This parameter indicates which TSC1 control purposes are supported in group 1 of 4.";
CM_ SG_ 3221225472 EngDefaultTorqueLimit "Companion parameter to Transmission Torque Limit (SPN 1845).";
CM_ SG_ 3221225472 EngMomentOfInertia "Moment of inertia for the engine, including items driven full-time by the engine such as fuel, oil and cooling pumps.";
CM_ SG_ 3221225472 EngRqdTorqueCtrlRangeUpperLimit "The maximum engine torque that the engine will allow when operating in a torque control/limit mode.";
CM_ SG_ 3221225472 EngRqdTorqueCtrlRangeLowerLimit "The minimum engine torque that the engine will allow when operating in a torque control/limit mode.";
CM_ SG_ 3221225472 EngRqedSpeedCtrlRangeLowerLimit "The minimum engine speed that the engine will allow when operating in a speed control/limit mode.";
CM_ SG_ 3221225472 EngMxMomentaryOverrideTimeLimit "The maximum time limit allowed to override the engine's high idle speed.";
CM_ SG_ 3221225472 EngMxMmntaryOverrideSpeedPoint7 "The maximum engine speed above high idle allowed by the engine control during a momentary high idle override.";
CM_ SG_ 3221225472 EngReferenceTorque "This parameter is the 100% reference value for all defined indicated engine torque parameters.";
CM_ SG_ 3221225472 EngSpeedAtHighIdlePoint6 "Engine speed of high idle (point 6) of the engine torque map (see PGN 65251 and supporting document).";
CM_ SG_ 3221225472 EngSpeedAtPoint5 "Engine speed of point 3, 4, and 5 of the engine torque map (see PGN 65251 and supporting document).";
CM_ SG_ 3221225472 EngSpeedAtPoint4 "Engine speed of point 3, 4, and 5 of the engine torque map (see PGN 65251 and supporting document).";
CM_ SG_ 3221225472 EngSpeedAtPoint3 "Engine speed of point 3, 4, and 5 of the engine torque map (see PGN 65251 and supporting document).";
CM_ SG_ 3221225472 EngSpeedAtPoint2 "Engine speed of point 2 of the engine torque map (see PGN 65251 and supporting document).";
CM_ SG_ 3221225472 EngPercentTorqueAtIdlePoint1 "The torque limit that indicates the available engine torque which can be provided by the engine at idle speed.";
CM_ SG_ 3221225472 EngShutdownOverrideSwitch "Switch signal which indicates the position of the engine shutdown override switch.";
CM_ SG_ 3221225472 EngTestModeSwitch "Switch signal which indicates the position of the engine test mode switch.";
CM_ SG_ 3221225472 EngIdleDecrementSwitch "Switch signal which indicates the position of the idle decrement switch.";
CM_ SG_ 3221225472 EngIdleIncrementSwitch "Switch signal which indicates the position of the idle increment switch.";
CM_ SG_ 3221225472 CruiseCtrlStates "This parameter is used to indicate the current state, or mode, of operation by the cruise control device.";
CM_ SG_ 3221225472 PTOState "This parameter is used to indicate the current state or mode of operation by the power takeoff (PTO) device.";
CM_ SG_ 3221225472 CruiseCtrlSetSpeed "Value of set (chosen) velocity of velocity control system.";
CM_ SG_ 3221225472 CruiseCtrlAccelerateSwitch "Switch signal of the cruise control activator which indicates that the activator is in the position “accelerate.";
CM_ SG_ 3221225472 CruiseCtrlResumeSwitch "Switch signal of the cruise control activator which indicates that the activator is in the position “resume.";
CM_ SG_ 3221225472 CruiseCtrlCoastSwitch "Switch signal of the cruise control activator which indicates that the activator is in the position “coast (decelerate).";
CM_ SG_ 3221225472 CruiseCtrlSetSwitch "Switch signal of the cruise control activator which indicates that the activator is in the position “set.";
CM_ SG_ 3221225472 ClutchSwitch "Switch signal which indicates that the clutch pedal is being pressed.";
CM_ SG_ 3221225472 BrakeSwitch "Switch signal which indicates that the driver operated brake foot pedal is being pressed.";
CM_ SG_ 3221225472 CruiseCtrlEnableSwitch "Switch signal which indicates that it is possible to manage the cruise control function.";
CM_ SG_ 3221225472 CruiseCtrlActive "Cruise control is switched on.";
CM_ SG_ 3221225472 WheelBasedVehicleSpeed "Speed of the vehicle as calculated from wheel or tailshaft speed.Speed of the vehicle as calculated from wheel or tailshaft speed.";
CM_ SG_ 3221225472 CruiseCtrlPauseSwitch "Switch signal which indicates the position of the Cruise Control Pause Switch used on Remote Cruise Control applications.";
CM_ SG_ 3221225472 ParkingBrakeSwitch "Switch signal which indicates when the parking brake is set.";
CM_ SG_ 3221225472 TwoSpeedAxleSwitch "Switch signal which indicates the current axle range.";
CM_ SG_ 3221225472 SoftwareID3 "Software IDSoftware ID";
CM_ SG_ 3221225472 SoftwareID2 "Software IDSoftware ID";
CM_ SG_ 3221225472 SoftwareID1 "Software IDSoftware ID";
CM_ SG_ 3221225472 NmbrOfSftwrIdentificationFields "Number of software identification designators represented in the software identification parameter group.Number of software identification designators represented in the software identification parameter group.";
CM_ SG_ 3221225472 TrnsShftSlctorDisplayModeSwitch "Status of the operator’s switch used to ‘toggle’ through multiple display modes of a shift selector display.";
CM_ SG_ 3221225472 TransMode4 "Indicates whether transmission mode 4 is enabled.";
CM_ SG_ 3221225472 TransMode3 "Indicates whether transmission mode 3 is enabled.";
CM_ SG_ 3221225472 TransMode2 "Indicates whether transmission mode 2 is enabled.";
CM_ SG_ 3221225472 TransMode1 "Indicates whether transmission mode 1 is enabled.";
CM_ SG_ 3221225472 DisengageDiffLockRqCentralRear "Command signal used to disengage the various differential locks, e.";
CM_ SG_ 3221225472 DisengageDiffLockRqCentralFront "Command signal used to disengage the various differential locks, e.";
CM_ SG_ 3221225472 DisengageDiffLockRqCentral "Command signal used to disengage the various differential locks, e.";
CM_ SG_ 3221225472 DisengageDiffLockRqRearAxle2 "Command signal used to disengage the various differential locks, e.";
CM_ SG_ 3221225472 DisengageDiffLockRqRearAxle1 "Command signal used to disengage the various differential locks, e.";
CM_ SG_ 3221225472 DisengageDiffLockRqFrontAxle2 "Command signal used to disengage the various differential locks, e.";
CM_ SG_ 3221225472 DisengageDiffLockRqFrontAxle1 "Command signal used to disengage the various differential locks, e.";
CM_ SG_ 3221225472 TransRqedGear "Gear requested by the operator, ABS, or engine.";
CM_ SG_ 3221225472 RqedPercentClutchSlip "Parameter which represents the percent clutch slip requested by a device.";
CM_ SG_ 3221225472 DisengageDrivelineRq "Command signal used to simply disengage the driveline, e.";
CM_ SG_ 3221225472 TorqueConverterLockupDisableRq "Command signal to prevent torque converter lockup, which may cause problems in certain circumstances for ASR.";
CM_ SG_ 3221225472 TransGearShiftInhibitRq "Command signal to inhibit gear shifts.";
CM_ SG_ 3221225472 ControlPurpose "State signal which indicates which control mode the sending device is using to generate the TSC1 command.State signal which indicates which control mode the sending device is using to generate the TSC1 command.State signal which indicates which control mode the sending device is using to generate the TSC1 command.State signal which indicates which control mode the sending device is using to generate the TSC1 command.State signal which indicates which control mode the sending device is using to generate the TSC1 command.State signal which indicates which control mode the sending device is using to generate the TSC1 command.State signal which indicates which control mode the sending device is using to generate the TSC1 command.";
CM_ SG_ 3221225472 TransmissionRate "This parameter indicates the transmission rate at which the sending device will transmit the TSC1 message.This parameter indicates the transmission rate at which the sending device will transmit the TSC1 message.This parameter indicates the transmission rate at which the sending device will transmit the TSC1 message.This parameter indicates the transmission rate at which the sending device will transmit the TSC1 message.This parameter indicates the transmission rate at which the sending device will transmit the TSC1 message.This parameter indicates the transmission rate at which the sending device will transmit the TSC1 message.This parameter indicates the transmission rate at which the sending device will transmit the TSC1 message.";
CM_ SG_ 3221225472 EngRqedTorque_TorqueLimit "Parameter provided to the engine or retarder in the torque/speed control message for controlling or limiting the output torque.Parameter provided to the engine or retarder in the torque/speed control message for controlling or limiting the output torque.Parameter provided to the engine or retarder in the torque/speed control message for controlling or limiting the output torque.Parameter provided to the engine or retarder in the torque/speed control message for controlling or limiting the output torque.Parameter provided to the engine or retarder in the torque/speed control message for controlling or limiting the output torque.Parameter provided to the engine or retarder in the torque/speed control message for controlling or limiting the output torque.Parameter provided to the engine or retarder in the torque/speed control message for controlling or limiting the output torque.";
CM_ SG_ 3221225472 EngRqedSpeed_SpeedLimit "Parameter provided to the engine from external sources in the torque/speed control message.Parameter provided to the engine from external sources in the torque/speed control message.Parameter provided to the engine from external sources in the torque/speed control message.Parameter provided to the engine from external sources in the torque/speed control message.Parameter provided to the engine from external sources in the torque/speed control message.Parameter provided to the engine from external sources in the torque/speed control message.Parameter provided to the engine from external sources in the torque/speed control message.";
CM_ SG_ 3221225472 EngRqedSpeedCtrlConditions "This mode tells the engine control system the governor characteristics that are desired during speed control.This mode tells the engine control system the governor characteristics that are desired during speed control.This mode tells the engine control system the governor characteristics that are desired during speed control.This mode tells the engine control system the governor characteristics that are desired during speed control.This mode tells the engine control system the governor characteristics that are desired during speed control.This mode tells the engine control system the governor characteristics that are desired during speed control.This mode tells the engine control system the governor characteristics that are desired during speed control.";
CM_ SG_ 3221225472 LocalMinuteOffset "Local offset in minutes from a reference time.Local offset in minutes from a reference time.";
CM_ SG_ 3221225472 Year "Part of a parameter used to represent a calendar date.Part of a parameter used to represent a calendar date.";
CM_ SG_ 3221225472 Day "Part of a parameter used to represent a calendar date.Part of a parameter used to represent a calendar date.";
CM_ SG_ 3221225472 Month "Part of a parameter used to represent a calendar date.Part of a parameter used to represent a calendar date.";
CM_ SG_ 3221225472 Hours "Part of a parameter used to represent time.Part of a parameter used to represent time.";
CM_ SG_ 3221225472 Minutes "Part of a parameter used to represent time.Part of a parameter used to represent time.";
CM_ SG_ 3221225472 Seconds "Part of a parameter used to represent time.Part of a parameter used to represent time.";
CM_ SG_ 3221225472 ReferenceRetarderTorque "This parameter is the 100% reference value for all defined indicated retarder torque parameters.This parameter is the 100% reference value for all defined indicated retarder torque parameters.";
CM_ SG_ 3221225472 RetarderSpeedAtPoint4 "Retarder speed of point 4 of the engine retarder torque map.Retarder speed of point 4 of the engine retarder torque map.";
CM_ SG_ 3221225472 RetarderSpeedAtPoint3 "Retarder speed of point 3 of the engine retarder torque map.Retarder speed of point 3 of the engine retarder torque map.";
CM_ SG_ 3221225472 PercentTorqueAtMaxSpeedPoint2 "The torque limit that indicates the available retarder torque which can be provided by the retarder at its maximum speed.The torque limit that indicates the available retarder torque which can be provided by the retarder at its maximum speed.";
CM_ SG_ 3221225472 MaxRetarderSpeedPoint2 "Maximum speed of retarder (Please reference PGN 65249).Maximum speed of retarder (Please reference PGN 65249).";
CM_ SG_ 3221225472 PercentTorqueAtIdlePoint1 "The torque limit that indicates the available retarder torque which can be provided by the retarder at idle speed.The torque limit that indicates the available retarder torque which can be provided by the retarder at idle speed.";
CM_ SG_ 3221225472 RetarderCtrlMethod "This parameter identifies the number of steps used by the retarder.This parameter identifies the number of steps used by the retarder.";
CM_ SG_ 3221225472 RetarderType "A vehicle retarder is a supplementary device to the wheel brakes for the driver to better control the vehicle.A vehicle retarder is a supplementary device to the wheel brakes for the driver to better control the vehicle.";
CM_ SG_ 3221225472 ActlMxAvlblRtarderPercentTorque "This is the maximum amount of torque that the retarder can immediately deliver.This is the maximum amount of torque that the retarder can immediately deliver.";
CM_ SG_ 3221225472 SrcAddrssOfCtrllngDvcFrRtrdrCtrl "The source address of the SAE J1939 device currently controlling the retarder.The source address of the SAE J1939 device currently controlling the retarder.";
CM_ SG_ 3221225472 EngCoolantLoadIncrease "Status of an event, external to the engine, that may increase the nominal temperature of the engine coolant liquid.Status of an event, external to the engine, that may increase the nominal temperature of the engine coolant liquid.";
CM_ SG_ 3221225472 IntendedRetarderPercentTorque "Braking torque of retarder that the retarder is currently trying to achieve.Braking torque of retarder that the retarder is currently trying to achieve.";
CM_ SG_ 3221225472 ActualRetarderPercentTorque "Actual braking torque of the retarder as a percent of retarder configuration reference torque SPN 556.Actual braking torque of the retarder as a percent of retarder configuration reference torque SPN 556.";
CM_ SG_ 3221225472 RetarderEnableShiftAssistSwitch "Switch signal which indicates whether the operator wishes the retarder to be enabled for transmission shift assist.Switch signal which indicates whether the operator wishes the retarder to be enabled for transmission shift assist.";
CM_ SG_ 3221225472 RetarderEnableBrakeAssistSwitch "Switch signal which indicates whether the operator wishes the retarder to be enabled for vehicle braking assist.Switch signal which indicates whether the operator wishes the retarder to be enabled for vehicle braking assist.";
CM_ SG_ 3221225472 RetarderTorqueMode "State signal which indicates which retarder torque mode is currently generating, limiting, or controlling the torque.State signal which indicates which retarder torque mode is currently generating, limiting, or controlling the torque.";
CM_ SG_ 3221225472 EngExhaustGasTemp "Temperature of combustion byproducts leaving the engine.";
CM_ SG_ 3221225472 EngAirInletPress "Absolute air pressure at inlet to intake manifold or air box.";
CM_ SG_ 3221225472 EngIntakeManifold1Temp "Temperature of pre-combustion air found in intake manifold of engine air supply system.";
CM_ SG_ 3221225472 EngTurboBoostPress "Gage pressure of air measured downstream on the compressor discharge side of the turbocharger.Gage pressure of air measured downstream on the compressor discharge side of the turbocharger.";
CM_ SG_ 3221225472 EngParticulateTrapInletPress "Exhaust back pressure as a result of particle accumulation on filter media placed in the exhaust stream.";
CM_ SG_ 3221225472 EngTotalRevolutions "Accumulated number of revolutions of engine crankshaft during its operation.";
CM_ SG_ 3221225472 EngTotalHoursOfOperation "Accumulated time of operation of engine.";
CM_ SG_ 3221225472 CargoWeight "The mass of freight carried.";
CM_ SG_ 3221225472 TrailerWeight "Total mass of freight-carrying vehicle designed to be pulled by truck, including the weight of the contents.";
CM_ SG_ 3221225472 AxleWeight "Total mass imposed by the tires on the road surface at the specified axle.";
CM_ SG_ 3221225472 AxleLocation "To identify to which of several similar devices (such as tires or fuel tanks) the information applies.";
CM_ SG_ 3221225472 VehicleIdentificationNumber "Vehicle Identification Number";
CM_ SG_ 3221225472 HighResolutionTripDistance "Distance traveled during all or part of a journey.";
CM_ SG_ 3221225472 HghRslutionTotalVehicleDistance "Accumulated distance traveled by the vehicle during its operation.";
CM_ SG_ 3221225472 LongitudinalAcceleration "Indicates the longitudinal acceleration of the vehicle.";
CM_ SG_ 3221225472 LateralAcceleration "Indicates a lateral acceleration of the vehicle.";
CM_ SG_ 3221225472 YawRate "Indicates the rotation about the vertical axis.";
CM_ SG_ 3221225472 SteerWheelTurnCounter "Indicates number of steering wheel turns, absolute position or relative position at ignition on.";
CM_ SG_ 3221225472 SteerWheelAngle "The main operator`s steering wheel angle (on the steering column, not the actual wheel angle).";
CM_ SG_ 3221225472 YCBrakeCtrlActive "State signal which indicates that Yaw Control (YC) has activated brake control.";
CM_ SG_ 3221225472 YCEngCtrlActive "State Signal which indicates that the Yaw Control (YC) has commanded engine control to be active.";
CM_ SG_ 3221225472 ROPBrakeCtrlActive "State signal which indicates that Roll over Prevention (ROP) has activated brake control.";
CM_ SG_ 3221225472 ROPEngCtrlActive "State Signal which indicates that the Roll Over Prevention (ROP) has commanded engine control to be active.";
CM_ SG_ 3221225472 VDCFullyOperational "Signal that indicates whether VDC is fully operational or whether its functionality is reduced by a permanent or temporary (e.";
CM_ SG_ 3221225472 VDCInformationSignal "This parameter commands the VDC information signal, for example a dash lamp.";
CM_ SG_ 3221225472 TotalVehicleDistance "Accumulated distance traveled by vehicle during its operation.";
CM_ SG_ 3221225472 TripDistance "Distance traveled during all or part of a journey.";
CM_ SG_ 3221225472 TireLocation "Identifies which tire is associated with the parametric data in this PGN.Identifies which tire is associated with the parametric data in this PGN.Identifies which tire is associated with the parametric data in this PGN.";
CM_ SG_ 3221225472 TireTemp_21 "Temperature at the surface of the tire sidewall. (SP242)";
CM_ SG_ 3221225472 TireTemp_20 "Temperature at the surface of the tire sidewall. (SP242)";
CM_ SG_ 3221225472 TireTemp_11 "Temperature at the surface of the tire sidewall. (SP242)";
CM_ SG_ 3221225472 TireTemp_10 "Temperature at the surface of the tire sidewall. (SP242)";
CM_ SG_ 3221225472 TireTemp_01 "Temperature at the surface of the tire sidewall. (SP242)";
CM_ SG_ 3221225472 TireTemp_00 "Temperature at the surface of the tire sidewall. (SP242)";
CM_ SG_ 3221225472 TirePressThresholdDetection_21 "Signal indicating the pressure level of the tire. (SP2587)";
CM_ SG_ 3221225472 TirePressThresholdDetection_20 "Signal indicating the pressure level of the tire. (SP2587)";
CM_ SG_ 3221225472 TirePressThresholdDetection_11 "Signal indicating the pressure level of the tire. (SP2587)";
CM_ SG_ 3221225472 TirePressThresholdDetection_10 "Signal indicating the pressure level of the tire. (SP2587)";
CM_ SG_ 3221225472 TirePressThresholdDetection_01 "Signal indicating the pressure level of the tire. (SP2587)";
CM_ SG_ 3221225472 TirePressThresholdDetection_00 "Signal indicating the pressure level of the tire. (SP2587)";
CM_ SG_ 3221225472 TirePress_21 "Pressure at which air is contained in cavity formed by tire and rim. (SP241)";
CM_ SG_ 3221225472 TirePress_20 "Pressure at which air is contained in cavity formed by tire and rim. (SP241)";
CM_ SG_ 3221225472 TirePress_11 "Pressure at which air is contained in cavity formed by tire and rim. (SP241)";
CM_ SG_ 3221225472 TirePress_10 "Pressure at which air is contained in cavity formed by tire and rim. (SP241)";
CM_ SG_ 3221225472 TirePress_01 "Pressure at which air is contained in cavity formed by tire and rim. (SP241)";
CM_ SG_ 3221225472 TirePress_00 "Pressure at which air is contained in cavity formed by tire and rim. (SP241)";
CM_ SG_ 3221225472 TireAirLeakageRate_21 "The pressure loss rate of a tire. (SP2586)";
CM_ SG_ 3221225472 TireAirLeakageRate_20 "The pressure loss rate of a tire. (SP2586)";
CM_ SG_ 3221225472 TireAirLeakageRate_11 "The pressure loss rate of a tire. (SP2586)";
CM_ SG_ 3221225472 TireAirLeakageRate_10 "The pressure loss rate of a tire. (SP2586)";
CM_ SG_ 3221225472 TireAirLeakageRate_01 "The pressure loss rate of a tire. (SP2586)";
CM_ SG_ 3221225472 TireAirLeakageRate_00 "The pressure loss rate of a tire. (SP2586)";
CM_ SG_ 3221225472 CTIWheelSensorStatus_21 "Indicates whether the wheel is being monitored by the CTI controller. (SP1699)";
CM_ SG_ 3221225472 CTIWheelSensorStatus_20 "Indicates whether the wheel is being monitored by the CTI controller. (SP1699)";
CM_ SG_ 3221225472 CTIWheelSensorStatus_11 "Indicates whether the wheel is being monitored by the CTI controller. (SP1699)";
CM_ SG_ 3221225472 CTIWheelSensorStatus_10 "Indicates whether the wheel is being monitored by the CTI controller. (SP1699)";
CM_ SG_ 3221225472 CTIWheelSensorStatus_01 "Indicates whether the wheel is being monitored by the CTI controller. (SP1699)";
CM_ SG_ 3221225472 CTIWheelSensorStatus_00 "Indicates whether the wheel is being monitored by the CTI controller. (SP1699)";
CM_ SG_ 3221225472 CTIWheelEndElectricalFault_21 "Indicates the status of electrical fault on CTI wheel interface. (SP1697)";
CM_ SG_ 3221225472 CTIWheelEndElectricalFault_20 "Indicates the status of electrical fault on CTI wheel interface. (SP1697)";
CM_ SG_ 3221225472 CTIWheelEndElectricalFault_11 "Indicates the status of electrical fault on CTI wheel interface. (SP1697)";
CM_ SG_ 3221225472 CTIWheelEndElectricalFault_10 "Indicates the status of electrical fault on CTI wheel interface. (SP1697)";
CM_ SG_ 3221225472 CTIWheelEndElectricalFault_01 "Indicates the status of electrical fault on CTI wheel interface. (SP1697)";
CM_ SG_ 3221225472 CTIWheelEndElectricalFault_00 "Indicates the status of electrical fault on CTI wheel interface. (SP1697)";
CM_ SG_ 3221225472 CTITireStatus_21 "Indicates the status of the tire. (SP1698)";
CM_ SG_ 3221225472 CTITireStatus_20 "Indicates the status of the tire. (SP1698)";
CM_ SG_ 3221225472 CTITireStatus_11 "Indicates the status of the tire. (SP1698)";
CM_ SG_ 3221225472 CTITireStatus_10 "Indicates the status of the tire. (SP1698)";
CM_ SG_ 3221225472 CTITireStatus_01 "Indicates the status of the tire. (SP1698)";
CM_ SG_ 3221225472 CTITireStatus_00 "Indicates the status of the tire. (SP1698)";
CM_ SG_ 3221225472 TachographVehicleSpeed "Speed of the vehicle registered by the tachograph.";
CM_ SG_ 3221225472 TachographOutputShaftSpeed "Calculated speed of the transmission output shaft.";
CM_ SG_ 3221225472 DirectionIndicator "Indicates the direction of the vehicle.";
CM_ SG_ 3221225472 HandlingInformation "Indicates that handling information is present.";
CM_ SG_ 3221225472 SystemEvent "Indicates that a tachograph event has occurred.";
CM_ SG_ 3221225472 Driver2TimeRelatedStates "Indicates if the driver approaches or exceeds working time limits (or other limits).";
CM_ SG_ 3221225472 Overspeed "Indicates whether the vehicle is exceeding the legal speed limit set in the tachograph.";
CM_ SG_ 3221225472 Driver1TimeRelatedStates "Indicates if the driver approaches or exceeds working time limits (or other limits).";
CM_ SG_ 3221225472 DriveRecognize "Indicates whether motion of the vehicle is detected or not.";
CM_ SG_ 3221225472 Driver2WorkingState "State of work of the driver.";
CM_ SG_ 3221225472 Driver1WorkingState "State of work of the driver.";
CM_ SG_ 3221225472 NumberOfForwardGearRatios "Number of forward gear ratios in the transmission, provided as part of the configuration.";
CM_ SG_ 3221225472 NumberOfReverseGearRatios "Number of reverse gear ratios in the transmission, provided as part of the transmission configuration.";
CM_ SG_ 3221225472 EngTurbo1Speed "Rotational velocity of rotor in the turbocharger.";
CM_ SG_ 3221225472 EngTurboLubeOilPress1 "Gage pressure of oil in turbocharger lubrication system.";
CM_ SG_ 3221225472 AirSuspensionSupplyPressRq "Command signal to influence the pneumatic pressure in the circuit for the electronically controlled air suspension system.";
CM_ SG_ 3221225472 AuxEquipmentSupplyPressRq "Command signal to influence the pneumatic pressure in the auxiliary circuit.";
CM_ SG_ 3221225472 ServiceBrakeAirPressRqCircuit2 "Command signal to influence the pneumatic pressure in the service brake circuit or reservoir #2.";
CM_ SG_ 3221225472 ServiceBrakeAirPressRqCircuit1 "Command signal to influence the pneumatic pressure in the service brake circuit or reservoir #1.";
CM_ SG_ 3221225472 ParkingAnd_OrTrailerAirPressRq "Command signal to influence the pneumatic pressure in the circuit or reservoir for the parking brake and/or the trailer supply.";
CM_ SG_ 3221225472 PneumaticSupplyPressRq "Command signal to influence the pneumatic pressure in the main reservoir.";
CM_ SG_ 3221225472 EngOverspeedTest "The engine overspeed test signal as measured by the reporting ECM.";
CM_ SG_ 3221225472 EngAirShutoffCmdStatus "State signal which indicates when the Air Shutoff driver output is being driven.";
CM_ SG_ 3221225472 EngAlarmOutputCmdStatus "State signal which indicates when the Alarm driver output is being driven.";
CM_ SG_ 3221225472 EngAlarmAcknowledge "The Engine Alarm Acknowledge Input signal as measured by the reporting ECM.";
CM_ SG_ 3221225472 EngProtectionSystemConfig "Parameter which indicates the configuration of the engine shutdown system.";
CM_ SG_ 3221225472 EngProtectionSystemTimerState "Status signal which indicates the current mode of the engine protection system timer system.";
CM_ SG_ 3221225472 EngPrtectionSystemTimerOverride "Status signal which indicates the status of the override feature of the engine protection system timer.";
CM_ SG_ 3221225472 EngPrtctnSystmApprchingShutdown "Status signal which indicates that engine shutdown is imminent.";
CM_ SG_ 3221225472 EngPrtctionSystemHasShutdownEng "Status signal which indicates whether or not the engine protection system has shutdown the engine.";
CM_ SG_ 3221225472 RefrigerantHighPressSwitch "Switch signal which indicates the position of the high pressure switch in the coolant circuit of an air conditioning system.";
CM_ SG_ 3221225472 RefrigerantLowPressSwitch "Switch signal which indicates the position of the low pressure switch in the coolant circuit of an air conditioning system.";
CM_ SG_ 3221225472 EngIdleShutdownTimerFunction "Parameter which indicates the configuration of the idle shutdown timer system.";
CM_ SG_ 3221225472 EngIdleShutdownTimerState "Status signal which indicates the current mode of operation of the idle shutdown timer system.";
CM_ SG_ 3221225472 EngIdleShutdownTimerOverride "Status signal which indicates the status of the override feature of the idle shutdown timer system.";
CM_ SG_ 3221225472 EngIdleShutdownDriverAlertMode "Status signal which indicates the status of the driver alert mode of the idle shutdown timer system.";
CM_ SG_ 3221225472 EngIdleShutdownHasShutdownEng "Status signal which identifies whether or not the engine has been shutdown by the idle shutdown timer system.";
CM_ SG_ 3221225472 ServiceComponentIdentificationB "Identification of component needing service.";
CM_ SG_ 3221225472 ServiceComponentIdentificationA "Identification of component needing service.";
CM_ SG_ 3221225472 SrvceDelay_OperationalTimeBased "The time in vehicle operational time until the next vehicle service inspection is required.";
CM_ SG_ 3221225472 ServiceDelay_CalendarTimeBased "The time in weeks until the next vehicle service inspection is required.";
CM_ SG_ 3221225472 ServiceDistance "The distance which can be traveled by the vehicle before the next service inspection is required.";
CM_ SG_ 3221225472 ServiceComponentIdentification "Identification of component needing service.Identification of component needing service.";
CM_ SG_ 3221225472 HydRetarderOilTemp "Temperature of oil found in a hydraulic retarder.";
CM_ SG_ 3221225472 HydRetarderPress "Gage pressure of oil in hydraulic retarder system.";
CM_ SG_ 3221225472 EngBuildHoursReset "Command signal used to reset the engine rebuild hours.";
CM_ SG_ 3221225472 TripGroup2Proprietary "Command signal used to reset proprietary parameters associated with a trip but not defined within this document.";
CM_ SG_ 3221225472 TripGroup1 "Command signal used to reset the PGNs and parameters as defined in Table SPN988_A.";
CM_ SG_ 3221225472 OperatorPTOMemorySelectSwitch "Measured state of the operator PTO memory select switch.";
CM_ SG_ 3221225472 EngPTOAccelerateSwitch "Switch signal of the PTO control activator which indicates that the activator is in the position \"accelerate\".";
CM_ SG_ 3221225472 EngPTOResumeSwitch "Switch signal of the PTO control activator which indicates that the activator is in the position \"resume\".";
CM_ SG_ 3221225472 EngPTOCoast_DecelerateSwitch "Switch signal of the PTO control activator which indicates that the activator is in the position \"coast/decelerate\".";
CM_ SG_ 3221225472 EngPTOSetSwitch "Switch signal of the PTO control activator which indicates that the activator is in the position \"set\".";
CM_ SG_ 3221225472 EngRmtPTOVriableSpeedCtrlSwitch "Switch signal which indicates that the remote PTO toggle switch is in the enabled (ON) position.";
CM_ SG_ 3221225472 EngRmtPTOPrprgrmmdSpdCtrlSwitch "Switch signal which indicates that the remote PTO toggle switch is in the enabled (ON) position.";
CM_ SG_ 3221225472 PowerTakeoffSetSpeed "Rotational velocity selected by operator for device used to transmit engine power to auxiliary equipment.";
CM_ SG_ 3221225472 PowerTakeoffSpeed "Rotational velocity of device used to transmit engine power to auxiliary equipment.";
CM_ SG_ 3221225472 PowerTakeoffOilTemp "Temperature of lubricant in device used to transmit engine power to auxiliary equipment.";
CM_ SG_ 3221225472 RmtPTOPrprgrmmdSpeedCtrlSwitch2 "Switch signal which indicates that the remote PTO toggle switch #2 is in the enabled (ON) position.";
CM_ SG_ 3221225472 AuxInputIgnoreSwitch "Switch signal which overrides other switch input's ability to kick out of an engine's operating condition.";
CM_ SG_ 3221225472 EngAverageFuelEconomy "Average of instantaneous fuel economy for that segment of vehicle operation of interest.";
CM_ SG_ 3221225472 EngInstantaneousFuelEconomy "Current fuel economy at current vehicle velocity.";
CM_ SG_ 3221225472 EngFuelRate "Amount of fuel consumed by engine per unit of time.";
CM_ SG_ 3221225472 EngThrottlePos "The position of the valve used to regulate the supply of a fluid, usually air or fuel/air mixture, to an engine.";
CM_ SG_ 3221225472 EngTotalFuelUsed "Accumulated amount of fuel used during vehicle operation.";
CM_ SG_ 3221225472 EngTripFuel "Fuel consumed during all or part of a journey.";
CM_ SG_ 3221225472 FanSpeed "The speed of the fan associated with engine coolant system.";
CM_ SG_ 3221225472 FanDriveState "This parameter is used to indicate the current state or mode of operation by the fan drive.";
CM_ SG_ 3221225472 EstPercentFanSpeed "Estimated fan speed as a ratio of the fan drive (current speed) to the fully engaged fan drive (maximum fan speed).";
CM_ SG_ 3221225472 TransShiftInhibitIndicator "State signal indicating a transmission request for the Shift Inhibit Indicator to be active or inactive.";
CM_ SG_ 3221225472 TransEngCrankEnable "State signal from the transmission indicating if the transmission’s status is such that engine cranking is allowed (i.";
CM_ SG_ 3221225472 EngECUTemp "Temperature of the engine electronic control unit.";
CM_ SG_ 3221225472 EngOilTemp2 "Temperature of the engine lubricant.";
CM_ SG_ 3221225472 EngIntercoolerThermostatOpening "The current position of the thermostat used to regulate the temperature of the engine intercooler.";
CM_ SG_ 3221225472 EngIntercoolerTemp "Temperature of liquid found in the intercooler located after the turbocharger.";
CM_ SG_ 3221225472 EngTurboOilTemp "Temperature of the turbocharger lubricant.";
CM_ SG_ 3221225472 EngOilTemp1 "Temperature of the engine lubricant.";
CM_ SG_ 3221225472 EngFuelTemp "Temperature of fuel entering injectors.";
CM_ SG_ 3221225472 EngCoolantTemp "Temperature of liquid found in engine cooling system.";
CM_ SG_ 3221225472 EngExhstGsOxygnSnsrClsdLpOprton "Indicates whether the engine is using the Exhaust Gas Oxygen sensor to control the air/fuel ratio.";
CM_ SG_ 3221225472 EngCoolantLevel "Ratio of volume of liquid found in engine cooling system to total cooling system volume.";
CM_ SG_ 3221225472 EngCoolantPress "Gage pressure of liquid found in engine cooling system.";
CM_ SG_ 3221225472 EngCrankcasePress "Gage pressure inside engine crankcase.";
CM_ SG_ 3221225472 EngOilPress "Gage pressure of oil in engine lubrication system as provided by oil pump.";
CM_ SG_ 3221225472 EngOilLevel "Ratio of current volume of engine sump oil to maximum required volume.";
CM_ SG_ 3221225472 EngExCrankcaseBlowbyPress "Differential crankcase blow-by pressure as measured through a tube with a venturi.";
CM_ SG_ 3221225472 EngFuelDeliveryPress "Gage pressure of fuel in system as delivered from supply pump to the injection pump.";
CM_ SG_ 3221225472 XBRAccelerationLimit "The brake system may temporarily or generally limit the maximum brake performance available for external systems.";
CM_ SG_ 3221225472 XBRActiveCtrlMode "This parameter indicates which XBR Control Mode is executed by the brake system.";
CM_ SG_ 3221225472 XBRSystemState "This parameter indicates which external brake control is allowed.";
CM_ SG_ 3221225472 FoundationBrakeUse "This parameter indicates if the brake system presently uses the foundation brakes.";
CM_ SG_ 3221225472 HillHolderMode "Signal which indicates the current mode of the hill holder function.";
CM_ SG_ 3221225472 HaltBrakeMode "Signal which indicates the current mode of the halt brake function.";
CM_ SG_ 3221225472 BrkLnngRmnngRearAxle3RightWheel "The percentage of brake lining which can still be measured for the right wheel on the rear axle #3.";
CM_ SG_ 3221225472 BrkLnngRmningRearAxle3LeftWheel "The percentage of brake lining which can still be measured for the left wheel on the rear axle #3.";
CM_ SG_ 3221225472 BrkLnngRmnngRearAxle2RightWheel "The percentage of brake lining which can still be measured for the right wheel on the rear axle #2.";
CM_ SG_ 3221225472 BrkLnngRmningRearAxle2LeftWheel "The percentage of brake lining which can still be measured for the left wheel on the rear axle #2.";
CM_ SG_ 3221225472 BrkLnngRmnngRearAxle1RightWheel "The percentage of brake lining which can still be measured for the right wheel on the rear axle #1.";
CM_ SG_ 3221225472 BrkLnngRmningRearAxle1LeftWheel "The percentage of brake lining which can still be measured for the left wheel on the rear axle #1.";
CM_ SG_ 3221225472 BrkLnngRmnngFrontAxleRightWheel "The percentage of brake lining which can still be measured for the right wheel on the front axle.";
CM_ SG_ 3221225472 BrkLnngRmningFrontAxleLeftWheel "The percentage of brake lining which can still be measured for the left wheel on the front axle.";
CM_ SG_ 3221225472 BrkAppPrssHghRngRrAxl3RghtWheel "The brake application pressure for the right wheel on the rear axle #3.";
CM_ SG_ 3221225472 BrkAppPrssHghRngRrAxl3LeftWheel "The brake application pressure for the left wheel on the rear axle #3.";
CM_ SG_ 3221225472 BrkAppPrssHghRngRrAxl2RghtWheel "The brake application pressure for the right wheel on the rear axle #2.";
CM_ SG_ 3221225472 BrkAppPrssHghRngRrAxl2LeftWheel "The brake application pressure for the left wheel on the rear axle #2.";
CM_ SG_ 3221225472 BrkAppPrssHghRngRrAxl1RghtWheel "The brake application pressure for the right wheel on the rear axle #1.";
CM_ SG_ 3221225472 BrkAppPrssHghRngRrAxl1LeftWheel "The brake application pressure for the left wheel on the rear axle #1.";
CM_ SG_ 3221225472 BrkAppPrssHghRngFrntAxlRghtWhel "The brake application pressure for the right wheel on the front axle.";
CM_ SG_ 3221225472 BrkAppPrssHghRngFrntAxlLftWheel "The brake application pressure for the left wheel on the front axle.";
CM_ SG_ 3221225472 RlativeSpeedRearAxle2RightWheel "The speed of the rear axle #2, right wheel relative to the front axle speed, SPN 904.";
CM_ SG_ 3221225472 RelativeSpeedRearAxle2LeftWheel "The speed of the rear axle #2, left wheel relative to the front axle speed, SPN 904.";
CM_ SG_ 3221225472 RlativeSpeedRearAxle1RightWheel "The speed of the rear axle #1, right wheel relative to the front axle speed, SPN 904.";
CM_ SG_ 3221225472 RelativeSpeedRearAxle1LeftWheel "The speed of the rear axle #1, left wheel relative to the front axle speed, SPN 904.";
CM_ SG_ 3221225472 RlativeSpeedFrontAxleRightWheel "The speed of the front axle, right wheel relative to the front axle speed, SPN 904.";
CM_ SG_ 3221225472 RelativeSpeedFrontAxleLeftWheel "The speed of the front axle, left wheel relative to the front axle speed, SPN 904.";
CM_ SG_ 3221225472 FrontAxleSpeed "The average speed of the two front wheels.";
CM_ SG_ 3221225472 SrcAddrssOfCtrllngDvcFrBrkCntrl "The source address of the SAE J1939 device currently controlling the brake system.";
CM_ SG_ 3221225472 BrakePedalPos "Ratio of brake pedal position to maximum pedal position.";
CM_ SG_ 3221225472 TrctrMntdTrilerABSWarningSignal "This parameter commands the tractor-mounted trailer ABS optical warning signal.";
CM_ SG_ 3221225472 TrailerABSStatus "State signal which indicates that ABS in the trailer is actively controlling the brakes.";
CM_ SG_ 3221225472 HaltBrakeSwitch "Switch signal which indicates the position of the halt brake switch.";
CM_ SG_ 3221225472 ATC_ASRInformationSignal "This parameter commands the ATC/ASR driver information signal, for example a dash lamp.";
CM_ SG_ 3221225472 RemoteAccelEnableSwitch "Switch signal which indicates that the remote accelerator has been enabled and controls the engine.";
CM_ SG_ 3221225472 EngAuxEngShutdownSwitch "Switch signal which requests that all engine fueling stop.";
CM_ SG_ 3221225472 EngDerateSwitch "Switch signal used to activate the torque limiting feature of the engine.";
CM_ SG_ 3221225472 AccelInterlockSwitch "Switch signal used to disable the accelerator and remote accelerator inputs, causing the engine to return to idle.";
CM_ SG_ 3221225472 TractionCtrlOverrideSwitch "Switch signal which indicates the position of the traction control override switch.";
CM_ SG_ 3221225472 ASRHillHolderSwitch "Switch signal which indicates the position of the ASR “hill holder” switch.";
CM_ SG_ 3221225472 ASROffroadSwitch "Switch signal which indicates the position of the ASR off-road switch.";
CM_ SG_ 3221225472 ABSOffroadSwitch "Switch signal which indicates the position of the ABS off-road switch.";
CM_ SG_ 3221225472 EBSBrakeSwitch "Switch signal which indicates that the brake pedal is being pressed.";
CM_ SG_ 3221225472 AntiLockBrakingActive "State signal which indicates that the ABS is active.";
CM_ SG_ 3221225472 ASRBrakeCtrlActive "State signal which indicates that ASR brake control is active.";
CM_ SG_ 3221225472 ASREngCtrlActive "State signal which indicates that ASR engine control has been commanded to be active.";
CM_ SG_ 3221225472 CargoAmbientTemp "Temperature of air inside vehicle container used to accommodate cargo.";
CM_ SG_ 3221225472 EngFuelFilterDiffPress "Differential pressure measured across the fuel filter located between the fuel tank and the supply pump.";
CM_ SG_ 3221225472 FuelLevel "Ratio of volume of fuel to the total volume of fuel storage container.";
CM_ SG_ 3221225472 WasherFluidLevel "Ratio of volume of liquid to total container volume of fluid reservoir in windshield wash system.";
CM_ SG_ 3221225472 RqCabZoneHeating "Request to activate cab zone heating.";
CM_ SG_ 3221225472 RqEngZoneHeating "Request to activate engine zone heating.";
CM_ SG_ 3221225472 AuxHeaterModeRq "Request to activate the auxiliary heater.";
CM_ SG_ 3221225472 EngAutomaticStartEnableSwitch "Switch signal which enables the idle management system to be enabled.";
CM_ SG_ 3221225472 VhclLmtngSpdGvrnrIncrmentSwitch "Switch signal which increases the Vehicle Limiting Speed Governor (VLSG).";
CM_ SG_ 3221225472 VhclLmtngSpdGvrnrDcrementSwitch "Switch signal which decreases the Vehicle Limiting Speed Governor (VLSG).";
CM_ SG_ 3221225472 BatteryMainSwitchHoldRq "Request to hold the battery main switch.";
CM_ SG_ 3221225472 AuxHeaterCoolantPumpRq "Indicates whether to activate the auxiliary heater coolant water pump.";
CM_ SG_ 3221225472 CabInteriorTempCmd "Parameter used to command a certain cab interior temperature.";
BA_DEF_ SG_  "SAEDocument" STRING ;
BA_DEF_ SG_  "GenSigEVName" STRING ;
BA_DEF_ BO_  "SAE_Document" STRING ;
BA_DEF_ BO_  "SingleFrame" INT 0 1;
BA_DEF_ SG_  "SigType" ENUM  "Default","Range","RangeSigned","ASCII","Discrete","Control","ReferencePGN","DTC","StringDelimiter","StringLength","StringLengthControl";
BA_DEF_ SG_  "GenSigStartValue" FLOAT 0 10000;
BA_DEF_ SG_  "GenSigSendType" ENUM  "Cyclic","OnWrite","reserved","OnChange","reserved","reserved","reserved","NoSigSendType";
BA_DEF_ SG_  "GenSigILSupport" ENUM  "Yes","No";
BA_DEF_ BO_  "GenMsgILSupport" ENUM  "Yes","No";
BA_DEF_ SG_  "SPN" INT 0 524287;
BA_DEF_ BO_  "GenMsgRequestable" INT 0 1;
BA_DEF_ BO_  "GenMsgSendType" ENUM  "cyclic","reserved","cyclicIfActive","reserved","reserved","reserved","reserved","reserved","noMsgSendType";
BA_DEF_ BO_  "VFrameFormat" ENUM  "StandardCAN","ExtendedCAN","reserved","J1939PG";
BA_DEF_ BO_  "GenMsgCycleTime" INT 0 3600000;
BA_DEF_ BU_  "NodeLayerModules" STRING ;
BA_DEF_ BU_  "NmStationAddress" INT 0 255;
BA_DEF_ BU_  "NmJ1939AAC" INT 0 1;
BA_DEF_ BU_  "NmJ1939IndustryGroup" INT 0 7;
BA_DEF_ BU_  "NmJ1939System" INT 0 127;
BA_DEF_ BU_  "NmJ1939SystemInstance" INT 0 15;
BA_DEF_ BU_  "NmJ1939Function" INT 0 255;
BA_DEF_ BU_  "NmJ1939FunctionInstance" INT 0 7;
BA_DEF_ BU_  "NmJ1939ECUInstance" INT 0 3;
BA_DEF_ BU_  "NmJ1939ManufacturerCode" INT 0 2047;
BA_DEF_ BU_  "NmJ1939IdentityNumber" INT 0 2097151;
BA_DEF_ BU_  "ECU" STRING ;
BA_DEF_  "DatabaseVersion" STRING ;
BA_DEF_  "BusType" STRING ;
BA_DEF_  "ProtocolType" STRING ;
BA_DEF_DEF_  "SAEDocument" "";
BA_DEF_DEF_  "GenSigEVName" "Env@Nodename_@Signame";
BA_DEF_DEF_  "SAE_Document" "";
BA_DEF_DEF_  "SingleFrame" 1;
BA_DEF_DEF_  "SigType" "Default";
BA_DEF_DEF_  "GenSigStartValue" 0;
BA_DEF_DEF_  "GenSigSendType" "NoSigSendType";
BA_DEF_DEF_  "GenSigILSupport" "Yes";
BA_DEF_DEF_  "GenMsgILSupport" "Yes";
BA_DEF_DEF_  "SPN" 0;
BA_DEF_DEF_  "GenMsgRequestable" 1;
BA_DEF_DEF_  "GenMsgSendType" "noMsgSendType";
BA_DEF_DEF_  "VFrameFormat" "J1939PG";
BA_DEF_DEF_  "GenMsgCycleTime" 0;
BA_DEF_DEF_  "NodeLayerModules" "";
BA_DEF_DEF_  "NmStationAddress" 254;
BA_DEF_DEF_  "NmJ1939AAC" 0;
BA_DEF_DEF_  "NmJ1939IndustryGroup" 0;
BA_DEF_DEF_  "NmJ1939System" 0;
BA_DEF_DEF_  "NmJ1939SystemInstance" 0;
BA_DEF_DEF_  "NmJ1939Function" 0;
BA_DEF_DEF_  "NmJ1939FunctionInstance" 0;
BA_DEF_DEF_  "NmJ1939ECUInstance" 0;
BA_DEF_DEF_  "NmJ1939ManufacturerCode" 0;
BA_DEF_DEF_  "NmJ1939IdentityNumber" 0;
BA_DEF_DEF_  "ECU" "";
BA_DEF_DEF_  "DatabaseVersion" "";
BA_DEF_DEF_  "BusType" "";
BA_DEF_DEF_  "ProtocolType" "";
BA_ "DatabaseVersion" "7.0";
BA_ "ProtocolType" "J1939";
BA_ "BusType" "CAN";
BA_ "NmStationAddress" BU_ TPMS 51;
BA_ "NmJ1939Function" BU_ TPMS 38;
BA_ "NmJ1939ManufacturerCode" BU_ TPMS 1861;
BA_ "NmJ1939IdentityNumber" BU_ TPMS 603215;
BA_ "ECU" BU_ TPMS "TPMS";
BA_ "NodeLayerModules" BU_ TPMS "J1939_IL.dll";
BA_ "NmStationAddress" BU_ EBS 11;
BA_ "NmJ1939Function" BU_ EBS 9;
BA_ "NmJ1939ManufacturerCode" BU_ EBS 1861;
BA_ "NmJ1939IdentityNumber" BU_ EBS 603211;
BA_ "ECU" BU_ EBS "EBS";
BA_ "NodeLayerModules" BU_ EBS "J1939_IL.dll";
BA_ "SPN" SG_ 3221225472 TireTemp 242;
BA_ "GenSigStartValue" SG_ 3221225472 TireTemp 9312;
BA_ "SigType" SG_ 3221225472 TireTemp 1;
BA_ "SPN" SG_ 3221225472 TirePress 241;
BA_ "SigType" SG_ 3221225472 TirePress 1;
BA_ "SPN" SG_ 3221225472 FlashRedStopLamp 3039;
BA_ "SPN" SG_ 3221225472 FlashProtectLamp 3041;
BA_ "SigType" SG_ 3221225472 FlashMalfuncIndicatorLamp 4;
BA_ "SPN" SG_ 3221225472 FlashMalfuncIndicatorLamp 3038;
BA_ "SPN" SG_ 3221225472 FlashAmberWarningLamp 3040;
BA_ "SigType" SG_ 3221225472 OccurenceCount5 1;
BA_ "SigType" SG_ 3221225472 OccurenceCount4 1;
BA_ "SigType" SG_ 3221225472 OccurenceCount3 1;
BA_ "SigType" SG_ 3221225472 OccurenceCount2 1;
BA_ "SigType" SG_ 3221225472 OccurenceCount1 1;
BA_ "SPN" SG_ 3221225472 OccurenceCount1 1216;
BA_ "SPN" SG_ 3221225472 SPNConversionMethod1 1706;
BA_ "SPN" SG_ 3221225472 FailureModeIdentifier1 1215;
BA_ "SPN" SG_ 3221225472 SPN1 1214;
BA_ "SigType" SG_ 3221225472 MalfunctionIndicatorLampStatus 4;
BA_ "SPN" SG_ 3221225472 MalfunctionIndicatorLampStatus 1213;
BA_ "SigType" SG_ 3221225472 RedStopLampState 4;
BA_ "SPN" SG_ 3221225472 RedStopLampState 623;
BA_ "SigType" SG_ 3221225472 AmberWarningLampStatus 4;
BA_ "SPN" SG_ 3221225472 AmberWarningLampStatus 624;
BA_ "SigType" SG_ 3221225472 ProtectLampStatus 4;
BA_ "SPN" SG_ 3221225472 ProtectLampStatus 987;
BA_ "SPN" SG_ 3221225472 SPN1High 1214;
BA_ "SigType" SG_ 3221225472 TransCurrentRange 1;
BA_ "SPN" SG_ 3221225472 TransCurrentRange 163;
BA_ "SigType" SG_ 3221225472 TransRqedRange 1;
BA_ "SPN" SG_ 3221225472 TransRqedRange 162;
BA_ "SigType" SG_ 3221225472 TransCurrentGear 1;
BA_ "SPN" SG_ 3221225472 TransCurrentGear 523;
BA_ "SigType" SG_ 3221225472 TransActualGearRatio 1;
BA_ "SPN" SG_ 3221225472 TransActualGearRatio 526;
BA_ "SigType" SG_ 3221225472 TransSelectedGear 1;
BA_ "SPN" SG_ 3221225472 TransSelectedGear 524;
BA_ "SigType" SG_ 3221225472 SrcAddrssOfCtrllngDvcFrTrnsCtrl 1;
BA_ "SPN" SG_ 3221225472 SrcAddrssOfCtrllngDvcFrTrnsCtrl 1482;
BA_ "SigType" SG_ 3221225472 TransInputShaftSpeed 1;
BA_ "SPN" SG_ 3221225472 TransInputShaftSpeed 161;
BA_ "SigType" SG_ 3221225472 ProgressiveShiftDisable 4;
BA_ "SPN" SG_ 3221225472 ProgressiveShiftDisable 607;
BA_ "SigType" SG_ 3221225472 EngMomentaryOverspeedEnable 4;
BA_ "SPN" SG_ 3221225472 EngMomentaryOverspeedEnable 606;
BA_ "SigType" SG_ 3221225472 PercentClutchSlip 1;
BA_ "SPN" SG_ 3221225472 PercentClutchSlip 522;
BA_ "SigType" SG_ 3221225472 TransOutputShaftSpeed 1;
BA_ "SPN" SG_ 3221225472 TransOutputShaftSpeed 191;
BA_ "SigType" SG_ 3221225472 TransShiftInProcess 4;
BA_ "SPN" SG_ 3221225472 TransShiftInProcess 574;
BA_ "SigType" SG_ 3221225472 TorqueConverterLockupEngaged 4;
BA_ "SPN" SG_ 3221225472 TorqueConverterLockupEngaged 573;
BA_ "SigType" SG_ 3221225472 TransDrivelineEngaged 4;
BA_ "SPN" SG_ 3221225472 TransDrivelineEngaged 560;
BA_ "SigType" SG_ 3221225472 ExhaustGasMass 1;
BA_ "SPN" SG_ 3221225472 ExhaustGasMass 3236;
BA_ "SPN" SG_ 3221225472 AftrTrtmntIntakeDewPointMessage 3237;
BA_ "SPN" SG_ 3221225472 AftrTrtmntExhustDewPointMessage 3238;
BA_ "SigType" SG_ 3221225472 EstEngPrsticLossesPercentTorque 1;
BA_ "SPN" SG_ 3221225472 EstEngPrsticLossesPercentTorque 2978;
BA_ "SigType" SG_ 3221225472 EngsDsrdOprtngSpdAsymmtryAdjstmn 1;
BA_ "SPN" SG_ 3221225472 EngsDsrdOprtngSpdAsymmtryAdjstmn 519;
BA_ "SigType" SG_ 3221225472 EngsDesiredOperatingSpeed 1;
BA_ "SPN" SG_ 3221225472 EngsDesiredOperatingSpeed 515;
BA_ "SigType" SG_ 3221225472 NominalFrictionPercentTorque 1;
BA_ "SPN" SG_ 3221225472 NominalFrictionPercentTorque 514;
BA_ "SigType" SG_ 3221225472 ActMaxAvailEngPercentTorque 1;
BA_ "SPN" SG_ 3221225472 ActMaxAvailEngPercentTorque 3357;
BA_ "SigType" SG_ 3221225472 AccelPedalPos2 1;
BA_ "SPN" SG_ 3221225472 AccelPedalPos2 29;
BA_ "SigType" SG_ 3221225472 VhclAccelerationRateLimitStatus 4;
BA_ "SPN" SG_ 3221225472 VhclAccelerationRateLimitStatus 2979;
BA_ "SigType" SG_ 3221225472 EngPercentLoadAtCurrentSpeed 1;
BA_ "SPN" SG_ 3221225472 EngPercentLoadAtCurrentSpeed 92;
BA_ "SigType" SG_ 3221225472 AccelPedal2LowIdleSwitch 4;
BA_ "SPN" SG_ 3221225472 AccelPedal2LowIdleSwitch 2970;
BA_ "SigType" SG_ 3221225472 RoadSpeedLimitStatus 4;
BA_ "SPN" SG_ 3221225472 RoadSpeedLimitStatus 1437;
BA_ "SigType" SG_ 3221225472 AccelPedalKickdownSwitch 4;
BA_ "SPN" SG_ 3221225472 AccelPedalKickdownSwitch 559;
BA_ "SigType" SG_ 3221225472 AccelPedal1LowIdleSwitch 4;
BA_ "SPN" SG_ 3221225472 AccelPedal1LowIdleSwitch 558;
BA_ "SigType" SG_ 3221225472 RemoteAccelPedalPos 1;
BA_ "SPN" SG_ 3221225472 RemoteAccelPedalPos 974;
BA_ "SigType" SG_ 3221225472 AccelPedalPos1 1;
BA_ "SPN" SG_ 3221225472 AccelPedalPos1 91;
BA_ "SigType" SG_ 3221225472 EngDemandPercentTorque 1;
BA_ "SPN" SG_ 3221225472 EngDemandPercentTorque 2432;
BA_ "SigType" SG_ 3221225472 EngStarterMode 4;
BA_ "SPN" SG_ 3221225472 EngStarterMode 1675;
BA_ "SigType" SG_ 3221225472 SrcAddrssOfCtrllngDvcForEngCtrl 1;
BA_ "SPN" SG_ 3221225472 SrcAddrssOfCtrllngDvcForEngCtrl 1483;
BA_ "SigType" SG_ 3221225472 EngSpeed 1;
BA_ "SPN" SG_ 3221225472 EngSpeed 190;
BA_ "SigType" SG_ 3221225472 ActualEngPercentTorque 1;
BA_ "SPN" SG_ 3221225472 ActualEngPercentTorque 513;
BA_ "SigType" SG_ 3221225472 DriversDemandEngPercentTorque 1;
BA_ "SPN" SG_ 3221225472 DriversDemandEngPercentTorque 512;
BA_ "SigType" SG_ 3221225472 EngTorqueMode 4;
BA_ "SPN" SG_ 3221225472 EngTorqueMode 899;
BA_ "SigType" SG_ 3221225472 SupportTSC1CtrlPurposeGroup4Of4 1;
BA_ "SPN" SG_ 3221225472 SupportTSC1CtrlPurposeGroup4Of4 3348;
BA_ "SigType" SG_ 3221225472 SupportVariableRateTSC1Message 1;
BA_ "SPN" SG_ 3221225472 SupportVariableRateTSC1Message 3344;
BA_ "SigType" SG_ 3221225472 SupportTSC1CtrlPurposeGroup3Of4 1;
BA_ "SPN" SG_ 3221225472 SupportTSC1CtrlPurposeGroup3Of4 3347;
BA_ "SigType" SG_ 3221225472 SupportTSC1CtrlPurposeGroup2Of4 1;
BA_ "SPN" SG_ 3221225472 SupportTSC1CtrlPurposeGroup2Of4 3346;
BA_ "SigType" SG_ 3221225472 SupportTSC1CtrlPurposeGroup1Of4 1;
BA_ "SPN" SG_ 3221225472 SupportTSC1CtrlPurposeGroup1Of4 3345;
BA_ "SigType" SG_ 3221225472 EngDefaultTorqueLimit 1;
BA_ "SPN" SG_ 3221225472 EngDefaultTorqueLimit 1846;
BA_ "SigType" SG_ 3221225472 EngMomentOfInertia 1;
BA_ "SPN" SG_ 3221225472 EngMomentOfInertia 1794;
BA_ "SigType" SG_ 3221225472 EngExRngRqdSpdCtrlRngUpperLimit 1;
BA_ "SPN" SG_ 3221225472 EngExRngRqdSpdCtrlRngUpperLimit 1712;
BA_ "SigType" SG_ 3221225472 EngRqdTorqueCtrlRangeUpperLimit 1;
BA_ "SPN" SG_ 3221225472 EngRqdTorqueCtrlRangeUpperLimit 538;
BA_ "SigType" SG_ 3221225472 EngRqdTorqueCtrlRangeLowerLimit 1;
BA_ "SPN" SG_ 3221225472 EngRqdTorqueCtrlRangeLowerLimit 537;
BA_ "SigType" SG_ 3221225472 EngRqedSpeedCtrlRangeUpperLimit 1;
BA_ "SPN" SG_ 3221225472 EngRqedSpeedCtrlRangeUpperLimit 536;
BA_ "SigType" SG_ 3221225472 EngRqedSpeedCtrlRangeLowerLimit 1;
BA_ "SPN" SG_ 3221225472 EngRqedSpeedCtrlRangeLowerLimit 535;
BA_ "SigType" SG_ 3221225472 EngMxMomentaryOverrideTimeLimit 1;
BA_ "SPN" SG_ 3221225472 EngMxMomentaryOverrideTimeLimit 534;
BA_ "SigType" SG_ 3221225472 EngMxMmntaryOverrideSpeedPoint7 1;
BA_ "SPN" SG_ 3221225472 EngMxMmntaryOverrideSpeedPoint7 533;
BA_ "SigType" SG_ 3221225472 EngReferenceTorque 1;
BA_ "SPN" SG_ 3221225472 EngReferenceTorque 544;
BA_ "SigType" SG_ 3221225472 EngSpeedAtHighIdlePoint6 1;
BA_ "SPN" SG_ 3221225472 EngSpeedAtHighIdlePoint6 532;
BA_ "SigType" SG_ 3221225472 EngGainOfEndspeedGovernor 1;
BA_ "SPN" SG_ 3221225472 EngGainOfEndspeedGovernor 545;
BA_ "SigType" SG_ 3221225472 EngPercentTorqueAtPoint5 1;
BA_ "SPN" SG_ 3221225472 EngPercentTorqueAtPoint5 543;
BA_ "SigType" SG_ 3221225472 EngSpeedAtPoint5 1;
BA_ "SPN" SG_ 3221225472 EngSpeedAtPoint5 531;
BA_ "SigType" SG_ 3221225472 EngPercentTorqueAtPoint4 1;
BA_ "SPN" SG_ 3221225472 EngPercentTorqueAtPoint4 542;
BA_ "SigType" SG_ 3221225472 EngSpeedAtPoint4 1;
BA_ "SPN" SG_ 3221225472 EngSpeedAtPoint4 530;
BA_ "SigType" SG_ 3221225472 EngPercentTorqueAtPoint3 1;
BA_ "SPN" SG_ 3221225472 EngPercentTorqueAtPoint3 541;
BA_ "SigType" SG_ 3221225472 EngSpeedAtPoint3 1;
BA_ "SPN" SG_ 3221225472 EngSpeedAtPoint3 529;
BA_ "SigType" SG_ 3221225472 EngPercentTorqueAtPoint2 1;
BA_ "SPN" SG_ 3221225472 EngPercentTorqueAtPoint2 540;
BA_ "SigType" SG_ 3221225472 EngSpeedAtPoint2 1;
BA_ "SPN" SG_ 3221225472 EngSpeedAtPoint2 528;
BA_ "SigType" SG_ 3221225472 EngPercentTorqueAtIdlePoint1 1;
BA_ "SPN" SG_ 3221225472 EngPercentTorqueAtIdlePoint1 539;
BA_ "SigType" SG_ 3221225472 EngSpeedAtIdlePoint1 1;
BA_ "SPN" SG_ 3221225472 EngSpeedAtIdlePoint1 188;
BA_ "SigType" SG_ 3221225472 EngShutdownOverrideSwitch 4;
BA_ "SPN" SG_ 3221225472 EngShutdownOverrideSwitch 1237;
BA_ "SigType" SG_ 3221225472 EngTestModeSwitch 4;
BA_ "SPN" SG_ 3221225472 EngTestModeSwitch 966;
BA_ "SigType" SG_ 3221225472 EngIdleDecrementSwitch 4;
BA_ "SPN" SG_ 3221225472 EngIdleDecrementSwitch 967;
BA_ "SigType" SG_ 3221225472 EngIdleIncrementSwitch 4;
BA_ "SPN" SG_ 3221225472 EngIdleIncrementSwitch 968;
BA_ "SigType" SG_ 3221225472 CruiseCtrlStates 4;
BA_ "SPN" SG_ 3221225472 CruiseCtrlStates 527;
BA_ "SigType" SG_ 3221225472 PTOState 4;
BA_ "SPN" SG_ 3221225472 PTOState 976;
BA_ "SigType" SG_ 3221225472 CruiseCtrlSetSpeed 1;
BA_ "SPN" SG_ 3221225472 CruiseCtrlSetSpeed 86;
BA_ "SigType" SG_ 3221225472 CruiseCtrlAccelerateSwitch 4;
BA_ "SPN" SG_ 3221225472 CruiseCtrlAccelerateSwitch 602;
BA_ "SigType" SG_ 3221225472 CruiseCtrlResumeSwitch 4;
BA_ "SPN" SG_ 3221225472 CruiseCtrlResumeSwitch 601;
BA_ "SigType" SG_ 3221225472 CruiseCtrlCoastSwitch 4;
BA_ "SPN" SG_ 3221225472 CruiseCtrlCoastSwitch 600;
BA_ "SigType" SG_ 3221225472 CruiseCtrlSetSwitch 4;
BA_ "SPN" SG_ 3221225472 CruiseCtrlSetSwitch 599;
BA_ "SigType" SG_ 3221225472 ClutchSwitch 4;
BA_ "SPN" SG_ 3221225472 ClutchSwitch 598;
BA_ "SigType" SG_ 3221225472 BrakeSwitch 4;
BA_ "SPN" SG_ 3221225472 BrakeSwitch 597;
BA_ "SigType" SG_ 3221225472 CruiseCtrlEnableSwitch 4;
BA_ "SPN" SG_ 3221225472 CruiseCtrlEnableSwitch 596;
BA_ "SigType" SG_ 3221225472 CruiseCtrlActive 4;
BA_ "SPN" SG_ 3221225472 CruiseCtrlActive 595;
BA_ "SigType" SG_ 3221225472 WheelBasedVehicleSpeed 1;
BA_ "SPN" SG_ 3221225472 WheelBasedVehicleSpeed 84;
BA_ "SigType" SG_ 3221225472 CruiseCtrlPauseSwitch 4;
BA_ "SPN" SG_ 3221225472 CruiseCtrlPauseSwitch 1633;
BA_ "SigType" SG_ 3221225472 ParkingBrakeSwitch 4;
BA_ "SPN" SG_ 3221225472 ParkingBrakeSwitch 70;
BA_ "SigType" SG_ 3221225472 TwoSpeedAxleSwitch 4;
BA_ "SPN" SG_ 3221225472 TwoSpeedAxleSwitch 69;
BA_ "SPN" SG_ 3221225472 ECUType 2904;
BA_ "SigType" SG_ 3221225472 ECUType 8;
BA_ "SPN" SG_ 3221225472 ECUSerialNumber 2902;
BA_ "SigType" SG_ 3221225472 ECUSerialNumber 8;
BA_ "SPN" SG_ 3221225472 ECUPartNumber 2901;
BA_ "SigType" SG_ 3221225472 ECUPartNumber 8;
BA_ "SPN" SG_ 3221225472 ECULocation 2903;
BA_ "SigType" SG_ 3221225472 ECULocation 8;
BA_ "SPN" SG_ 3221225472 SoftwareID3 234;
BA_ "SigType" SG_ 3221225472 SoftwareID3 8;
BA_ "SPN" SG_ 3221225472 SoftwareID2 234;
BA_ "SigType" SG_ 3221225472 SoftwareID2 8;
BA_ "SPN" SG_ 3221225472 SoftwareID1 234;
BA_ "SigType" SG_ 3221225472 SoftwareID1 8;
BA_ "SigType" SG_ 3221225472 NmbrOfSftwrIdentificationFields 1;
BA_ "SPN" SG_ 3221225472 NmbrOfSftwrIdentificationFields 965;
BA_ "SigType" SG_ 3221225472 TrnsShftSlctorDisplayModeSwitch 4;
BA_ "SPN" SG_ 3221225472 TrnsShftSlctorDisplayModeSwitch 2985;
BA_ "SigType" SG_ 3221225472 TransMode4 4;
BA_ "SPN" SG_ 3221225472 TransMode4 1855;
BA_ "SigType" SG_ 3221225472 TransMode3 4;
BA_ "SPN" SG_ 3221225472 TransMode3 1854;
BA_ "SigType" SG_ 3221225472 TransMode2 4;
BA_ "SPN" SG_ 3221225472 TransMode2 1853;
BA_ "SigType" SG_ 3221225472 TransMode1 4;
BA_ "SPN" SG_ 3221225472 TransMode1 1852;
BA_ "SigType" SG_ 3221225472 DisengageDiffLockRqCentralRear 4;
BA_ "SPN" SG_ 3221225472 DisengageDiffLockRqCentralRear 691;
BA_ "SigType" SG_ 3221225472 DisengageDiffLockRqCentralFront 4;
BA_ "SPN" SG_ 3221225472 DisengageDiffLockRqCentralFront 690;
BA_ "SigType" SG_ 3221225472 DisengageDiffLockRqCentral 4;
BA_ "SPN" SG_ 3221225472 DisengageDiffLockRqCentral 689;
BA_ "SigType" SG_ 3221225472 DisengageDiffLockRqRearAxle2 4;
BA_ "SPN" SG_ 3221225472 DisengageDiffLockRqRearAxle2 688;
BA_ "SigType" SG_ 3221225472 DisengageDiffLockRqRearAxle1 4;
BA_ "SPN" SG_ 3221225472 DisengageDiffLockRqRearAxle1 687;
BA_ "SigType" SG_ 3221225472 DisengageDiffLockRqFrontAxle2 4;
BA_ "SPN" SG_ 3221225472 DisengageDiffLockRqFrontAxle2 686;
BA_ "SigType" SG_ 3221225472 DisengageDiffLockRqFrontAxle1 4;
BA_ "SPN" SG_ 3221225472 DisengageDiffLockRqFrontAxle1 685;
BA_ "SigType" SG_ 3221225472 TransRqedGear 1;
BA_ "SPN" SG_ 3221225472 TransRqedGear 525;
BA_ "SigType" SG_ 3221225472 RqedPercentClutchSlip 1;
BA_ "SPN" SG_ 3221225472 RqedPercentClutchSlip 684;
BA_ "SigType" SG_ 3221225472 DisengageDrivelineRq 4;
BA_ "SPN" SG_ 3221225472 DisengageDrivelineRq 683;
BA_ "SigType" SG_ 3221225472 TorqueConverterLockupDisableRq 4;
BA_ "SPN" SG_ 3221225472 TorqueConverterLockupDisableRq 682;
BA_ "SigType" SG_ 3221225472 TransGearShiftInhibitRq 4;
BA_ "SPN" SG_ 3221225472 TransGearShiftInhibitRq 681;
BA_ "SigType" SG_ 3221225472 ControlPurpose 4;
BA_ "SPN" SG_ 3221225472 ControlPurpose 3350;
BA_ "SigType" SG_ 3221225472 TransmissionRate 4;
BA_ "SPN" SG_ 3221225472 TransmissionRate 3349;
BA_ "SigType" SG_ 3221225472 EngRqedTorque_TorqueLimit 1;
BA_ "SPN" SG_ 3221225472 EngRqedTorque_TorqueLimit 518;
BA_ "SigType" SG_ 3221225472 EngRqedSpeed_SpeedLimit 1;
BA_ "SPN" SG_ 3221225472 EngRqedSpeed_SpeedLimit 898;
BA_ "SigType" SG_ 3221225472 OverrideCtrlModePriority 4;
BA_ "SPN" SG_ 3221225472 OverrideCtrlModePriority 897;
BA_ "SigType" SG_ 3221225472 EngRqedSpeedCtrlConditions 4;
BA_ "SPN" SG_ 3221225472 EngRqedSpeedCtrlConditions 696;
BA_ "SigType" SG_ 3221225472 EngOverrideCtrlMode 4;
BA_ "SPN" SG_ 3221225472 EngOverrideCtrlMode 695;
BA_ "SigType" SG_ 3221225472 LocalHourOffset 1;
BA_ "SPN" SG_ 3221225472 LocalHourOffset 1602;
BA_ "SigType" SG_ 3221225472 LocalMinuteOffset 1;
BA_ "SPN" SG_ 3221225472 LocalMinuteOffset 1601;
BA_ "SigType" SG_ 3221225472 Year 1;
BA_ "SPN" SG_ 3221225472 Year 964;
BA_ "SigType" SG_ 3221225472 Day 1;
BA_ "SPN" SG_ 3221225472 Day 962;
BA_ "SigType" SG_ 3221225472 Month 1;
BA_ "SPN" SG_ 3221225472 Month 963;
BA_ "SigType" SG_ 3221225472 Hours 1;
BA_ "SPN" SG_ 3221225472 Hours 961;
BA_ "SigType" SG_ 3221225472 Minutes 1;
BA_ "SPN" SG_ 3221225472 Minutes 960;
BA_ "SigType" SG_ 3221225472 Seconds 1;
BA_ "SPN" SG_ 3221225472 Seconds 959;
BA_ "SigType" SG_ 3221225472 PercentTorqueAtPeakTorquePoint5 1;
BA_ "SPN" SG_ 3221225472 PercentTorqueAtPeakTorquePoint5 555;
BA_ "SigType" SG_ 3221225472 ReferenceRetarderTorque 1;
BA_ "SPN" SG_ 3221225472 ReferenceRetarderTorque 556;
BA_ "SigType" SG_ 3221225472 RetarderSpeedAtPeakTorquePoint5 1;
BA_ "SPN" SG_ 3221225472 RetarderSpeedAtPeakTorquePoint5 547;
BA_ "SigType" SG_ 3221225472 PercentTorqueAtPoint4 1;
BA_ "SPN" SG_ 3221225472 PercentTorqueAtPoint4 554;
BA_ "SigType" SG_ 3221225472 RetarderSpeedAtPoint4 1;
BA_ "SPN" SG_ 3221225472 RetarderSpeedAtPoint4 550;
BA_ "SigType" SG_ 3221225472 PercentTorqueAtPoint3 1;
BA_ "SPN" SG_ 3221225472 PercentTorqueAtPoint3 553;
BA_ "SigType" SG_ 3221225472 RetarderSpeedAtPoint3 1;
BA_ "SPN" SG_ 3221225472 RetarderSpeedAtPoint3 549;
BA_ "SigType" SG_ 3221225472 PercentTorqueAtMaxSpeedPoint2 1;
BA_ "SPN" SG_ 3221225472 PercentTorqueAtMaxSpeedPoint2 552;
BA_ "SigType" SG_ 3221225472 MaxRetarderSpeedPoint2 1;
BA_ "SPN" SG_ 3221225472 MaxRetarderSpeedPoint2 548;
BA_ "SigType" SG_ 3221225472 PercentTorqueAtIdlePoint1 1;
BA_ "SPN" SG_ 3221225472 PercentTorqueAtIdlePoint1 551;
BA_ "SigType" SG_ 3221225472 RetarderSpeedAtIdlePoint1 1;
BA_ "SPN" SG_ 3221225472 RetarderSpeedAtIdlePoint1 546;
BA_ "SigType" SG_ 3221225472 RetarderCtrlMethod 1;
BA_ "SPN" SG_ 3221225472 RetarderCtrlMethod 557;
BA_ "SigType" SG_ 3221225472 RetarderLocation 4;
BA_ "SPN" SG_ 3221225472 RetarderLocation 902;
BA_ "SigType" SG_ 3221225472 RetarderType 4;
BA_ "SPN" SG_ 3221225472 RetarderType 901;
BA_ "SigType" SG_ 3221225472 RetarderSelectionNonEng 1;
BA_ "SPN" SG_ 3221225472 RetarderSelectionNonEng 1716;
BA_ "SigType" SG_ 3221225472 ActlMxAvlblRtarderPercentTorque 1;
BA_ "SPN" SG_ 3221225472 ActlMxAvlblRtarderPercentTorque 1717;
BA_ "SigType" SG_ 3221225472 DrvrsDmandRetarderPercentTorque 1;
BA_ "SPN" SG_ 3221225472 DrvrsDmandRetarderPercentTorque 1715;
BA_ "SigType" SG_ 3221225472 SrcAddrssOfCtrllngDvcFrRtrdrCtrl 1;
BA_ "SPN" SG_ 3221225472 SrcAddrssOfCtrllngDvcFrRtrdrCtrl 1480;
BA_ "SigType" SG_ 3221225472 RetarderRqingBrakeLight 4;
BA_ "SPN" SG_ 3221225472 RetarderRqingBrakeLight 1667;
BA_ "SigType" SG_ 3221225472 EngCoolantLoadIncrease 4;
BA_ "SPN" SG_ 3221225472 EngCoolantLoadIncrease 1082;
BA_ "SigType" SG_ 3221225472 IntendedRetarderPercentTorque 1;
BA_ "SPN" SG_ 3221225472 IntendedRetarderPercentTorque 1085;
BA_ "SigType" SG_ 3221225472 ActualRetarderPercentTorque 1;
BA_ "SPN" SG_ 3221225472 ActualRetarderPercentTorque 520;
BA_ "SigType" SG_ 3221225472 RetarderEnableShiftAssistSwitch 4;
BA_ "SPN" SG_ 3221225472 RetarderEnableShiftAssistSwitch 572;
BA_ "SigType" SG_ 3221225472 RetarderEnableBrakeAssistSwitch 4;
BA_ "SPN" SG_ 3221225472 RetarderEnableBrakeAssistSwitch 571;
BA_ "SigType" SG_ 3221225472 RetarderTorqueMode 4;
BA_ "SPN" SG_ 3221225472 RetarderTorqueMode 900;
BA_ "SigType" SG_ 3221225472 EngCoolantFilterDiffPress 1;
BA_ "SPN" SG_ 3221225472 EngCoolantFilterDiffPress 112;
BA_ "SigType" SG_ 3221225472 EngExhaustGasTemp 1;
BA_ "SPN" SG_ 3221225472 EngExhaustGasTemp 173;
BA_ "SigType" SG_ 3221225472 EngAirFilter1DiffPress 1;
BA_ "SPN" SG_ 3221225472 EngAirFilter1DiffPress 107;
BA_ "SigType" SG_ 3221225472 EngAirInletPress 1;
BA_ "SPN" SG_ 3221225472 EngAirInletPress 106;
BA_ "SigType" SG_ 3221225472 EngIntakeManifold1Temp 1;
BA_ "SPN" SG_ 3221225472 EngIntakeManifold1Temp 105;
BA_ "SigType" SG_ 3221225472 EngTurboBoostPress 1;
BA_ "SPN" SG_ 3221225472 EngTurboBoostPress 102;
BA_ "SigType" SG_ 3221225472 EngParticulateTrapInletPress 1;
BA_ "SPN" SG_ 3221225472 EngParticulateTrapInletPress 81;
BA_ "SigType" SG_ 3221225472 EngTotalRevolutions 1;
BA_ "SPN" SG_ 3221225472 EngTotalRevolutions 249;
BA_ "SigType" SG_ 3221225472 EngTotalHoursOfOperation 1;
BA_ "SPN" SG_ 3221225472 EngTotalHoursOfOperation 247;
BA_ "SigType" SG_ 3221225472 CargoWeight 1;
BA_ "SPN" SG_ 3221225472 CargoWeight 181;
BA_ "SigType" SG_ 3221225472 TrailerWeight 1;
BA_ "SPN" SG_ 3221225472 TrailerWeight 180;
BA_ "SigType" SG_ 3221225472 AxleWeight 1;
BA_ "SPN" SG_ 3221225472 AxleWeight 582;
BA_ "SigType" SG_ 3221225472 AxleLocation 1;
BA_ "SPN" SG_ 3221225472 AxleLocation 2928;
BA_ "SPN" SG_ 3221225472 VehicleIdentificationNumber 237;
BA_ "SigType" SG_ 3221225472 VehicleIdentificationNumber 8;
BA_ "SigType" SG_ 3221225472 HighResolutionTripDistance 1;
BA_ "SPN" SG_ 3221225472 HighResolutionTripDistance 918;
BA_ "SigType" SG_ 3221225472 HghRslutionTotalVehicleDistance 1;
BA_ "SPN" SG_ 3221225472 HghRslutionTotalVehicleDistance 917;
BA_ "SigType" SG_ 3221225472 LongitudinalAcceleration 1;
BA_ "SPN" SG_ 3221225472 LongitudinalAcceleration 1810;
BA_ "SigType" SG_ 3221225472 LateralAcceleration 1;
BA_ "SPN" SG_ 3221225472 LateralAcceleration 1809;
BA_ "SigType" SG_ 3221225472 YawRate 1;
BA_ "SPN" SG_ 3221225472 YawRate 1808;
BA_ "SigType" SG_ 3221225472 SteerWheelAngleSensorType 4;
BA_ "SPN" SG_ 3221225472 SteerWheelAngleSensorType 1812;
BA_ "SigType" SG_ 3221225472 SteerWheelTurnCounter 4;
BA_ "SPN" SG_ 3221225472 SteerWheelTurnCounter 1811;
BA_ "SigType" SG_ 3221225472 SteerWheelAngle 1;
BA_ "SPN" SG_ 3221225472 SteerWheelAngle 1807;
BA_ "SigType" SG_ 3221225472 YCBrakeCtrlActive 4;
BA_ "SPN" SG_ 3221225472 YCBrakeCtrlActive 1819;
BA_ "SigType" SG_ 3221225472 YCEngCtrlActive 4;
BA_ "SPN" SG_ 3221225472 YCEngCtrlActive 1817;
BA_ "SigType" SG_ 3221225472 ROPBrakeCtrlActive 4;
BA_ "SPN" SG_ 3221225472 ROPBrakeCtrlActive 1818;
BA_ "SigType" SG_ 3221225472 ROPEngCtrlActive 4;
BA_ "SPN" SG_ 3221225472 ROPEngCtrlActive 1816;
BA_ "SigType" SG_ 3221225472 VDCBrakeLightRq 4;
BA_ "SPN" SG_ 3221225472 VDCBrakeLightRq 1815;
BA_ "SigType" SG_ 3221225472 VDCFullyOperational 4;
BA_ "SPN" SG_ 3221225472 VDCFullyOperational 1814;
BA_ "SigType" SG_ 3221225472 VDCInformationSignal 4;
BA_ "SPN" SG_ 3221225472 VDCInformationSignal 1813;
BA_ "SigType" SG_ 3221225472 TotalVehicleDistance 1;
BA_ "SPN" SG_ 3221225472 TotalVehicleDistance 245;
BA_ "SigType" SG_ 3221225472 TripDistance 1;
BA_ "SPN" SG_ 3221225472 TripDistance 244;
BA_ "SigType" SG_ 3221225472 ReferenceTirePressSetting 1;
BA_ "SPN" SG_ 3221225472 ReferenceTirePressSetting 3193;
BA_ "SigType" SG_ 3221225472 TireLocation 1;
BA_ "SPN" SG_ 3221225472 TireLocation 929;
BA_ "SigType" SG_ 3221225472 ReferenceTirePress 1;
BA_ "SPN" SG_ 3221225472 ReferenceTirePress 3191;
BA_ "SigType" SG_ 3221225472 TireTemp_21 1;
BA_ "GenSigStartValue" SG_ 3221225472 TireTemp_21 9312;
BA_ "SPN" SG_ 3221225472 TireTemp_21 521121;
BA_ "SigType" SG_ 3221225472 TireTemp_20 1;
BA_ "GenSigStartValue" SG_ 3221225472 TireTemp_20 9312;
BA_ "SPN" SG_ 3221225472 TireTemp_20 521120;
BA_ "SigType" SG_ 3221225472 TireTemp_11 1;
BA_ "GenSigStartValue" SG_ 3221225472 TireTemp_11 9312;
BA_ "SPN" SG_ 3221225472 TireTemp_11 521111;
BA_ "SigType" SG_ 3221225472 TireTemp_10 1;
BA_ "GenSigStartValue" SG_ 3221225472 TireTemp_10 9312;
BA_ "SPN" SG_ 3221225472 TireTemp_10 521110;
BA_ "SigType" SG_ 3221225472 TireTemp_01 1;
BA_ "GenSigStartValue" SG_ 3221225472 TireTemp_01 9312;
BA_ "SPN" SG_ 3221225472 TireTemp_01 521101;
BA_ "SigType" SG_ 3221225472 TireTemp_00 1;
BA_ "GenSigStartValue" SG_ 3221225472 TireTemp_00 9312;
BA_ "SPN" SG_ 3221225472 TireTemp_00 521100;
BA_ "SigType" SG_ 3221225472 TirePressThresholdDetection_21 4;
BA_ "GenSigILSupport" SG_ 3221225472 TirePressThresholdDetection_21 1;
BA_ "SPN" SG_ 3221225472 TirePressThresholdDetection_21 521621;
BA_ "SigType" SG_ 3221225472 TirePressThresholdDetection_20 4;
BA_ "GenSigILSupport" SG_ 3221225472 TirePressThresholdDetection_20 1;
BA_ "SPN" SG_ 3221225472 TirePressThresholdDetection_20 521620;
BA_ "SigType" SG_ 3221225472 TirePressThresholdDetection_11 4;
BA_ "GenSigILSupport" SG_ 3221225472 TirePressThresholdDetection_11 1;
BA_ "SPN" SG_ 3221225472 TirePressThresholdDetection_11 521611;
BA_ "SigType" SG_ 3221225472 TirePressThresholdDetection_10 4;
BA_ "GenSigILSupport" SG_ 3221225472 TirePressThresholdDetection_10 1;
BA_ "SPN" SG_ 3221225472 TirePressThresholdDetection_10 521610;
BA_ "SigType" SG_ 3221225472 TirePressThresholdDetection_01 4;
BA_ "GenSigILSupport" SG_ 3221225472 TirePressThresholdDetection_01 1;
BA_ "SPN" SG_ 3221225472 TirePressThresholdDetection_01 521601;
BA_ "SigType" SG_ 3221225472 TirePressThresholdDetection_00 4;
BA_ "SPN" SG_ 3221225472 TirePressThresholdDetection_00 521600;
BA_ "GenSigILSupport" SG_ 3221225472 TirePressThresholdDetection_00 1;
BA_ "SigType" SG_ 3221225472 TirePress_21 1;
BA_ "SPN" SG_ 3221225472 TirePress_21 521021;
BA_ "SigType" SG_ 3221225472 TirePress_20 1;
BA_ "SPN" SG_ 3221225472 TirePress_20 521020;
BA_ "SigType" SG_ 3221225472 TirePress_11 1;
BA_ "SPN" SG_ 3221225472 TirePress_11 521011;
BA_ "SigType" SG_ 3221225472 TirePress_10 1;
BA_ "SPN" SG_ 3221225472 TirePress_10 521010;
BA_ "SigType" SG_ 3221225472 TirePress_01 1;
BA_ "SPN" SG_ 3221225472 TirePress_01 521001;
BA_ "SigType" SG_ 3221225472 TirePress_00 1;
BA_ "SPN" SG_ 3221225472 TirePress_00 521000;
BA_ "SigType" SG_ 3221225472 TireAirLeakageRate_21 1;
BA_ "GenSigILSupport" SG_ 3221225472 TireAirLeakageRate_21 1;
BA_ "SPN" SG_ 3221225472 TireAirLeakageRate_21 521521;
BA_ "SigType" SG_ 3221225472 TireAirLeakageRate_20 1;
BA_ "GenSigILSupport" SG_ 3221225472 TireAirLeakageRate_20 1;
BA_ "SPN" SG_ 3221225472 TireAirLeakageRate_20 521520;
BA_ "SigType" SG_ 3221225472 TireAirLeakageRate_11 1;
BA_ "GenSigILSupport" SG_ 3221225472 TireAirLeakageRate_11 1;
BA_ "SPN" SG_ 3221225472 TireAirLeakageRate_11 521511;
BA_ "SigType" SG_ 3221225472 TireAirLeakageRate_10 1;
BA_ "GenSigILSupport" SG_ 3221225472 TireAirLeakageRate_10 1;
BA_ "SPN" SG_ 3221225472 TireAirLeakageRate_10 521510;
BA_ "SigType" SG_ 3221225472 TireAirLeakageRate_01 1;
BA_ "GenSigILSupport" SG_ 3221225472 TireAirLeakageRate_01 1;
BA_ "SPN" SG_ 3221225472 TireAirLeakageRate_01 521501;
BA_ "SigType" SG_ 3221225472 TireAirLeakageRate_00 1;
BA_ "SPN" SG_ 3221225472 TireAirLeakageRate_00 521500;
BA_ "GenSigILSupport" SG_ 3221225472 TireAirLeakageRate_00 1;
BA_ "SigType" SG_ 3221225472 CTIWheelSensorStatus_21 4;
BA_ "GenSigILSupport" SG_ 3221225472 CTIWheelSensorStatus_21 1;
BA_ "SPN" SG_ 3221225472 CTIWheelSensorStatus_21 521421;
BA_ "SigType" SG_ 3221225472 CTIWheelSensorStatus_20 4;
BA_ "GenSigILSupport" SG_ 3221225472 CTIWheelSensorStatus_20 1;
BA_ "SPN" SG_ 3221225472 CTIWheelSensorStatus_20 521420;
BA_ "SigType" SG_ 3221225472 CTIWheelSensorStatus_11 4;
BA_ "GenSigILSupport" SG_ 3221225472 CTIWheelSensorStatus_11 1;
BA_ "SPN" SG_ 3221225472 CTIWheelSensorStatus_11 521411;
BA_ "SigType" SG_ 3221225472 CTIWheelSensorStatus_10 4;
BA_ "GenSigILSupport" SG_ 3221225472 CTIWheelSensorStatus_10 1;
BA_ "SPN" SG_ 3221225472 CTIWheelSensorStatus_10 521410;
BA_ "SigType" SG_ 3221225472 CTIWheelSensorStatus_01 4;
BA_ "GenSigILSupport" SG_ 3221225472 CTIWheelSensorStatus_01 1;
BA_ "SPN" SG_ 3221225472 CTIWheelSensorStatus_01 521401;
BA_ "SigType" SG_ 3221225472 CTIWheelSensorStatus_00 4;
BA_ "SPN" SG_ 3221225472 CTIWheelSensorStatus_00 521400;
BA_ "GenSigILSupport" SG_ 3221225472 CTIWheelSensorStatus_00 1;
BA_ "SigType" SG_ 3221225472 CTIWheelEndElectricalFault_21 4;
BA_ "GenSigILSupport" SG_ 3221225472 CTIWheelEndElectricalFault_21 1;
BA_ "SPN" SG_ 3221225472 CTIWheelEndElectricalFault_21 521221;
BA_ "SigType" SG_ 3221225472 CTIWheelEndElectricalFault_20 4;
BA_ "GenSigILSupport" SG_ 3221225472 CTIWheelEndElectricalFault_20 1;
BA_ "SPN" SG_ 3221225472 CTIWheelEndElectricalFault_20 521220;
BA_ "SigType" SG_ 3221225472 CTIWheelEndElectricalFault_11 4;
BA_ "GenSigILSupport" SG_ 3221225472 CTIWheelEndElectricalFault_11 1;
BA_ "SPN" SG_ 3221225472 CTIWheelEndElectricalFault_11 521211;
BA_ "SigType" SG_ 3221225472 CTIWheelEndElectricalFault_10 4;
BA_ "GenSigILSupport" SG_ 3221225472 CTIWheelEndElectricalFault_10 1;
BA_ "SPN" SG_ 3221225472 CTIWheelEndElectricalFault_10 521210;
BA_ "SigType" SG_ 3221225472 CTIWheelEndElectricalFault_01 4;
BA_ "GenSigILSupport" SG_ 3221225472 CTIWheelEndElectricalFault_01 1;
BA_ "SPN" SG_ 3221225472 CTIWheelEndElectricalFault_01 521201;
BA_ "SigType" SG_ 3221225472 CTIWheelEndElectricalFault_00 4;
BA_ "SPN" SG_ 3221225472 CTIWheelEndElectricalFault_00 521200;
BA_ "GenSigILSupport" SG_ 3221225472 CTIWheelEndElectricalFault_00 1;
BA_ "SigType" SG_ 3221225472 CTITireStatus_21 4;
BA_ "GenSigILSupport" SG_ 3221225472 CTITireStatus_21 1;
BA_ "SPN" SG_ 3221225472 CTITireStatus_21 521321;
BA_ "SigType" SG_ 3221225472 CTITireStatus_20 4;
BA_ "GenSigILSupport" SG_ 3221225472 CTITireStatus_20 1;
BA_ "SPN" SG_ 3221225472 CTITireStatus_20 521320;
BA_ "SigType" SG_ 3221225472 CTITireStatus_11 4;
BA_ "GenSigILSupport" SG_ 3221225472 CTITireStatus_11 1;
BA_ "SPN" SG_ 3221225472 CTITireStatus_11 521311;
BA_ "SigType" SG_ 3221225472 CTITireStatus_10 4;
BA_ "GenSigILSupport" SG_ 3221225472 CTITireStatus_10 1;
BA_ "SPN" SG_ 3221225472 CTITireStatus_10 521310;
BA_ "SigType" SG_ 3221225472 CTITireStatus_01 4;
BA_ "GenSigILSupport" SG_ 3221225472 CTITireStatus_01 1;
BA_ "SPN" SG_ 3221225472 CTITireStatus_01 521301;
BA_ "SigType" SG_ 3221225472 CTITireStatus_00 4;
BA_ "SPN" SG_ 3221225472 CTITireStatus_00 521300;
BA_ "GenSigILSupport" SG_ 3221225472 CTITireStatus_00 1;
BA_ "SigType" SG_ 3221225472 TachographVehicleSpeed 1;
BA_ "SPN" SG_ 3221225472 TachographVehicleSpeed 1624;
BA_ "SigType" SG_ 3221225472 TachographOutputShaftSpeed 1;
BA_ "SPN" SG_ 3221225472 TachographOutputShaftSpeed 1623;
BA_ "SigType" SG_ 3221225472 DirectionIndicator 4;
BA_ "SPN" SG_ 3221225472 DirectionIndicator 1619;
BA_ "SigType" SG_ 3221225472 TachographPerformance 4;
BA_ "SPN" SG_ 3221225472 TachographPerformance 1620;
BA_ "SigType" SG_ 3221225472 HandlingInformation 4;
BA_ "SPN" SG_ 3221225472 HandlingInformation 1621;
BA_ "SigType" SG_ 3221225472 SystemEvent 4;
BA_ "SPN" SG_ 3221225472 SystemEvent 1622;
BA_ "SigType" SG_ 3221225472 DriverCardDriver2 4;
BA_ "SPN" SG_ 3221225472 DriverCardDriver2 1616;
BA_ "SigType" SG_ 3221225472 Driver2TimeRelatedStates 4;
BA_ "SPN" SG_ 3221225472 Driver2TimeRelatedStates 1618;
BA_ "SigType" SG_ 3221225472 Overspeed 4;
BA_ "SPN" SG_ 3221225472 Overspeed 1614;
BA_ "SigType" SG_ 3221225472 DriverCardDriver1 4;
BA_ "SPN" SG_ 3221225472 DriverCardDriver1 1615;
BA_ "SigType" SG_ 3221225472 Driver1TimeRelatedStates 4;
BA_ "SPN" SG_ 3221225472 Driver1TimeRelatedStates 1617;
BA_ "SigType" SG_ 3221225472 DriveRecognize 4;
BA_ "SPN" SG_ 3221225472 DriveRecognize 1611;
BA_ "SigType" SG_ 3221225472 Driver2WorkingState 4;
BA_ "SPN" SG_ 3221225472 Driver2WorkingState 1613;
BA_ "SigType" SG_ 3221225472 Driver1WorkingState 4;
BA_ "SPN" SG_ 3221225472 Driver1WorkingState 1612;
BA_ "SigType" SG_ 3221225472 TransTorqueLimit 1;
BA_ "SPN" SG_ 3221225472 TransTorqueLimit 1845;
BA_ "SigType" SG_ 3221225472 TransGearRatio 1;
BA_ "SPN" SG_ 3221225472 TransGearRatio 581;
BA_ "SigType" SG_ 3221225472 NumberOfForwardGearRatios 1;
BA_ "SPN" SG_ 3221225472 NumberOfForwardGearRatios 957;
BA_ "SigType" SG_ 3221225472 NumberOfReverseGearRatios 1;
BA_ "SPN" SG_ 3221225472 NumberOfReverseGearRatios 958;
BA_ "SigType" SG_ 3221225472 EngTurboOilLevelSwitch 4;
BA_ "SPN" SG_ 3221225472 EngTurboOilLevelSwitch 1665;
BA_ "SigType" SG_ 3221225472 EngTurbo1Speed 1;
BA_ "SPN" SG_ 3221225472 EngTurbo1Speed 103;
BA_ "SigType" SG_ 3221225472 EngTurboLubeOilPress1 1;
BA_ "SPN" SG_ 3221225472 EngTurboLubeOilPress1 104;
BA_ "SigType" SG_ 3221225472 AirSuspensionSupplyPressRq 1;
BA_ "SPN" SG_ 3221225472 AirSuspensionSupplyPressRq 2608;
BA_ "SigType" SG_ 3221225472 AuxEquipmentSupplyPressRq 1;
BA_ "SPN" SG_ 3221225472 AuxEquipmentSupplyPressRq 2607;
BA_ "SigType" SG_ 3221225472 ServiceBrakeAirPressRqCircuit2 1;
BA_ "SPN" SG_ 3221225472 ServiceBrakeAirPressRqCircuit2 2606;
BA_ "SigType" SG_ 3221225472 ServiceBrakeAirPressRqCircuit1 1;
BA_ "SPN" SG_ 3221225472 ServiceBrakeAirPressRqCircuit1 2605;
BA_ "SigType" SG_ 3221225472 ParkingAnd_OrTrailerAirPressRq 1;
BA_ "SPN" SG_ 3221225472 ParkingAnd_OrTrailerAirPressRq 2604;
BA_ "SigType" SG_ 3221225472 PneumaticSupplyPressRq 1;
BA_ "SPN" SG_ 3221225472 PneumaticSupplyPressRq 2603;
BA_ "SigType" SG_ 3221225472 EngOverspeedTest 4;
BA_ "SPN" SG_ 3221225472 EngOverspeedTest 2812;
BA_ "SigType" SG_ 3221225472 EngAirShutoffCmdStatus 4;
BA_ "SPN" SG_ 3221225472 EngAirShutoffCmdStatus 2813;
BA_ "SigType" SG_ 3221225472 EngAlarmOutputCmdStatus 4;
BA_ "SPN" SG_ 3221225472 EngAlarmOutputCmdStatus 2814;
BA_ "SigType" SG_ 3221225472 EngAlarmAcknowledge 4;
BA_ "SPN" SG_ 3221225472 EngAlarmAcknowledge 2815;
BA_ "SigType" SG_ 3221225472 EngProtectionSystemConfig 4;
BA_ "SPN" SG_ 3221225472 EngProtectionSystemConfig 1111;
BA_ "SigType" SG_ 3221225472 EngProtectionSystemTimerState 4;
BA_ "SPN" SG_ 3221225472 EngProtectionSystemTimerState 1107;
BA_ "SigType" SG_ 3221225472 EngPrtectionSystemTimerOverride 4;
BA_ "SPN" SG_ 3221225472 EngPrtectionSystemTimerOverride 1108;
BA_ "SigType" SG_ 3221225472 EngPrtctnSystmApprchingShutdown 4;
BA_ "SPN" SG_ 3221225472 EngPrtctnSystmApprchingShutdown 1109;
BA_ "SigType" SG_ 3221225472 EngPrtctionSystemHasShutdownEng 4;
BA_ "SPN" SG_ 3221225472 EngPrtctionSystemHasShutdownEng 1110;
BA_ "SigType" SG_ 3221225472 EngWaitToStartLamp 4;
BA_ "SPN" SG_ 3221225472 EngWaitToStartLamp 1081;
BA_ "SigType" SG_ 3221225472 RefrigerantHighPressSwitch 4;
BA_ "SPN" SG_ 3221225472 RefrigerantHighPressSwitch 605;
BA_ "SigType" SG_ 3221225472 RefrigerantLowPressSwitch 4;
BA_ "SPN" SG_ 3221225472 RefrigerantLowPressSwitch 875;
BA_ "SigType" SG_ 3221225472 A_CHighPressFanSwitch 4;
BA_ "SPN" SG_ 3221225472 A_CHighPressFanSwitch 985;
BA_ "SigType" SG_ 3221225472 EngIdleShutdownTimerFunction 4;
BA_ "SPN" SG_ 3221225472 EngIdleShutdownTimerFunction 591;
BA_ "SigType" SG_ 3221225472 EngIdleShutdownTimerState 4;
BA_ "SPN" SG_ 3221225472 EngIdleShutdownTimerState 590;
BA_ "SigType" SG_ 3221225472 EngIdleShutdownTimerOverride 4;
BA_ "SPN" SG_ 3221225472 EngIdleShutdownTimerOverride 592;
BA_ "SigType" SG_ 3221225472 EngIdleShutdownDriverAlertMode 4;
BA_ "SPN" SG_ 3221225472 EngIdleShutdownDriverAlertMode 594;
BA_ "SigType" SG_ 3221225472 EngIdleShutdownHasShutdownEng 4;
BA_ "SPN" SG_ 3221225472 EngIdleShutdownHasShutdownEng 593;
BA_ "SigType" SG_ 3221225472 ServiceComponentIdentificationB 1;
BA_ "SPN" SG_ 3221225472 ServiceComponentIdentificationB 912;
BA_ "SigType" SG_ 3221225472 ServiceComponentIdentificationA 1;
BA_ "SPN" SG_ 3221225472 ServiceComponentIdentificationA 911;
BA_ "SigType" SG_ 3221225472 SrvceDelay_OperationalTimeBased 1;
BA_ "SPN" SG_ 3221225472 SrvceDelay_OperationalTimeBased 916;
BA_ "SigType" SG_ 3221225472 ServiceDelay_CalendarTimeBased 1;
BA_ "SPN" SG_ 3221225472 ServiceDelay_CalendarTimeBased 915;
BA_ "SigType" SG_ 3221225472 ServiceDistance 1;
BA_ "SPN" SG_ 3221225472 ServiceDistance 914;
BA_ "SigType" SG_ 3221225472 ServiceComponentIdentification 1;
BA_ "SPN" SG_ 3221225472 ServiceComponentIdentification 1584;
BA_ "SigType" SG_ 3221225472 HydRetarderOilTemp 1;
BA_ "SPN" SG_ 3221225472 HydRetarderOilTemp 120;
BA_ "SigType" SG_ 3221225472 HydRetarderPress 1;
BA_ "SPN" SG_ 3221225472 HydRetarderPress 119;
BA_ "SigType" SG_ 3221225472 EngBuildHoursReset 4;
BA_ "SPN" SG_ 3221225472 EngBuildHoursReset 1211;
BA_ "SigType" SG_ 3221225472 TripGroup2Proprietary 4;
BA_ "SPN" SG_ 3221225472 TripGroup2Proprietary 989;
BA_ "SigType" SG_ 3221225472 TripGroup1 4;
BA_ "SPN" SG_ 3221225472 TripGroup1 988;
BA_ "SigType" SG_ 3221225472 OperatorPTOMemorySelectSwitch 4;
BA_ "SPN" SG_ 3221225472 OperatorPTOMemorySelectSwitch 2897;
BA_ "SigType" SG_ 3221225472 EngPTOAccelerateSwitch 4;
BA_ "SPN" SG_ 3221225472 EngPTOAccelerateSwitch 981;
BA_ "SigType" SG_ 3221225472 EngPTOResumeSwitch 4;
BA_ "SPN" SG_ 3221225472 EngPTOResumeSwitch 982;
BA_ "SigType" SG_ 3221225472 EngPTOCoast_DecelerateSwitch 4;
BA_ "SPN" SG_ 3221225472 EngPTOCoast_DecelerateSwitch 983;
BA_ "SigType" SG_ 3221225472 EngPTOSetSwitch 4;
BA_ "SPN" SG_ 3221225472 EngPTOSetSwitch 984;
BA_ "SigType" SG_ 3221225472 EngRmtPTOVriableSpeedCtrlSwitch 4;
BA_ "SPN" SG_ 3221225472 EngRmtPTOVriableSpeedCtrlSwitch 978;
BA_ "SigType" SG_ 3221225472 EngRmtPTOPrprgrmmdSpdCtrlSwitch 4;
BA_ "SPN" SG_ 3221225472 EngRmtPTOPrprgrmmdSpdCtrlSwitch 979;
BA_ "SigType" SG_ 3221225472 EngPTOEnableSwitch 4;
BA_ "SPN" SG_ 3221225472 EngPTOEnableSwitch 980;
BA_ "SigType" SG_ 3221225472 PowerTakeoffSetSpeed 1;
BA_ "SPN" SG_ 3221225472 PowerTakeoffSetSpeed 187;
BA_ "SigType" SG_ 3221225472 PowerTakeoffSpeed 1;
BA_ "SPN" SG_ 3221225472 PowerTakeoffSpeed 186;
BA_ "SigType" SG_ 3221225472 PowerTakeoffOilTemp 1;
BA_ "SPN" SG_ 3221225472 PowerTakeoffOilTemp 90;
BA_ "SigType" SG_ 3221225472 RmtPTOPrprgrmmdSpeedCtrlSwitch2 4;
BA_ "SPN" SG_ 3221225472 RmtPTOPrprgrmmdSpeedCtrlSwitch2 3447;
BA_ "SigType" SG_ 3221225472 AuxInputIgnoreSwitch 4;
BA_ "SPN" SG_ 3221225472 AuxInputIgnoreSwitch 3448;
BA_ "SigType" SG_ 3221225472 EngAverageFuelEconomy 1;
BA_ "SPN" SG_ 3221225472 EngAverageFuelEconomy 185;
BA_ "SigType" SG_ 3221225472 EngInstantaneousFuelEconomy 1;
BA_ "SPN" SG_ 3221225472 EngInstantaneousFuelEconomy 184;
BA_ "SigType" SG_ 3221225472 EngFuelRate 1;
BA_ "SPN" SG_ 3221225472 EngFuelRate 183;
BA_ "SigType" SG_ 3221225472 EngThrottlePos 1;
BA_ "SPN" SG_ 3221225472 EngThrottlePos 51;
BA_ "SigType" SG_ 3221225472 EngTotalFuelUsed 1;
BA_ "SPN" SG_ 3221225472 EngTotalFuelUsed 250;
BA_ "SigType" SG_ 3221225472 EngTripFuel 1;
BA_ "SPN" SG_ 3221225472 EngTripFuel 182;
BA_ "SigType" SG_ 3221225472 FanSpeed 1;
BA_ "SPN" SG_ 3221225472 FanSpeed 1639;
BA_ "SigType" SG_ 3221225472 FanDriveState 4;
BA_ "SPN" SG_ 3221225472 FanDriveState 977;
BA_ "SigType" SG_ 3221225472 EstPercentFanSpeed 1;
BA_ "SPN" SG_ 3221225472 EstPercentFanSpeed 975;
BA_ "SigType" SG_ 3221225472 TransRqedGearFeedback 1;
BA_ "SPN" SG_ 3221225472 TransRqedGearFeedback 3289;
BA_ "SigType" SG_ 3221225472 TransMode1Indicator 4;
BA_ "SPN" SG_ 3221225472 TransMode1Indicator 2536;
BA_ "SigType" SG_ 3221225472 TransMode2Indicator 4;
BA_ "SPN" SG_ 3221225472 TransMode2Indicator 2537;
BA_ "SigType" SG_ 3221225472 TransMode3Indicator 4;
BA_ "SPN" SG_ 3221225472 TransMode3Indicator 2538;
BA_ "SigType" SG_ 3221225472 TransMode4Indicator 4;
BA_ "SPN" SG_ 3221225472 TransMode4Indicator 2539;
BA_ "SigType" SG_ 3221225472 TransShiftInhibitIndicator 4;
BA_ "SPN" SG_ 3221225472 TransShiftInhibitIndicator 1851;
BA_ "SigType" SG_ 3221225472 TransEngCrankEnable 4;
BA_ "SPN" SG_ 3221225472 TransEngCrankEnable 2900;
BA_ "SigType" SG_ 3221225472 ActiveShiftConsoleIndicator 4;
BA_ "SPN" SG_ 3221225472 ActiveShiftConsoleIndicator 2945;
BA_ "SigType" SG_ 3221225472 TransReadyForBrakeRelease 4;
BA_ "SPN" SG_ 3221225472 TransReadyForBrakeRelease 3086;
BA_ "SigType" SG_ 3221225472 TransRqedRangeDisplayFlashState 4;
BA_ "SPN" SG_ 3221225472 TransRqedRangeDisplayFlashState 1849;
BA_ "SigType" SG_ 3221225472 TransRqedRangeDisplayBlankState 4;
BA_ "SPN" SG_ 3221225472 TransRqedRangeDisplayBlankState 1850;
BA_ "SigType" SG_ 3221225472 EngExhaustGasRecirculationTemp 1;
BA_ "SPN" SG_ 3221225472 EngExhaustGasRecirculationTemp 412;
BA_ "SigType" SG_ 3221225472 EngExhstGsRcirculationDiffPress 1;
BA_ "SPN" SG_ 3221225472 EngExhstGsRcirculationDiffPress 411;
BA_ "SigType" SG_ 3221225472 EngECUTemp 1;
BA_ "SPN" SG_ 3221225472 EngECUTemp 1136;
BA_ "SigType" SG_ 3221225472 EngOilTemp2 1;
BA_ "SPN" SG_ 3221225472 EngOilTemp2 1135;
BA_ "SigType" SG_ 3221225472 EngIntercoolerThermostatOpening 1;
BA_ "SPN" SG_ 3221225472 EngIntercoolerThermostatOpening 1134;
BA_ "SigType" SG_ 3221225472 EngIntercoolerTemp 1;
BA_ "SPN" SG_ 3221225472 EngIntercoolerTemp 52;
BA_ "SigType" SG_ 3221225472 EngTurboOilTemp 1;
BA_ "SPN" SG_ 3221225472 EngTurboOilTemp 176;
BA_ "SigType" SG_ 3221225472 EngOilTemp1 1;
BA_ "SPN" SG_ 3221225472 EngOilTemp1 175;
BA_ "SigType" SG_ 3221225472 EngFuelTemp 1;
BA_ "SPN" SG_ 3221225472 EngFuelTemp 174;
BA_ "SigType" SG_ 3221225472 EngCoolantTemp 1;
BA_ "SPN" SG_ 3221225472 EngCoolantTemp 110;
BA_ "SigType" SG_ 3221225472 EngExhstGsOxygnSnsrClsdLpOprton 4;
BA_ "SPN" SG_ 3221225472 EngExhstGsOxygnSnsrClsdLpOprton 1696;
BA_ "SigType" SG_ 3221225472 EngExhstGsOxygnSnsrFlngCrrction 1;
BA_ "SPN" SG_ 3221225472 EngExhstGsOxygnSnsrFlngCrrction 1695;
BA_ "SigType" SG_ 3221225472 EngActualExhaustOxygen 1;
BA_ "SPN" SG_ 3221225472 EngActualExhaustOxygen 1119;
BA_ "SigType" SG_ 3221225472 EngDesiredExhaustOxygen 1;
BA_ "SPN" SG_ 3221225472 EngDesiredExhaustOxygen 1118;
BA_ "SigType" SG_ 3221225472 EngDesiredRatedExhaustOxygen 1;
BA_ "SPN" SG_ 3221225472 EngDesiredRatedExhaustOxygen 1117;
BA_ "SigType" SG_ 3221225472 EngCoolantLevel 1;
BA_ "SPN" SG_ 3221225472 EngCoolantLevel 111;
BA_ "SigType" SG_ 3221225472 EngCoolantPress 1;
BA_ "SPN" SG_ 3221225472 EngCoolantPress 109;
BA_ "SigType" SG_ 3221225472 EngCrankcasePress 1;
BA_ "SPN" SG_ 3221225472 EngCrankcasePress 101;
BA_ "SigType" SG_ 3221225472 EngOilPress 1;
BA_ "SPN" SG_ 3221225472 EngOilPress 100;
BA_ "SigType" SG_ 3221225472 EngOilLevel 1;
BA_ "SPN" SG_ 3221225472 EngOilLevel 98;
BA_ "SigType" SG_ 3221225472 EngExCrankcaseBlowbyPress 1;
BA_ "SPN" SG_ 3221225472 EngExCrankcaseBlowbyPress 22;
BA_ "SigType" SG_ 3221225472 EngFuelDeliveryPress 1;
BA_ "SPN" SG_ 3221225472 EngFuelDeliveryPress 94;
BA_ "SigType" SG_ 3221225472 XBRAccelerationLimit 1;
BA_ "SPN" SG_ 3221225472 XBRAccelerationLimit 2921;
BA_ "SigType" SG_ 3221225472 XBRActiveCtrlMode 4;
BA_ "SPN" SG_ 3221225472 XBRActiveCtrlMode 2918;
BA_ "SigType" SG_ 3221225472 XBRSystemState 4;
BA_ "SPN" SG_ 3221225472 XBRSystemState 2917;
BA_ "SigType" SG_ 3221225472 FoundationBrakeUse 4;
BA_ "SPN" SG_ 3221225472 FoundationBrakeUse 2919;
BA_ "SigType" SG_ 3221225472 HillHolderMode 4;
BA_ "SPN" SG_ 3221225472 HillHolderMode 2912;
BA_ "SigType" SG_ 3221225472 HaltBrakeMode 4;
BA_ "SPN" SG_ 3221225472 HaltBrakeMode 2913;
BA_ "SigType" SG_ 3221225472 BrkLnngRmnngRearAxle3RightWheel 1;
BA_ "SPN" SG_ 3221225472 BrkLnngRmnngRearAxle3RightWheel 1106;
BA_ "SigType" SG_ 3221225472 BrkLnngRmningRearAxle3LeftWheel 1;
BA_ "SPN" SG_ 3221225472 BrkLnngRmningRearAxle3LeftWheel 1105;
BA_ "SigType" SG_ 3221225472 BrkLnngRmnngRearAxle2RightWheel 1;
BA_ "SPN" SG_ 3221225472 BrkLnngRmnngRearAxle2RightWheel 1104;
BA_ "SigType" SG_ 3221225472 BrkLnngRmningRearAxle2LeftWheel 1;
BA_ "SPN" SG_ 3221225472 BrkLnngRmningRearAxle2LeftWheel 1103;
BA_ "SigType" SG_ 3221225472 BrkLnngRmnngRearAxle1RightWheel 1;
BA_ "SPN" SG_ 3221225472 BrkLnngRmnngRearAxle1RightWheel 1102;
BA_ "SigType" SG_ 3221225472 BrkLnngRmningRearAxle1LeftWheel 1;
BA_ "SPN" SG_ 3221225472 BrkLnngRmningRearAxle1LeftWheel 1101;
BA_ "SigType" SG_ 3221225472 BrkLnngRmnngFrontAxleRightWheel 1;
BA_ "SPN" SG_ 3221225472 BrkLnngRmnngFrontAxleRightWheel 1100;
BA_ "SigType" SG_ 3221225472 BrkLnngRmningFrontAxleLeftWheel 1;
BA_ "SPN" SG_ 3221225472 BrkLnngRmningFrontAxleLeftWheel 1099;
BA_ "SigType" SG_ 3221225472 BrkAppPrssHghRngRrAxl3RghtWheel 1;
BA_ "SPN" SG_ 3221225472 BrkAppPrssHghRngRrAxl3RghtWheel 1098;
BA_ "SigType" SG_ 3221225472 BrkAppPrssHghRngRrAxl3LeftWheel 1;
BA_ "SPN" SG_ 3221225472 BrkAppPrssHghRngRrAxl3LeftWheel 1097;
BA_ "SigType" SG_ 3221225472 BrkAppPrssHghRngRrAxl2RghtWheel 1;
BA_ "SPN" SG_ 3221225472 BrkAppPrssHghRngRrAxl2RghtWheel 1096;
BA_ "SigType" SG_ 3221225472 BrkAppPrssHghRngRrAxl2LeftWheel 1;
BA_ "SPN" SG_ 3221225472 BrkAppPrssHghRngRrAxl2LeftWheel 1095;
BA_ "SigType" SG_ 3221225472 BrkAppPrssHghRngRrAxl1RghtWheel 1;
BA_ "SPN" SG_ 3221225472 BrkAppPrssHghRngRrAxl1RghtWheel 1094;
BA_ "SigType" SG_ 3221225472 BrkAppPrssHghRngRrAxl1LeftWheel 1;
BA_ "SPN" SG_ 3221225472 BrkAppPrssHghRngRrAxl1LeftWheel 1093;
BA_ "SigType" SG_ 3221225472 BrkAppPrssHghRngFrntAxlRghtWhel 1;
BA_ "SPN" SG_ 3221225472 BrkAppPrssHghRngFrntAxlRghtWhel 1092;
BA_ "SigType" SG_ 3221225472 BrkAppPrssHghRngFrntAxlLftWheel 1;
BA_ "SPN" SG_ 3221225472 BrkAppPrssHghRngFrntAxlLftWheel 1091;
BA_ "SigType" SG_ 3221225472 RlativeSpeedRearAxle2RightWheel 1;
BA_ "SPN" SG_ 3221225472 RlativeSpeedRearAxle2RightWheel 910;
BA_ "SigType" SG_ 3221225472 RelativeSpeedRearAxle2LeftWheel 1;
BA_ "SPN" SG_ 3221225472 RelativeSpeedRearAxle2LeftWheel 909;
BA_ "SigType" SG_ 3221225472 RlativeSpeedRearAxle1RightWheel 1;
BA_ "SPN" SG_ 3221225472 RlativeSpeedRearAxle1RightWheel 908;
BA_ "SigType" SG_ 3221225472 RelativeSpeedRearAxle1LeftWheel 1;
BA_ "SPN" SG_ 3221225472 RelativeSpeedRearAxle1LeftWheel 907;
BA_ "SigType" SG_ 3221225472 RlativeSpeedFrontAxleRightWheel 1;
BA_ "SPN" SG_ 3221225472 RlativeSpeedFrontAxleRightWheel 906;
BA_ "SigType" SG_ 3221225472 RelativeSpeedFrontAxleLeftWheel 1;
BA_ "SPN" SG_ 3221225472 RelativeSpeedFrontAxleLeftWheel 905;
BA_ "SigType" SG_ 3221225472 FrontAxleSpeed 1;
BA_ "SPN" SG_ 3221225472 FrontAxleSpeed 904;
BA_ "SigType" SG_ 3221225472 SrcAddrssOfCtrllngDvcFrBrkCntrl 1;
BA_ "SPN" SG_ 3221225472 SrcAddrssOfCtrllngDvcFrBrkCntrl 1481;
BA_ "SigType" SG_ 3221225472 BrakePedalPos 1;
BA_ "SPN" SG_ 3221225472 BrakePedalPos 521;
BA_ "SigType" SG_ 3221225472 TrctrMntdTrilerABSWarningSignal 4;
BA_ "SPN" SG_ 3221225472 TrctrMntdTrilerABSWarningSignal 1792;
BA_ "SigType" SG_ 3221225472 TrailerABSStatus 4;
BA_ "SPN" SG_ 3221225472 TrailerABSStatus 1836;
BA_ "SigType" SG_ 3221225472 HaltBrakeSwitch 4;
BA_ "SPN" SG_ 3221225472 HaltBrakeSwitch 2911;
BA_ "SigType" SG_ 3221225472 ATC_ASRInformationSignal 4;
BA_ "SPN" SG_ 3221225472 ATC_ASRInformationSignal 1793;
BA_ "SigType" SG_ 3221225472 ABS_EBSAmberWarningSignal 4;
BA_ "SPN" SG_ 3221225472 ABS_EBSAmberWarningSignal 1438;
BA_ "SigType" SG_ 3221225472 EBSRedWarningSignal 4;
BA_ "SPN" SG_ 3221225472 EBSRedWarningSignal 1439;
BA_ "SigType" SG_ 3221225472 ABSFullyOperational 4;
BA_ "SPN" SG_ 3221225472 ABSFullyOperational 1243;
BA_ "SigType" SG_ 3221225472 EngRetarderSelection 1;
BA_ "SPN" SG_ 3221225472 EngRetarderSelection 973;
BA_ "SigType" SG_ 3221225472 RemoteAccelEnableSwitch 4;
BA_ "SPN" SG_ 3221225472 RemoteAccelEnableSwitch 969;
BA_ "SigType" SG_ 3221225472 EngAuxEngShutdownSwitch 4;
BA_ "SPN" SG_ 3221225472 EngAuxEngShutdownSwitch 970;
BA_ "SigType" SG_ 3221225472 EngDerateSwitch 4;
BA_ "SPN" SG_ 3221225472 EngDerateSwitch 971;
BA_ "SigType" SG_ 3221225472 AccelInterlockSwitch 4;
BA_ "SPN" SG_ 3221225472 AccelInterlockSwitch 972;
BA_ "SigType" SG_ 3221225472 TractionCtrlOverrideSwitch 4;
BA_ "SPN" SG_ 3221225472 TractionCtrlOverrideSwitch 1238;
BA_ "SigType" SG_ 3221225472 ASRHillHolderSwitch 4;
BA_ "SPN" SG_ 3221225472 ASRHillHolderSwitch 577;
BA_ "SigType" SG_ 3221225472 ASROffroadSwitch 4;
BA_ "SPN" SG_ 3221225472 ASROffroadSwitch 576;
BA_ "SigType" SG_ 3221225472 ABSOffroadSwitch 4;
BA_ "SPN" SG_ 3221225472 ABSOffroadSwitch 575;
BA_ "SigType" SG_ 3221225472 EBSBrakeSwitch 4;
BA_ "SPN" SG_ 3221225472 EBSBrakeSwitch 1121;
BA_ "SigType" SG_ 3221225472 AntiLockBrakingActive 4;
BA_ "SPN" SG_ 3221225472 AntiLockBrakingActive 563;
BA_ "SigType" SG_ 3221225472 ASRBrakeCtrlActive 4;
BA_ "SPN" SG_ 3221225472 ASRBrakeCtrlActive 562;
BA_ "SigType" SG_ 3221225472 ASREngCtrlActive 4;
BA_ "SPN" SG_ 3221225472 ASREngCtrlActive 561;
BA_ "SPN" SG_ 3221225472 Driver2 1626;
BA_ "SigType" SG_ 3221225472 Driver2 8;
BA_ "SPN" SG_ 3221225472 Driver1 1625;
BA_ "SigType" SG_ 3221225472 Driver1 8;
BA_ "SigType" SG_ 3221225472 CargoAmbientTemp 1;
BA_ "SPN" SG_ 3221225472 CargoAmbientTemp 169;
BA_ "SigType" SG_ 3221225472 EngOilFilterDiffPress 1;
BA_ "SPN" SG_ 3221225472 EngOilFilterDiffPress 99;
BA_ "SigType" SG_ 3221225472 EngFuelFilterDiffPress 1;
BA_ "SPN" SG_ 3221225472 EngFuelFilterDiffPress 95;
BA_ "SigType" SG_ 3221225472 FuelLevel 1;
BA_ "SPN" SG_ 3221225472 FuelLevel 96;
BA_ "SigType" SG_ 3221225472 WasherFluidLevel 1;
BA_ "SPN" SG_ 3221225472 WasherFluidLevel 80;
BA_ "SigType" SG_ 3221225472 SelectedMaxVehicleSpeedLimit 1;
BA_ "SPN" SG_ 3221225472 SelectedMaxVehicleSpeedLimit 2596;
BA_ "SigType" SG_ 3221225472 RqCabZoneHeating 4;
BA_ "SPN" SG_ 3221225472 RqCabZoneHeating 1686;
BA_ "SigType" SG_ 3221225472 RqEngZoneHeating 4;
BA_ "SPN" SG_ 3221225472 RqEngZoneHeating 1685;
BA_ "SigType" SG_ 3221225472 AuxHeaterModeRq 4;
BA_ "SPN" SG_ 3221225472 AuxHeaterModeRq 1683;
BA_ "SigType" SG_ 3221225472 EngAutomaticStartEnableSwitch 4;
BA_ "SPN" SG_ 3221225472 EngAutomaticStartEnableSwitch 1656;
BA_ "SigType" SG_ 3221225472 AtmaticGearShiftingEnableSwitch 4;
BA_ "SPN" SG_ 3221225472 AtmaticGearShiftingEnableSwitch 1666;
BA_ "SigType" SG_ 3221225472 VhclLmtngSpdGvernorEnableSwitch 4;
BA_ "SPN" SG_ 3221225472 VhclLmtngSpdGvernorEnableSwitch 1653;
BA_ "SigType" SG_ 3221225472 VhclLmtngSpdGvrnrIncrmentSwitch 4;
BA_ "SPN" SG_ 3221225472 VhclLmtngSpdGvrnrIncrmentSwitch 1654;
BA_ "SigType" SG_ 3221225472 VhclLmtngSpdGvrnrDcrementSwitch 4;
BA_ "SPN" SG_ 3221225472 VhclLmtngSpdGvrnrDcrementSwitch 1655;
BA_ "SigType" SG_ 3221225472 SeatBeltSwitch 4;
BA_ "SPN" SG_ 3221225472 SeatBeltSwitch 1856;
BA_ "SigType" SG_ 3221225472 OperatorSeatDirectionSwitch 4;
BA_ "SPN" SG_ 3221225472 OperatorSeatDirectionSwitch 1714;
BA_ "SigType" SG_ 3221225472 BatteryMainSwitchHoldRq 4;
BA_ "SPN" SG_ 3221225472 BatteryMainSwitchHoldRq 1682;
BA_ "SigType" SG_ 3221225472 AuxHeaterCoolantPumpRq 4;
BA_ "SPN" SG_ 3221225472 AuxHeaterCoolantPumpRq 1684;
BA_ "SigType" SG_ 3221225472 CabInteriorTempCmd 1;
BA_ "SPN" SG_ 3221225472 CabInteriorTempCmd 1691;
VAL_ 3221225472 FailureModeIdentifier5 31 "Not available" 19 "Received network data in error" 18 "Below normal (moderatels severe)" 17 "Below normal (least severe)" 16 "Above normal (moderately severe)" 15 "Above normal (least severe)" 14 "Special intstructions" 13 "Out of calibration" 12 "Bad intelligent device" 11 "Root cause not known" 10 "Abnormal rate of change" 9 "Abnormal update rate" 8 "Abnormal frequency" 7 "Mechanical system not responding" 6 "Current above normal" 5 "Current below normal" 4 "Voltage below normal" 3 "Voltage above normal" 2 "Data erratic" 1 "Below normal (most severe)" 0 "Above normal (most severe)" ;
VAL_ 3221225472 FailureModeIdentifier4 31 "Not available" 19 "Received network data in error" 18 "Below normal (moderatels severe)" 17 "Below normal (least severe)" 16 "Above normal (moderately severe)" 15 "Above normal (least severe)" 14 "Special intstructions" 13 "Out of calibration" 12 "Bad intelligent device" 11 "Root cause not known" 10 "Abnormal rate of change" 9 "Abnormal update rate" 8 "Abnormal frequency" 7 "Mechanical system not responding" 6 "Current above normal" 5 "Current below normal" 4 "Voltage below normal" 3 "Voltage above normal" 2 "Data erratic" 1 "Below normal (most severe)" 0 "Above normal (most severe)" ;
VAL_ 3221225472 FlashRedStopLamp 3 "Unavailable / Do Not Flash" 2 "Reserved" 1 "Fast Flash" 0 "Slow Flash" ;
VAL_ 3221225472 FlashProtectLamp 3 "Unavailable / Do Not Flash" 2 "Reserved" 1 "Fast Flash" 0 "Slow Flash" ;
VAL_ 3221225472 FlashMalfuncIndicatorLamp 3 "Unavailable / Do Not Flash" 2 "Reserved" 1 "Fast Flash" 0 "Slow Flash" ;
VAL_ 3221225472 FlashAmberWarningLamp 3 "Unavailable / Do Not Flash" 2 "Reserved" 1 "Fast Flash" 0 "Slow Flash" ;
VAL_ 3221225472 FailureModeIdentifier3 31 "Not available" 19 "Received network data in error" 18 "Below normal (moderatels severe)" 17 "Below normal (least severe)" 16 "Above normal (moderately severe)" 15 "Above normal (least severe)" 14 "Special intstructions" 13 "Out of calibration" 12 "Bad intelligent device" 11 "Root cause not known" 10 "Abnormal rate of change" 9 "Abnormal update rate" 8 "Abnormal frequency" 7 "Mechanical system not responding" 6 "Current above normal" 5 "Current below normal" 4 "Voltage below normal" 3 "Voltage above normal" 2 "Data erratic" 1 "Below normal (most severe)" 0 "Above normal (most severe)" ;
VAL_ 3221225472 FailureModeIdentifier2 31 "Not available" 19 "Received network data in error" 18 "Below normal (moderatels severe)" 17 "Below normal (least severe)" 16 "Above normal (moderately severe)" 15 "Above normal (least severe)" 14 "Special intstructions" 13 "Out of calibration" 12 "Bad intelligent device" 11 "Root cause not known" 10 "Abnormal rate of change" 9 "Abnormal update rate" 8 "Abnormal frequency" 7 "Mechanical system not responding" 6 "Current above normal" 5 "Current below normal" 4 "Voltage below normal" 3 "Voltage above normal" 2 "Data erratic" 1 "Below normal (most severe)" 0 "Above normal (most severe)" ;
VAL_ 3221225472 FailureModeIdentifier1 31 "Not available" 19 "Received network data in error" 18 "Below normal (moderatels severe)" 17 "Below normal (least severe)" 16 "Above normal (moderately severe)" 15 "Above normal (least severe)" 14 "Special intstructions" 13 "Out of calibration" 12 "Bad intelligent device" 11 "Root cause not known" 10 "Abnormal rate of change" 9 "Abnormal update rate" 8 "Abnormal frequency" 7 "Mechanical system not responding" 6 "Current above normal" 5 "Current below normal" 4 "Voltage below normal" 3 "Voltage above normal" 2 "Data erratic" 1 "Below normal (most severe)" 0 "Above normal (most severe)" ;
VAL_ 3221225472 MalfunctionIndicatorLampStatus 3 "Not available" 2 "Reserved" 1 "Lamp on" 0 "Lamp off" ;
VAL_ 3221225472 RedStopLampState 3 "Not available" 2 "Reserved" 1 "Lamp on" 0 "Lamp off" ;
VAL_ 3221225472 AmberWarningLampStatus 3 "Not available" 2 "Reserved" 1 "Lamp on" 0 "Lamp off" ;
VAL_ 3221225472 ProtectLampStatus 3 "Not available" 2 "Reserved" 1 "Lamp on" 0 "Lamp off" ;
VAL_ 3221225472 ProgressiveShiftDisable 2 "Reserved" 3 "TakeNoAction" 1 "ProgressiveShiftIsDisabled" 0 "ProgressiveShiftIsNotDisabled" ;
VAL_ 3221225472 EngMomentaryOverspeedEnable 2 "Reserved" 3 "TakeNoAction" 1 "MomentaryEngOverspeedIsEnabled" 0 "MomentaryEngOverspeedIsDisabled" ;
VAL_ 3221225472 TransShiftInProcess 3 "NotAvailable" 2 "Error" 1 "ShiftInProcess" 0 "ShiftIsNotInProcess" ;
VAL_ 3221225472 TorqueConverterLockupEngaged 3 "NotAvailable" 2 "Error" 1 "TorqueConverterLockupEngaged" 0 "TorqueConverterLockupDisengaged" ;
VAL_ 3221225472 TransDrivelineEngaged 3 "NotAvailable" 2 "Error" 1 "DrivelineEngaged" 0 "DrivelineDisengaged" ;
VAL_ 3221225472 VhclAccelerationRateLimitStatus 3 "NotAvailable" 2 "Reserved" 1 "LimitActive" 0 "LimitNotActive" ;
VAL_ 3221225472 AccelPedal2LowIdleSwitch 3 "NotAvailable" 2 "Error" 1 "AccelPedal2InLowIdleCondition" 0 "AcclPedal2NotInLowIdleCondition" ;
VAL_ 3221225472 RoadSpeedLimitStatus 3 "NotAvailable" 2 "Error" 1 "NotActive" 0 "Active" ;
VAL_ 3221225472 AccelPedalKickdownSwitch 3 "NotAvailable" 2 "Error" 1 "KickdownActive" 0 "KickdownPassive" ;
VAL_ 3221225472 AccelPedal1LowIdleSwitch 3 "NotAvailable" 2 "Error" 1 "AccelPedal1InLowIdleCondition" 0 "AcclPedal1NotInLowIdleCondition" ;
VAL_ 3221225472 EngStarterMode 15 "notAvailable" 14 "error" 12 "starterInhibitedReasonUnknown" 9 "1011Reserved" 8 "strtrInhbtdDueToStarterOvertemp" 7 "strtrInhbtdDToActiveImmobilizer" 6 "strtrInhbtdDTDrvlnEnggdOthrTrns" 5 "strtrInhbtdDTEngNtReadyForStart" 4 "strtrInhbtdDToEngAlreadyRunning" 3 "strtFnshdStrtrNtActvAftrHvngBnA" 2 "starterActiveGearEngaged" 1 "starterActiveGearNotEngaged" 0 "startNotRqed" ;
VAL_ 3221225472 EngTorqueMode 15 "Not available" 11 "Remote accelerator" 10 "Braking system" 9 "High speed governor" 8 "Torque limiting" 7 "ABS control" 6 "Transmission control" 5 "ASR control" 4 "Road speed governor" 3 "PTO governor" 2 "Cruise control" 1 "Accelerator pedal/operator selec" 0 "Low idle governor/no request (de" ;
VAL_ 3221225472 SupportTSC1CtrlPurposeGroup4Of4 1 "P25ReservedForAssignmentBySAE" ;
VAL_ 3221225472 SupportVariableRateTSC1Message 1 "MsTransRate" ;
VAL_ 3221225472 SupportTSC1CtrlPurposeGroup3Of4 1 "P17ReservedForAssignmentBySAE" ;
VAL_ 3221225472 SupportTSC1CtrlPurposeGroup2Of4 1 "P9ReservedForAssignmentBySAE" ;
VAL_ 3221225472 SupportTSC1CtrlPurposeGroup1Of4 1 "P1AccelPedal_OperatorSelection" ;
VAL_ 3221225472 EngShutdownOverrideSwitch 3 "NotAvailable" 2 "Error" 1 "On" 0 "Off" ;
VAL_ 3221225472 EngTestModeSwitch 3 "NotAvailable" 2 "Error" 1 "On" 0 "Off" ;
VAL_ 3221225472 EngIdleDecrementSwitch 3 "NotAvailable" 2 "Error" 1 "On" 0 "Off" ;
VAL_ 3221225472 EngIdleIncrementSwitch 3 "NotAvailable" 2 "Error" 1 "On" 0 "Off" ;
VAL_ 3221225472 CruiseCtrlAccelerateSwitch 3 "NotAvailable" 2 "Error" 1 "CrsCtrlActivatorInPosAccelerate" 0 "CrsCtrlActvtrNotInPosAccelerate" ;
VAL_ 3221225472 CruiseCtrlResumeSwitch 3 "NotAvailable" 2 "Error" 1 "CruiseCtrlActivatorInPosResume" 0 "CrseCtrlActivatorNotInPosResume" ;
VAL_ 3221225472 CruiseCtrlCoastSwitch 3 "NotAvailable" 2 "Error" 1 "CruiseCtrlActivatorInPosCoast" 0 "CriseCtrlActivatorNotInPosCoast" ;
VAL_ 3221225472 CruiseCtrlSetSwitch 3 "NotAvailable" 2 "Error" 1 "CruiseCtrlActivatorInPosSet" 0 "CruiseCtrlActivatorNotInPosSet" ;
VAL_ 3221225472 ClutchSwitch 3 "NotAvailable" 2 "Error" 1 "ClutchPedalDepressed" 0 "ClutchPedalReleased" ;
VAL_ 3221225472 BrakeSwitch 3 "NotAvailable" 2 "Error" 1 "BrakePedalDepressed" 0 "BrakePedalReleased" ;
VAL_ 3221225472 CruiseCtrlEnableSwitch 3 "NotAvailable" 2 "Error" 1 "CruiseCtrlEnabled" 0 "CruiseCtrlDisabled" ;
VAL_ 3221225472 CruiseCtrlActive 3 "NotAvailable" 2 "Error" 1 "CruiseCtrlSwitchedOn" 0 "CruiseCtrlSwitchedOff" ;
VAL_ 3221225472 CruiseCtrlPauseSwitch 3 "TakeNoAction" 2 "ErrorIndicator" 1 "On" 0 "Off" ;
VAL_ 3221225472 ParkingBrakeSwitch 3 "NotAvailable" 2 "Error" 1 "ParkingBrakeSet" 0 "ParkingBrakeNotSet" ;
VAL_ 3221225472 TwoSpeedAxleSwitch 3 "NotAvailable" 2 "Error" 1 "HighSpeedRange" 0 "LowSpeedRange" ;
VAL_ 3221225472 TrnsShftSlctorDisplayModeSwitch 3 "NotAvailable" 2 "Error" 1 "On" 0 "Off" ;
VAL_ 3221225472 TransMode4 3 "TakeNoAction" 2 "Reserved" 1 "Enable" 0 "Disable" ;
VAL_ 3221225472 TransMode3 3 "TakeNoAction" 2 "Reserved" 1 "Enable" 0 "Disable" ;
VAL_ 3221225472 TransMode2 3 "TakeNoAction" 2 "Reserved" 1 "Enable" 0 "Disable" ;
VAL_ 3221225472 TransMode1 3 "TakeNoAction" 2 "Reserved" 1 "Enable" 0 "Disable" ;
VAL_ 3221225472 DisengageDiffLockRqCentralRear 2 "Reserved" 3 "TakeNoAction" 1 "DisengageDiffLock" 0 "EngageDiffLock" ;
VAL_ 3221225472 DisengageDiffLockRqCentralFront 2 "Reserved" 3 "TakeNoAction" 1 "DisengageDiffLock" 0 "EngageDiffLock" ;
VAL_ 3221225472 DisengageDiffLockRqCentral 2 "Reserved" 3 "TakeNoAction" 1 "DisengageDiffLock" 0 "EngageDiffLock" ;
VAL_ 3221225472 DisengageDiffLockRqRearAxle2 2 "Reserved" 3 "TakeNoAction" 1 "DisengageDiffLock" 0 "EngageDiffLock" ;
VAL_ 3221225472 DisengageDiffLockRqRearAxle1 2 "Reserved" 3 "TakeNoAction" 1 "DisengageDiffLock" 0 "EngageDiffLock" ;
VAL_ 3221225472 DisengageDiffLockRqFrontAxle2 2 "Reserved" 3 "TakeNoAction" 1 "DisengageDiffLock" 0 "EngageDiffLock" ;
VAL_ 3221225472 DisengageDiffLockRqFrontAxle1 2 "Reserved" 3 "TakeNoAction" 1 "DisengageDiffLock" 0 "EngageDiffLock" ;
VAL_ 3221225472 TransRqedGear 61 "Reserved" 222 "NeutralSelectorPos" 223 "ReverseSelectorPos" 224 "PsUnknownAnd_OrNoButtonsPressed" 225 "PrssOfMmntryBttnTRslctCrrentPos" 226 "BtwnRvrsAndPrkShiftSelectorPoss" 227 "BtwnNtrlAndRvrsShftSelectorPoss" 228 "BtwnDrvAndNtrlShiftSelectorPoss" 229 "BtwnD1AndDriveShiftSelectorPoss" 230 "BetweenD2AndD1ShiftSelectorPoss" 231 "BetweenD3AndD2ShiftSelectorPoss" 232 "BetweenD4AndD3ShiftSelectorPoss" 233 "BetweenD5AndD4ShiftSelectorPoss" 234 "BetweenD6AndD5ShiftSelectorPoss" 235 "BetweenD7AndD6ShiftSelectorPoss" 236 "BtwnTwoForwardShiftSelectorPoss" 237 "BtwnTwoReverseShiftSelectorPoss" 238 "BetweenTwoShiftSelectorPoss" 239 "D77thFrwrdSlctrPsRfrncdFrmDrive" 240 "D66thFrwrdSlctrPsRfrncdFrmDrive" 241 "D55thFrwrdSlctrPsRfrncdFrmDrive" 242 "D44thFrwrdSlctrPsRfrncdFrmDrive" 243 "D33rdFrwrdSlctrPsRfrncdFrmDrive" 244 "D22ndFrwrdSlctrPsRfrncdFrmDrive" 245 "D11stFrwrdSlctrPsRfrncdFrmDrive" 246 "Downshift2GearsFromCurrentPos" 247 "Downshift1GearFromCurrentPos" 248 "Upshift2GearsFromCurrentPos" 249 "Upshift1GearFromCurrentPos" 250 "ForwardLowPos" 251 "ParkPos" 252 "ForwardDrivePos" 253 "HoldCurrentGear" ;
VAL_ 3221225472 DisengageDrivelineRq 2 "Reserved" 3 "TakeNoAction" 1 "DisengageDriveline" 0 "AllowDrivelineEngagement" ;
VAL_ 3221225472 TorqueConverterLockupDisableRq 2 "Reserved" 3 "TakeNoAction" 1 "DisableTorqueConvertorLockup" 0 "AllowTorqueConvertorLockup" ;
VAL_ 3221225472 TransGearShiftInhibitRq 2 "Reserved" 3 "TakeNoAction" 1 "GearShiftsAreInhibited" 0 "GearShiftsAreAllowed" ;
VAL_ 3221225472 ControlPurpose 5 "TemporaryPowerTrainControl" 4 "EngineProtection" 3 "RoadSpeedGovernor" 2 "PTOGovernor" 1 "CruiseControl" 0 "AcceleratorPedal" ;
VAL_ 3221225472 TransmissionRate 7 "UseStandardRate" 6 "25ms" 5 "50ms" 4 "100ms" 3 "250ms" 2 "500ms" 1 "750ms" 0 "1000ms" ;
VAL_ 3221225472 OverrideCtrlModePriority 3 "LowPriority" 2 "MdmPrrtyUsdFrPwrtrnCtrlOprtnsWh" 1 "HighPriority" 0 "HghstPrrtyUsdFrSttnsThtRqrImmdt" ;
VAL_ 3221225472 EngRqedSpeedCtrlConditions 2 "ThsCtrlCndtnHsBnOptmzdTMnmzRpmO" 3 "StbltyOptmzdFrDrvlnEnggdAnd_OrI" 1 "StbltyOptmzdFrDrvlnDsnggdAndNnl" 0 "ThsSpdGvrnrGnSlctnIsAdjstdTPrvd" ;
VAL_ 3221225472 EngOverrideCtrlMode 3 "Spd_TrqLmtCtrlLmtSpdAnd_OrTrqBs" 2 "TrqCtrlCntrlTrqTInclddDsrdTrqVl" 1 "SpdCtrlGvrnSpdTInclddDsrdSpdVle" 0 "OvrrdDsbldDsblAnyExstngCtrlCmdd" ;
VAL_ 3221225472 RetarderLocation 15 "NotAvailable" 14 "Other" 6 "1101NotDefined" 5 "Trailer" 4 "Driveline" 3 "TransOutput" 2 "TransInput" 1 "EngExhaustBrake" 0 "EngCompressionReleaseBrake" ;
VAL_ 3221225472 RetarderType 15 "NotAvailable" 14 "Other" 5 "1101NotDefined" 4 "Exhaust" 3 "CompressionRelease" 2 "CooledFriction" 1 "Hyd" 0 "Electric_Magnetic" ;
VAL_ 3221225472 EngCoolantLoadIncrease 3 "NotAvailable" 2 "Error" 1 "CoolantLoadIncreasePossible" 0 "NoCoolantLoadIncrease" ;
VAL_ 3221225472 RetarderEnableShiftAssistSwitch 3 "NotAvailable" 2 "Error" 1 "RetarderShiftAssistEnabled" 0 "RetarderShiftAssistDisabled" ;
VAL_ 3221225472 RetarderEnableBrakeAssistSwitch 3 "NotAvailable" 2 "Error" 1 "RetarderBrakeAssistEnabled" 0 "RetarderBrakeAssistDisabled" ;
VAL_ 3221225472 SteerWheelAngleSensorType 3 "NotAvailable" 2 "Reserved" 1 "AbsMeasuringPrinciple" 0 "RelativeMeasuringPrinciple" ;
VAL_ 3221225472 YCBrakeCtrlActive 3 "DontCare_TakeNoAction" 2 "Reserved" 1 "YCBrakeCtrlActive" 0 "YCBrakeCtrlPassiveButInstalled" ;
VAL_ 3221225472 YCEngCtrlActive 3 "DontCare_TakeNoAction" 2 "Reserved" 1 "YCEngCtrlActive" 0 "YCEngCtrlPassiveButInstalled" ;
VAL_ 3221225472 ROPBrakeCtrlActive 3 "DontCare_TakeNoAction" 2 "Reserved" 1 "ROPBrakeCtrlActive" 0 "ROPBrakeCtrlPassiveButInstalled" ;
VAL_ 3221225472 ROPEngCtrlActive 3 "DontCare_TakeNoAction" 2 "Reserved" 1 "ROPEngCtrlActive" 0 "ROPEngCtrlPassiveButInstalled" ;
VAL_ 3221225472 VDCBrakeLightRq 3 "DontCare_TakeNoAction" 2 "Reserved" 1 "TurnBrakeLightOn" 0 "TurnBrakeLightNotOn" ;
VAL_ 3221225472 VDCFullyOperational 3 "DontCare_TakeNoAction" 2 "Reserved" 1 "FullyOperational" 0 "NotFullyOperational" ;
VAL_ 3221225472 VDCInformationSignal 3 "DontCare_TakeNoAction" 2 "Reserved" 1 "On" 0 "Off" ;
VAL_ 3221225472 TireLocation 33 "Axle2_Position1" 32 "Axle2_Position0" 17 "Axle1_Position1" 16 "Axle1_Position0" 1 "Axle0_Position1" 0 "Axle0_Position0" ;
VAL_ 3221225472 TirePressThresholdDetection_21 7 "NotAvailable" 6 "ErrorIndicator" 5 "NotDefined" 4 "ExtrmUndrPrssTrPrssrIsAtALvlWhr" 3 "UndrPrssTrPrssrIsLwrThnThPrssrD" 2 "NWrnngPrssTrPrssrIsWthnThThrshl" 1 "OvrPrssTrPrssrIsHghrThnThPrssrD" 0 "ExtrmOvrPrssTrPrssrIsAtALvlWhrT" ;
VAL_ 3221225472 TirePressThresholdDetection_20 7 "NotAvailable" 6 "ErrorIndicator" 5 "NotDefined" 4 "ExtrmUndrPrssTrPrssrIsAtALvlWhr" 3 "UndrPrssTrPrssrIsLwrThnThPrssrD" 2 "NWrnngPrssTrPrssrIsWthnThThrshl" 1 "OvrPrssTrPrssrIsHghrThnThPrssrD" 0 "ExtrmOvrPrssTrPrssrIsAtALvlWhrT" ;
VAL_ 3221225472 TirePressThresholdDetection_11 7 "NotAvailable" 6 "ErrorIndicator" 5 "NotDefined" 4 "ExtrmUndrPrssTrPrssrIsAtALvlWhr" 3 "UndrPrssTrPrssrIsLwrThnThPrssrD" 2 "NWrnngPrssTrPrssrIsWthnThThrshl" 1 "OvrPrssTrPrssrIsHghrThnThPrssrD" 0 "ExtrmOvrPrssTrPrssrIsAtALvlWhrT" ;
VAL_ 3221225472 TirePressThresholdDetection_10 7 "NotAvailable" 6 "ErrorIndicator" 5 "NotDefined" 4 "ExtrmUndrPrssTrPrssrIsAtALvlWhr" 3 "UndrPrssTrPrssrIsLwrThnThPrssrD" 2 "NWrnngPrssTrPrssrIsWthnThThrshl" 1 "OvrPrssTrPrssrIsHghrThnThPrssrD" 0 "ExtrmOvrPrssTrPrssrIsAtALvlWhrT" ;
VAL_ 3221225472 TirePressThresholdDetection_01 7 "NotAvailable" 6 "ErrorIndicator" 5 "NotDefined" 4 "ExtrmUndrPrssTrPrssrIsAtALvlWhr" 3 "UndrPrssTrPrssrIsLwrThnThPrssrD" 2 "NWrnngPrssTrPrssrIsWthnThThrshl" 1 "OvrPrssTrPrssrIsHghrThnThPrssrD" 0 "ExtrmOvrPrssTrPrssrIsAtALvlWhrT" ;
VAL_ 3221225472 TirePressThresholdDetection_00 7 "NotAvailable" 6 "ErrorIndicator" 5 "NotDefined" 4 "ExtrmUndrPrssTrPrssrIsAtALvlWhr" 3 "UndrPrssTrPrssrIsLwrThnThPrssrD" 2 "NWrnngPrssTrPrssrIsWthnThThrshl" 1 "OvrPrssTrPrssrIsHghrThnThPrssrD" 0 "ExtrmOvrPrssTrPrssrIsAtALvlWhrT" ;
VAL_ 3221225472 CTIWheelSensorStatus_21 3 "NotSupported" 2 "NotDefined" 1 "On" 0 "Off_IsolatedFromCTIPressCtrl" ;
VAL_ 3221225472 CTIWheelSensorStatus_20 3 "NotSupported" 2 "NotDefined" 1 "On" 0 "Off_IsolatedFromCTIPressCtrl" ;
VAL_ 3221225472 CTIWheelSensorStatus_11 3 "NotSupported" 2 "NotDefined" 1 "On" 0 "Off_IsolatedFromCTIPressCtrl" ;
VAL_ 3221225472 CTIWheelSensorStatus_10 3 "NotSupported" 2 "NotDefined" 1 "On" 0 "Off_IsolatedFromCTIPressCtrl" ;
VAL_ 3221225472 CTIWheelSensorStatus_01 3 "NotSupported" 2 "NotDefined" 1 "On" 0 "Off_IsolatedFromCTIPressCtrl" ;
VAL_ 3221225472 CTIWheelSensorStatus_00 3 "NotSupported" 2 "NotDefined" 1 "On" 0 "Off_IsolatedFromCTIPressCtrl" ;
VAL_ 3221225472 CTIWheelEndElectricalFault_21 3 "NotSupported" 2 "Error" 1 "NotDefined" 0 "Ok" ;
VAL_ 3221225472 CTIWheelEndElectricalFault_20 3 "NotSupported" 2 "Error" 1 "NotDefined" 0 "Ok" ;
VAL_ 3221225472 CTIWheelEndElectricalFault_11 3 "NotSupported" 2 "Error" 1 "NotDefined" 0 "Ok" ;
VAL_ 3221225472 CTIWheelEndElectricalFault_10 3 "NotSupported" 2 "Error" 1 "NotDefined" 0 "Ok" ;
VAL_ 3221225472 CTIWheelEndElectricalFault_01 3 "NotSupported" 2 "Error" 1 "NotDefined" 0 "Ok" ;
VAL_ 3221225472 CTIWheelEndElectricalFault_00 3 "NotSupported" 2 "Error" 1 "NotDefined" 0 "Ok" ;
VAL_ 3221225472 CTITireStatus_21 3 "NotSupported" 2 "Error" 1 "TireLeakDetected" 0 "Ok" ;
VAL_ 3221225472 CTITireStatus_20 3 "NotSupported" 2 "Error" 1 "TireLeakDetected" 0 "Ok" ;
VAL_ 3221225472 CTITireStatus_11 3 "NotSupported" 2 "Error" 1 "TireLeakDetected" 0 "Ok" ;
VAL_ 3221225472 CTITireStatus_10 3 "NotSupported" 2 "Error" 1 "TireLeakDetected" 0 "Ok" ;
VAL_ 3221225472 CTITireStatus_01 3 "NotSupported" 2 "Error" 1 "TireLeakDetected" 0 "Ok" ;
VAL_ 3221225472 CTITireStatus_00 3 "NotSupported" 2 "Error" 1 "TireLeakDetected" 0 "Ok" ;
VAL_ 3221225472 DirectionIndicator 3 "NotAvailable" 2 "Error" 1 "Reverse" 0 "Forward" ;
VAL_ 3221225472 TachographPerformance 3 "NotAvailable" 2 "Error" 1 "PerformanceAnalysis" 0 "NormalPerformance" ;
VAL_ 3221225472 HandlingInformation 3 "NotAvailable" 2 "Error" 1 "HandlingInformation" 0 "NoHandlingInformation" ;
VAL_ 3221225472 SystemEvent 3 "NotAvailable" 2 "Error" 1 "TachographEvent" 0 "NoTachographEvent" ;
VAL_ 3221225472 DriverCardDriver2 3 "NotAvailable" 2 "Error" 1 "DriverCardPresent" 0 "DriverCardNotPresent" ;
VAL_ 3221225472 Driver2TimeRelatedStates 15 "NotAvailable" 14 "Error" 13 "Other" 7 "1100Reserved" 6 "Limit616HReached" 5 "Limit515MinBefore16H" 4 "Limit49HReached" 3 "Limit315MinBefore9H" 2 "Limit24HReached" 1 "Limit115MinBefore4H" 0 "Normal_NoLimitsReached" ;
VAL_ 3221225472 Overspeed 3 "NotAvailable" 2 "Error" 1 "Overspeed" 0 "NoOverspeed" ;
VAL_ 3221225472 DriverCardDriver1 3 "NotAvailable" 2 "Error" 1 "DriverCardPresent" 0 "DriverCardNotPresent" ;
VAL_ 3221225472 Driver1TimeRelatedStates 15 "NotAvailable" 14 "Error" 13 "Other" 7 "1100Reserved" 6 "Limit616HReached" 5 "Limit515MinBefore16H" 4 "Limit49HReached" 3 "Limit315MinBefore9H" 2 "Limit24HReached" 1 "Limit115MinBefore4H" 0 "Normal_NoLimitsReached" ;
VAL_ 3221225472 DriveRecognize 3 "NotAvailable" 2 "Error" 1 "VehicleMotionDetected" 0 "VehicleMotionNotDetected" ;
VAL_ 3221225472 Driver2WorkingState 7 "NotAvailable" 6 "Error" 4 "101Reserved" 3 "DriveBehindWheel" 2 "WrkLdngUnldingWorkingInAnOffice" 1 "DriverAvailableShortBreak" 0 "RestSleeping" ;
VAL_ 3221225472 Driver1WorkingState 7 "NotAvailable" 6 "Error" 4 "101Reserved" 3 "DriveBehindWheel" 2 "WrkLdngUnldingWorkingInAnOffice" 1 "DriverAvailableShortBreak" 0 "RestSleeping" ;
VAL_ 3221225472 EngOverspeedTest 3 "NotAvailable" 2 "Reserved" 1 "EngOverspeedTestActive" 0 "EngOverspeedTestNotActive" ;
VAL_ 3221225472 EngAirShutoffCmdStatus 0 "ArShtffDsbldNtAttmptngTShtffEng" 3 "NotAvailable" 2 "Reserved" 1 "ArShtffEnbldAttmptngTShtffEngAr" ;
VAL_ 3221225472 EngAlarmOutputCmdStatus 3 "NotAvailable" 2 "Reserved" 1 "EngAlarmOutputCmdActive" 0 "EngAlarmOutputCmdNotActive" ;
VAL_ 3221225472 EngAlarmAcknowledge 3 "NotAvailable" 2 "Error" 1 "EngAlarmAcknowledgeActive" 0 "EngAlarmAcknowledgeNotActive" ;
VAL_ 3221225472 EngProtectionSystemConfig 3 "NotAvailable" 2 "Error" 1 "EnabledInCalib" 0 "DisabledInCalib" ;
VAL_ 3221225472 EngProtectionSystemTimerState 3 "NotAvailable" 2 "Error" 1 "Active" 0 "Inactive" ;
VAL_ 3221225472 EngPrtectionSystemTimerOverride 3 "NotAvailable" 2 "Error" 1 "Active" 0 "Inactive" ;
VAL_ 3221225472 EngPrtctnSystmApprchingShutdown 3 "NotAvailable" 2 "Error" 1 "Approaching" 0 "NotApproaching" ;
VAL_ 3221225472 EngPrtctionSystemHasShutdownEng 0 "No" ;
VAL_ 3221225472 EngWaitToStartLamp 3 "NotAvailable" 2 "Error" 1 "On" 0 "Off" ;
VAL_ 3221225472 RefrigerantHighPressSwitch 3 "NotAvailable" 2 "Error" 1 "PrssTHghCmprssrCltchMyBDsngaged" 0 "PressNormal" ;
VAL_ 3221225472 RefrigerantLowPressSwitch 3 "NotAvailable" 2 "Error" 1 "PrssTLwCmprssrCltchMyBDsengaged" 0 "PressNormal" ;
VAL_ 3221225472 A_CHighPressFanSwitch 3 "NotAvailable" 2 "Error" 1 "PressHighFanMayBeEngaged" 0 "PressNormal" ;
VAL_ 3221225472 EngIdleShutdownTimerFunction 3 "NotAvailable" 2 "Error" 1 "EnabledInCalib" 0 "DisabledInCalib" ;
VAL_ 3221225472 EngIdleShutdownTimerState 3 "NotAvailable" 2 "Error" 1 "Active" 0 "Inactive" ;
VAL_ 3221225472 EngIdleShutdownTimerOverride 3 "NotAvailable" 2 "Error" 1 "Active" 0 "Inactive" ;
VAL_ 3221225472 EngIdleShutdownDriverAlertMode 3 "NotAvailable" 2 "Error" 1 "Active" 0 "Inactive" ;
VAL_ 3221225472 EngIdleShutdownHasShutdownEng 1 "Yes" 0 "No" ;
VAL_ 3221225472 EngBuildHoursReset 2 "Reserved" 3 "TakeNoAction" 1 "Reset" 0 "DoNotReset" ;
VAL_ 3221225472 TripGroup2Proprietary 2 "Reserved" 3 "NotApplicable" 1 "Reset" 0 "TakeNoAction" ;
VAL_ 3221225472 TripGroup1 2 "Reserved" 3 "NotApplicable" 1 "Reset" 0 "TakeNoAction" ;
VAL_ 3221225472 OperatorPTOMemorySelectSwitch 3 "notAvailable" 2 "error" 1 "PTOSetSpeedMemory2Selected" 0 "PTOSetSpeedMemory1Selected" ;
VAL_ 3221225472 EngPTOAccelerateSwitch 3 "NotAvailable" 2 "Error" 1 "On" 0 "Off" ;
VAL_ 3221225472 EngPTOResumeSwitch 3 "NotAvailable" 2 "Error" 1 "On" 0 "Off" ;
VAL_ 3221225472 EngPTOCoast_DecelerateSwitch 3 "NotAvailable" 2 "Error" 1 "On" 0 "Off" ;
VAL_ 3221225472 EngPTOSetSwitch 3 "NotAvailable" 2 "Error" 1 "On" 0 "Off" ;
VAL_ 3221225472 EngRmtPTOVriableSpeedCtrlSwitch 3 "NotAvailable" 2 "Error" 1 "On" 0 "Off" ;
VAL_ 3221225472 EngRmtPTOPrprgrmmdSpdCtrlSwitch 3 "NotAvailable" 2 "Error" 1 "On" 0 "Off" ;
VAL_ 3221225472 EngPTOEnableSwitch 3 "NotAvailable" 2 "Error" 1 "On" 0 "Off" ;
VAL_ 3221225472 RmtPTOPrprgrmmdSpeedCtrlSwitch2 3 "NotAvailable" 2 "Error" 1 "On" 0 "Off" ;
VAL_ 3221225472 AuxInputIgnoreSwitch 3 "NotAvailable" 2 "Error" 1 "On" 0 "Off" ;
VAL_ 3221225472 FanDriveState 15 "NotAvailable" 14 "Other" 13 "EngBrake" 12 "Timer" 11 "A_CSystem" 10 "TransRetarder" 9 "ManualCtrl" 8 "NotDefined" 7 "DefaultOperation" 6 "ExcessiveHydOilTemp" 5 "ExcessiveTransOilTemp" 4 "ExcessiveEngCoolantTemp" 3 "ExcessiveEngOilTemp" 2 "ExcessiveEngAirTemp" 1 "EngSystemGeneral" 0 "FanOff" ;
VAL_ 3221225472 TransMode1Indicator 3 "NotAvailable" 2 "Error" 1 "TransMode1Active" 0 "TransMode1NotActive" ;
VAL_ 3221225472 TransMode2Indicator 3 "NotAvailable" 2 "Error" 1 "TransMode2Active" 0 "TransMode2NotActive" ;
VAL_ 3221225472 TransMode3Indicator 3 "NotAvailable" 2 "Error" 1 "TransMode3Active" 0 "TransMode3NotActive" ;
VAL_ 3221225472 TransMode4Indicator 3 "NotAvailable" 2 "Error" 1 "TransMode4Active" 0 "TransMode4NotActive" ;
VAL_ 3221225472 TransShiftInhibitIndicator 3 "TakeNoAction" 2 "Reserved" 1 "ActiveShiftIsInhibited" 0 "InactiveShiftIsNotInhibited" ;
VAL_ 3221225472 TransEngCrankEnable 3 "NotAvailable" 2 "Error" 1 "CrnkngEnbldEngCrnkngIsAllwdByTr" 0 "CrnkngDsbldEngCrnkngIsPrhbtdByT" ;
VAL_ 3221225472 ActiveShiftConsoleIndicator 3 "NotAvailable" 2 "Reserved" 1 "SecondShiftConsoleIsActive" 0 "PrimaryShiftConsoleIsActive" ;
VAL_ 3221225472 TransReadyForBrakeRelease 3 "DontCare" 2 "Reserved" 1 "TransReadyForBrakeRelease" 0 "TransNotReadyForBrakeRelease" ;
VAL_ 3221225472 TransRqedRangeDisplayFlashState 3 "TakeNoAction" 2 "Reserved" 1 "ActvTrnsRqdRngDsplyShldBFlshing" 0 "InctvTrnsRqdRngDsplyShldNtBFlsh" ;
VAL_ 3221225472 TransRqedRangeDisplayBlankState 3 "TakeNoAction" 2 "Reserved" 1 "ActvTrnsRqdRngDsplyShldBBlanked" 0 "InctvTrnsRqdRngDsplyShldNtBBlnk" ;
VAL_ 3221225472 EngExhstGsOxygnSnsrClsdLpOprton 3 "DontCare_TakeNoAction" 2 "Reserved" 1 "CmdToEnableFunction" 0 "CmdToDisableFunction" ;
VAL_ 3221225472 XBRActiveCtrlMode 15 "NotAvailable" 4 "1110ReservedForSAEAssignment" 3 "MxMdOfXBRAcclrtnCtrlBngExecuted" 2 "AddtnMdOfXBRAcclrtnCtrlBngExctd" 1 "DrvrsBrkDmndBngExctdNExtlBrkDmn" 0 "NoBrakeDemandBeingExecuted" ;
VAL_ 3221225472 XBRSystemState 3 "NotAvailable" 2 "NoExtlBrakeDemandWillBeAccepted" 1 "OnlyExtlBrkDmndOfHghstXBRPrrtyW" 0 "AnyExtlBrkeDemandWillBeAccepted" ;
VAL_ 3221225472 FoundationBrakeUse 3 "NotAvailable" 2 "Reserved" 1 "FoundationBrakesInUse" 0 "FoundationBrakesNotInUse" ;
VAL_ 3221225472 HillHolderMode 7 "NotAvailable" 6 "Reserved" 3 "101NotDefined" 2 "ActvBtWllChngTInctvInAShortTime" 1 "Active" 0 "Inactive" ;
VAL_ 3221225472 HaltBrakeMode 7 "NotAvailable" 6 "Reserved" 3 "101NotDefined" 2 "ActiveButNotFunctioningProperly" 1 "Active" 0 "Inactive" ;
VAL_ 3221225472 TrctrMntdTrilerABSWarningSignal 3 "TakeNoAction" 2 "Reserved" 1 "On" 0 "Off" ;
VAL_ 3221225472 TrailerABSStatus 3 "TrlrABSSttsInfrmtnNtAvlblPrmtrN" 2 "Reserved" 1 "TrailerABSActive" 0 "TrlrABSSttsInfrmtnAvlblBtNtActv" ;
VAL_ 3221225472 HaltBrakeSwitch 3 "NotAvailable" 2 "Error" 1 "HaltBrakeSwitchActive" 0 "HaltBrakeSwitchPassive" ;
VAL_ 3221225472 ATC_ASRInformationSignal 3 "TakeNoAction" 2 "Reserved" 1 "On" 0 "Off" ;
VAL_ 3221225472 ABS_EBSAmberWarningSignal 3 "TakeNoAction" 2 "Reserved" 1 "On" 0 "Off" ;
VAL_ 3221225472 EBSRedWarningSignal 3 "TakeNoAction" 2 "Reserved" 1 "On" 0 "Off" ;
VAL_ 3221225472 ABSFullyOperational 3 "NotAvailable" 2 "Reserved" 1 "FullyOperational" 0 "NotFullyOperational" ;
VAL_ 3221225472 RemoteAccelEnableSwitch 3 "NotAvailable" 2 "Error" 1 "On" 0 "Off" ;
VAL_ 3221225472 EngAuxEngShutdownSwitch 3 "NotAvailable" 2 "Error" 1 "On" 0 "Off" ;
VAL_ 3221225472 EngDerateSwitch 3 "NotAvailable" 2 "Error" 1 "On" 0 "Off" ;
VAL_ 3221225472 AccelInterlockSwitch 3 "NotAvailable" 2 "Error" 1 "On" 0 "Off" ;
VAL_ 3221225472 TractionCtrlOverrideSwitch 3 "NotAvailableNotInstalled" 2 "Error" 1 "On" 0 "Off" ;
VAL_ 3221225472 ASRHillHolderSwitch 3 "NotAvailable" 2 "Error" 1 "ASRHillHolderSwitchActive" 0 "ASRHillHolderSwitchPassive" ;
VAL_ 3221225472 ASROffroadSwitch 2 "Error" 1 "ASROffroadSwitchActive" 0 "ASROffroadSwitchPassive" 3 "NotAvailable" ;
VAL_ 3221225472 ABSOffroadSwitch 3 "NotAvailable" 2 "Error" 1 "ABSOffroadSwitchActive" 0 "ABSOffroadSwitchPassive" ;
VAL_ 3221225472 EBSBrakeSwitch 3 "NotAvailable" 2 "Error" 1 "BrakePedalIsBeingPressed" 0 "BrakePedalIsNotBeingPressed" ;
VAL_ 3221225472 AntiLockBrakingActive 3 "NotAvailable" 2 "Reserved" 1 "ABSActive" 0 "ABSPassiveButInstalled" ;
VAL_ 3221225472 ASRBrakeCtrlActive 3 "NotAvailable" 2 "Reserved" 1 "ASRBrakeCtrlActive" 0 "ASRBrakeCtrlPassiveButInstalled" ;
VAL_ 3221225472 ASREngCtrlActive 3 "NotAvailable" 2 "Reserved" 1 "ASREngCtrlActive" 0 "ASREngCtrlPassiveButInstalled" ;
VAL_ 3221225472 RqCabZoneHeating 3 "DontCare_TakeNoAction" 2 "Reserved" 1 "HeatCabZone" 0 "DoNotCabEngZone" ;
VAL_ 3221225472 RqEngZoneHeating 3 "DontCare_TakeNoAction" 2 "Reserved" 1 "HeatEngZone" 0 "DoNotHeatEngZone" ;
VAL_ 3221225472 AuxHeaterModeRq 15 "DontCare_TakeNoAction" 14 "Reserved" 4 "1101NotDefined" 3 "NormalMode" 2 "EconomyMode" 1 "OffDTADRPrErpnRgltnsFrTrnsprtOf" 0 "DeactivateAuxHeater" ;
VAL_ 3221225472 SeatBeltSwitch 3 "NotAvailable" 2 "ErrrSwtchStteCannotBeDetermined" 1 "OKSeatBeltIsBuckled" 0 "NOTBuckled" ;
VAL_ 3221225472 OperatorSeatDirectionSwitch 3 "NotAvailable" 2 "Error" 1 "OperatorSeatIsFacingForward" 0 "OperatorSeatNotFacingForward" ;
VAL_ 3221225472 BatteryMainSwitchHoldRq 3 "DontCare_TakeNoAction" 2 "undefined" 1 "HoldBatteryMainSwitch" 0 "ReleaseBatteryMainSwitch" ;
VAL_ 3221225472 AuxHeaterCoolantPumpRq 3 "DontCare_TakeNoAction" 2 "Reserved" 1 "ActivateWaterPump" 0 "DeactivateWaterPump" ;
